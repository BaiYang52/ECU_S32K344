# S32K324_M7 register map
Vendor: NXP Semiconductors; File version: 1.1
S32K324_M7 NXP Microcontroller
CPU: CM7 r0p1, little endian, MPU, FPU, VTOR, 4 interrupt priority bits
Registers are 32-bit, read-write, reset 0x0 unless marked. A register's access mark holds for its fields unless they carry their own. Offsets are from the block's base; lines under a group give offsets from that group; [hi:lo] are bit positions; {n}, {i} and the like mark numbered series; 'fields as' and 'values as' point back to an identical list; <NAME> marks a mode.

## Memory map
0x40080000 TRGMUX size 0xA0
0x40084000 BCTU size 0x474
0x40088000 EMIOS_0 size 0x31C — eMIOS
0x4008C000 EMIOS_1 size 0x31C — eMIOS
0x40090000 EMIOS_2 size 0x31C — eMIOS
0x40098000 LCU_0 size 0x2AC — LCU
0x4009C000 LCU_1 size 0x2AC — LCU
0x400A0000 ADC_0 size 0x3B8 — ADC
0x400A4000 ADC_1 size 0x3B8 — ADC
0x400A8000 ADC_2 size 0x3B8 — ADC
0x400B0000 PIT_0 size 0x140 — PIT
0x400B4000 PIT_1 size 0x140 — PIT
0x400B8000 MU_2__MUA size 0x290 — MUA
0x400BC000 MU_2__MUB size 0x290 — MUB
0x40200000 AXBS_LITE size 0x614 — AXBS
0x40204000 XBIC_AXBS size 0x10 — XBIC
0x40208000 XBIC_AXBS_PERI size 0x10 — XBIC
0x4020C000 EDMA size 0x180 — DMA MP
0x40210000 TCD size 0x24C040 — DMA TCD
0x40250600 MDM_AP size 0x100
0x40254700 SDA_AP size 0x100
0x40258000 EIM size 0x888
0x4025C000 ERM size 0x23C
0x40260000 MSCM size 0xA60
0x40264000 PRAMC_0 size 0x4 — PRAMC
0x40268000 PFLASH size 0x4C0
0x40270000 SWT_0 size 0x20 — SWT
0x40274000 STM_0 size 0x4C — STM
0x40278000 XRDC size 0x2470
0x4027C000 INTM size 0x48
0x40280000 DMAMUX_0 size 0x10 — DMAMUX
0x40284000 DMAMUX_1 size 0x10 — DMAMUX
0x40288000 RTC size 0x18
0x4028C000 MC_RGM size 0x30
0x40290000 SIUL2 size 0x17B8
0x402A8000 VIRT_WRAPPER size 0x108 — VIRT_WRAPPER memory map
0x402AC000 DCM size 0x4000
0x402AC000 DCM_GPR size 0x4000
0x402B4000 WKPU size 0x74
0x402BC000 CMU_0 size 0x18 — CMU_FC
0x402BC020 CMU_1 size 0x10 — CMU_FM
0x402BC040 CMU_2 size 0x10 — CMU_FM
0x402BC060 CMU_3 size 0x18 — CMU_FC
0x402BC080 CMU_4 size 0x18 — CMU_FC
0x402BC0A0 CMU_5 size 0x18 — CMU_FC
0x402C4000 TSPC size 0xA8
0x402C8000 SIRC size 0x10
0x402CC000 SXOSC size 0x8
0x402D0000 FIRC size 0xC
0x402D4000 FXOSC size 0x8
0x402D8000 MC_CGM size 0x600
0x402DC000 MC_ME size 0x538
0x402E0000 PLL size 0x88 — PLLDIG
0x402E8000 PMC size 0x10
0x402EC000 FLASH size 0x180 — c40asf flash memory
0x402FC000 PIT_2 size 0x140 — PIT
0x40304000 CAN_0 size 0x3200 — CAN
0x40308000 CAN_1 size 0xD30 — CAN
0x4030C000 CAN_2 size 0xD30 — CAN
0x40310000 CAN_3 size 0xCB0 — CAN
0x40314000 CAN_4 size 0xCB0 — CAN
0x40318000 CAN_5 size 0xCB0 — CAN
0x40324000 FLEXIO size 0x920
{0x40328000+0x4000*n} LPUART_{n} size 0x34 (n=0..7) — LPUART
0x40350000 LPI2C_0 size 0x174 — LPI2C
0x40354000 LPI2C_1 size 0x174 — LPI2C
0x40358000 LPSPI_0 size 0x800 — LPSPI
0x4035C000 LPSPI_1 size 0x800 — LPSPI
0x40360000 LPSPI_2 size 0x800 — LPSPI
0x40364000 LPSPI_3 size 0x800 — LPSPI
0x4036C000 SAI_0 size 0xE4 — SAI
0x40370000 LPCMP_0 size 0x34 — LPCMP
0x40374000 LPCMP_1 size 0x34 — LPCMP
0x4037C000 TEMPSENSE size 0xFFFF
0x40380000 CRC size 0xC
0x40384000 FCCU size 0x13C
0x4038C000 MU_0__MUB size 0x290 — MUB
0x40394000 JDC size 0x10
0x4039C000 CONFIGURATION_GPR size 0x68
0x403A0000 STCU size 0x2244 — STCU2
0x403B0000 SELFTEST_GPR size 0x18
0x40400000 XBIC_AXBS_TCM size 0x10 — XBIC
0x40404000 XBIC_AXBS_EDMA size 0x10 — XBIC
0x40460000 SEMA42 size 0x44
0x40464000 PRAMC_1 size 0x4 — PRAMC
0x4046C000 SWT_1 size 0x20 — SWT
0x40474000 STM_1 size 0x4C — STM
0x40480000 EMAC size 0x11F0
{0x4046C000+0x4000*n} LPUART_{n} size 0x34 (n=8..15) — LPUART
0x404BC000 LPSPI_4 size 0x800 — LPSPI
0x404C0000 LPSPI_5 size 0x800 — LPSPI
0x404CC000 QUADSPI size 0x360
0x404DC000 SAI_1 size 0xE4 — SAI
0x404E8000 LPCMP_2 size 0x34 — LPCMP
0x404EC000 MU_1__MUB size 0x290 — MUB
0x68000000 QUADSPI_ARDB size 0x200 — ARDB
0xE0080000 MCM_0_CM7 size 0x414 — MCM
0xE0080000 MCM_1_CM7 size 0x414 — MCM

## Interrupts
{n+4} DMATCD{n} (TCD) (n=0..31)
36 ERM_0 (ERM)
37 ERM_1 (ERM)
39 STM0 (STM_0)
40 STM1 (STM_1)
42 SWT0 (SWT_0)
43 SWT1 (SWT_1)
48 FLASH_0 (FLASH)
49 FLASH_1 (FLASH)
50 FLASH_2 (FLASH)
51 RGM (MC_RGM)
52 PMC
53 SIUL_0 (SIUL2)
54 SIUL_1 (SIUL2)
55 SIUL_2 (SIUL2)
56 SIUL_3 (SIUL2)
83 WKPU
84 CMU0 (CMU_0)
85 CMU1 (CMU_1)
86 CMU2 (CMU_2)
87 BCTU
92 LCU0 (LCU_0)
93 LCU1 (LCU_1)
96 PIT0 (PIT_0)
97 PIT1 (PIT_1)
98 PIT2 (PIT_2)
102 RTC
105 EMAC_0 (EMAC)
106 EMAC_1 (EMAC)
107 EMAC_2 (EMAC)
108 EMAC_3 (EMAC)
109 FlexCAN0_0 (CAN_0)
110 FlexCAN0_1 (CAN_0)
111 FlexCAN0_2 (CAN_0)
112 FlexCAN0_3 (CAN_0)
113 FlexCAN1_0 (CAN_1)
114 FlexCAN1_1 (CAN_1)
115 FlexCAN1_2 (CAN_1)
116 FlexCAN2_0 (CAN_2)
117 FlexCAN2_1 (CAN_2)
118 FlexCAN2_2 (CAN_2)
119 FlexCAN3_0 (CAN_3)
120 FlexCAN3_1 (CAN_3)
121 FlexCAN4_0 (CAN_4)
122 FlexCAN4_1 (CAN_4)
123 FlexCAN5_0 (CAN_5)
124 FlexCAN5_1 (CAN_5)
{n+141} LPUART{n} (LPUART_{n}) (n=0..15)
161 LPI2C0 (LPI2C_0)
162 LPI2C1 (LPI2C_1)
165 LPSPI0 (LPSPI_0)
166 LPSPI1 (LPSPI_1)
167 LPSPI2 (LPSPI_2)
168 LPSPI3 (LPSPI_3)
169 LPSPI4 (LPSPI_4)
170 LPSPI5 (LPSPI_5)
174 SAI0 (SAI_0)
175 SAI1 (SAI_1)
178 JDC
180 ADC0 (ADC_0)
181 ADC1 (ADC_1)
182 ADC2 (ADC_2)
183 LPCMP0 (LPCMP_0)
184 LPCMP1 (LPCMP_1)
185 LPCMP2 (LPCMP_2)
189 FCCU_0 (FCCU)
190 FCCU_1 (FCCU)
191 STCU_LBIST_MBIST (STCU)
212 SoC_PLL (PLL)

## Licence text in the file
Copyright 2016-2021 NXP NXP Confidential. This software is owned or controlled by NXP and may only be used strictly in accordance with the applicable license terms. By expressly accepting such terms or by downloading, installing, activating and/or otherwise using the software, you are agreeing that you have read, and that you agree to comply with and are bound by, such license terms. If you do not agree to be bound by the applicable license terms, then you may not retain, install, activate or otherwise use the software. The production use license in Section 2.3 is expressly granted for this software.
