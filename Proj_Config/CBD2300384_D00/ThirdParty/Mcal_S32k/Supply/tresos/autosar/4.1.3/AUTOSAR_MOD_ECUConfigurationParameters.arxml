[part 4 of 7: package /AUTOSAR/EcucDefs]
AUTOSAR XML (schema 4-1-3)
# The material contained in this specification is protected by copyright and
# other types of Intellectual Property Rights. The commercial exploitation of
# the material contained in this specification requires a license to such
# Intellectual Property Rights.
# This specification may be utilized or reproduced without any modification, in
# any form or by any means, for informational purposes only.
# For any other purpose, no part of the specification may be utilized or
# reproduced, in any form or by any means, without permission in writing from
# the publisher.
# licensed under the same rules as applicable to the AUTOSAR Standard.
package /AUTOSAR/EcucDefs  (continued)
  module definition Dlt [0..1]: variants link-time/post-build/pre-compile
    container DltGeneral  # Flags for adding removing functionality from code.
      boolean DltDevErrorDetect: set at pre-compile  # Enables/Disables development error detection.
      boolean DltImplementAppIdContextIdQuery: set at pre-compile  # If set the functionality for Verbose Mode shall be available.
      boolean DltImplementExtendedHeader: set at pre-compile  # If set the extended functionality for the header shall be available.
      boolean DltImplementFilterMessages: set at pre-compile  # This flag is for code generation of Dlt. If set the functionality for filtering messages shall be included in the code.
      boolean DltImplementNVRamStorage: set at pre-compile  # If set the functionality for storing and loading information in and from NVRam shall be available.
      boolean DltImplementSWCInjection: set at pre-compile  # If the remote call from functions over the Dlt in SW-C shall be available.
      boolean DltImplementTimestamp: set at pre-compile  # If set the timestamp functionality for the header shall be available.
      boolean DltImplementVerboseMode: set at pre-compile  # If set the functionality for Verbose Mode shall be available.
      boolean DltImplementVfbTrace: set at pre-compile  # If set the the header files and the implementation of VFB-trace shall be generated.
      boolean DltVersionInfoApi [0..1]: set at pre-compile  # Pre-processor switch for enabling Version Info API support. | True: version information API activated False: version information API deactivated
      integer DltVfbTraceLogLevel: 0..6, set at link in variant link-time / pre-compile in variant post-build+pre-compile  # The log level of the log messages generated by the VFB-Trace. | ImplementationType: Dlt_MessageLogLevelType
      symbolic name reference DltGptChannel: set at pre-compile, destination=GptChannelConfiguration  # Reference to the hardware free running timer of the GPT module for time stamps (if no HWFRT is applied, calls to add timestamps are ignored).
    container DltMemory  # Configuration parameters for reserving memory for some internal storing and buffer.
      integer DltInitBufferSize: 0..4294967295, scope=ECU, set at link in variant link-time / pre-compile in variant post-build+pre-compile  # Buffer size for the C-init buffer. This buffer is for storing messages from other BSW modules before Dlt is initialized. | Unit: byte
      integer DltMaxCountAppIds: 1..4294967295, scope=ECU, set at link in variant link-time / pre-compile in variant post-build+pre-compile  # The maximum count of register able Application Ids. There shall be a table to manage registered Application IDs, this is the number of lines to hold in this table. | Unit: byte
      integer DltMaxCountContextIds: 1..4294967295, scope=ECU, set at link in variant link-time / pre-compile in variant post-build+pre-compile  # The maximum count of registrable Context Ids. There shall be a table to manage registered Context IDs, this is the number of lines to hold in this table. | Unit: byte
      integer DltMaxCountContextIdsPerAppId: 1..4294967295, scope=ECU, set at link in variant link-time / pre-compile in variant post-build+pre-compile  # Each Context ID belongs to a specific Application ID. Dlt shall handle the correlation between them. The table of the registered Application IDs shall hold for every Application ID several references to the proper Context IDs. This is the maximum count for Context IDs per Application ID. | Unit: byte
      integer DltMessageBufferSize: 0..4294967295, scope=ECU, set at link in variant link-time / pre-compile in variant post-build+pre-compile  # Buffer size for storing Dlt messages for waiting to transmit over the Network (send buffer). | Unit: byte
    container DltMultipleConfigurationContainer: multiple-configuration-container=true  # Container holding the sub-structure for multiple configuration support.
      symbolic name reference DltNvRamBlockRef: scope=ECU, set at post-build in variant post-build / pre-compile in variant pre-compile, destination=NvMBlockDescriptor  # Reference to the NvM Block which is used to store the Dlt parameters.
      container DltBandwidth  # Configuration parameters controlling network and diagnostic interfaces bandwidth. If DltImplementNVRamStorage is enabled this parameters are the initial values for the NVRam. If DltImplementNVRamStorage is not set, Link-Time or Post-Build configuration shall be uesd.
        integer DltBandwidthForComModule: 0..4294967295, scope=ECU, set at link in variant link-time / post-build in variant post-build / pre-compile in variant pre-compile  # For communication over the Dlt Communication Module the maximum bandwidth shall be set. | Unit: kbit per second
        integer DltBandwidthForDiagChannel: 0..4294967295, scope=ECU, set at link in variant link-time / post-build in variant post-build / pre-compile in variant pre-compile  # For communication over the DCM and as follows over the diagnostic interface the maximum bandwidth shall be set. | Unit: kbit per second
        float DltTimePeriodTrafficShaping: 0..Inf, scope=ECU, set at link in variant link-time / post-build in variant post-build / pre-compile in variant pre-compile  # For implementing a traffic shaping, a time window for measuring shall be provided. | Unit: second
      container DltMessageFiltering  # Configuration parameters for setting message filtering properties in Dlt module.
        integer DltDefaultMaxLogLevel: 0..6, scope=ECU, set at link in variant link-time / post-build in variant post-build / pre-compile in variant pre-compile  # The maximum log level a received message (from SW-C to Dlt) can have. This can also be modified at runtime and stored persistently in NVRAM. If DltImplementNVRamStorage is enabled this parameter is the initial value for the corresponding NVRam entry. If DltImplementNVRamStorage is not set, Link-Time or Post-Build configuration shall be used. The value 0 means logging is disabled. | ImplementationType: Dlt_MessageLogLevelType
        boolean DltDefaultTraceStatus: scope=ECU, set at link in variant link-time / post-build in variant post-build / pre-compile in variant pre-compile  # Tells if trace messages shall be forwarded by Dlt. This functionality can also be modified at runtime and changed can stored persistently in NVRAM. If DltImplementNVRamStorage is enabled this parameter is the initial value for the corresponding NVRam entry. If DltImplementNVRamStorage is not set, Link-Time or Post-Build configuration shall be used.
        integer DltFactoryDefaultMaxLogLevel: 0..6, scope=ECU, set at link in variant link-time / post-build in variant post-build / pre-compile in variant pre-compile  # The maximum log level a received message (from SW-C to Dlt) can have. This is for setting DltDefaultMaxLogLevel to factory defaults. The value 0 means logging is disabled. | ImplementationType: Dlt_MessageLogLevelType
        boolean DltFilterMessages: scope=ECU, set at link in variant link-time / pre-compile in variant post-build+pre-compile  # This flag gives the Dlt the instruction to filter or not to filter incoming log or trace messages. If it is not set all incoming messages are forwarded to the communication channel. So also the caller of the DltSendXXXMessage can leave the field trace_info or log_info empty. | If DltImplementNVRamStorage is enabled this parameter is the initial value for the corresponding NVRam entry. If DltImplementNVRamStorage is not set, Link-Time or Post-Build configuration shall be used.
      container DltProtocol  # Configuration parameters for handling the specific protocol variants.
        string DltEcuId: scope=ECU, set at link in variant link-time / post-build in variant post-build / pre-compile in variant pre-compile  # This is the name of the ECU for use within the Dlt protocol. The meaning is described in the document. This name is transmitted within the Dlt protocol. There this are 4 characters. If you want to use an number representation type this as character.
        enumeration DltHeaderPayloadEndianes: {BigEndian, LittleEndian}, scope=ECU, set at pre-compile  # Determines the endianess of the CPU (Most Significant Byte).
        boolean DltHeaderUseEcuId: scope=ECU, set at link in variant link-time / post-build in variant post-build / pre-compile in variant pre-compile  # Corresponds to field WEID (With ECU ID). If set ECU ID shall be placed in the header, else not. | If DltImplementNVRamStorage is enabled this parameter is the initial value for the corresponding NVRam entry. If DltImplementNVRamStorage is not set, Link-Time or Post-Build configuration shall be used.
        boolean DltHeaderUseExtendedHeader: scope=ECU, set at link in variant link-time / post-build in variant post-build / pre-compile in variant pre-compile  # Corresponds to field UEH (Use Extended Header). If set the Extended Header shall be attached, else not. | If DltImplementNVRamStorage is enabled this parameter is the initial value for the corresponding NVRam entry. If DltImplementNVRamStorage is not set, Link-Time or Post-Build configuration shall be used.
        boolean DltHeaderUseSessionID: scope=ECU, set at link in variant link-time / post-build in variant post-build / pre-compile in variant pre-compile  # Corresponds to field WSID (with Session ID). If set the Session ID shall be placed in the header, else not. | If DltImplementNVRamStorage is enabled this parameter is the initial value for the corresponding NVRam entry. If DltImplementNVRamStorage is not set, Link-Time or Post-Build configuration shall be used.
        boolean DltHeaderUseTimestamp: scope=ECU, set at link in variant link-time / post-build in variant post-build / pre-compile in variant pre-compile  # Corresponds to field WTMS (With Timestamp). If set the timestamp shall be placed in the header, else not. | If DltImplementNVRamStorage is enabled this parameter is the initial value for the corresponding NVRam entry. If DltImplementNVRamStorage is not set, Link-Time or Post-Build configuration shall be used.
        integer DltMaxMessageLength: 8..65535, scope=ECU, set at link in variant link-time / pre-compile in variant post-build+pre-compile  # The maximum length of a Dlt log or trace message.
        boolean DltUseVerboseMode: scope=ECU, set at link in variant link-time / post-build in variant post-build / pre-compile in variant pre-compile  # If this flag is set Dlt shall use the Verbose Mode for generating the header of the transport protocol. Also it shall store the information provided by registering Context ID and Application ID (description) at runtime if flag is set. If it is not set, the Non Verbose Mode shall be used. | If DltImplementNVRamStorage is enabled this parameter is the initial value for the corresponding NVRam entry. If DltImplementNVRamStorage is not set, Link-Time or Post-Build configuration shall be used.
    container DltVfbTrace [0..*]  # All functions to trace from the VFB by the Dlt.
      function name DltVfbTraceFunction: set at pre-compile  # The Dlt generator shall enable VFB tracing for a given hook function when there is a #define in the Dlt-VFB configuration header file for the hook function name and tracing is globally enabled. | Example: #define Dlt_Rte WriteHook i1 p1 a Start. Also the corresponding function shall be generated. The exact argument description for the function is to take from the provided BSWModudulDescription from the RTE module.
      foreign reference DltBswModuleEntryRef: set at pre-compile, destination-type=BSW-MODULE-ENTRY  # Foreign reference to the BSWModuleEntry describing the trace function implementation.
  module definition DoIP [0..1]: variants link-time/post-build/pre-compile  # Configuration of the DoIP (Diagnostic over IP) module.
    container DoIPConfigSet: multiple-configuration-container=true  # This container contains the configuration parameters and sub containers of the AUTOSAR DoIP module. This container is a MultipleConfigurationContainer, i.e. this container and its sub-containers exist once per configuration set.
      integer DoIPEid [0..1]: 0..281474976710655, set at link in variant link-time / post-build in variant post-build / pre-compile in variant pre-compile  # Configured EID (Entity ID of) for vehicle identification/vehicle announcement. Only necessary if DoIPUseMacAddressForIdentification is set to FALSE.
      integer DoIPGid [0..1]: 0..281474976710655, set at link in variant link-time / post-build in variant post-build / pre-compile in variant pre-compile  # Configured GID (Group ID of) for vehicle identification/vehicle announcement.
      integer DoIPLogicalAddress: 0..65535, set at link in variant link-time / post-build in variant post-build / pre-compile in variant pre-compile  # Describes the logical address of the DoIP entity, i.e. the LA that will route diagnostic requests to the Dcm of the DoIP entity.
      container DoIPChannel [1..65536]  # Configuration of one DoIPChannel.
        reference DoIPChannelSARef: destination=DoIPTester  # Reference to the DoIPTester.
        reference DoIPChannelTARef: destination=DoIPTargetAddress  # Reference to the target address.
        container DoIPPduRRxPdu  # This container contains the Rx Pdus to connect with the Rx Pdus of the PduR.
          integer DoIPPduRRxPduId: 0..65535, scope=ECU, set at link in variant link-time / post-build in variant post-build / pre-compile in variant pre-compile, symbolic-name-value=true  # The DoIPPduRRxPduId is required by the API call DoIP_CancelReceive.
          reference DoIPPduRRxPduRef: set at link in variant link-time / post-build in variant post-build / pre-compile in variant pre-compile, destination=Pdu  # Reference to the "global" Pdu structure to allow harmonization of handle IDs in the COM-Stack.
        container DoIPPduRTxPdu [0..1]  # This container contains the Tx Pdus to connect with the Tx Pdus of the PduR. If the parameter is not configured the channel is for functional addressing.
          integer DoIPPduRTxPduId: 0..65535, scope=ECU, set at link in variant link-time / post-build in variant post-build / pre-compile in variant pre-compile, symbolic-name-value=true  # The DoIPPduRTxPduId is required by DoIP_Transmit and DoIP_CancelTransmit.
          reference DoIPPduRTxPduRef: set at link in variant link-time / post-build in variant post-build / pre-compile in variant pre-compile, destination=Pdu  # Reference to the "global" Pdu structure to allow harmonization of handle IDs in the COM-Stack.
      container DoIPConnections  # Container contains all lower layer connection specific information, i.e. the single Pdu References and Handle IDs to the SoAd.
        container DoIPTargetAddress [1..255]  # This container describes a possible TargetAddress that is supported by DoIP.
          integer DoIPTargetAddressValue: 0..65535, set at link in variant link-time / post-build in variant post-build / pre-compile in variant pre-compile  # Valid Target Address of a DoIP target address.
        container DoIPTcpConnection [1..255]  # This container describes a tcp connection to the lower layer SoAd module.
          container DoIPSoAdRxPdu  # This container contains the Rx Pdus received by DoIP
            integer DoIPSoAdRxPduId: 0..65535, scope=ECU, set at link in variant link-time / post-build in variant post-build / pre-compile in variant pre-compile, symbolic-name-value=true  # The DoIPSoAdRxPduId is required by the API call DoIP_SoAdTpRxIndication to receive I-PDUs from the SoAd.
            reference DoIPSoAdRxPduRef: set at link in variant link-time / post-build in variant post-build / pre-compile in variant pre-compile, destination=Pdu  # Reference to the "global" Pdu structure to allow harmonization of handle IDs in the COM-Stack.
          container DoIPSoAdTxPdu  # This container describes the TxPdu sent via the SoAd
            integer DoIPSoAdTxPduId: 0..65535, scope=ECU, set at link in variant link-time / post-build in variant post-build / pre-compile in variant pre-compile, symbolic-name-value=true  # The DoIPSoAdTxPduId is required by the API call DoIP_SoAdTpTxConfirmation that is called by the SoAd to confirm that the IPdu has been transmitted successfully.
            reference DoIPSoAdTxPduRef: set at link in variant link-time / post-build in variant post-build / pre-compile in variant pre-compile, destination=Pdu  # Reference to the "global" Pdu structure to allow harmonization of handle IDs in the COM-Stack.
        container DoIPUdpConnection [1..255]  # This Container describes the udp connection to the lower layer SoAd module.
          container DoIPSoAdRxPdu  # This container contains the Rx Pdus received by DoIP
            integer DoIPSoAdRxPduId: 0..65535, scope=ECU, set at link in variant link-time / post-build in variant post-build / pre-compile in variant pre-compile, symbolic-name-value=true  # The DoIPSoAdRxPduId is required by the API call DoIP_SoAdTpRxIndication to receive I-PDUs from the SoAd.
            reference DoIPSoAdRxPduRef: set at link in variant link-time / post-build in variant post-build / pre-compile in variant pre-compile, destination=Pdu  # Reference to the "global" Pdu structure to allow harmonization of handle IDs in the COM-Stack.
          container DoIPSoAdTxPdu  # This container describes the TxPdu sent via the SoAd
            integer DoIPSoAdTxPduId: 0..65535, scope=ECU, set at link in variant link-time / post-build in variant post-build / pre-compile in variant pre-compile, symbolic-name-value=true  # The DoIPSoAdTxPduId is required by the API call DoIP_SoAdTpTxConfirmation that is called by the SoAd to confirm that the IPdu has been transmitted successfully.
            reference DoIPSoAdTxPduRef: set at link in variant link-time / post-build in variant post-build / pre-compile in variant pre-compile, destination=Pdu  # Reference to the "global" Pdu structure to allow harmonization of handle IDs in the COM-Stack.
      container DoIPRoutingActivation [0..255]: post-build-changeable=true  # This container describes the routing activation possibilities by representing for each container a possible routing activation request message to the DoIP entity and the according references to the activated diagnostic messages.
        integer DoIPRoutingActivationNumber: 0..255, set at link in variant link-time / post-build in variant post-build / pre-compile in variant pre-compile  # Identifies the Routing activation Number which is received for a DoIP routing activation request message.
        reference DoIPTargetAddressRef [1..255]: set at link in variant link-time / post-build in variant post-build / pre-compile in variant pre-compile, destination=DoIPTargetAddress  # Reference to all DoIPTargetAddress which are activated on this Routing activation.
        container DoIPRoutingActivationAuthenticationCallback [0..1]  # Container describes the Callbackfunction to call on a Routing Activation Request for Authentication. If this container is configured but the DoIPRoutingActivationAuthenticationFunc parameter is not present, the DoIP module will use an RPort of ServiceInterface &lt;RoutingActivation&gt;_RoutingActivation with the name "CB&lt;RoutingActivation&gt;RoutingActivation". &lt;RoutingActivation&gt; is the ShortName of the DoIPRoutingActiviation container.
          function name DoIPRoutingActivationAuthenticationFunc [0..1]: set at link in variant link-time+post-build / pre-compile in variant pre-compile  # Direct C Callback function to trigger the authentication function for routing activation. If the DoIPRoutingActivationAuthenticationFunc parameter is present, the DoIP module will not use an RPort of ServiceInterface &lt;RoutingActivation&gt;_RoutingActivation but call the configured function.
          integer DoIPRoutingActivationAuthenticationReqLength: 0..4, set at link in variant link-time+post-build / pre-compile in variant pre-compile  # Describes the amount of bytes used to handle to the authentication function on routing activation. If 0 is configured as length the parameter AuthenticationReqData will not be handled to the API.
          integer DoIPRoutingActivationAuthenticationResLength: 0..4, set at link in variant link-time+post-build / pre-compile in variant pre-compile  # Describes the amount of bytes used to read by the authentication function on routing activation. If 0 is configured as length the parameter AuthenticationResData will not be fetched via the API.
        container DoIPRoutingActivationConfirmationCallback [0..1]  # Container describes the Callbackfunction to call on a Routing Activation Request for Confirmation. If this container is configured but the DoIPRoutingActivationConfirmationFunc parameter is not present the DoIP module will use an RPort of ServiceInterface &lt;RoutingActivation&gt;_RoutingActivation with the name "CB&lt;RoutingActivation&gt;RoutingActivation". &lt;RoutingActivation&gt; is the ShortName of the DoIPRoutingActiviation container.
          function name DoIPRoutingActivationConfirmationFunc [0..1]: set at link in variant link-time+post-build / pre-compile in variant pre-compile  # Direct C Callback function to trigger the confirmation function for routing activation. If the DoIPRoutingActivationConfirmationFunc parameter is present the DoIP module will not use an RPort of ServiceInterface &lt;RoutingActivation&gt;_RoutingActivation but call the configured function.
          integer DoIPRoutingActivationConfirmationReqLength: 0..4, set at link in variant link-time+post-build / pre-compile in variant pre-compile  # Describes the amount of bytes used to handle to the confirmation function on routing activation. If 0 is configured as length the parameter ConfirmedReqData will not be handled to the API.
          integer DoIPRoutingActivationConfirmationResLength: 0..4, set at link in variant link-time+post-build / pre-compile in variant pre-compile  # Describes the amount of bytes used to read by the confirmation function on routing activation. If 0 is configured as length the parameter ConfirmedResData will not be fetched via the API.
      container DoIPTester [0..255]: post-build-changeable=true  # This container describes the properties of the possible connectable Tester for the DoIP entity.
        integer DoIPNumByteDiagAckNack: 0..4294967295, set at link in variant link-time / post-build in variant post-build / pre-compile in variant pre-compile  # Specifies the number of original Diagnostic request bytes the DoIP entity responses on a NACK of a diagnostic response message to the Tester.
        integer DoIPTesterSA: 0..65535, set at link in variant link-time / post-build in variant post-build / pre-compile in variant pre-compile  # Source Address of the Tester sent via routing activation or diagnostic message.
        reference DoIPRoutingActivationRef [1..255]: set at link in variant link-time / post-build in variant post-build / pre-compile in variant pre-compile, destination=DoIPRoutingActivation  # Reference to a DoIPRoutingActivation describing the possible routing activations of the DoIPTester
    container DoIPGeneral  # This container specifies the general configuration parameters of the DoIP module.
      float DoIPAliveCheckResponseTimeout: 0..Inf, set at pre-compile  # Timeout in [s] for waiting for a response to an Alive Check request before the connection is considered to be disconnected. Represents parameter T_TCP_AliveCheck of ISO 13400-2:2012.
      boolean DoIPDevelopmentErrorDetect: set at pre-compile  # Pre-processor switch for enabling development error detection support.
      boolean DoIPDhcpOptionVinUse: set at pre-compile  # If DoIPDhcpOptionVinUse is set to true the DoIP module will add the VIN to the Dhcp host name if no valid Dhcp host name is already set.
      boolean DoIPEntityStatusMaxByteFieldUse: set at pre-compile  # This parameter is used to distinguish the optional support of the Max data size element of a diagnostic entity status response.
      integer DoIPGIDInvalidityPattern: 0..255, set at pre-compile  # Specifies the Byte pattern that is used for response messages if no valid GID could be retrieved.
      float DoIPGeneralInactivityTime: 0..Inf, set at pre-compile  # Timeout in [s] for maximum inactivity of a TCP socket connection before the DoIP module will close the according socket connection. Represents parameter T_TCP_General_Inactivity of ISO 13400-2:2012
      string DoIPHeaderFileInclusion [0..*]: set at pre-compile  # Name of the header file(s) to be included by the DoIP module containing the used C-callback declarations.
      string DoIPHostNameSizeMax: set at pre-compile, max-length=255, min-length=5  # Maximum Size of the DHCP HostName in ASCII. This parameter is necessary to reserve the correct amount of bytes for working with the DHCP HostName option. Minimum range is 5 because Dhcp Host Name should be at least "DoIP-" on any configuration.
      float DoIPInitialInactivityTime: 0..Inf, set at pre-compile  # Timeout in [s] used for initial inactivity of a connected TCP socket connection directly after socket connection. Represents parameter T_TCP_Initial_Inactivity of ISO 13400-2:2012
      float DoIPInitialVehicleAnnouncementTime: 0..Inf, set at pre-compile  # Time to wait in [s] for sending first vehicle anouncement message after IP address assignment. Represents parameter A_DoIP_Announce_Wait of ISO 13400-2:2012
      float DoIPMainFunctionPeriod: 0..Inf, set at pre-compile  # Determines the frequency at which the DoIP_MainFunction() is called in [s].
      integer DoIPMaxRequestBytes: 1..18446744073709551615, set at pre-compile  # Specifies the maximum allowed bytes of a DoIP message request without the DoIP header.
      integer DoIPMaxTesterConnections: 1..255, set at pre-compile  # Maximum ammount of tester connections that shall be maintained at one time before alive check is performed.
      enumeration DoIPNodeType: {DOIP_GATEWAY, DOIP_NODE}, set at pre-compile  # Describes the Type of the DoIP node.
      boolean DoIPUseEIDasGID: set at pre-compile  # Specifies if the DoIP entity shall use its EID if it is the Master for vehicle identification gid on the vehicle identification/vehicle announcement.
      boolean DoIPUseMacAddressForIdentification: set at pre-compile  # Provided the information if a configured EID at vehicle identification response/vehicle announment is used or the MAC address. | TRUE: Use MAC Address instead of EID for Vehicle identification/announcement. FALSE: Use configured EID for vehicle identification/announcement. Dependencies: DoIPEID
      boolean DoIPUseVehicleIdentificationSyncStatus: set at pre-compile  # Defines if the optional VIN/GID synchronization status is used additionally in the vehicle identification/announcement.
      float DoIPVehicleAnnouncementInterval: 0..Inf, set at pre-compile  # Time to wait in [s] for sending subsequent vehicle anouncement messages. Represents parameter A_DoIP_Announce_Interval of ISO 13400-2:2012
      integer DoIPVehicleAnnouncementRepetition: 1..255, set at pre-compile  # Amount of repetitions of the vehicle announcement message on IP address assignment. Represents parameter A_DoIP_Annunce_Num of ISO 13400-2:2012
      boolean DoIPVersionInfoApi: set at pre-compile  # Activates the DoIP_GetVersionInfo() API. | TRUE: Enables the DoIP_GetVersionInfo() API. FALSE: DoIP_GetVersionInfo() API is not included.
      boolean DoIPVinGidMaster: set at pre-compile  # Specifies if the DoIP entity is the Vehicle identification Master for the GID (Group ID).
      integer DoIPVinInvalidityPattern: 0..255, set at pre-compile  # Specifies the Byte pattern that is used for response messages if no valid VIN could be retrieved.
      container DoIPGetGid [0..1]  # This container describes the Callbackfunction to get the GID. | If this container is not configured no Callbackfunction will be used. If this container is configured but the DoIPGetGID parameter is not present, the DoIP module will use an RPort of ServiceInterface CallbackGetGID with the name "CBGetGID".
        function name DoIPGetGID [0..1]: set at link in variant link-time+post-build / pre-compile in variant pre-compile  # Direct C Callback function to get the GID of the DoIP entity. If the DoIPGetGID parameter is present, the DoIP module will not use an RPort of ServiceInterface CallbackGetGID but call the configured function.
      container DoIPPowerModeCallback  # This container describes the Callbackfunction to get the Power Mode. This container shall always be present. | If the DoIPPowerMode parameter is not present, the DoIP module will use an RPort of ServiceInterface CallbackGetPowerMode with the name "CBGetPowerMode".
        function name DoIPPowerMode [0..1]: set at link in variant link-time+post-build / pre-compile in variant pre-compile  # Direct C Callback function to get the Power Mode of the DoIP entity. If the DoIPPowerMode parameter is present, the DoIP module will not use an RPort of ServiceInterface CallbackGetPowerMode but will call the configured function.
      container DoIPTriggerGidSynchronization [0..1]  # This container describes the Callbackfunction to trigger the GID synchronisation. | If this container is not configured no Callbackfunction will be used. If this container is configured but the DoIPTriggerGIDSynchronzation parameter is not present, the DoIP module will use an RPort of ServiceInterface CallbackTriggerGIDSynchronization with the name "CBTriggerGIDSynchronization".
        function name DoIPTriggerGIDSynchronzation [0..1]: set at link in variant link-time+post-build / pre-compile in variant pre-compile  # Direct C Callback function to trigger the synchronization of the GID. If the DoIPTriggerGIDSynchronzation parameter is present, the DoIP module will not use an RPort of ServiceInterface CallbackTriggerGIDSynchronization but call the configured function.
  module definition Ea [0..1]: variants pre-compile  # Configuration of the Ea (EEPROM Abstraction) module. | The module shall abstract from the device specific addressing scheme and segmentation and provide the upper layers with a virtual addressing scheme and segmentation as well as a 'virtually' unlimited number of erase cycles.
    container EaBlockConfiguration [1..*]  # Configuration of block specific parameters for the EEPROM abstraction module.
      integer EaBlockNumber: 1..65534, scope=ECU, set at pre-compile, symbolic-name-value=true  # Block identifier (handle). | 0x0000 and 0xFFFF shall not be used for block numbers (see EA006). Range: min = 2^NVM_DATASET_SELECTION_BITS max = 0xFFFF -2^NVM_DATASET_SELECTION_BITS Note: Depending on the number of bits set aside for dataset selection several other block numbers shall also be left out to ease implementation.
      integer EaBlockSize: 1..65535, scope=ECU, set at pre-compile  # Size of a logical block in bytes.
      boolean EaImmediateData: scope=ECU, set at pre-compile  # Marker for high priority data. | true: Block contains immediate data. false: Block does not contain immediate data.
      integer EaNumberOfWriteCycles: 0..4294967295, set at pre-compile  # Number of write cycles required for this block.
      symbolic name reference EaDeviceIndex: set at pre-compile, destination=EepGeneral  # Device index (handle). | Range: 0 .. 254 (0xFF reserved for broadcast call to GetStatus function).
    container EaGeneral  # General configuration of the EEPROM abstraction module. This container lists block independent configuration parameters.
      boolean EaDevErrorDetect: set at pre-compile  # Pre-processor switch to enable and disable development error detection. | true: Development error detection enabled. false: Development error detection disabled.
      integer EaIndex [0..1]: 0..254, set at pre-compile  # This parameter is obsolete and will be removed in future. Tags: atp.Status=obsolete, atp.StatusRevisionBegin=4.1.1 | Specifies the InstanceId of this module instance. If only one instance is present it shall have the Id 0. This element is obsolete and will be removed in a future revision.
      float EaMainFunctionPeriod: 1E-7..Inf, scope=ECU, set at pre-compile  # The period between successive calls to the main function in seconds.
      function name EaNvmJobEndNotification [0..1]: set at pre-compile  # Mapped to the job end notification routine provided by the upper layer module (NvM_JobEndNotification).
      function name EaNvmJobErrorNotification [0..1]: set at pre-compile  # Mapped to the job error notification routine provided by the upper layer module (NvM_JobErrorNotification).
      boolean EaPollingMode: set at pre-compile  # Pre-processor switch to enable and disable the polling mode for this module. | true: Polling mode enabled, callback functions (provided to EEP module) disabled. false: Polling mode disabled, callback functions (provided to EEP module) enabled.
      boolean EaSetModeSupported: set at pre-compile, default-value=true  # Compile switch to enable / disable the function Ea_SetMode.
      boolean EaVersionInfoApi: set at pre-compile  # Pre-processor switch to enable / disable the API to read out the modules version information. | true: Version info API enabled. false: Version info API disabled.
      integer EaVirtualPageSize: 0..65535, set at pre-compile  # The size in bytes to which logical blocks shall be aligned.
    container EaPublishedInformation  # Additional published parameters not covered by CommonPublishedInformation container. | Note that these parameters do not have any configuration class setting, since they are published information.
      integer EaBlockOverhead: 0..65535, set at published-information  # Management overhead per logical block in bytes. | Note: If the management overhead depends on the block size or block location a formula has to be provided that allows the configurator to calculate the management overhead correctly.
      float EaMaximumBlockingTime [0..1]: 0..Inf, set at published-information  # This parameter is obsolete and will be removed in future. Tags: atp.Status=obsolete, atp.StatusRevisionBegin=4.1.1 | The maximum time the EA module's API routines shall be blocked (delayed) by internal operations. (EA070) Note: Internal operations in that case means operations that are not explicitly invoked from the upper layer module but need to be handled for proper operation of this module or the underlying memory driver. This element is obsolete and will be removed in a future revision.
      integer EaPageOverhead: 0..65535, set at published-information  # Management overhead per page in bytes. | Note: If the management overhead depends on the block size or block location a formula has to be provided that allows the configurator to calculate the management overhead correctly.
  module definition EcuC [0..1]: variants post-build/pre-compile  # Virtual module to collect ECU Configuration specific / global configuration information.
    container EcucConfigSet [0..1]: multiple-configuration-container=true  # This container contains the configuration parameters and sub containers of the global PduCollection. This container is a MultipleConfigurationContainer, i.e. this container and its sub-containers exist once per configuration set.
      container EcucPduCollection [0..1]  # Collection of all Pdu objects flowing through the Com-Stack.
        enumeration PduIdTypeEnum: {UINT16, UINT8}  # The PduIdType is used within the entire AUTOSAR Com Stack except for bus drivers. The size of this global type depends on the maximum number of PDUs used within one software module. If no software module deals with more PDUs that 256, this type can be set to uint8. If at least one software module handles more than 256 PDUs, this type must be set to uint16. See AUTOSAR_SWS_CommunicationStackTypes for more details.
        enumeration PduLengthTypeEnum: {UINT16, UINT32, UINT8}  # The PduLengthType is used within the entire AUTOSAR Com Stack except for bus drivers. The size of this global type depends on the maximum length of PDUs to be sent by an ECU. If no segmentation is used the length depends on the maximum payload size of a frame of the underlying communication system (for FlexRay maximum size is 255 bytes, therefore uint8). If segmentation is used it depends on the maximum length of a segmented N-PDU (in general uint16 is used). See AUTOSAR_SWS_CommunicationStackTypes for more details.
        container Pdu [0..*]: post-build-changeable=true  # One Pdu flowing through the COM-Stack. | This Pdu is used by all Com-Stack modules to agree on referencing the same Pdu.
          integer MetaDataLength [0..1]: 0..4, set at post-build in variant post-build / pre-compile in variant pre-compile, default-value=0  # Number of additional bytes in PDU data that contain auxiliary information (MetaData) for the PDU, e.g. the CAN ID. These bytes are handled as part of the PDU data and increase the PDU data length accordingly.
          integer PduLength: 0..4294967295, set at post-build in variant post-build / pre-compile in variant pre-compile  # Length of the Pdu in bytes. It should be noted that in former AUTOSAR releases (Rel 2.1, Rel 3.0, Rel 3.1, Rel 4.0 Rev. 1) this parameter was defined in bits.
          foreign reference SysTPduToFrameMappingRef [0..1]: set at pre-compile, destination-type=PDU-TO-FRAME-MAPPING  # Optional reference to the PduToFrameMapping from the SystemTemplate which this Pdu represents. | This parameter is obsolete and will be removed in future. This element is obsolete and will be removed in a future revision.
          foreign reference SysTPduToFrameTriggeringRef [0..1]: set at post-build in variant post-build / pre-compile in variant pre-compile, destination-type=FRAME-TRIGGERING  # Reference to the FrameTriggering from the SystemTemplate which this Pdu belongs to. | SysTPduToFrameTriggeringRef shall be used for UserDefinedPdus, NmPdus and NPdus which are not going through the Pdu Router. This reference shall not be used if SysTPduToPduTriggeringRef exists.
          foreign reference SysTPduToPduTriggeringRef [0..1]: set at post-build in variant post-build / pre-compile in variant pre-compile, destination-type=PDU-TRIGGERING  # Reference to the PduTriggering from the SystemTemplate which this Pdu represents. | SysTPduToPduTriggeringRef shall be used for all Pdus except UserDefinedPdus, NmPdus and NPdus which are not going through the Pdu Router. For these Pdus, SysTPduToFrameTriggeringRef shall be used.
    container EcucHardware [0..1]  # Hardware definition of this Ecu.
      container EcucCoreDefinition [0..*]  # Definition of one Core on this Ecu.
        integer EcucCoreId: 0..65535, set at pre-compile, symbolic-name-value=true  # ID of the core.
        foreign reference EcucCoreHwRef [0..1]: set at pre-compile, destination-type=HW-ELEMENT  # Optional reference to the HwElement of HwCategory ProcessingUnit that represents this Core in the ECU Resource Template.
    container EcucPartitionCollection [0..1]  # Collection of Partitions defined for this ECU.
      container EcucPartition [0..*]  # Definition of one Partition on this ECU. | One Partition will be implemented using one Os-Application.
        boolean EcucPartitionBswModuleExecution: set at pre-compile  # Denotes that this partition will execute BSW Modules. BSW Modules can only be executed in such partitions.
        boolean PartitionCanBeRestarted: set at pre-compile  # Specifies the requirement whether the Partition can be restarted. If set to true all software executing in this partition shall be capable of handling a restart.
        foreign reference EcucPartitionBswModuleDistinguishedPartition [0..*]: set at pre-compile, destination-type=BSW-DISTINGUISHED-PARTITION  # This maps the abstract partition of the Bsw Module to a concrete Partition existing in the ECU.
        instance reference EcucPartitionSoftwareComponentInstanceRef [0..*]: set at pre-compile, destination-context=ROOT-SW-COMPOSITION-PROTOTYPE, destination-type=SW-COMPONENT-PROTOTYPE  # References the SW Component instances from the Ecu Extract that shall be executed in this partition.
    container EcucUnitGroupAssignment [0..1]  # Collection of UnitGroup references to support the generation of ASAM MCD file.
      foreign reference EcucUnitGroupRef [1..*]: set at pre-compile, destination-type=UNIT-GROUP  # Optional reference to the UnitGroup to support the generation of ASAM MCD file. These UnitGroups are selecting a set of units for a specific country.
    container EcucVariationResolver [0..1]  # Collection of PredefinedVariant elements containing definition of values for SwSystemconst which shall be applied when resolving the variability during ECU Configuration.
      foreign reference PredefinedVariantRef [1..*]: set at pre-compile, destination-type=PREDEFINED-VARIANT
  module definition EcuM [0..1]: variants post-build  # Configuration of the EcuM (ECU State Manager) module.
    container EcuMConfiguration: multiple-configuration-container=true  # This container contains the configuration (parameters) of the ECU State Manager.
      container EcuMCommonConfiguration  # This container contains the common configuration (parameters) of the ECU State Manager.
        integer EcuMConfigConsistencyHash: 0..18446744073709551615, set at link  # A hash value generated across all pre-compile and link-time parameters of all BSW modules. This hash value is compared against a field in the EcuM_ConfigType and hence allows checking the consistency of the entire configuration.
        reference EcuMDefaultAppMode: set at post-build, destination=OsAppMode  # The default application mode loaded when the ECU comes out of reset.
        reference EcuMOSResource [1..*]: set at pre-compile, destination=OsResource  # This parameter is a reference to a OS resource which is used to bring the ECU into sleep mode. | In case of multi core each core shall have an own OsResource.
        container EcuMDefaultShutdownTarget  # This container describes the default shutdown target to be selected by EcuM. The actual shutdown target may be overridden by the EcuM_SelectShutdownTarget service.
          enumeration EcuMDefaultState: {EcuMStateOff, EcuMStateReset, EcuMStateSleep}, set at post-build  # This parameter describes the state part of the default shutdown target selected when the ECU comes out of reset. If EcuMStateSleep is selected, the parameter EcuMDefaultSleepModeRef selects the specific sleep mode.
          symbolic name reference EcuMDefaultResetModeRef [0..1]: set at post-build, destination=EcuMResetMode  # If EcuMDefaultShutdownTarget is EcuMStateReset, this parameter selects the default reset mode. Otherwise this parameter may be ignored.
          symbolic name reference EcuMDefaultSleepModeRef [0..1]: set at post-build, destination=EcuMSleepMode  # If EcuMDefaultShutdownTarget is EcuMStateSleep, this parameter selects the default sleep mode. Otherwise this parameter may be ignored.
        container EcuMDemEventParameterRefs [0..1]  # This container is deprecated and will be removed in a future release. | Container for the references to DemEventParameter elements which shall be invoked using the API Dem_ReportErrorStatus in case the corresponding error occurs. The EventId is taken from the referenced DemEventParameter's DemEventId value. The standardized errors are provided in this container and can be extended by vendor specific error references.
          symbolic name reference ECUM_E_ALL_RUN_REQUESTS_KILLED [0..1]: set at pre-compile, destination=DemEventParameter  # This reference is deprecated and will be removed in a future release. | Reference to the DemEventParameter which shall be issued when the error "ECUM_E_ALL_RUN_REQUESTS_KILLED" has occurred. Only applicable if EcuMFixed is implemented. This element is obsolete and will be removed in a future revision.
          symbolic name reference ECUM_E_CONFIGURATION_DATA_INCONSISTENT [0..1]: set at pre-compile, destination=DemEventParameter  # This reference is deprecated and will be removed in a future release. | Reference to the DemEventParameter which shall be issued when the error "ECUM_E_CONFIGURATION_DATA_INCONSISTENT" has occurred. This element is obsolete and will be removed in a future revision.
          symbolic name reference ECUM_E_IMPROPER_CALLER [0..1]: set at pre-compile, destination=DemEventParameter  # This reference is deprecated and will be removed in a future release. | Reference to the DemEventParameter which shall be issued when the error "ECUM_E_IMPROPER_CALLER" has occurred. Only applicable if EcuMFlex is implemented. This element is obsolete and will be removed in a future revision.
          symbolic name reference ECUM_E_RAM_CHECK_FAILED [0..1]: set at pre-compile, destination=DemEventParameter  # This reference is deprecated and will be removed in a future release. | Reference to the DemEventParameter which shall be issued when the error "ECUM_E_RAM_CHECK_FAILED" has occurred. This element is obsolete and will be removed in a future revision.
        container EcuMDriverInitListOne [0..1]  # Container for Init Block I. | This container holds a list of module IDs that will be initialized. Each module in the list will be called for initialization in the list order. All modules in this list are initialized before the OS is started and so these modules require no OS support.
          container EcuMDriverInitItem [1..*]  # These containers describe the entries in a driver init list.
            string EcuMModuleID [0..1]: set at pre-compile  # Short name of the module to be initialized, e.g. Mcu, Gpt etc. | In case EcuMModuleConfigRef is used the EcuMModuleID is optional (in case it is given it shall have the same value as the referenced EcuMModuleConfiguration).
            string EcuMModuleService: set at pre-compile  # The service to be called to initialize that module, e.g. Init, PreInit, Start etc. | If the service is Init and the parameter EcuMFlexModuleConfigurationRef / EcuMFixedModuleConfigurationRef has been set for that module, the corresponding pointer to the init structure (<Module>_ConfigType).
            choice reference EcuMModuleConfigRef [0..1]: destination=[EcuMFixedModuleConfiguration, EcuMFlexModuleConfiguration]  # In case a BSWM Module is configured with several instances in this ECU Configuration there shall be a reference which determines the to be used multipleConfigurationContainer for this BSW Module instance.
        container EcuMDriverInitListZero [0..1]  # Container for Init Block 0. | This container holds a list of module IDs that will be initialized. Each module in the list will be called for initialization in the list order. All modules in this list are initialized before the post-build configuration has been loaded and the OS is initialized. Therefore, these modules may not use post-build configuration.
          container EcuMDriverInitItem [1..*]  # These containers describe the entries in a driver init list.
            string EcuMModuleID [0..1]: set at pre-compile  # Short name of the module to be initialized, e.g. Mcu, Gpt etc. | In case EcuMModuleConfigRef is used the EcuMModuleID is optional (in case it is given it shall have the same value as the referenced EcuMModuleConfiguration).
            string EcuMModuleService: set at pre-compile  # The service to be called to initialize that module, e.g. Init, PreInit, Start etc. | If the service is Init and the parameter EcuMFlexModuleConfigurationRef / EcuMFixedModuleConfigurationRef has been set for that module, the corresponding pointer to the init structure (<Module>_ConfigType).
            choice reference EcuMModuleConfigRef [0..1]: destination=[EcuMFixedModuleConfiguration, EcuMFlexModuleConfiguration]  # In case a BSWM Module is configured with several instances in this ECU Configuration there shall be a reference which determines the to be used multipleConfigurationContainer for this BSW Module instance.
        container EcuMDriverRestartList [0..1]  # List of module IDs.
          container EcuMDriverInitItem [1..*]  # These containers describe the entries in a driver init list.
            string EcuMModuleID [0..1]: set at pre-compile  # Short name of the module to be initialized, e.g. Mcu, Gpt etc. | In case EcuMModuleConfigRef is used the EcuMModuleID is optional (in case it is given it shall have the same value as the referenced EcuMModuleConfiguration).
            string EcuMModuleService: set at pre-compile  # The service to be called to initialize that module, e.g. Init, PreInit, Start etc. | If the service is Init and the parameter EcuMFlexModuleConfigurationRef / EcuMFixedModuleConfigurationRef has been set for that module, the corresponding pointer to the init structure (<Module>_ConfigType).
            choice reference EcuMModuleConfigRef [0..1]: destination=[EcuMFixedModuleConfiguration, EcuMFlexModuleConfiguration]  # In case a BSWM Module is configured with several instances in this ECU Configuration there shall be a reference which determines the to be used multipleConfigurationContainer for this BSW Module instance.
        container EcuMSleepMode [1..*]  # These containers describe the configured sleep modes. | The names of these containers specify the symbolic names of the different sleep modes.
          integer EcuMSleepModeId: 0..255, scope=ECU, set at pre-compile, symbolic-name-value=true  # This ID identifies this sleep mode in services like EcuM_SelectShutdownTarget.
          boolean EcuMSleepModeSuspend: set at pre-compile  # Flag, which is set true, if the CPU is suspended, halted, or powered off in the sleep mode. If the CPU keeps running in this sleep mode, then this flag must be set to false.
          symbolic name reference EcuMSleepModeMcuModeRef: set at pre-compile, destination=McuModeSettingConf  # This parameter is a reference to the corresponding MCU mode for this sleep mode.
          symbolic name reference EcuMWakeupSourceMask [1..*]: set at pre-compile, destination=EcuMWakeupSource  # These parameters are references to the wakeup sources that shall be enabled for this sleep mode.
        container EcuMWakeupSource [1..*]  # These containers describe the configured wakeup sources.
          float EcuMCheckWakeupTimeout [0..1]: 0..10, set at pre-compile, default-value=0  # This Parameter is the initial Value for the Time of the EcuM to delay shut down of the ECU if the check of the Wakeup Source is done asynchronously (CheckWakeupTimer). | The unit is in seconds.
          float EcuMValidationTimeout [0..1]: 0..Inf, set at pre-compile  # The validation timeout (period for which the ECU State Manager will wait for the validation of a wakeup event) can be defined for each wakeup source independently. The timeout is specified in seconds. | When the timeout is not instantiated, there is no validation routine and the ECU Manager shall not validate the wakeup source.
          integer EcuMWakeupSourceId: 0..31, scope=ECU, set at pre-compile, symbolic-name-value=true  # This parameter defines the identifier of this wakeup source.
          boolean EcuMWakeupSourcePolling: set at pre-compile  # This parameter describes if the wakeup source needs polling.
          symbolic name reference EcuMComMChannelRef [0..1]: set at pre-compile, destination=ComMChannel  # This parameter is a reference to a Network (channel) defined in the Communication Manager. No reference indicates that the wakeup source is not a communication channel.
          symbolic name reference EcuMResetReasonRef [0..*]: set at pre-compile, destination=McuResetReasonConf  # This parameter describes the mapping of reset reasons detected by the MCU driver into wakeup sources.
      container EcuMFixedConfiguration [0..1]  # This container contains the configuration (parameters) of the EcuMFixed. | Only applicable if EcuMFixed is implemented. In order to initialize the PostBuild BSW modules, either the EcuMFixedModuleConfigurationRef or EcuMFixedPostBuildVariationCriterion shall be used. Which one of these two shall be used depends on the chosen PostBuild approach (MultipleConfigurationContaineror or VariantHandling) as explained in the TPS_EcuConfiguration document.
        float EcuMNvramReadallTimeout: 0..Inf, set at post-build  # Period given in seconds for which the ECU State Manager will wait until it considers a ReadAll job of the NVRAM Manager as failed.
        float EcuMNvramWriteallTimeout: 0..Inf, set at post-build  # Period given in seconds for which the ECU State Manager will wait until it considers a WriteAll job of the NVRAM Manager as failed.
        float EcuMRunMinimumDuration: 0..Inf, set at post-build  # Duration given in seconds for which the ECU State Manager will | stay in RUN state even when no one requests RUN. This duration should be long at least as long as a SW-Cs needs to request RUN.
        symbolic name reference EcuMComMCommunicationAllowedList [0..*]: set at pre-compile, destination=ComMChannel  # These parameters contain references to the ComMChannels for which EcuM has to call ComM_CommunicationAllowed.
        symbolic name reference EcuMNormalMcuModeRef: set at pre-compile, destination=McuModeSettingConf  # This parameter is a reference to the normal MCU mode to be restored after a sleep.
        container EcuMDriverInitListThree [0..1]  # Container for Init Block III. | This container holds a list of module IDs that will be initialized. Each module in the list will be called for initialization in the list order. All modules in this list are initialized after the OS is started and so these modules may use OS support. These modules may also rely on the Nvram ReadAll job to have provided all data.
          container EcuMDriverInitItem [1..*]  # These containers describe the entries in a driver init list.
            string EcuMModuleID [0..1]: set at pre-compile  # Short name of the module to be initialized, e.g. Mcu, Gpt etc. | In case EcuMModuleConfigRef is used the EcuMModuleID is optional (in case it is given it shall have the same value as the referenced EcuMModuleConfiguration).
            string EcuMModuleService: set at pre-compile  # The service to be called to initialize that module, e.g. Init, PreInit, Start etc. | If the service is Init and the parameter EcuMFlexModuleConfigurationRef / EcuMFixedModuleConfigurationRef has been set for that module, the corresponding pointer to the init structure (<Module>_ConfigType).
            choice reference EcuMModuleConfigRef [0..1]: destination=[EcuMFixedModuleConfiguration, EcuMFlexModuleConfiguration]  # In case a BSWM Module is configured with several instances in this ECU Configuration there shall be a reference which determines the to be used multipleConfigurationContainer for this BSW Module instance.
        container EcuMDriverInitListTwo [0..1]  # Container for Init Block II. | This container holds a list of module IDs that will be initialized. Each module in the list will be called for initialization in the list order. All modules in this list are initialized after the OS is started and so these modules may use OS support. These modules may not rely on the Nvram ReadAll job to have provided all data.
          container EcuMDriverInitItem [1..*]  # These containers describe the entries in a driver init list.
            string EcuMModuleID [0..1]: set at pre-compile  # Short name of the module to be initialized, e.g. Mcu, Gpt etc. | In case EcuMModuleConfigRef is used the EcuMModuleID is optional (in case it is given it shall have the same value as the referenced EcuMModuleConfiguration).
            string EcuMModuleService: set at pre-compile  # The service to be called to initialize that module, e.g. Init, PreInit, Start etc. | If the service is Init and the parameter EcuMFlexModuleConfigurationRef / EcuMFixedModuleConfigurationRef has been set for that module, the corresponding pointer to the init structure (<Module>_ConfigType).
            choice reference EcuMModuleConfigRef [0..1]: destination=[EcuMFixedModuleConfiguration, EcuMFlexModuleConfiguration]  # In case a BSWM Module is configured with several instances in this ECU Configuration there shall be a reference which determines the to be used multipleConfigurationContainer for this BSW Module instance.
        container EcuMFixedModuleConfiguration [0..*]  # Collection of references to multiple configuration containers of BSW Modules.
          choice reference EcuMFixedModuleConfigurationRef: set at post-build, destination=[AdcConfigSet, CanConfigSet, CanIfInitCfg, CanNmGlobalConfig, CanSMConfiguration, CanTpConfig, CanTrcvConfigSet, CddConfigSet, ComConfig, ComMConfigSet, DbgMultipleConfigurationContainer, DcmConfigSet, DemConfigSet, DioConfig, DltMultipleConfigurationContainer, EepInitConfiguration, EthConfigSet, EthIfConfigSet, EthTrcvConfigSet, FiMConfigSet, FlsConfigSet, FlsTstConfigSet, FrArTpMultipleConfig, FrIfConfig, FrMultipleConfiguration, FrNmChannelConfig, FrSMConfig, FrTpMultipleConfig, GptChannelConfigSet, IcuConfigSet, IpduMConfig, J1939TpConfiguration, LinGlobalConfig, LinIfGlobalConfig, LinSMConfigSet, LinTpGlobalConfig, McuModuleConfiguration, OcuConfigSet, PduRRoutingTables, PortConfigSet, PwmChannelConfigSet, RtePostBuildVariantConfiguration, SoAdConfig, SpiDriver, TcpIpConfig, UdpNmGlobalConfig, WdgMConfigSet, WdgSettingsConfig, XcpConfig]  # This parameter contains one reference to the init structure of the corresponding BSW module.
        container EcuMFixedPostBuildVariationCriterion [0..*]  # The container contains the necessary information to initialize the BSW module using VariantHandling approach explained in the TPS_EcuConfiguration document.
          integer EcuMFixedPostBuildVariantValue: 0..18446744073709551615, set at post-build  # The value identifying the post-build variant.
          foreign reference EcuMFixedPostBuildVariationCriterionRef: set at post-build, destination-type=POST-BUILD-VARIANT-CRITERION  # Reference to the PostBuildVariantCriterion which is used to have a common selecting element for the PostBuild variants.
        container EcuMFixedUserConfig [1..*]  # These containers describe the identifiers that are needed to refer to a software component or another appropriate entity in the system which is designated to request the RUN state. Application requestors refer to entities above RTE, system requestors to entities below RTE (e.g. Communication Manager).
          integer EcuMFixedUser: 0..255, set at pre-compile, symbolic-name-value=true  # Parameter used to identify one user.
        container EcuMTTII [0..*]  # These containers describe the structures and the following configuration items describe its elements. These structures are concatenated to build a list as indicated by Figure 27 - Configuration Container Diagram. | The list must contain at least one element when ECUM_TTII_ENABLED is set to true.
          integer EcuMDivisor: 0..18446744073709551615, set at pre-compile  # This parameter defines the divisor preload value.
          symbolic name reference EcuMSleepModeRef: set at pre-compile, destination=EcuMSleepMode  # This configuration parameter is a reference to a configured sleep mode that is used for TTII.
          symbolic name reference EcuMSuccessorRef [0..1]: set at pre-compile, destination=EcuMSleepMode  # This parameter is a reference to the next sleep mode in the TTII protocol.
      container EcuMFlexConfiguration [0..1]  # This container contains the configuration (parameters) of the EcuMFlex. | Only applicable if EcuMFlex is implemented. In order to initialize the PostBuild BSW modules, either the EcuMFlexModuleConfigurationRef or EcuMFlexPostBuildVariationCriterion shall be used. Which one of these two shall be used depends on the chosen PostBuild approach (MultipleConfigurationContaineror or VariantHandling) as explained in the TPS_EcuConfiguration document.
        reference EcuMPartitionRef [0..*]: set at pre-compile, destination=EcucPartition  # Reference denotes the partition a EcuM shall run inside.
        symbolic name reference EcuMNormalMcuModeRef: set at pre-compile, destination=McuModeSettingConf  # This parameter is a reference to the normal MCU mode to be restored after a sleep.
        container EcuMAlarmClock [0..*]  # These containers describe the configured alarm clocks. | The name of these conatiners allows giving a symbolic name to one alarm clock.
          integer EcuMAlarmClockId: 0..255, set at pre-compile, symbolic-name-value=true  # This ID identifies this alarmclock.
          float EcuMAlarmClockTimeOut: 0..Inf, set at pre-compile  # This parameter allows to define a timeout for this alarm clock.
          symbolic name reference EcuMAlarmClockUser: set at pre-compile, destination=EcuMFlexUserConfig  # This parameter allows an alarm to be assigned to a user.
        container EcuMFlexModuleConfiguration [0..*]  # Collection of references to multiple configuration containers of BSW Modules.
          choice reference EcuMFlexModuleConfigurationRef: set at post-build, destination=[AdcConfigSet, BswMConfig, CanConfigSet, CanTrcvConfigSet, CddConfigSet, DioConfig, EthConfigSet, EthTrcvConfigSet, FlsConfigSet, FrMultipleConfiguration, GptChannelConfigSet, IcuConfigSet, LinGlobalConfig, McuModuleConfiguration, OcuConfigSet, PortConfigSet, PwmChannelConfigSet, SpiDriver, WdgMConfigSet, WdgSettingsConfig]  # This parameter contains one reference to the init structure of the corresponding BSW module.
        container EcuMFlexPostBuildVariationCriterion [0..*]  # The container contains the necessary information to initialize the BSW module using VariantHandling approach explained in the TPS_EcuConfiguration document.
          integer EcuMFlexPostBuildVariantValue: 0..18446744073709551615, set at post-build  # The value identifying the post-build variant.
          foreign reference EcuMFlexPostBuildVariationCriterionRef: set at post-build, destination-type=POST-BUILD-VARIANT-CRITERION  # Reference to the PostBuildVariantCriterion which is used to have a common selecting element for the PostBuild variants.
        container EcuMFlexUserConfig [1..*]  # These containers describe the identifiers that are needed to refer to a software component or another appropriate entity in the system which uses the EcuMFlex Interfaces.
          integer EcuMFlexUser: 0..255, set at pre-compile, symbolic-name-value=true  # Parameter used to identify one user.
          reference EcuMFlexEcucPartitionRef [0..1]: set at pre-compile, destination=EcucPartition  # Denotes in which "EcucPartition" the user of the EcuM is executed.
        container EcuMGoDownAllowedUsers [0..1]  # This container describes the collection of allowed users which are allowed to call the EcuM_GoDown API.
          symbolic name reference EcuMGoDownAllowedUserRef [1..*]: set at pre-compile, destination=EcuMFlexUserConfig  # These parameters describe the references to the users which are allowed to call the EcuM_GoDown API.
        container EcuMResetMode [1..*]  # These containers describe the configured reset modes. | The name of these containers allows one of the following symbolic names to be given to the different reset modes: - ECUM_RESET_MCU - ECUM_RESET_WDGM - ECUM_RESET_IO.
          integer EcuMResetModeId: 0..255, set at pre-compile, symbolic-name-value=true  # This ID identifies this reset mode in services like EcuM_SelectShutdownTarget.
        container EcuMSetClockAllowedUsers [0..1]  # This container describes the collection of allowed users which are allowed to call the EcuM_SetClock API.
          symbolic name reference EcuMSetClockAllowedUserRef [1..*]: set at pre-compile, destination=EcuMFlexUserConfig  # These parameters describe the references to the users which are allowed to call the EcuM_SetClock API.
        container EcuMShutdownCause [1..*]  # These containers describe the configured shut down or reset causes. | The name of these containers allows to give one of the following symbolic names to the different shut down causes: - ECUM_CAUSE_ECU_STATE - ECU state machine entered a state for shutdown, - ECUM_CAUSE_WDGM - WdgM detected failure, - ECUM_CAUSE_DCM - Dcm requests shutdown (split into UDS services?), - and values from configuration.
          integer EcuMShutdownCauseId: 0..255, set at pre-compile, symbolic-name-value=true  # This ID identifies this shut down cause.
        container EcuMShutdownTarget [0..*]  # This container is deprecated and will be removed in a future release. | These containers describe the configured shut down targets. The name of these containers allows to give symbolic names to the different shut down targets.
          integer EcuMShutdownTargetId [0..1]: 0..255, set at pre-compile, symbolic-name-value=true  # This ID identifies this shut down target in services like EcuM_SelectShutdownTarget. Tags: atp.Status=obsolete, atp.StatusRevisionBegin=4.1.1
    container EcuMFixedGeneral [0..1]  # This container holds the general, pre-compile configuration parameters for the EcuMFixed. | Only applicable if EcuMFixed is implemented.
      boolean EcuMIncludeComM: set at pre-compile  # This configuration parameter defines whether the communication manager is supported by EcuM. This feature is presented for development purpose to compile out the communication manager in the early debugging phase.
      boolean EcuMIncludeNvM: set at pre-compile  # This configuration parameter defines whether the non volatile memory manager is supported by EcuM. This feature is presented for development purpose to compile out the volatile memory manager in the early debugging phase. Tags: atp.Status=obsolete, atp.StatusComment=This element is marked as obsolete and will be removed in a future revision., atp.StatusRevisionBegin=4.1.1
      boolean EcuMIncludeNvramMgr: set at pre-compile  # This configuration parameter defines whether the non volatile memory manager is supported by EcuM. This feature is presented for development purpose to compile out the volatile memory manager in the early debugging phase. Tags: atp.Status=obsolete, atp.StatusComment=This element is marked as obsolete and will be removed in a future revision., atp.StatusRevisionBegin=4.1.1
      boolean EcuMTTIIEnabled: set at pre-compile  # Boolean switch to enable / disable TTII
      symbolic name reference EcuMTTIIWakeupSourceRef: set at pre-compile, destination=EcuMWakeupSource  # This configuration parameter references the initial sleep mode to be used by TTII when TTII is activated after a RUN mode.
    container EcuMFlexGeneral [0..1]  # This container holds the general, pre-compile configuration parameters for the EcuMFlex. | Only applicable if EcuMFlex is implemented.
      boolean EcuMAlarmClockPresent: set at pre-compile  # This flag indicates whether the optional AlarmClock feature is present.
      boolean EcuMEnableDefBehaviour [0..1]: set at pre-compile  # This parameter is deprecated and will be removed in future. Tags: atp.Status=obsolete, atp.StatusRevisionBegin=4.1.2 | Old description: Switches the defensive behaviour on or off. This element is obsolete and will be removed in a future revision.
      boolean EcuMResetLoopDetection [0..1]: set at pre-compile  # If false, no reset loop detection is performed.
      boolean EcuMSetProgrammableInterrupts [0..1]: set at pre-compile  # If this configuration parameter exists and is to true, the callout "EcuM_AL_SetProgrammableInterrupts" is called during startup of EcuM (during StartPreOS).
      symbolic name reference EcuMAlarmWakeupSource [0..1]: set at pre-compile, destination=EcuMWakeupSource  # This parameter describes the reference to the EcuMWakeupSource being used for the EcuM AlarmClock.
    container EcuMGeneral  # This container holds the general, pre-compile configuration parameters.
      boolean EcuMDevErrorDetect: set at pre-compile  # If false, no debug artifacts (e.g. calls to DET) shall remain in the executable object. Initialization of DET, however is controlled by configuration of optional BSW modules.
      boolean EcuMIncludeDem [0..1]: set at pre-compile  # This parameter is deprecated and will be removed in a future release. Tags: atp.Status=obsolete, atp.StatusRevisionBegin=4.1.1 | If enabled, the according BSW module will be included to the ECU State Manager. This element is obsolete and will be removed in a future revision.
      boolean EcuMIncludeDet: set at pre-compile  # If defined, the according BSW module will be initialized by the ECU State Manager
      float EcuMMainFunctionPeriod: 0..Inf, scope=ECU, set at pre-compile  # This parameter defines the schedule period of EcuM_MainFunction. | Unit: [s]
      boolean EcuMVersionInfoApi: set at pre-compile  # Switches the version info API on or off
  module definition Eep [0..*]: variants post-build/pre-compile  # Configuration of the Eep (internal or external EEPROM driver) module. | Its multiplicity describes the number of EEPROM drivers present, so there will be one container for each EEPROM driver in the ECUC template. When no EEPROM driver is present then the multiplicity is 0.
    container EepGeneral  # Container for general configuration parameters of the EEPROM driver. These parameters are always pre-compile.
      boolean EepDevErrorDetect: set at pre-compile, default-value=true  # Pre-processor switch to enable and disable development error detection. | true: Development error detection enabled. false: Development error detection disabled.
      integer EepDriverIndex: 0..254, scope=ECU, set at pre-compile, symbolic-name-value=true  # Index of the driver, used by EA.
      boolean EepUseInterrupts: set at pre-compile, default-value=false  # Switches to activate or deactivate interrupt controlled job processing. | true: Interrupt controlled job processing enabled. false: Interrupt controlled job processing disabled.
      boolean EepVersionInfoApi: set at pre-compile, default-value=false  # Pre-processor switch to enable / disable the API to read out the modules version information. | true: Version info API enabled. false: Version info API disabled.
      boolean EepWriteCycleReduction: set at pre-compile, default-value=false  # Switches to activate or deactivate write cycle reduction (EEPROM value is read and compared before being overwritten). | true: Write cycle reduction enabled. false: Write cycle reduction disabled.
    container EepInitConfiguration: multiple-configuration-container=true  # Container for runtime configuration parameters of the EEPROM driver. | Implementation Type: Eep_ConfigType.
      integer EepBaseAddress: 0..4294967295, set at post-build in variant post-build / pre-compile in variant pre-compile  # This parameter is the EEPROM device base address. | Implementation Type: Eep_AddressType.
      enumeration EepDefaultMode: {MEMIF_MODE_FAST, MEMIF_MODE_SLOW}, set at post-build in variant post-build / pre-compile in variant pre-compile, default-value=MEMIF_MODE_SLOW  # This parameter is the default EEPROM device mode after initialization. | Implementation Type: MemIf_ModeType.
      integer EepFastReadBlockSize: 0..4294967295, set at post-build in variant post-build / pre-compile in variant pre-compile  # Number of bytes read within one job processing cycle in fast mode. If the hardware does not support burst mode this parameter shall be set to the same value as EepNormalReadBlockSize. | Implementation Type: Eep_LengthType.
      integer EepFastWriteBlockSize: 0..4294967295, set at post-build in variant post-build / pre-compile in variant pre-compile  # Number of bytes written within one job processing cycle in fast mode. If the hardware does not support burst mode this parameter shall be set to the same value as EepNormalWriteBlockSize. | Implementation Type: Eep_LengthType.
      float EepJobCallCycle [0..1]: 0..Inf, set at post-build in variant post-build / pre-compile in variant pre-compile  # Call cycle time of the EEPROM driver's main function. Unit: [s]
      function name EepJobEndNotification [0..1]: set at post-build in variant post-build / pre-compile in variant pre-compile  # This parameter is a reference to a callback function for positive job result (see EEP045).
      function name EepJobErrorNotification [0..1]: set at post-build in variant post-build / pre-compile in variant pre-compile  # This parameter is a reference to a callback function for negative job result (see EEP046).
      integer EepNormalReadBlockSize: 0..4294967295, set at post-build in variant post-build / pre-compile in variant pre-compile  # Number of bytes read within one job processing cycle in normal mode. | Implementation Type: Eep_LengthType.
      integer EepNormalWriteBlockSize: 0..4294967295, set at post-build in variant post-build / pre-compile in variant pre-compile  # Number of bytes written within one job processing cycle in normal mode. | Implementation Type: Eep_LengthType.
      integer EepSize: 0..4294967295, set at post-build in variant post-build / pre-compile in variant pre-compile  # This parameter is the used size of EEPROM device in bytes. | Implementation Type: Eep_LengthType.
      container EepDemEventParameterRefs [0..1]  # Container for the references to DemEventParameter elements which shall be invoked using the API Dem_ReportErrorStatus API in case the corresponding error occurs. The EventId is taken from the referenced DemEventParameter's DemEventId value. The standardized errors are provided in the container and can be extended by vendor specific error references.
        symbolic name reference EEP_E_COMPARE_FAILED [0..1]: set at post-build in variant post-build / pre-compile in variant pre-compile, destination=DemEventParameter  # Reference to the DemEventParameter which shall be issued when the error "EEPROM compare failed (HW)" has occurred.
        symbolic name reference EEP_E_ERASE_FAILED [0..1]: set at post-build in variant post-build / pre-compile in variant pre-compile, destination=DemEventParameter  # Reference to the DemEventParameter which shall be issued when the error "EEPROM erase failed (HW)" has occurred.
        symbolic name reference EEP_E_READ_FAILED [0..1]: set at post-build in variant post-build / pre-compile in variant pre-compile, destination=DemEventParameter  # Reference to the DemEventParameter which shall be issued when the error "EEPROM read failed (HW)" has occurred.
        symbolic name reference EEP_E_WRITE_FAILED [0..1]: set at post-build in variant post-build / pre-compile in variant pre-compile, destination=DemEventParameter  # Reference to the DemEventParameter which shall be issued when the error "EEPROM write failed (HW)" has occurred.
      container EepExternalDriver [0..1]  # This container is present for external EEPROM drivers only. Internal EEPROM drivers do not use the parameter listed in this container, hence its multiplicity is 0 for internal drivers.
        symbolic name reference EepSpiReference [1..*]: set at post-build in variant post-build / pre-compile in variant pre-compile, destination=SpiSequence  # Reference to SPI sequence (required for external EEPROM drivers).
    container EepPublishedInformation  # Additional published parameters not covered by CommonPublishedInformation container. | Note that these parameters do not have any configuration class setting, since they are published information.
      integer EepAllowedWriteCycles: 0..4294967295, set at published-information  # Specified maximum number of write cycles under worst case conditions of specific EEPROM hardware (e.g. +90°C)
      float EepEraseTime: 0..Inf, set at published-information  # Maximum time for erasing one EEPROM data unit.
      integer EepEraseUnitSize: 0..4294967295, set at published-information  # Size of smallest erasable EEPROM data unit in bytes.
      integer EepEraseValue: 0..255, set at published-information  # Value of an erased EEPROM cell.
      integer EepMinimumAddressType: 0..4294967295, set at published-information  # Minimum expected size of Eep_AddressType.
      integer EepMinimumLengthType: 0..4294967295, set at published-information  # Minimum expected size of Eep_LengthType.
      integer EepReadUnitSize: 0..4294967295, set at published-information  # Size of smallest readable EEPROM data unit in bytes.
      integer EepSpecifiedEraseCycles: 0..4294967295, set at published-information  # Number of erase cycles specified for the EEP device (usually given in the device data sheet).
      integer EepTotalSize: 0..4294967295, set at published-information  # Total size of EEPROM in bytes. | Implementation Type: Eep_LengthType.
      float EepWriteTime: 0..Inf, set at published-information  # Maximum time for writing one EEPROM data unit.
      integer EepWriteUnitSize: 0..4294967295, set at published-information  # Size of smallest writeable EEPROM data unit in bytes.
  module definition Eth [0..*]: variants link-time/post-build/pre-compile  # Configuration of the Eth (Ethernet Driver) module.
    container EthConfigSet: multiple-configuration-container=true  # All included containers and parameters that may be part of a multiple configuration set.
      container EthCtrlConfig [1..*]  # Configuration of the individual controller
        boolean EthCtrlEnableMii: set at pre-compile  # Enables / Disables Media Independent Interface (MII) for transceiver access
        boolean EthCtrlEnableRxInterrupt: set at pre-compile  # Enables / Disables receive interrupt
        boolean EthCtrlEnableTxInterrupt: set at pre-compile  # Enables / Disables transmit interrupt
        integer EthCtrlIdx: 0..255, scope=ECU, set at link in variant link-time / post-build in variant post-build / pre-compile in variant pre-compile, symbolic-name-value=true  # Specifies the instance ID of the configured controller.
        string EthCtrlPhyAddress [0..1]: set at link in variant link-time / post-build in variant post-build / pre-compile in variant pre-compile, max-length=17, min-length=17  # Specifies the unique 48-bit physical address (MAC address) of the controller in network byte order. | Regular Expression: [0-9a-fA-F]{2}[[:-][0-9a-fA-F]{2}]{5}
        integer EthCtrlRxBufLenByte: 0..1522, set at link in variant link-time / post-build in variant post-build / pre-compile in variant pre-compile  # Limits the maximum receive buffer length (frame length) in bytes.
        integer EthCtrlTxBufLenByte: 0..1522, set at link in variant link-time / post-build in variant post-build / pre-compile in variant pre-compile  # Limits the maximum transmit buffer length (frame length) in bytes.
        integer EthRxBufTotal: 0..255, set at link in variant link-time / post-build in variant post-build / pre-compile in variant pre-compile  # Configures the number of receive buffers.
        integer EthTxBufTotal: 0..255, set at link in variant link-time / post-build in variant post-build / pre-compile in variant pre-compile  # Configures the number of transmit buffers.
        container EthDemEventParameterRefs [0..1]  # Container for the references to DemEventParameter elements which shall be invoked using the API Dem_ReportErrorStatus in case the corresponding error occurs. The EventId is taken from the referenced DemEventParameter's DemEventId value. The standardized errors are provided in the container and can be extended by vendor specific error references.
          symbolic name reference ETH_E_ACCESS [0..1]: set at link in variant link-time / post-build in variant post-build / pre-compile in variant pre-compile, destination=DemEventParameter  # Reference to the DemEventParameter which shall be issued when the error "Controller access failed" has occured.
    container EthGeneral  # General configuration of Ethernet Driver module
      boolean EthDevErrorDetect: set at pre-compile  # Enables / Disables development error detection.
      integer EthIndex: 0..255, set at pre-compile  # Specifies the InstanceId of this module instance. If only one instance is present it shall have the Id 0.
      integer EthMaxCtrlsSupported: 1..255, set at pre-compile  # Limits the total number of supported controllers.
      boolean EthUpdatePhysAddrFilter: set at pre-compile, default-value=false  # Enables/Disables optional API Eth_UpdatePhysAddrFilter.
      boolean EthVersionInfoApi: set at pre-compile  # Enables / Disables version info API
  module definition EthIf [0..1]: variants link-time/post-build/pre-compile  # Configuration of the EthIf (Ethernet Interface) module.
    container EthIfConfigSet: multiple-configuration-container=true  # Collecting container for all parameters with post-build configuration classes.
      container EthIfController [1..*]  # This container contains the configuration of EthIfController.
        integer EthIfCtrlIdx: 0..255, scope=ECU, set at link in variant link-time / post-build in variant post-build / pre-compile in variant pre-compile, symbolic-name-value=true  # This parameter provides a zero-based consecutive index of the Ethernet Communication Controllers. Upper layer BSW modules and the EthIf itself use this index to identify a Ethernet CC.
        integer EthIfCtrlMtu: 64..9000, scope=ECU, set at link in variant link-time / post-build in variant post-build / pre-compile in variant pre-compile  # Specifies the maximum transmission unit (MTU) of the EthIfCtrl in [bytes]. | Note: in case a VLAN tag is used for the EthIfCtrl, the MTU is 4 bytes smaller than the maximum payload size of an Ethernet frame which can be transmitted on the network.
        integer EthIfMaxTxBufsTotal: 1..255, set at pre-compile  # Limits the total number of transmit buffers.
        integer EthIfVlanId [0..1]: 0..4095, scope=ECU, set at link in variant link-time / post-build in variant post-build / pre-compile in variant pre-compile  # A virtual-LAN is identified by this attribute according to IEEE 802.1Q.
        symbolic name reference EthIfEthCtrlRef: scope=ECU, set at link in variant link-time / post-build in variant post-build / pre-compile in variant pre-compile, destination=EthCtrlConfig  # Reference to a Controller, which is handled by a specific Driver. This reference is unique for the ECU.
        symbolic name reference EthIfEthTrcvRef: scope=ECU, set at link in variant link-time / post-build in variant post-build / pre-compile in variant pre-compile, destination=EthTrcvConfig  # Reference to a Ethernet Transceiver.
      container EthIfFrameOwnerConfig [1..*]  # Configuration of Ethernet frame owner
        integer EthIfFrameType: 0..65535, set at link in variant link-time / post-build in variant post-build / pre-compile in variant pre-compile  # Selects the Ethernet frame type.
        integer EthIfOwner: 0..255, set at link in variant link-time / post-build in variant post-build / pre-compile in variant pre-compile  # Selects the owner of an Ethernet frame type. The owner is a zero based index into the callback function configuration 'EthIfRxIndicationConfig'. I.e. an Ethernet frame of type IPv4 (0x800) at index 0 will call the first callback function configured in 'EthIfRxIndicationConfig'.
      container EthIfRxIndicationConfig [1..*]  # Configuration of receive callback functions.
        function name EthIfRxIndicationFunction: set at link in variant link-time / post-build in variant post-build / pre-compile in variant pre-compile  # Specifies receive indication callback function.
      container EthIfTrcvLinkStateChgConfig [1..*]  # Specifies link state change callback function
        function name EthIfTrcvLinkStateChgFunction: set at link in variant link-time / post-build in variant post-build / pre-compile in variant pre-compile  # Specifies link state change callback function
      container EthIfTxConfirmationConfig [1..*]  # Configuration of transmit indication callback functions.
        function name EthIfTxConfirmationFunction: set at link in variant link-time / post-build in variant post-build / pre-compile in variant pre-compile  # Specifies transmit indication callback function
    container EthIfGeneral  # This container contains the general configuration parameters of the Ethernet Interface.
      boolean EthIfDevErrorDetect: set at pre-compile  # Enables / Disables development error detection.
      boolean EthIfEnableRxInterrupt: set at pre-compile  # Enables / Disables receive interrupt.
      boolean EthIfEnableTxInterrupt: set at pre-compile  # Enables / Disables the transmit interrupt.
      boolean EthIfGetBaudRate: set at pre-compile  # Enables / Disables GetBaudRate API.
      boolean EthIfGetCounterState: set at pre-compile  # Enables / Disables GetCounterState API.
      float EthIfMainFunctionPeriod: 0..Inf, set at pre-compile  # Specifies the period of main function EthIf_MainFunctionRx and EthIf_MainFunctionTx in seconds. Ethernet Interface does not require this information but the BSW scheduler.
      float EthIfMainFunctionRxTimeout: 0..Inf, set at pre-compile  # Timeout in seconds after which the EthIf stops to receive frames in an EthIfMainFunctionRx period.
      integer EthIfMaxTrcvsTotal: 1..255, set at pre-compile  # Limits the total number of transceivers.
      string EthIfPublicCddHeaderFile [0..*]: scope=ECU, set at pre-compile, max-length=32, min-length=1  # Defines header files for callback functions which shall be included in case of CDDs. Range of characters is 1.. 32.
      integer EthIfRxIndicationIterations: 0..65535, set at pre-compile  # Maximum number of Ethernet frames per Ethernet controller polled from the Ethernet driver within EthIf_MainFunctionRx.
      boolean EthIfStartAutoNegotiation: set at pre-compile  # Enables / Disables StartAutoNegotiation API.
      integer EthIfTrcvLinkStateChgMainReload: 1..255, set at pre-compile  # Specifies the frequency of transceiver link state change checks in each | period of main function EthIf_MainFunctionTx.
      boolean EthIfVersionInfoApi: set at pre-compile  # Enables / Disables version info API
      boolean EthIfVersionInfoApiMacro: set at pre-compile  # Enables / Disables version info API macro implementation.
  module definition EthSM [0..1]: variants pre-compile  # Configuration of the Ethernet State Manager
    container EthSMGeneral  # This container contains the global parameter of the Ethernet State Manager.
      boolean EthSMDevErrorDetect: set at pre-compile  # Enables and disables the development error detection and notification mechanism.
      boolean EthSMDummyMode: set at pre-compile  # Disables the API to the EthIf. The API to the ComM is available but the functionality is deactivated. The function calls from the ComM will be answered with the return value E_OK.
      float EthSMMainFunctionPeriod: 0.005..1, set at pre-compile  # Specifies the period in seconds that the MainFunction has to be triggered with.
      boolean EthSMVersionInfoApi: set at pre-compile  # Enables and disables the version info API.
    container EthSMNetwork [1..*]  # This container contains the Ethernet network-specific parameters of each Ethernet network. It also contains the controller and transceiver IDs assigned to a Ethernet network.
      float EthSMConfirmationTimeout [0..1]: 0..Inf, set at pre-compile  # Please note that this parameter is deprecated and will be removed in future. Tags: atp.Status=obsolete, atp.StatusRevisionBegin=4.1.3 | Timeout in seconds for the calls to EthIf: EthIf_ControllerInit EthIf_TransceiverInit EthIf_SetControllerMode EthIf_SetTransceiverMode This element is obsolete and will be removed in a future revision.
      symbolic name reference EthSMComMNetworkHandleRef: set at pre-compile, destination=ComMChannel  # Unique handle to identify one certain Ethernet network. Reference to one of the network handles configured for the ComM.
      symbolic name reference EthSMEthIfControllerRef: set at pre-compile, destination=EthIfController  # Reference to EthIfCtrl container where a ETH controller and | transceiver (optional) combination is configured.
      container EthSMDemEventParameterRefs [0..1]  # Container for the references to DemEventParameter elements which shall be invoked using the API Dem_ReportErrorStatus API in case the corresponding error occurs. The EventId is taken from the referenced DemEventParameter's DemEventId value. The standardized errors are provided in the container and can be extended by vendor specific error references.
        symbolic name reference ETHSM_E_LINK_DOWN [0..1]: set at pre-compile, destination=DemEventParameter  # Reference to configured DEM event to report bus off errors for this Eth network.
  module definition EthTrcv [0..*]: variants link-time/post-build/pre-compile  # Configuration of Ethernet Transceiver Driver module
    container EthTrcvConfigSet: multiple-configuration-container=true  # All underlying parameters may be part of a multiple configuration set.
      container EthTrcvConfig [1..*]  # Configuration of the individual transceiver
        boolean EthTrcvAutoNegotiationEnabled: set at link in variant link-time / post-build in variant post-build / pre-compile in variant pre-compile  # Specifies if Auto-Negotiation is enabled (TRUE) or disabled (FALSE) for determination of the Ethernet transceiver speed.
        integer EthTrcvCtrlIdx: 0..255, set at link in variant link-time / post-build in variant post-build / pre-compile in variant pre-compile  # Specifies the controller used for MII access to the transceiver
        enumeration EthTrcvDuplexMode: {ETHTRCV_DUPLEX_MODE_FULL, ETHTRCV_DUPLEX_MODE_HALF}, set at link in variant link-time / post-build in variant post-build / pre-compile in variant pre-compile  # Specifies the duplex mode of the Ethernet transceiver link if Auto-Negotiation is disabled. This parameter is ignored if Auto-Negotiation is enabled.
        integer EthTrcvIdx: 0..255, scope=ECU, set at link in variant link-time / post-build in variant post-build / pre-compile in variant pre-compile, symbolic-name-value=true  # Specifies the instance ID of the configured transceiver.
        integer EthTrcvMiiIdx: 0..255, set at link in variant link-time / post-build in variant post-build / pre-compile in variant pre-compile  # Specifies the transceiver index used for MII access to the transceiver
        enumeration EthTrcvSpeed: {TRCV_SPEED_10, TRCV_SPEED_100, TRCV_SPEED_1000}, set at link in variant link-time / post-build in variant post-build / pre-compile in variant pre-compile  # Specifies the speed of the Ethernet transceiver link in [MBit/s]. If AutoNegotiation is enabled this is the maximum speed advertised for Auto-Negotiation.
        container EthTrcvDemEventParameterRefs [0..1]  # Container for the references to DemEventParameter elements which shall be invoked using the API Dem_ReportErrorStatus API in case the corresponding error occurs. The EventId is taken from the referenced DemEventParameter's DemEventId value. The standardized errors are provided in the container and can be extended by vendor specific error references.
          symbolic name reference ETHTRCV_E_ACCESS [0..1]: set at link in variant link-time / post-build in variant post-build / pre-compile in variant pre-compile, destination=DemEventParameter  # Reference to the DemEventParameter which shall be issued when the error "Transceiver access failed" has occurred.
    container EthTrcvGeneral  # General configuration of Ethernet Transceiver Driver module
      boolean EthTrcvDevErrorDetect: set at pre-compile  # Enables / Disables development error detection
      boolean EthTrcvGetBaudRateApi: set at pre-compile  # Enables / Disables EthTrcv_GetBaudRate API
      boolean EthTrcvGetDuplexModeApi: set at pre-compile  # Enables / Disables EthTrcv_GetDuplexMode API
      boolean EthTrcvGetLinkStateApi: set at pre-compile  # Enables / Disables EthTrcv_GetLinkState API
      boolean EthTrcvGetTransceiverModeApi: set at pre-compile  # Enables / Disables EthTrcv_GetTransceiverMode API
      integer EthTrcvIndex: 0..255, set at pre-compile  # Specifies the InstanceId of this module instance. If only one instance is present it shall have the Id 0.
      integer EthTrcvMaxTrcvsSupported: 0..255, set at pre-compile, default-value=1
      boolean EthTrcvSetTransceiverModeApi: set at pre-compile  # Enables / Disables EthTrcv_SetTransceiverMode API
      boolean EthTrcvStartAutoNegotiationApi: set at pre-compile  # Enables / Disables EthTrcv_StartAutoNegotiation API
      boolean EthTrcvVersionInfoApi: set at pre-compile  # Enables / Disables version info API
      boolean EthTrcvVersionInfoApiMacro: set at pre-compile  # Enables / Disables version info API macro implementation
  module definition Fee [0..1]: variants pre-compile  # Configuration of the Fee (Flash EEPROM Emulation) module.
    container FeeBlockConfiguration [1..*]  # Configuration of block specific parameters for the Flash EEPROM Emulation module.
      integer FeeBlockNumber: 1..65534, scope=ECU, set at pre-compile, symbolic-name-value=true  # Block identifier (handle). | 0x0000 and 0xFFFF shall not be used for block numbers (see FEE006). Range: min = 2^NVM_DATASET_SELECTION_BITS max = 0xFFFF -2^NVM_DATASET_SELECTION_BITS Note: Depending on the number of bits set aside for dataset selection several other block numbers shall also be left out to ease implementation.
      integer FeeBlockSize: 1..65535, scope=ECU, set at pre-compile  # Size of a logical block in bytes.
      boolean FeeImmediateData: scope=ECU, set at pre-compile  # Marker for high priority data. | true: Block contains immediate data. false: Block does not contain immediate data.
      integer FeeNumberOfWriteCycles: 0..4294967295, set at pre-compile  # Number of write cycles required for this block.
      symbolic name reference FeeDeviceIndex: set at pre-compile, destination=FlsGeneral  # Device index (handle). | Range: 0 .. 254 (0xFF reserved for broadcast call to GetStatus function).
    container FeeGeneral  # Container for general parameters. These parameters are not specific to a block.
      boolean FeeDevErrorDetect: set at pre-compile  # Pre-processor switch to enable and disable development error detection. | true: Development error detection enabled. false: Development error detection disabled.
      integer FeeIndex [0..1]: 0..254, set at pre-compile  # This parameter is obsolete and will be removed in future. Tags: atp.Status=obsolete, atp.StatusRevisionBegin=4.1.1 | Specifies the InstanceId of this module instance. If only one instance is present it shall have the Id 0. This element is obsolete and will be removed in a future revision.
      float FeeMainFunctionPeriod: 1E-7..Inf, scope=ECU, set at pre-compile  # The period between successive calls to the main function in seconds.
      function name FeeNvmJobEndNotification [0..1]: set at pre-compile  # Mapped to the job end notification routine provided by the upper layer module (NvM_JobEndNotification).
      function name FeeNvmJobErrorNotification [0..1]: set at pre-compile  # Mapped to the job error notification routine provided by the upper layer module (NvM_JobErrorNotification).
      boolean FeePollingMode: set at pre-compile  # Pre-processor switch to enable and disable the polling mode for this module. | true: Polling mode enabled, callback functions (provided to FLS module) disabled. false: Polling mode disabled, callback functions (provided to FLS module) enabled.
      boolean FeeSetModeSupported: set at pre-compile  # Compiler switch to enable/disable the 'SetMode' functionality of the FEE module. | TRUE: SetMode functionality supported / code present, FALSE: SetMode functionality not supported / code not present. Note: This configuration setting has to be consistent with that of all underlying flash device drivers (configuration parameter FlsSetModeApi).
      boolean FeeVersionInfoApi: set at pre-compile  # Pre-processor switch to enable / disable the API to read out the modules version information. | true: Version info API enabled. false: Version info API disabled.
      integer FeeVirtualPageSize: 0..65535, set at pre-compile  # The size in bytes to which logical blocks shall be aligned.
    container FeePublishedInformation  # Additional published parameters not covered by CommonPublishedInformation container. | Note that these parameters do not have any configuration class setting, since they are published information.
      integer FeeBlockOverhead: 0..65535, set at published-information  # Management overhead per logical block in bytes. | Note: If the management overhead depends on the block size or block location a formula has to be provided that allows the configurator to calculate the management overhead correctly.
      float FeeMaximumBlockingTime [0..1]: 0..Inf, set at published-information  # This parameter is obsolete and will be removed in future. Tags: atp.Status=obsolete, atp.StatusRevisionBegin=4.1.1 | The maximum time the FEE module's API routines shall be blocked (delayed) by internal operations. Note: Internal operations in that case means operations that are not explicitly invoked from the upper layer module but need to be handled for proper operation of this module or the underlying memory driver. This element is obsolete and will be removed in a future revision.
      integer FeePageOverhead: 0..65535, set at published-information  # Management overhead per page in bytes. | Note: If the management overhead depends on the block size or block location a formula has to be provided that allows the configurator to calculate the management overhead correctly.
  module definition FiM [0..1]: variants post-build/pre-compile  # Configuration of the FiM (Function Inhibition Manager) module.
    container FiMConfigSet: multiple-configuration-container=true  # This container contains the configuration parameters and sub containers of the FiM module supporting multiple configuration sets. | This container is a MultipleConfigurationContainer, i.e. this container and its sub-containers exist once per configuration set.
      container FiMEventSummary [0..*]  # The summarized EventId definition record consists of a summarized event ID and a specific EventId. | This record means that a particular FID that has to be disabled in case of summarized event (defined above) is to be disabled in any of the specific events. A possible solution could be assigning events as summarized events along with a list of specific events. During the configuration process the summarized event substitutes the referenced single events. However, it is not outlined how this requirement is solved - whether by configuration process or by implementation within the FiM. The FiM configuration tool could also build up a suitable data structure for summarized events and deal with it in the FiM implementation.
        symbolic name reference FiMInputSumEventRef [1..*]: set at post-build in variant post-build / pre-compile in variant pre-compile, destination=DemEventParameter
        symbolic name reference FiMOutputSumEventRef: set at post-build in variant post-build / pre-compile in variant pre-compile, destination=FiMSummaryEventId
      container FiMFID [1..*]  # This container includes symbolic names of all FIDs.
        integer FiMFunctionId: 0..65535, scope=ECU, set at pre-compile, symbolic-name-value=true  # The configuration parameter is used as an ID which represents a functionality. FiMFunctionId is the unique identifier assigned during FIM configuration. | Implementation Type: FiM_FunctionIdType.
      container FiMInhibitionConfiguration [1..*]  # This container includes all configuration parameters concerning the relationship between event and FID.
        enumeration FiMInhInhibitionMask: {FIM_LAST_FAILED, FIM_NOT_TESTED, FIM_TESTED, FIM_TESTED_AND_FAILED}, set at post-build in variant post-build / pre-compile in variant pre-compile  # The configuration parameter is used to specify the inhibition mask for an event - FID relation.
        reference FiMInhFunctionIdRef: set at post-build in variant post-build / pre-compile in variant pre-compile, destination=FiMFID
        container FiMInhEventId  # The configuration parameter is used for an existing DEM event and summarized events as well.
          choice container FiMInhRefChoice
            container FiMInhChoiceDemRef [0..1]
              symbolic name reference FiMInhEventRef: destination=DemEventParameter
            container FiMInhChoiceSumRef [0..1]
              symbolic name reference FiMInhSumRef [1..*]: destination=FiMSummaryEventId
      container FiMSummaryEventId [0..*]  # This container defines the name of a summarized event.
        integer FiMEventSumId: 0..65535, set at post-build in variant post-build / pre-compile in variant pre-compile, symbolic-name-value=true  # The summarized EventId definition record defines the existence of a summarized event with a specific name. This summarized event can be referenced in the FiMEventSummary (as FiMSummaryEventId) and Inhibition configuration (as FiMInhEventId).
    container FiMGeneral
      boolean FiMDataFixed: set at pre-compile  # Enable or disable calibration of inhibit relations The scope of the parameter is to meet the requirement (FIM008) to have the option to calibrate inhibit data on the one hand side and also to provide the option to protect inhibit data for consistency reasons.
      boolean FiMDevErrorDetect: set at pre-compile  # This configuration parameter is used to switch on or to switch off the detection of development errors during development.
      boolean FiMEventUpdateTriggeredByDem: set at pre-compile  # This configuration parameter specifies the way FIM obtains status of EventIds. | TRUE: the DEM informs FIM about changes of event status, FALSE: the FIM polls event status from the DEM module either cyclically or on demand.
      integer FiMMaxEventFidLinks: 1..65535, set at pre-compile  # This configuration parameter specifies the total maximum number of links between EventIds and FIDs.
      integer FiMMaxEventsPerFid: 1..65535, set at pre-compile  # This configuration parameter specifies the maximum number of EventIds that can be linked to a single FID.
      integer FiMMaxFidsPerEvent: 1..65535, set at pre-compile  # This configuration parameter specifies the maximum number of FIDs that can be linked to a single event.
      integer FiMMaxSummaryEvents: 0..65535, set at pre-compile  # This configuration parameter specifies the maximum number of summarized events that can be configured.
      integer FiMMaxSummaryLinks: 0..65535, set at pre-compile  # This configuration parameter specifies the total maximum number of links between EventIds and summarized events.
      integer FiMMaxTotalLinks: 1..65535, set at pre-compile  # This configuration parameter specifies the total maximum number of links between EventIds and FIDs plus the number of links between EventIds and summarized events.
      float FiMTaskTime: 0..0.1, scope=ECU, set at pre-compile, origin=AUTOSAR_ECUC V1.0.0  # Allow to configure the time for the periodic cyclic task. Please note: This configuration value shall be equal to the value in the Basic Software Scheduler configuration of the RTE module. | The AUTOSAR configuration standard is to use SI units, so this parameter is defined as float value in seconds. DEM configuration tools must convert this float value to the appropriate value format for the use in the software implementation of DEM. min: A negative value is not allowed. max: FID must be set after a maximal time of 100ms after DEM status is set. upperMultiplicity: Exactly one TaskTime must be specified per configuration. lowerMultiplicity: Exactly one TaskTime must be specified per configuration.
      boolean FiMVersionInfoApi: set at pre-compile  # This configuration parameter is used to switch on or to switch off the API to get the version information.
  module definition Fls [0..*]: variants post-build/pre-compile  # Configuration of the Fls (internal or external flash driver) module. | Its multiplicity describes the number of flash drivers present, so there will be one container for each flash driver in the ECUC template. When no flash driver is present then the multiplicity is 0.
    container FlsConfigSet: multiple-configuration-container=true  # Container for runtime configuration parameters of the flash driver. | Implementation Type: Fls_ConfigType.
      integer FlsAcErase: 0..4294967295, set at post-build in variant post-build / pre-compile in variant pre-compile  # Address offset in RAM to which the erase flash access code shall be loaded. | Used as function pointer to access the erase flash access code.
      integer FlsAcWrite: 0..4294967295, set at post-build in variant post-build / pre-compile in variant pre-compile  # Address offset in RAM to which the write flash access code shall be loaded. | Used as function pointer to access the write flash access code.
      float FlsCallCycle: 0..1, set at post-build in variant post-build / pre-compile in variant pre-compile  # Cycle time of calls of the flash driver's main function (in seconds).
      enumeration FlsDefaultMode: {MEMIF_MODE_FAST, MEMIF_MODE_SLOW}, set at post-build in variant post-build / pre-compile in variant pre-compile, default-value=MEMIF_MODE_SLOW  # This parameter is the default FLS device mode after initialization. | Implementation Type: MemIf_ModeType.
      function name FlsJobEndNotification [0..1]: set at post-build in variant post-build / pre-compile in variant pre-compile  # Mapped to the job end notification routine provided by some upper layer module, typically the Fee module.
      function name FlsJobErrorNotification [0..1]: set at post-build in variant post-build / pre-compile in variant pre-compile  # Mapped to the job error notification routine provided by some upper layer module, typically the Fee module.
      integer FlsMaxReadFastMode: 0..4294967295, set at post-build in variant post-build / pre-compile in variant pre-compile  # The maximum number of bytes to read or compare in one cycle of the flash driver's job processing function in fast mode.
      integer FlsMaxReadNormalMode: 0..4294967295, set at post-build in variant post-build / pre-compile in variant pre-compile  # The maximum number of bytes to read or compare in one cycle of the flash driver's job processing function in normal mode.
      integer FlsMaxWriteFastMode: 0..4294967295, set at post-build in variant post-build / pre-compile in variant pre-compile  # The maximum number of bytes to write in one cycle of the flash driver's job processing function in fast mode.
      integer FlsMaxWriteNormalMode: 0..4294967295, set at post-build in variant post-build / pre-compile in variant pre-compile  # The maximum number of bytes to write in one cycle of the flash driver's job processing function in normal mode.
      integer FlsProtection: 0..4294967295, set at post-build in variant post-build / pre-compile in variant pre-compile  # Erase/write protection settings. Only relevant if supported by hardware.
      container FlsDemEventParameterRefs [0..1]  # Container for the references to DemEventParameter elements which shall be invoked using the Dem_ReportErrorStatus API in case the corresponding error occurs. The EventId is taken from the referenced DemEventParameter's DemEventId value. The standardized errors are provided in the container and can be extended by vendor specific error references.
        symbolic name reference FLS_E_COMPARE_FAILED [0..1]: set at post-build in variant post-build / pre-compile in variant pre-compile, destination=DemEventParameter  # Reference to the DemEventParameter which shall be issued when the error "Flash compare failed (HW)" has occurred.
        symbolic name reference FLS_E_ERASE_FAILED [0..1]: set at post-build in variant post-build / pre-compile in variant pre-compile, destination=DemEventParameter  # Reference to the DemEventParameter which shall be issued when the error "Flash erase failed (HW)" has occurred.
        symbolic name reference FLS_E_READ_FAILED [0..1]: set at post-build in variant post-build / pre-compile in variant pre-compile, destination=DemEventParameter  # Reference to the DemEventParameter which shall be issued when the error "Flash read failed (HW)" has occurred.
        symbolic name reference FLS_E_UNEXPECTED_FLASH_ID [0..1]: set at post-build in variant post-build / pre-compile in variant pre-compile, destination=DemEventParameter  # Reference to the DemEventParameter which shall be issued when the error "Expected hardware ID not matched" has occurred.
        symbolic name reference FLS_E_WRITE_FAILED [0..1]: set at post-build in variant post-build / pre-compile in variant pre-compile, destination=DemEventParameter  # Reference to the DemEventParameter which shall be issued when the error "Flash write failed (HW)" has occurred.
      container FlsExternalDriver [0..1]  # This container is present for external Flash drivers only. Internal Flash drivers do not use the parameter listed in this container, hence its multiplicity is 0 for internal drivers.
        symbolic name reference FlsSpiReference [1..*]: set at pre-compile, destination=SpiSequence  # Reference to SPI sequence (required for external Flash drivers).
      container FlsSectorList  # List of flashable sectors and pages.
        container FlsSector [1..*]  # Configuration description of a flashable sector
          integer FlsNumberOfSectors: 0..65535, set at pre-compile  # Number of continuous sectors with identical values for FlsSectorSize and | FlsPageSize. The parameter FlsSectorStartAddress denotes the start address of the first sector.
          integer FlsPageSize: 0..4294967295, set at pre-compile  # Size of one page of this sector. | Implementation Type: Fls_LengthType.
          integer FlsSectorSize: 0..4294967295, set at pre-compile  # Size of this sector. | Implementation Type: Fls_LengthType.
          integer FlsSectorStartaddress: 0..4294967295, set at pre-compile  # Start address of this sector. | Implementation Type: Fls_AddressType.
    container FlsGeneral  # Container for general parameters of the flash driver. These parameters are always pre-compile.
      boolean FlsAcLoadOnJobStart: set at pre-compile, default-value=false  # The flash driver shall load the flash access code to RAM whenever an erase or write job is started and unload (overwrite) it after that job has been finished or canceled. | true: Flash access code loaded on job start / unloaded on job end or error. false: Flash access code not loaded to / unloaded from RAM at all.
      integer FlsBaseAddress: 0..4294967295, set at pre-compile  # The flash memory start address (see also SWS_Fls_00208 and SWS_Fls_00209). | This parameter defines the lower boundary for read / write / erase and compare jobs.
      boolean FlsCancelApi: set at pre-compile  # Compile switch to enable and disable the Fls_Cancel function. | true: API supported / function provided. false: API not supported / function not provided
      boolean FlsCompareApi: set at pre-compile  # Compile switch to enable and disable the Fls_Compare function. | true: API supported / function provided. false: API not supported / function not provided
      boolean FlsDevErrorDetect: set at pre-compile, default-value=true  # Pre-processor switch to enable and disable development error detection. | true: Development error detection enabled. false: Development error detection disabled.
      integer FlsDriverIndex: 0..254, scope=ECU, set at pre-compile, symbolic-name-value=true  # Index of the driver, used by FEE.
      boolean FlsGetJobResultApi: set at pre-compile  # Compile switch to enable and disable the Fls_GetJobResult function. | true: API supported / function provided. false: API not supported / function not provided
      boolean FlsGetStatusApi: set at pre-compile  # Compile switch to enable and disable the Fls_GetStatus function. | true: API supported / function provided. false: API not supported / function not provided
      boolean FlsSetModeApi: set at pre-compile  # Compile switch to enable and disable the Fls_SetMode function. | true: API supported / function provided. false: API not supported / function not provided
      integer FlsTotalSize: 0..4294967295, set at pre-compile  # The total amount of flash memory in bytes (see also SWS_Fls_00208 and SWS_Fls_00209). | This parameter in conjunction with FLS_BASE_ADDRESS defines the upper boundary for read / write / erase and compare jobs.
      boolean FlsUseInterrupts: set at pre-compile, default-value=false  # Job processing triggered by hardware interrupt. | true: Job processing triggered by interrupt (hardware controlled). false: Job processing not triggered by interrupt (software controlled)
      boolean FlsVersionInfoApi: set at pre-compile  # Pre-processor switch to enable / disable the API to read out the modules version information. | true: Version info API enabled. false: Version info API disabled.
    container FlsPublishedInformation  # Additional published parameters not covered by CommonPublishedInformation container. | Note that these parameters do not have any configuration class setting, since they are published information.
      integer FlsAcLocationErase: 0..4294967295, set at published-information  # Position in RAM, to which the erase flash access code has to be loaded. | Only relevant if the erase flash access code is not position independent. If this information is not provided it is assumed that the erase flash access code is position independent and that therefore the RAM position can be freely configured.
      integer FlsAcLocationWrite: 0..4294967295, set at published-information  # Position in RAM, to which the write flash access code has to be loaded. | Only relevant if the write flash access code is not position independent. If this information is not provided it is assumed that the write flash access code is position independent and that therefore the RAM position can be freely configured.
      integer FlsAcSizeErase: 0..4294967295, set at published-information  # Number of bytes in RAM needed for the erase flash access code.
      integer FlsAcSizeWrite: 0..4294967295, set at published-information  # Number of bytes in RAM needed for the write flash access code.
      float FlsEraseTime: 0..Inf, set at published-information  # Maximum time to erase one complete flash sector.
      integer FlsErasedValue: 0..4294967295, set at published-information  # The contents of an erased flash memory cell.
      string FlsExpectedHwId: set at published-information  # Unique identifier of the hardware device that is expected by this driver (the device for which this driver has been implemented). | Only relevant for external flash drivers.
      integer FlsSpecifiedEraseCycles: 0..4294967295, set at published-information  # Number of erase cycles specified for the flash device (usually given in the device data sheet). | If the number of specified erase cycles depends on the operating environment (temperature, voltage, ...) during reprogramming of the flash device, the minimum number for which a data retention of at least 15 years over the temperature range from -40°C .. +125°C can be guaranteed shall be given. Note: If there are different numbers of specified erase cycles for different flash sectors of the device this parameter has to be extended to a parameter list (similar to the sector list above).
      float FlsWriteTime: 0..Inf, set at published-information  # Maximum time to program one complete flash page.
  module definition FlsTst [0..1]: variants post-build/pre-compile
    container FlsTstConfigSet: multiple-configuration-container=true  # Multiple Configuration Set Container
      integer FlsTstBlockNumberBgnd: 0..4294967295, set at post-build in variant post-build / pre-compile in variant pre-compile  # This parameter shall represent the number of test blocks available for the background test. | calculationFormula = Number of configured FlsTstBlocks in the FlsTstBlockBgndConfigSet (or 0 if no FlsTstBlocks are configured).
      integer FlsTstBlockNumberFgnd: 0..4294967295, set at post-build in variant post-build / pre-compile in variant pre-compile  # This parameter shall represent the number of test blocks available for the foreground test. | calculationFormula = Number of configured FlsTstBlocks in the FlsTstBlockFgndConfigSet (or 0 if no FlsTstBlocks are configured).
      function name FlsTstTestCompletedNotification: set at post-build in variant post-build / pre-compile in variant pre-compile  # Pointer to function, which shall be called after finishing the background Flash test interval.
      container FlsTstBlockBgndConfigSet [0..1]  # This container defines the blocks in background mode.
        container FlsTstBlock [1..*]  # This container specifies configuration parameters for an individual test block.
          integer FlsTstBlockBaseAddress: 0..18446744073709551615, set at post-build in variant post-build / pre-compile in variant pre-compile  # Start Address of the Flash block.
          integer FlsTstBlockIndex: 0..4294967295, set at post-build in variant post-build / pre-compile in variant pre-compile, symbolic-name-value=true  # Foreground Test: Index identifies block to be tested by FlsTst_StartFgnd(); | Background Test: The scheduling for background test shall follow an order defined by this index. '0' means highest priority.
          integer FlsTstBlockSize: 0..4294967295, set at post-build in variant post-build / pre-compile in variant pre-compile  # This parameter shall represent the Flash Test block size.
          integer FlsTstNumberOfTestedCells: 0..4294967295, set at pre-compile  # Configures the Number of cells to be tested in background mode during one scheduled task (FlsTst_MainFunction() call).
          integer FlsTstSignatureAddress: 0..18446744073709551615, set at post-build in variant post-build / pre-compile in variant pre-compile  # Address of the signature reference value of the Flash test block.
          enumeration FlsTstTestAlgorithm: {FLSTST_16BIT_CRC, FLSTST_32BIT_CRC, FLSTST_8BIT_CRC, FLSTST_CHECKSUM, FLSTST_DUPLICATED_MEMORY, FLSTST_ECC}, set at post-build in variant post-build / pre-compile in variant pre-compile  # This is the configuration of the test algorithm for foreground mode and background mode. The availability of algorithm is implementation specific.
      container FlsTstBlockFgndConfigSet [0..1]  # This container defines the blocks in foreground mode.
        container FlsTstBlock [1..*]  # This container specifies configuration parameters for an individual test block.
          integer FlsTstBlockBaseAddress: 0..18446744073709551615, set at post-build in variant post-build / pre-compile in variant pre-compile  # Start Address of the Flash block.
          integer FlsTstBlockIndex: 0..4294967295, set at post-build in variant post-build / pre-compile in variant pre-compile, symbolic-name-value=true  # Foreground Test: Index identifies block to be tested by FlsTst_StartFgnd(); | Background Test: The scheduling for background test shall follow an order defined by this index. '0' means highest priority.
          integer FlsTstBlockSize: 0..4294967295, set at post-build in variant post-build / pre-compile in variant pre-compile  # This parameter shall represent the Flash Test block size.
          integer FlsTstNumberOfTestedCells: 0..4294967295, set at pre-compile  # Configures the Number of cells to be tested in background mode during one scheduled task (FlsTst_MainFunction() call).
          integer FlsTstSignatureAddress: 0..18446744073709551615, set at post-build in variant post-build / pre-compile in variant pre-compile  # Address of the signature reference value of the Flash test block.
          enumeration FlsTstTestAlgorithm: {FLSTST_16BIT_CRC, FLSTST_32BIT_CRC, FLSTST_8BIT_CRC, FLSTST_CHECKSUM, FLSTST_DUPLICATED_MEMORY, FLSTST_ECC}, set at post-build in variant post-build / pre-compile in variant pre-compile  # This is the configuration of the test algorithm for foreground mode and background mode. The availability of algorithm is implementation specific.
    container FlsTstConfigurationOfOptApiServices
      boolean FlsTstGetCurrentStateApi: set at pre-compile, default-value=false  # Adds / removes the service FlsTst_GetCurrentState() from the code.
      boolean FlsTstGetErrorDetailsApi: set at pre-compile, default-value=false  # Adds / removes the service FlsTst_GetErrorDetails() from the code.
      boolean FlsTstGetTestResultBgndApi: set at pre-compile, default-value=false  # Adds / removes the service FlsTst_GetTestResultBgnd() from the code.
      boolean FlsTstGetTestResultFgndApi: set at pre-compile, default-value=false  # Adds / removes the service FlsTst_GetTestResultFgnd() from the code.
      boolean FlsTstGetTestSignatureBgndApi: set at pre-compile, default-value=false  # Adds / removes the service FlsTst_GetTestSignatureBgnd() from the code.
      boolean FlsTstGetTestSignatureFgndApi: set at pre-compile, default-value=false  # Adds / removes the service FlsTst_GetTestSignatureFgnd() from the code.
      boolean FlsTstStartFgndApi: set at pre-compile, default-value=false  # Adds / removes the service FlsTst_StartFgnd() from the code.
      boolean FlsTstSuspendResumeApi: set at pre-compile, default-value=false  # Adds / removes the services FlsTst_Suspend() and FlsTst_Resume() from the code.
      boolean FlsTstTestEccApi: set at pre-compile, default-value=false  # Adds / removes the service FlsTst_TestEcc() from the code.
      boolean FlsTstVersionInfoApi: set at pre-compile, default-value=false  # Adds / removes the service FlsTst_GetVersionInfo() from the code.
    container FlsTstDemEventParameterRefs [0..1]  # Container for the references to DemEventParameter elements which shall be invoked using the API Dem_ReportErrorStatus API in case the corresponding error occurs. The EventId is taken from the referenced DemEventParameter's DemEventId value. The standardized errors are provided in the container and can be extended by vendor specific error references.
      symbolic name reference FLSTST_E_FLSTST_FAILURE [0..1]: set at pre-compile, destination=DemEventParameter  # Reference to the DemEventParameter which shall be issued when the error "Flash Failure" has occurred.
    container FlsTstGeneral
      boolean FlsTstDevErrorDetect: set at pre-compile, default-value=false  # Switch for enabling the development error detection.
      integer FlsTstNumberOfTestedCellsAtomic: 0..4294967295, set at pre-compile  # Configures the Number of cells to be tested in background mode without checking user requests (Abort, Suspend).
      boolean FlsTstTestCompletedNotificationSupported: set at pre-compile, default-value=true  # Switch to indicate that the notification is supported.
      integer FlsTstTestIntervalIdEndValue: 0..4294967295, set at pre-compile  # Defines the end value of the Test Interval Id.
      boolean FlsTstTestResultSignature: set at pre-compile, default-value=false  # Configures the result of the test in background mode: | True: Test Result is a signature (see FlsTst155, FlsTst054) False: Test Result is ok/not ok (see FlsTst153, FlsTst042)
  module definition Fr [0..*]: variants post-build/pre-compile  # Configuration of the Fr (FlexRay driver) module.
    container FrGeneral  # General configuration (parameters) of the FlexRay Driver module.
      boolean FrBufferReconfig [0..1]: set at pre-compile  # Please note that the parameter is deprecated and will be removed in future. Tags: atp.Status=obsolete, atp.StatusRevisionBegin=4.1.3 | Old description: Enables or disables buffer reconfiguration at runtime. This element is obsolete and will be removed in a future revision.
      integer FrCtrlTestCount: 0..255, set at pre-compile, default-value=1  # Maxmimum number of iterations the FlexRay controller hardware test is performed during controller initialization.
      boolean FrDevErrorDetect: set at pre-compile  # Switches the Development Error Detection and Notification | on or off. true: Development Error Detection and Notification enabled. false: Development Error Detection and Notification disabled.
      boolean FrDisableLPduSupport: set at pre-compile  # Enables or disabled API function Fr_DisableLPdu.
      integer FrIndex: 0..255, set at pre-compile  # Specifies the InstanceId of this module instance. If only one instance is present it shall have the Id 0.
      integer FrNumCtrlSupported: 1..256, set at pre-compile  # Determines the maximum number of communication controllers that the driver supports.
      boolean FrPrepareLPduSupport: set at pre-compile  # Enables or disables API function Fr_PrepareLPdu.
      boolean FrReconfigLPduSupport: set at pre-compile  # Enables or disabled API function Fr_ReconfigLPdu.
      boolean FrRxStringentCheck: set at pre-compile, default-value=false  # If stringent check is enabled (true), received frames are accepted only if no slot status error occurred.
      boolean FrRxStringentLengthCheck: set at pre-compile, default-value=false  # If stringent check is enabled (true), received frames are accepted only if the received payload length matches the configured payload length.
      boolean FrVersionInfoApi: set at pre-compile  # Enables/disables the existence of the Fr_GetVersionInfo API.
    container FrMultipleConfiguration: multiple-configuration-container=true  # Configuration of the individual controllers.
      container FrController [1..*]  # Configuration of the individual controller.
        integer FrCtrlIdx: 0..255, set at post-build in variant post-build / pre-compile in variant pre-compile, symbolic-name-value=true  # Determines index of CC within Fr.
        boolean FrPAllowHaltDueToClock: set at post-build in variant post-build / pre-compile in variant pre-compile  # Boolean flag that controls the transition to the POC:halt state due to a clock synchronization errors. If set to true, the CC is allowed to transition to POC:halt. If set to false, the CC will not transition to the POC:halt state but will enter or remain in the POC:normal passive state (self healing would still be possible)
        integer FrPAllowPassiveToActive: 0..31, set at post-build in variant post-build / pre-compile in variant pre-compile  # Number of consecutive even/odd cycle pairs that must have valid clock correction terms before the CC will be allowed to transition from the POC:normal passive state to POC:normal active state. If set to zero, the CC is not allowed to transition from POC:normal passive to POC:normal active
        enumeration FrPChannels: {FR_CHANNEL_A, FR_CHANNEL_AB, FR_CHANNEL_B}, set at post-build in variant post-build / pre-compile in variant pre-compile  # Channels to which the node is connected. | Implementation Type: Fr_ChannelType
        integer FrPClusterDriftDamping: 0..20, set at post-build in variant post-build / pre-compile in variant pre-compile  # Local cluster drift damping factor used for rate correction [Microticks]. | Remark: Upper limit 10 for FlexRay Protocol 3.0 compliance.
        integer FrPDecodingCorrection: 12..143, set at post-build in variant post-build / pre-compile in variant pre-compile  # Value used by the receiver to calculate the difference between primary time reference point and secondary time reference point [Microticks]. | Remark: Lower limit 14 for FlexRay Protocol 2.1 Rev. A compliance. Upper limit 136 for FlexRay Protocol 3.0 compliance.
        integer FrPDelayCompensationA: 0..211, set at post-build in variant post-build / pre-compile in variant pre-compile  # Value used to compensate for reception delays on the indicated channel. This covers assumed propagation delay up to cPropagationDelayMax for microticks in the range of 0.0125us to 0.05us [Microticks]. | Remark: Lower limit 4 for FlexRay Protocol 3.0 compliance. Remark: Upper limit 200 for FlexRay Protocol 2.1 Rev A compliance.
        integer FrPDelayCompensationB: 0..211, set at post-build in variant post-build / pre-compile in variant pre-compile  # Value used to compensate for reception delays on the indicated channel. This covers assumed propagation delay up to cPropagationDelayMax for microticks in the range of 0.0125us to 0.05us [Microticks]. | Remark: Lower limit 4 for FlexRay Protocol 3.0 compliance. Remark: Upper limit 200 for FlexRay Protocol 2.1 Rev A compliance.
        boolean FrPExternalSync: set at post-build in variant post-build / pre-compile in variant pre-compile  # Flag indicating whether the node is externally synchronized (operating as time gateway sink in an TT-E cluster) or locally synchronized. | If FrPExternalSync is set to 'true' then FrPTwoKeySlotMode must also be set to 'true'. Remarks: Set to 'false' for FlexRay Protocol 2.1 Rev. A compliance.
        boolean FrPFallBackInternal: set at post-build in variant post-build / pre-compile in variant pre-compile  # Flag indicating whether a time gateway sink node will switch to local clock operation when synchronization with the time gateway source node is lost (FrPFallBackInternal = true) or will instead go to POC:ready (FrPFallBackInternal =false). | Remarks: Set to 'false' for FlexRay Protocol 2.1 Rev. A compliance.
        integer FrPKeySlotId: 0..1023, set at post-build in variant post-build / pre-compile in variant pre-compile  # ID of the key slot, i.e., the slot used to transmit the startup frame, sync frame, or designated key slot frame. If this parameter is set to zero the node does not have a key slot. | For Fr3.0: if the value is not provided in System Description it shall be configured to 0. For Fr2.1: if the value is not provided in System Description it is driver implementation specific which value to configure.
        boolean FrPKeySlotOnlyEnabled: set at post-build in variant post-build / pre-compile in variant pre-compile  # Flag indicating whether or not the node shall enter key slot only mode following startup. | Remarks: This parameter maps to FlexRay Protocol 2.1 Rev. A parameter pSingleSlotEnabled.
        boolean FrPKeySlotUsedForStartup: set at post-build in variant post-build / pre-compile in variant pre-compile  # Flag indicating whether the key slot is used to transmit a startup frame. | If FrPKeySlotUsedForStartup is set to true then FrPKeySlotUsedForSync must also be set to true. If FrPTwoKeySlotMode is set to true then both FrPKeySlotUsedForSync and FrPKeySlotUsedForStartup must also be set to true.
        boolean FrPKeySlotUsedForSync: set at post-build in variant post-build / pre-compile in variant pre-compile  # Flag indicating whether the key slot is used to transmit a sync frame. | If FrPKeySlotUsedForStartup is set to true then FrPKeySlotUsedForSync must also be set to true. If FrPTwoKeySlotMode is set to true then both FrPKeySlotUsedForSync and FrPKeySlotUsedForStartup must also be set to true.
        integer FrPLatestTx: 0..7988, set at post-build in variant post-build / pre-compile in variant pre-compile  # Number of the last minislot in which a frame transmission can start in the dynamic segment. | Remark: Upper limit 7980 for FlexRay Protocol 2.1 Rev A compliance.
        integer FrPMacroInitialOffsetA: 2..68, set at post-build in variant post-build / pre-compile in variant pre-compile  # Integer number of macroticks between the static slot boundary and the following macrotick boundary of the secondary time reference point based on the nominal macrotick duration [Macroticks].
        integer FrPMacroInitialOffsetB: 2..68, set at post-build in variant post-build / pre-compile in variant pre-compile  # Integer number of macroticks between the static slot boundary and the following macrotick boundary of the secondary time reference point based on the nominal macrotick duration [Macroticks].
        integer FrPMicroInitialOffsetA: 0..239, set at post-build in variant post-build / pre-compile in variant pre-compile  # Number of microticks between the secondary time reference point | and the macrotick boundary immediately following the secondary time reference point. The parameter depends on FrPDelayCompensationA and therefore it has to be set independently for each channel [Microticks].
        integer FrPMicroInitialOffsetB: 0..239, set at post-build in variant post-build / pre-compile in variant pre-compile  # Number of microticks between the secondary time reference point | and the macrotick boundary immediately following the secondary time reference point. The parameter depends on FrPDelayCompensationB and therefore it has to be set independently for each channel [Microticks].
        integer FrPMicroPerCycle: 640..1280000, set at post-build in variant post-build / pre-compile in variant pre-compile  # Nominal number of microticks in the communication cycle of the local node. If nodes have different microtick durations this number will differ from node to node [Microticks]. | Remark: Lower limit 960 for FlexRay Protocol 3.0 compliance. Upper limit 640000 for FlexRay Protocol 2.1 Rev A compliance.
        boolean FrPNmVectorEarlyUpdate: set at post-build in variant post-build / pre-compile in variant pre-compile  # Flag indicating when the update of the Network Management Vector | in the CHI shall take place. If FrPNmVectorEarlyUpdate is set to false, the update shall take place after the NIT. If FrPNmVectorEarlyUpdate is set to true, the update shall take place after the end of the static segment. Remarks: Set to 'false' for FlexRay Protocol 2.1 Rev. A compliance.
        integer FrPOffsetCorrectionOut: 13..16082, set at post-build in variant post-build / pre-compile in variant pre-compile  # Magnitude of the maximum permissible offset correction value [Microticks]. Remark: Upper limit 15567 for FlexRay Protocol 2.1 Rev A compliance. Remark: Lower limit 15 for FlexRay Protocol 3.0 compliance.
        integer FrPOffsetCorrectionStart: 7..15999, set at post-build in variant post-build / pre-compile in variant pre-compile  # Start of the offset correction phase within the NIT, expressed as the number of macroticks from the start of cycle [Macroticks]. | Remark: This parameter maps to FlexRay Protocol 2.1 Rev. A parameter gOffsetCorrectionStart. Remark: Lower limit 9 for FlexRay Protocol 2.1 Rev A compliance.
        integer FrPPayloadLengthDynMax: 0..127, set at post-build in variant post-build / pre-compile in variant pre-compile  # Maximum payload length for dynamic frames [16 bit words].
        integer FrPRateCorrectionOut: 2..3846, set at post-build in variant post-build / pre-compile in variant pre-compile  # Magnitude of the maximum permissible rate correction value and the maximum drift offset between two nodes operating with unsynchronized clocks for one communication cycle [Microticks]. | Remarks: This parameter maps to FlexRay Protocol 2.1 Rev. A parameter pdMaxDrift. Lower limit 3 for FlexRay Protocol 3.0 compliance. Upper limit 1923 for FlexRay Protocol 2.1 Rev A compliance.
        enumeration FrPSamplesPerMicrotick: {N1SAMPLES, N2SAMPLES, N4SAMPLES}, set at post-build in variant post-build / pre-compile in variant pre-compile  # Number of samples per microtick. Remark: Allowed range N1SAMPLES, N2SAMPLES for FlexRay Protocol 3.0 compliance.
        integer FrPSecondKeySlotId: 0..1023, set at post-build in variant post-build / pre-compile in variant pre-compile  # ID of the second key slot, in which a second startup frame shall be sent when operating as a coldstart node in a TT-L or TT-D cluster. If this parameter is set to zero the node does not have a second key slot. | Remark: Set to 0 for FlexRay Protocol 2.1 Rev A compliance.
        boolean FrPTwoKeySlotMode: set at post-build in variant post-build / pre-compile in variant pre-compile  # Flag indicating whether node operates as a coldstart node in a TT-E or TT-L cluster. | If pTwoKeySlotMode is set to true then both pKeySlotUsedForSync and pKeySlotUsedForStartup must also be set to true. If pExternalSync is set to true then pTwoKeySlotMode must also be set to true. Remark: Set to false for FlexRay Protocol 2.1 Rev A compliance.
        enumeration FrPWakeupChannel: {FR_CHANNEL_A, FR_CHANNEL_B}, set at post-build in variant post-build / pre-compile in variant pre-compile  # Channel used by the node to send a wakeup pattern. | FrPWakeupChannel must be selected from among the channels configured by FrPChannels.
        integer FrPWakeupPattern: 0..63, set at post-build in variant post-build / pre-compile in variant pre-compile  # Number of repetitions of the wakeup symbol that are combined to form a wakeup pattern when the node enters the POC:wakeup send state. | Remark: Lower limit 2 for FlexRay Protocol 2.1 Rev A compliance.
        integer FrPdAcceptedStartupRange: 0..2743, set at post-build in variant post-build / pre-compile in variant pre-compile  # Expanded range of measured clock deviation allowed for startup frames during integration [Microticks]. | Remark: Upper limit 1875 for FlexRay Protocol 2.1 Rev A compliance. Remark: Lower limit 29 for FlexRay Protocol 3.0 compliance.
        integer FrPdListenTimeout: 1284..2567692, set at post-build in variant post-build / pre-compile in variant pre-compile  # Value for the startup listen timeout and wakeup listen timeout. Although this is a node local parameter, the real time equivalent of this value should be the same for all nodes in the cluster [Microticks]. | Remark: Lower limit 1926 for FlexRay Protocol 3.0 compliance. Upper limit 1283846 for FlexRay Protocol 2.1 Rev. A compliance.
        enumeration FrPdMicrotick: {T100NS, T12_5NS, T200NS, T25NS, T50NS}, set at post-build in variant post-build / pre-compile in variant pre-compile  # Duration of a microtick. | Remark: Allowed range T12_5NS, T25NS, T50NS for FlexRay Protocol 3.0 compliance.
        container FrAbsoluteTimer [1..*]  # Specifies the absolute timer configuration parameters of the Fr.
          integer FrAbsTimerIdx: 0..254, set at post-build in variant post-build / pre-compile in variant pre-compile, symbolic-name-value=true  # Contains the index of an absolute timer contained in Fr on a certain FlexRay CC.
        container FrControllerDemEventParameterRefs [0..1]  # Container for the references to DemEventParameter elements which shall be invoked using the API Dem_ReportErrorStatus API in case the corresponding error occurs. The EventId is taken from the referenced DemEventParameter's DemEventId value. The standardized errors are provided in the container and can be extended by vendor specific error references.
          symbolic name reference FR_E_CTRL_TESTRESULT [0..1]: set at post-build in variant post-build / pre-compile in variant pre-compile, destination=DemEventParameter  # Reference to DEM event Id that is reported for FlexRay | controller hardware test failure. If this parameter is not configured, no event reporting happens.
        container FrFifo [0..*]  # One First In First Out (FIFO) queued receive structure, defining the admittance criteria to the FIFO, and mandating the ability to admit messages into the FIFO based on Message Id filtering criteria.
          boolean FrAdmitWithoutMessageId: set at post-build in variant post-build / pre-compile in variant pre-compile  # Determines whether or not frames received in the dynamic segment that don't contain a message ID will be admitted into the FIFO.
          integer FrBaseCycle: 0..63, set at post-build in variant post-build / pre-compile in variant pre-compile  # FIFO cycle counter acceptance criteria.
          enumeration FrChannels: {FR_CHANNEL_A, FR_CHANNEL_AB, FR_CHANNEL_B}, set at post-build in variant post-build / pre-compile in variant pre-compile  # FIFO channel admittance criteria.
          integer FrCycleRepetition: 1..64, set at post-build in variant post-build / pre-compile in variant pre-compile  # FIFO cycle counter acceptance criteria. Valid values are 1,2,4,5,8,10,16,20,32,40,50,64. | Remark: Values 1,2,4,8,16,32,64 are valid only for FlexRay Protocol 2.1 Rev A compliance.
          integer FrFifoDepth: 1..2048, set at post-build in variant post-build / pre-compile in variant pre-compile  # FrFifoDepth configures the maximum number of rx-frames which can be contained in the FIFO.
          integer FrMsgIdMask: 0..65535, set at post-build in variant post-build / pre-compile in variant pre-compile  # FIFO message identifier acceptance criteria (Mask filter).
          integer FrMsgIdMatch: 0..65535, set at post-build in variant post-build / pre-compile in variant pre-compile  # FIFO message identifier acceptance criteria (Match filter).
          container FrRange [1..*]  # FIFO Frame Id range acceptance criteria.
            integer FrRangeMax: 0..2047, set at post-build in variant post-build / pre-compile in variant pre-compile  # Last FrameId of this range that will be accepted by the FIFO.
            integer FrRangeMin: 0..2047, set at post-build in variant post-build / pre-compile in variant pre-compile  # First FrameId of this range that will be accepted by the FIFO.
  module definition FrArTp [0..1]: variants post-build/pre-compile  # Configuration of the FrArTp (FlexRay Transport Protocol) module.
    container FrArTpGeneral  # This container contains the general configuration (parameters) of the FlexRay TP.
      integer FrArTpChanNum [0..1]: 1..32, set at pre-compile  # This reference is deprecated and will be removed in a future release. Tags: atp.Status=obsolete, atp.StatusRevisionBegin=4.1.1 | Old description: Preprocessor switch for defining the number of concurrent channels the module supports. Up to 32 channels shall be definable here. This element is obsolete and will be removed in a future revision.
      boolean FrArTpDevErrorDetect: set at pre-compile  # Preprocessor switch for enabling development error detection.
      boolean FrArTpHaveAckRt: set at pre-compile  # Preprocessor switch for enabling the Acknowledgement and retry mechanisms.
      boolean FrArTpHaveGrpSeg: set at pre-compile  # Preprocessor switch for enabling segmentation of 1:n messages.
      boolean FrArTpHaveLm: set at pre-compile  # Preprocessor switch for enabling the mechanism for message longer than allowed by.
      boolean FrArTpHaveTc: set at pre-compile  # Preprocessor switch for enabling Transmit Cancellation and Receive Cancellation.
      float FrArTpMainFuncCycle: 0..1.024, scope=ECU, set at post-build in variant post-build / pre-compile in variant pre-compile  # This parameter contains the calling period of the TPs Main Function. The parameter is specified in seconds.
      boolean FrArTpVersionInfoApi: set at pre-compile  # Preprocessor switch for enabling the Version info API.
    container FrArTpMultipleConfig: multiple-configuration-container=true  # This container holds one or several multiple configuration sets.
      container FrArTpChannel [1..*]: post-build-changeable=true  # This container contains the configuration (parameters) of one FlexRay TP channel.
        enumeration FrArTpAckType: {FRARTP_ACK_WITHOUT_RT, FRARTP_ACK_WITH_RT, FRARTP_NO}, set at post-build in variant post-build / pre-compile in variant pre-compile  # This parameter defines the type of acknowledgement which is used for the specific channel.
        enumeration FrArTpAdrType: {FRARTP_OB, FRARTP_TB}, set at post-build in variant post-build / pre-compile in variant pre-compile  # This parameter states the addressing type this connection has. The meanings of the values are one byte and two byte.
        integer FrArTpChannelId [0..1]: 0..255, scope=ECU, set at post-build in variant post-build / pre-compile in variant pre-compile, symbolic-name-value=true  # Please note that this parameter is deprecated and will be removed in a future release. Tags: atp.Status=obsolete, atp.StatusRevisionBegin=4.1.1 | Old description: The Id of the channel. This element is obsolete and will be removed in a future revision.
        integer FrArTpConNum [0..1]: 0..65535, set at post-build in variant post-build / pre-compile in variant pre-compile  # Please note that this parameter is deprecated and will be removed in a future release. Tags: atp.Status=obsolete, atp.StatusRevisionBegin=4.1.1 | Old description: This parameter states the number of connections used in this channel. At least 256 shall be configurable here. This element is obsolete and will be removed in a future revision.
        integer FrArTpConcurrentConnections [0..1]: 0..255, set at post-build in variant post-build / pre-compile in variant pre-compile, default-value=0  # This parameter defines the number of connections that can be active at the same time. If set to 0, all configured connections can be active at the same time.
        boolean FrArTpGrpSeg: set at post-build in variant post-build / pre-compile in variant pre-compile  # Here can be specified, whether segmentation within a 1:n connection is allowed or not.
        enumeration FrArTpLm: {FRARTP_ISO, FRARTP_ISO6, FRARTP_L4G}, set at post-build in variant post-build / pre-compile in variant pre-compile  # This specifies the maximum message length for the particular channel.
        integer FrArTpMaxAr: 0..255, set at post-build in variant post-build / pre-compile in variant pre-compile  # This parameter defines the maximum number of trying to send a frame when a TIMEOUT AR occurs.
        integer FrArTpMaxAs: 0..255, set at post-build in variant post-build / pre-compile in variant pre-compile  # This parameter defines the maximum number of trying to send a frame when a TIMEOUT AS occurs.
        integer FrArTpMaxBs: 0..255, set at post-build in variant post-build / pre-compile in variant pre-compile  # This parameter defines the number of consecutive CFs between two FCs (block size). Valid values are 1 .. 16 when retry is activated, and 0 .. 255 otherwise.
        integer FrArTpMaxBufReq [0..1]: 0..255, set at post-build in variant post-build / pre-compile in variant pre-compile  # Please note that this parameter is deprecated and will be removed in a future release. Tags: atp.Status=obsolete, atp.StatusComment=FrArTpMaxWft will be used instead to configure the maximum number of wait frames on receiver side. On the sender side, timeCs defines the maximum time for retries., atp.StatusRevisionBegin=4.1.1 | FrArTpMaxWft will be used instead to configure the maximum number of wait frames on receiver side. On the sender side, timeCs defines the maximum time for retries. Old description: This parameter defines the maximum number of times the FrArTp should send a wait frame FC(WT). It is also used to limit the number of retries for PduR_FrArTpCopyTxData and PduR_FrArTpCopyRxData when no timer is active. This element is obsolete and will be removed in a future revision.
        integer FrArTpMaxFrIf [0..1]: 0..255, set at post-build in variant post-build / pre-compile in variant pre-compile  # Please note that this parameter is deprecated and will be removed in the future. Tags: atp.Status=obsolete, atp.StatusRevisionBegin=4.1.2 | Old description: This parameter defines the maximum number of trying to send a frame when the FrIf returns an error. This element is obsolete and will be removed in a future revision.
        integer FrArTpMaxRn: 0..255, set at post-build in variant post-build / pre-compile in variant pre-compile  # This parameter defines the maximum number of retries (if retry is configured for the particular channel).
        integer FrArTpMaxWft [0..1]: 0..255, set at post-build in variant post-build / pre-compile in variant pre-compile  # This parameter defines the maximal number of wait frames to be sent for a pending connection.
        float FrArTpStMin: 0..0.127, set at post-build in variant post-build / pre-compile in variant pre-compile  # This parameter defines the minimum amount of time between two succeeding CFs of a 1:1 segmented transmission in seconds. Valid values are 0, 100µs, 200µs .. 900µs, 1ms, 2ms .. 127ms. The value can be changed at runtime using the FrArTp_ChangeParameter interface. | FrArTpStMin must be an integer multiple of the cycle length multiplied with the multiplexing factor, i.e. FrArTpStMin = n * FrIfGdCycle * m, where n is an integer >= 0 and m is the cycle multiplexor of those cycles where PDUs of the PDU pool are scheduled. Please note: Due to the scheduling strategies of FrArTp, FrArTpStMin can only be kept to a degree defined by the maximum temporal distance of the PDUs of a PDU pool within one FlexRay cycle.
        float FrArTpStMinGrpSeg [0..1]: 0..0.127, set at post-build in variant post-build / pre-compile in variant pre-compile  # This parameter defines the minimum amount of time between two succeeding CFs of a 1:n segmented transmission in seconds. Valid values are 0, 100µs, 200µs ... 900µs, 1ms, 2ms .. 127ms. The value can be changed at runtime using the FrArTp_ChangeParameter interface. | FrArTpStMinGrpSeg must be an integer multiple of the cycle length multiplied with the multiplexing factor, i.e. FrArTpStMinGrpSeg = n * FrIfGdCycle * m, where n is an integer >= 0 and m is the cycle multiplexor of those cycles where PDUs of the PDU pool are scheduled. Please note: Due to the scheduling strategies of FrArTp, FrArTpStMinGrpSeg can only be kept to a degree defined by the maximum temporal distance of the PDUs of a PDU pool within one FlexRay cycle.
        boolean FrArTpTc: set at post-build in variant post-build / pre-compile in variant pre-compile, default-value=false  # With this switch Transmit Cancellation and Receive Cancellation can be turned on or off for this channel.
        float FrArTpTimeBr: 0..65.535, set at post-build in variant post-build / pre-compile in variant pre-compile  # This parameter defines the time in seconds between receiving the last CF of a block or an FF-x (or SF-x) and sending out an FC or AF. | It is obvious that FRARTP_TIME_BR + (FRARTP_TIMEOUT_AR * FRARTP_MAX_AR) < FRARTP_TIMEOUT_BS must hold (because the transmission duration on the bus has also to be considered). This parameter is defined in ISO 15765-2. It is contained in the configuration as a performance requirement.
        float FrArTpTimeBuffer [0..1]: 0..0.255, set at post-build in variant post-build / pre-compile in variant pre-compile  # Please note that this parameter is deprecated and will be removed in a future release. Tags: atp.Status=obsolete, atp.StatusComment=FrArTpTimeBr will be used instead to configure the delay between two wait frames (and thus two buffer requests) on receiver side. On sender side, the main task cycle will be used., atp.StatusRevisionBegin=4.1.1 | FrArTpTimeBr will be used instead to configure the delay between two wait frames (and thus two buffer requests) on receiver side. On sender side, the main task cycle will be used. Old description: This parameter defines the time in seconds of waiting for the next try to get a Tx or Rx buffer. This element is obsolete and will be removed in a future revision.
        float FrArTpTimeCs: 0..65.535, set at post-build in variant post-build / pre-compile in variant pre-compile  # This parameter defines the time in seconds between the sending of two consecutive CFs or between reception of an FC or AF and sending of the next CF . | It is obvious that FRARTP_TIME_CS + (FRARTP_TIMEOUT_AS * FRARTP_MAX_AS) < FRARTP_TIMEOUT_CR must hold (because the transmission duration on the bus has also to be considered). This parameter is defined in ISO 15765-2. It is contained in the configuration as a performance requirement.
        float FrArTpTimeFrIf [0..1]: 0..0.255, set at post-build in variant post-build / pre-compile in variant pre-compile  # Please note that this parameter is deprecated and will be removed in the future. Tags: atp.Status=obsolete, atp.StatusRevisionBegin=4.1.2 | Old description: This parameter defines the time in seconds of waiting for the next try to send via FrIf_Transmit. This element is obsolete and will be removed in a future revision.
        float FrArTpTimeoutAr: 0..65.535, set at post-build in variant post-build / pre-compile in variant pre-compile  # This parameter states the timeout in seconds between the PDU transmit request of the Transport Layer to the FlexRay Interface and the corresponding confirmation of the FlexRay Interface on the receiver side (for FC or AF).
        float FrArTpTimeoutAs: 0..65.535, set at post-build in variant post-build / pre-compile in variant pre-compile  # This parameter states the timeout in seconds between the PDU transmit request for the first PDU of the group used in the current connection of the Transport Layer to the FlexRay Interface and the corresponding confirmation of the FlexRay Interface (when having sent the last PDU of the | group used in this connection) on the sender side (SF-x, FF-x, CF).
        float FrArTpTimeoutBs: 0..65.535, set at post-build in variant post-build / pre-compile in variant pre-compile  # This parameter defines the timeout in seconds for waiting for an FC or AF on the sender side in a 1:1 connection.
        float FrArTpTimeoutCr: 0..65.535, set at post-build in variant post-build / pre-compile in variant pre-compile  # This parameter defines the timeout value in seconds for waiting for a CF or FF-x (in case of retry) after receiving the last CF or after sending an FC or AF on the receiver side.
        boolean FrArTpUsePduFc [0..1]: set at post-build in variant post-build / pre-compile in variant pre-compile  # Please note that this parameter is deprecated and will be removed in a future release. Tags: atp.Status=obsolete, atp.StatusComment=This element has been rendered irrelevant by the introduction of PDU pools., atp.StatusRevisionBegin=4.1.1 | It has been rendered irrelevant by the introduction of PDU pools. Old description: This switch defines, whether within this channel the dedicated FC/ACK PDU (FrArTpPduFc) shall be used or not. If this is not used FC / ACK frames are sent using the normal IDs, otherwise only FrArTpPduFc shall be used for sending / receiving FC / ACK frames. This element is obsolete and will be removed in a future revision.
        container FrArTpConnection [1..*]: post-build-changeable=true  # This container contains the configuration (parameters) of one FlexRay TP connection. | A connection can only belong to one channel.
          integer FrArTpConPrioPdus [0..1]: 0..255, set at post-build in variant post-build / pre-compile in variant pre-compile, default-value=0  # This parameter defines the number of TxNPdus to which this connection has prioritized access. It must be ensured that the number of prioritized PDUs of all connections is smaller than the total number of TxNPdus in the associated PDU pool.
          integer FrArTpLa: 0..65535, set at post-build in variant post-build / pre-compile in variant pre-compile  # This parameter defines the Local Address for the respective connection. | When the local instance is the sender, this is the Source Address within the TP frame. When the local instance is the receiver, this is the Target Address within the TP frame. Note that in case of 1 byte addressing only the values from 0x0000 - 0x00FF are valid.
          boolean FrArTpMultRec: set at post-build in variant post-build / pre-compile in variant pre-compile  # This parameter defines, whether this connection is an 1:1 ('false') or an 1:n ('true') connection. | Of course, if the channel to which the connection is configured has retry or acknowledgement enabled, no retry or acknowledgement will occur in case the connection is an 1:n connection.
          integer FrArTpRa: 0..65535, set at post-build in variant post-build / pre-compile in variant pre-compile  # This parameter defines the Remote Address for the respective connection. | When the local instance is the sender, this is the Target Address within the TP frame. When the local instance is the receiver, this is the Source Address within the TP frame. Note that in case of 1 byte addressing only the values from 0x0000 - 0x00FF are valid.
          reference FrArTpConPduRef [0..*]: set at post-build in variant post-build / pre-compile in variant pre-compile, destination=FrArTpPdu  # This reference is deprecated and will be removed in a future release. | It has been rendered irrelevant by the introduction of PDU pools. Old description: Each value defines a PDU to be used for this connection. Thus each value is a PDU-ID given in FrArTpPdu and this array cannot be longer than the array FrArTpPdu. Please note: Only PDUs of the same size shall be used within a connection. Of course the PDU having the TxConfirmation configured has to be used by every connection. This element is obsolete and will be removed in a future revision.
          container FrArTpRxSdu [0..1]: post-build-changeable=true  # Describes the Rx SDU
            integer FrArTpSduRxId: 0..65535, scope=ECU, set at post-build in variant post-build / pre-compile in variant pre-compile, symbolic-name-value=true  # This is a unique identifier for a received message. This Id is used in the CancelReceive and ChangeParameter API call. | ImplementationType: PduIdType
            reference FrArTpRxSduRef: set at post-build in variant post-build / pre-compile in variant pre-compile, destination=Pdu  # Reference to a PDU in the global PDU structure.
          container FrArTpTxSdu [0..1]: post-build-changeable=true  # Describes the Tx SDU
            integer FrArTpSduTxId: 0..65535, scope=ECU, set at post-build in variant post-build / pre-compile in variant pre-compile, symbolic-name-value=true  # This is a unique identifier for a received or a to be transmitted message. With this (and by means of e.g. a lookup table) the PDU Router can route the message appropriately without dealing with the particularities of the Transport Layer. This parameter can also be seen as the identifier of a connection. | ImplementationType: PduIdType
            reference FrArTpTxSduRef: set at post-build in variant post-build / pre-compile in variant pre-compile, destination=Pdu  # Reference to a PDU in the global PDU structure.
        container FrArTpPdu [1..*]: post-build-changeable=true  # Container to hold the PDU parameters. | ImplementationType: PduInfoType
          enumeration FrArTpPduDirection: {FRARTP_RX, FRARTP_TX}, set at post-build in variant post-build / pre-compile in variant pre-compile  # This parameter defines the direction of the PDU.
          integer FrArTpPduId: 0..65535, scope=ECU, set at post-build in variant post-build / pre-compile in variant pre-compile, symbolic-name-value=true  # This is the identifier of the FlexRay Interface PDUs (Fr N-PDU, Fr L-SDU) in which the Transport Layer Frames of this channel should be transmitted. | For FrArTpPduDirection == FRARTP_RX, this parameter specifies the ID that is used by FrIf when calling FrArTp_RxIndication, while for FrArTpPduDirection == FRARTP_TX this ID is used by FrIf when calling FrArTp_TxConfirmation or FrArTp_TriggerTransmit. ImplementationType: PduIdType
          reference FrArTpPduRef: set at post-build in variant post-build / pre-compile in variant pre-compile, destination=Pdu
        container FrArTpPduFc [0..2]  # Please note that this container with all references and parameters is deprecated and will be removed in the next major version. It has been rendered irrelevant by the introduction of PDU pools. | Old description: This is the identifier of the FlexRay Interface PDUs (Fr N-PDU, Fr L-SDU) in which the Transport Layer Flow Control and Acknowledgement Frames of this channel should be transmitted. ImplementationType: PduInfoType
          enumeration FrArTpPduFcDirection: {FRARTP_FC_RX, FRARTP_FC_TX}, set at post-build in variant post-build / pre-compile in variant pre-compile  # This parameter defines the direction of the PDU. Tags: atp.Status=obsolete, atp.StatusRevisionBegin=4.1.1 | This parameter is deprecated and will be removed in the next major version. This element is obsolete and will be removed in a future revision.
          integer FrArTpPduFcId: 0..65536, scope=ECU, set at post-build in variant post-build / pre-compile in variant pre-compile, symbolic-name-value=true  # This is the identifier of the FlexRay Interface PDUs (Fr N-PDU, Fr L-SDU) in which the Transport Layer Flow Control and Acknowledgement Frames of this channel should be transmitted. Tags: atp.Status=obsolete, atp.StatusRevisionBegin=4.1.1 | This parameter is deprecated and will be removed in the next major version. This element is obsolete and will be removed in a future revision.
          reference FrArTpPduFcRef: set at post-build in variant post-build / pre-compile in variant pre-compile, destination=Pdu  # This reference is deprecated and will be removed in the next major version.
