[part 1 of 5: package /AUTOSAR/EcucDefs]
AUTOSAR XML (schema 4-0-2)
# The material contained in this specification is protected by copyright and
# other types of Intellectual Property Rights. The commercial exploitation of
# the material contained in this specification requires a license to such
# Intellectual Property Rights.
# This specification may be utilized or reproduced without any modification, in
# any form or by any means, for informational purposes only.
# For any other purpose, no part of the specification may be utilized or
# reproduced, in any form or by any means, without permission in writing from
# the publisher.
# licensed under the same rules as applicable to the AUTOSAR Standard.
package /AUTOSAR/EcucDefs
  ecuc definition collection AUTOSARParameterDefinition: module=[Adc, BswM, Cal, Can, CanIf, CanNm, CanSM, CanTp, CanTrcv, Cdd, Com, ComM, CorTst, Crc, Csm, Dbg, Dcm, Dem, Det, Dio, Dlt, Ea, EcuC, EcuM, Eep, Eth, EthIf, EthSm, EthTrcv, Fee, FiM, Fls, FlsTst, Fr, FrIf, FrNm, FrSM, FrTp, FrTrcv, Gpt, Icu, IpduM, J1939Tp, Lin, LinIf, LinNm, LinSM, LinTp, LinTrcv, Mcu, MemIf, MemMap, Nm, NvM, Os, PduR, Port, Pwm, RamTst, Rte, SoAd, Spi, StbM, UdpNm, Wdg, WdgIf, WdgM, Xcp]
  module definition Adc [0..1]: variants post-build/pre-compile  # Configuration of the Adc (Analog Digital Conversion) module.
    container AdcConfigSet: multiple-configuration-container=true  # This is the base container that contains the post-build selectable configuration parameters
      container AdcHwUnit [1..*]  # This container contains the Driver configuration (parameters) depending on grouping of channels | This container could contain HW specific parameters which are not defined in the Standardized Module Definition. They must be added in the Vendor Specific Module Definition.
        enumeration AdcClockSource [0..1]: set at post-build in variant post-build / pre-compile in variant pre-compile  # The ADC module specific clock input for the conversion unit can | statically be configured to select different clock sources if provided by hardware. Enumeration literals are defined vendor specific.
        enumeration AdcHwUnitId: set at post-build in variant post-build / pre-compile in variant pre-compile  # Description: Numeric ID of the HW Unit. This symbolic name allows accessing Hw Unit data. Enumeration literals are defined vendor specific.
        integer AdcPrescale [0..1]: 0..65535, set at post-build in variant post-build / pre-compile in variant pre-compile  # Optional ADC module specific clock prescale factor, if supported by hardware. | ImplementationType: Adc_PrescaleType
        container AdcChannel [1..*]  # This container contains the channel configuration (parameters) depending on the hardware capability. | The organization of this data structure could contain dependencies to the microcontroller so this is left up to the implementer and its location is left up to the configuration. Note: Since a AdcChannel can be part of several AdcGroups, this container is not realized as a subcontainer of AdcGroup but instead as a subcontainer of AdcHwUnit.
          integer AdcChannelConvTime [0..1]: 0..18446744073709551615, set at post-build in variant post-build / pre-compile in variant pre-compile  # Configuration of conversion time, i.e. the time during which the analogue value is converted into digital representation, (in clock cycles) for each channel, if supported by hardware. | ImplementationType: Adc_ConversionTimeType
          integer AdcChannelHighLimit [0..1]: 0..18446744073709551615, set at pre-compile  # High limit - used for limit checking.
          integer AdcChannelId: 0..1024, set at post-build in variant post-build / pre-compile in variant pre-compile  # This parameter defines the assignment of the channel to the physical ADC hardware channel. | ImplementationType: Adc_ChannelType
          boolean AdcChannelLimitCheck [0..1]: set at pre-compile  # Enables or disables limit checking for an ADC channel.
          integer AdcChannelLowLimit [0..1]: 0..18446744073709551615, set at pre-compile  # Low limit - used for limit checking.
          enumeration AdcChannelRangeSelect [0..1]: {ADC_RANGE_ALWAYS, ADC_RANGE_BETWEEN, ADC_RANGE_NOT_BETWEEN, ADC_RANGE_NOT_OVER_HIGH, ADC_RANGE_NOT_UNDER_LOW, ADC_RANGE_OVER_HIGH, ADC_RANGE_UNDER_LOW}, set at pre-compile  # In case of active limit checking: defines which conversion values are taken into account related to the boarders defined with AdcChannelLowLimit and AdcChannelHighLimit. | Implementation Type: Adc_ChannelRangeSelectType
          enumeration AdcChannelRefVoltsrcHigh [0..1]: set at post-build in variant post-build / pre-compile in variant pre-compile  # Upper reference voltage source for each channel. | Enumeration literals are defined vendor specific.
          enumeration AdcChannelRefVoltsrcLow [0..1]: set at post-build in variant post-build / pre-compile in variant pre-compile  # Lower reference voltage source for each channel. | Enumeration literals are defined vendor specific.
          integer AdcChannelResolution [0..1]: 1..63, set at post-build in variant post-build / pre-compile in variant pre-compile  # Channel resolution in bits. | ImplementationType: Adc_ResolutionType
          integer AdcChannelSampTime [0..1]: 0..18446744073709551615, set at post-build in variant post-build / pre-compile in variant pre-compile  # Configuration of sampling time, i.e. the time during which the value is sampled, (in clock cycles) for each channel, if supported by hardware. | ImplementationType: Adc_SamplingTimeType
        container AdcGroup [1..*]  # This container contains the Group configuration (parameters).
          enumeration AdcGroupAccessMode: {ADC_ACCESS_MODE_SINGLE, ADC_ACCESS_MODE_STREAMING}, set at post-build in variant post-build / pre-compile in variant pre-compile  # Type of access mode to group conversion results. | ImplementationType: Adc_GroupAccessModeType
          enumeration AdcGroupConversionMode: {ADC_CONV_MODE_CONTINUOUS, ADC_CONV_MODE_ONESHOT}, set at post-build in variant post-build / pre-compile in variant pre-compile  # Type of conversion mode supported by the driver. | ImplementationType: Adc_GroupConvModeType
          integer AdcGroupId: 0..1023, set at post-build in variant post-build / pre-compile in variant pre-compile, symbolic-name-value=true  # Numeric ID of the group. This parameter is the symbolic name to be used on the API. This symbolic name allows accessing Channel Group data. This value will be assigned to the symbolic name derived of the AdcGroup container shortName. | ImplementationType: Adc_GroupType
          integer AdcGroupPriority [0..1]: 0..255, set at post-build in variant post-build / pre-compile in variant pre-compile  # Priority level of the AdcGroup. | ImplementationType: Adc_GroupPriorityType
          enumeration AdcGroupReplacement [0..1]: {ADC_GROUP_REPL_ABORT_RESTART, ADC_GROUP_REPL_SUSPEND_RESUME}, set at post-build in variant post-build / pre-compile in variant pre-compile  # Replacement mechanism, which is used on ADC group level, if a group conversion is interrupted by a group which has a higher priority. | ImplementationType: Adc_GroupReplacementType
          enumeration AdcGroupTriggSrc: {ADC_TRIGG_SRC_HW, ADC_TRIGG_SRC_SW}, set at post-build in variant post-build / pre-compile in variant pre-compile  # Type of source event that starts a group conversion. | ImplementationType: Adc_TriggerSourceType
          enumeration AdcHwTrigSignal [0..1]: {ADC_HW_TRIG_BOTH_EDGES, ADC_HW_TRIG_FALLING_EDGE, ADC_HW_TRIG_RISING_EDGE}, set at post-build in variant post-build / pre-compile in variant pre-compile  # Configures on which edge of the hardware trigger signal the driver should react, i.e. start the conversion (only if supported by the ADC hardware). | ImplementationType: Adc_HwTriggerSignalType
          integer AdcHwTrigTimer [0..1]: 0..18446744073709551615, set at post-build in variant post-build / pre-compile in variant pre-compile  # Reload value of the ADC module embedded timer (only if supported by ADC hardware). | ImplementationType: Adc_HwTriggerTimerType
          function name AdcNotification [0..1]: set at post-build in variant post-build / pre-compile in variant pre-compile  # Callback function for each group
          enumeration AdcStreamingBufferMode: {ADC_STREAM_BUFFER_CIRCULAR, ADC_STREAM_BUFFER_LINEAR}, set at post-build in variant post-build / pre-compile in variant pre-compile  # Configure streaming buffer as "linear buffer" (i.e. the ADC Driver stops the conversion as soon as the stream buffer is full) or as "ring buffer" (wraps around if the end of the stream buffer is reached). | ImplementationType: Adc_StreamBufferModeType
          integer AdcStreamingNumSamples: 1..255, set at post-build in variant post-build / pre-compile in variant pre-compile, default-value=1  # Number of ADC values to be acquired per channel in streaming access mode. | Note: in single access mode this parameter assumes value 1, since only one sample per channel is processed. ImplementationType: Adc_StreamNumSampleType
          reference AdcGroupDefinition [1..*]: set at post-build in variant post-build / pre-compile in variant pre-compile, destination=AdcChannel  # Assignment of AdcChannels to a AdcGroups. | ImplementationType: Adc_GroupDefType
    container AdcGeneral  # General configuration (parameters) of the ADC Driver software module.
      boolean AdcDeInitApi: set at pre-compile  # Adds / removes the service Adc_DeInit() from the code. | true: Adc_DeInit() can be used. false: Adc_DeInit() can not be used.
      boolean AdcDevErrorDetect: set at pre-compile  # Switches the Development Error Detection and Notification ON or OFF. | true: Enabled. false: Disabled.
      boolean AdcEnableLimitCheck: set at pre-compile  # Enables or disables limit checking feature in the ADC driver.
      boolean AdcEnableQueuing: set at pre-compile  # Determines, if the queuing mechanism is active in case of priority mechanism disabled. | Note: If priority mechanism is enabled, queuing mechanism is always active and the parameter ADC_ENABLE_QUEUING is not evaluated. true: Enabled. false: Disabled.
      boolean AdcEnableStartStopGroupApi: set at pre-compile  # Adds / removes the services Adc_StartGroupConversion() and Adc_StopGroupConversion() from the code. | true: Adc_StartGroupConversion() and Adc_StopGroupConversion() can be used. false: Adc_StartGroupConversion() and Adc_StopGroupConversion() can not be used.
      boolean AdcGrpNotifCapability: set at pre-compile  # Determines, if the group notification mechanism (the functions to enable and disable the notifications) is available at runtime. | true: Enabled. false: Disabled.
      boolean AdcHwTriggerApi: set at pre-compile  # Adds / removes the services Adc_EnableHardwareTrigger() and Adc_DisableHardwareTrigger() from the code. | true: Adc_EnableHardwareTrigger() and Adc_DisableHardwareTrigger() can be used. false: Adc_EnableHardwareTrigger() and Adc_DisableHardwareTrigger() can not be used.
      enumeration AdcPriorityImplementation: {ADC_PRIORITY_HW, ADC_PRIORITY_HW_SW, ADC_PRIORITY_NONE}, set at pre-compile  # Determines whether a priority mechanism is available for prioritization of the conversion requests and if available, the type of prioritization mechanism. The selection applies for groups with trigger source software and trigger source hardware. Two | types of prioritization mechanism can be selected. The hardware prioritization mechanism (AdcPriorityHw) uses the ADC hardware features for prioritization of the software conversion requests and hardware trigger signals for groups with trigger source hardware. The mixed hardware and software prioritization mechanism (AdcPriorityHwSw) uses the ADC hardware features for prioritization of ADC hardware trigger for groups with trigger source hardware and a software implemented prioritization mechanism for groups with trigger source software. The group priorities for software triggered groups are typically configured with lower priority levels than the group priorities for hardware triggered groups. ImplementationType: Adc_PriorityImplementationType
      boolean AdcReadGroupApi: set at pre-compile  # Adds / removes the service Adc_ReadGroup() and from the code. | true: Adc_ReadGroup() can be used. false: Adc_ReadGroup() can not be used.
      enumeration AdcResultAlignment: {ADC_ALIGN_LEFT, ADC_ALIGN_RIGHT}, set at pre-compile  # Alignment of ADC raw results in ADC result buffer (left/right alignment). | Implementation Type: Adc_ResultAlignmentType
      boolean AdcVersionInfoApi: set at pre-compile  # Adds / removes the service Adc_GetVersionInfo() from the code. | true: Adc_GetVersionInfo() can be used. false: Adc_GetVersionInfor() can not be used.
    container AdcPublishedInformation  # Additional published parameters not covered by CommonPublishedInformation container. | Note that these parameters do not have any configuration class setting, since they are published information.
      boolean AdcChannelValueSigned: set at published-information  # Information whether the result value of the ADC driver has sign information (true) or not (false). If the result shall be interpreted as signed value it shall apply to C-language rules.
      boolean AdcGroupFirstChannelFixed: set at published-information  # Information whether the first channel of an ADC Channel group can be configured (false) or is fixed (true) to a value determined by the ADC HW Unit.
      integer AdcMaxChannelResolution: 1..63, set at published-information  # Maximum Channel resolution in bits (does not specify accuracy).
  module definition BswM [0..1]: variants link-time/pre-compile  # Configuration of the BswM (Basic SW Mode Manager) module.
    container BswMConfig: multiple-configuration-container=true  # This container contains the configuration parameters and sub containers of the AUTOSAR BswM module. This container is a MultipleConfigurationContainer, i.e. this container and its sub-containers exist once per configuration set.
      container BswMArbitration [0..1]  # This container includes all configuration sub-containers and parameters related to the mode arbitration functionality of the BswM.
        container BswMLogicalExpression [0..*]  # This container describes the logical expressions that can be used for the mode arbitration. The logical expressions are built of a set of arguments and a logical operator. | Each argument can either be a mode condition or a sub-expression to allow definition of more complex logical expressions. There may be an unlimited number of arguments in each logical expression. Note that the order of evaluation of the expressions is not defined.
          enumeration BswMLogicalOperator [0..1]: {BSWM_AND, BSWM_NAND, BSWM_OR, BSWM_XOR}, set at link in variant link-time / pre-compile in variant pre-compile  # This parameter specifies the logical operator to be used in the logical expression. If the expression only consists of a single condition this parameter shall not be used.
          choice reference BswMArgumentRef [1..*]: set at link in variant link-time / pre-compile in variant pre-compile, destination=[BswMLogicalExpression, BswMModeCondition]  # This is a choice reference either to a mode condition or a sub-expression.
        container BswMModeCondition [0..*]  # This container describes the BswM mode conditions that can be used either by itself to form a rule or as a part of a logical expression.
          enumeration BswMConditionType: {BSWM_EQUALS, BSWM_EQUALS_NOT}, set at link in variant link-time / pre-compile in variant pre-compile  # This parameter specifies what kind of comparison that is made for the evaluation of the mode condition.
          reference BswMConditionMode: set at link in variant link-time / pre-compile in variant pre-compile, destination=BswMModeRequestPort  # This parameter references the mode request port that is used for the condition.
          choice container BswMConditionValue  # This container holds the parameters and references necessary to identify the mode type and the value that the mode request is compared to.
            container BswMBswMode  # This container defines the value and type of a mode in the BSW.
              enumeration BswMBswModeSourceType: {BSWM_CANSM_INDICATION, BSWM_COMM_INDICATION, BSWM_DCM_COM_REQUEST, BSWM_DCM_RESET_REQUEST, BSWM_DCM_SESSION_REQUEST, BSWM_ECUM_INDICATION, BSWM_ECUM_WAKEUP_SOURCE, BSWM_ETHSM_INDICATION, BSWM_FRSM_INDICATION, BSWM_GENERIC_REQUEST, BSWM_LINSM_INDICATION, BSWM_LINTP_MODE_REQUEST, BSWM_LIN_SCHEDULE_INDICATION, BSWM_NvM_REQUEST, BSWM_WDGM_REQUEST_PARTITION_RESET}, set at link in variant link-time / pre-compile in variant pre-compile  # This parameter specifies the type of mode request.
              string BswMBswRequestedMode: set at link in variant link-time / pre-compile in variant pre-compile  # This parameter contains the symbolic name (as a string) of a certain mode/state that can be requested/indicated by the BSW modules.
            container BswMSwcMode  # When the mode corresponds to a mode request or mode indication interface the mode is defined by a mode declaration. The mode declarations are defined in the SW-C Template and hence a foreign reference to the corresponding Mode Declaration is used.
              enumeration BswMSwcConditionType: {BSWM_SWC_MODE_NOTIFICATION, BSWM_SWC_MODE_REQUEST}, set at link in variant link-time / pre-compile in variant pre-compile  # This parameter defines if the condition relates to a mode request or a mode indication.
              foreign reference BswMSwcModeDeclRef: set at link in variant link-time / pre-compile in variant pre-compile, destination-type=MODE-DECLARATION  # This is a foreign reference to the Mode Declaration used for the mode requests corresponding to this condition.
        container BswMModeRequestPort [0..*]  # Each instance of this container defines a mode request interface that is used to requests or indicate modes from/to the BswM. These interfaces are implemented as ports or as ordinary C-functions based upon if the request is made by an SW-C or a BSW module. | There are different types of mode requests: 1. Mode requests from the SW-C:s 2. Mode Requests from other BSW modules such as the DCM. 3. State/mode indications from the RTE or other BSW modules such as the bus specific State Managers. Note that the BswM treats all request and indications in the exact same way.
          string BswMModeInitValue [0..1]: set at link in variant link-time / pre-compile in variant pre-compile  # This parameter defines the initial mode value that is used by BswM for the corresponding mode request after initialization. This parameter is optional and shall only be used for Mode Requests that does not already have an initial value.
          boolean BswMReqModeUndefAfterInit: set at link in variant link-time / pre-compile in variant pre-compile, default-value=false  # This parameter defines how a request shall be treated after reset/initialization. If this parameter is set to true the requested mode is undefined after initialization of BswM. The requested mode will remain undefined until the requester performs a request. | Mode arbitration rules shall not be evaluated as long as any of the used mode requests are undefined. If this parameter is set to false the configured BswMModeInitValue shall be used for rule evaluation.
          enumeration BswMRequestProcessing: {BSWM_DEFERRED, BSWM_IMMEDIATE}, set at link in variant link-time / pre-compile in variant pre-compile  # This parameter defines if the processing of the mode arbitration shall be done immediately when a mode request is received or if it shall be deferred to the processing of the main function of BswM.
          choice container BswMModeRequestSource  # This choice container specifies the source of the mode request or state/mode indication. The requester of a mode can be both SW-C:s and other BSW Modules, such as the bus specific State Managers.
            container BswMCanSMIndication [0..1]  # This is an indication of the current state of the CAN State Manager.
              symbolic name reference BswMCanSMChannelRef: set at link in variant link-time / pre-compile in variant pre-compile, destination=CanSMManagerNetwork  # This is a reference to the CAN channel handle that the mode request corresponds to.
            container BswMComMIndication [0..1]  # This is an indication of the current communication mode of a channel in the Communication Manager.
              symbolic name reference BswMComMChannelRef: set at link in variant link-time / pre-compile in variant pre-compile, destination=ComMChannel  # This is a reference to the Communication Manager channel handle that the indication corresponds to.
            container BswMDcmComModeRequest [0..1]  # The source of the mode request is the Diagnostic Communication Manager.
              string BswMDcmComMNetwork: set at link in variant link-time / pre-compile in variant pre-compile  # This parameter specifies the network the request relates to.
            container BswMDcmResetModeRequest [0..1]  # This is a reset mode request from the DCM. This container does not contain any parameters since there are no further configuration needed for this type of request.
            container BswMDcmSessionModeRequest [0..1]  # This is a session mode request from the DCM. This container does not contain any parameters since there are no further configuration needed for this type of request.
            container BswMEcuMIndication [0..1]  # This is a notification of the current operation mode of the ECU State Manager. This container does not contain any parameters since there are no further configuration needed for this type of request.
            container BswMEcuMWakeupSource [0..1]  # This is a notification of the current state of an ECU State Manager wakeup source.
              symbolic name reference BswMEcuMWakeupSrcRef: set at link in variant link-time / pre-compile in variant pre-compile, destination=EcuMWakeupSource  # This is a reference to the ECU State Manager Wakeup Source that the indication corresponds to.
            container BswMEthSMIndication [0..1]  # This is an indication of the current state of the Ethernet State Manager.
              symbolic name reference BswMEthSMChannelRef: set at link in variant link-time / pre-compile in variant pre-compile, destination=EthSmNetwork  # This is a reference to the Ethernet channel handle that the mode request corresponds to.
            container BswMFrSMIndication [0..1]  # This is an indication of the current state of the FlexRay State Manager.
              symbolic name reference BswMFrSMChannelRef: set at link in variant link-time / pre-compile in variant pre-compile, destination=FrSMCluster  # This is a reference to the FlexRay Cluster handle that the mode request corresponds to.
            container BswMGenericRequest [0..1]  # This mode request originates from a requester that is not among the list of standardized mode requesters (i.e. the different resource managers).
              integer BswMModeRequesterId: 0..65535, set at link in variant link-time / pre-compile in variant pre-compile  # This parameters identifies the different users of the generic mode request interface.
              integer BswMRequestedModeMax: 0..65535, set at link in variant link-time / pre-compile in variant pre-compile  # This parameter defines the upper limit for the modes requested by this mode requester.
            container BswMLinSMIndication [0..1]  # This is an indication of the current state of the LIN State Manager.
              symbolic name reference BswMLinSMChannelRef: set at link in variant link-time / pre-compile in variant pre-compile, destination=LinSMChannel  # This is a reference to the LIN channel handle that the mode request corresponds to.
            container BswMLinScheduleIndication [0..1]  # This is an indication of the currently active LIN Schedule Table for a specific LIN Interface.
              symbolic name reference BswMLinScheduleRef: set at link in variant link-time / pre-compile in variant pre-compile, destination=LinSMSchedule  # This is a reference to the LIN Schedule Table handle that the mode request corresponds to.
            container BswMLinTpModeRequest [0..1]  # This is a LinTp mode request from the LinIf. This port corresponds to a call of the BswM_LinTp_RequestMode API.
              symbolic name reference BswMLinTpChannelRef: set at link in variant link-time / pre-compile in variant pre-compile, destination=LinIfChannel  # This is a reference to the LIN Interface Channel that the mode | request corresponds to.
            container BswMNvMRequest [0..1]  # This is a mode request for a NvM Block
              symbolic name reference BswMNvMBlockRef: set at link in variant link-time / pre-compile in variant pre-compile, destination=NvMBlockDescriptor  # This is a reference to the NvM Block Descriptor that the request corresponds to.
            container BswMSwcModeNotification [0..1]  # This is a mode switch notification associated with a RTE switch interface.
              foreign reference BswMSwcModeNotificationIfcRef: set at link in variant link-time / pre-compile in variant pre-compile, destination-type=MODE-DECLARATION-GROUP-PROTOTYPE  # This is a foreign reference to the Mode Request Interface that the Mode Switch Notification corresponds to. The Mode Request Interface is specified in the SW Component Template and shall have a Mode Declaration Group as a Data Element
            container BswMSwcModeRequest [0..1]  # The source of the mode request is a SW Component.
              foreign reference BswMSwcModeRequestPortRef: set at link in variant link-time / pre-compile in variant pre-compile, destination-type=PORT-PROTOTYPE  # This is a foreign reference to the PortPrototype of the BswServiceComponent. This PortProtype shall be connected to the requesting SoftwareComponentPrototype's PortPrototype. The PortPrototype is specified in the SW Component Template.
            container BswMWdgMRequestPartitionReset [0..1]  # This is a Partition Reset request from from the WdgM. This port | corresponds to a call of the BswM_WdgM_RequestPartitionReset API.
              reference BswMWdgMRequestPartitionResetRef: set at link in variant link-time / pre-compile in variant pre-compile, destination=EcucPartition  # This is a reference to the partition that shall be reset.
        container BswMRule [0..*]  # Each instance of this container describes a BswM arbitration rule. The rule either consists of a simple mode condition or a more complex logical expression. This container also references the action lists that shall be invoked when the rule is evaluated to True or False.
          enumeration BswMRuleInitState: {BSWM_FALSE, BSWM_TRUE, BSWM_UNDEFINED}, set at link in variant link-time / pre-compile in variant pre-compile  # This parameter is a part of the reset/initialization behavior of BswM. | Action lists are executed when the result of a rule evaluation have changed since the last evaluation. This parameter defines the "previous evaluation result" of a rule to be used after initialization of the BswM. If this parameter is set to BSWM_UNDEFINED, the evaluation result is always treated as changed at the first evaluation of the rule after initialization. If this parameter is set to BSWM_TRUE, the evaluation result is treated as changed if the rule is evaluated to false. If this parameter is set to BSWM_FALSE, the evaluation result is treated as changed if the rule is evaluated to true.
          reference BswMRuleExpressionRef: set at link in variant link-time / pre-compile in variant pre-compile, destination=BswMLogicalExpression  # This choice reference either references the mode condition or the logical expression that is evaluated for each rule.
          reference BswMRuleFalseActionList [0..1]: set at link in variant link-time / pre-compile in variant pre-compile, destination=BswMActionList  # This is a reference to the action list that shall be executed when the rule is evaluated to False
          reference BswMRuleTrueActionList [0..1]: set at link in variant link-time / pre-compile in variant pre-compile, destination=BswMActionList  # This is a reference to the action list that shall be executed when the rule is evaluated to True
      container BswMModeControl [0..1]  # This container includes all configuration sub-containers and parameters related to the mode control functionality of the BswM.
        container BswMAction [0..*]  # Each container of this type defines an action. These actions can be part of one or several action lists.
          choice container BswMAvailableActions  # Choice container including the available actions to be used in the action lists.
            container BswMComMAllowCom [0..1]  # This container includes all parameters for the action to allow or to block communication for a ComM Channel. ComM_CommunicationAllowed is called when this action is configured.
              boolean BswMComAllowed: set at link in variant link-time / pre-compile in variant pre-compile  # The parameter BswMComMAllowChannelRef referes to a channel which will allow or block communication using the function ComM_CommunicationAllowed().
              symbolic name reference BswMComMAllowChannelRef: set at link in variant link-time / pre-compile in variant pre-compile, destination=ComMChannel  # This is a reference to the ComM Channel for which communication shall be allowed or blocked.
            container BswMComMModeLimitation [0..1]  # This container includes all parameters related to a limitation of communication mode for a ComM Channel. ComM_LimitChannelToNoComMode is called when this action is configured.
              boolean BswMComMLimitMode: set at link in variant link-time / pre-compile in variant pre-compile  # The function ComM_LimitChannelToNoComMode() takes in this boolean parameter to limit the channel's com mode to no-com mode.
              symbolic name reference BswMComMLimitChannelRef: set at link in variant link-time / pre-compile in variant pre-compile, destination=ComMChannel  # This is a reference to the ComM channel for which the communication mode should be limited.
            container BswMComMModeSwitch [0..1]  # This container includes all parameters related to a switch of communication mode for a ComM User. ComM_RequestComMode is called when this action is configured.
              enumeration BswMComMRequestedMode: {BSWM_FULL_COM, BSWM_NO_COM}, set at link in variant link-time / pre-compile in variant pre-compile  # This parameter specifies if the requested communication mode.
              symbolic name reference BswMComMUserRef: set at link in variant link-time / pre-compile in variant pre-compile, destination=ComMUser  # This is a reference to the ComM User that is associated to the Communication channel for which the communication mode should be requested.
            container BswMDeadlineMonitoringControl [0..1]  # This container includes all parameters related to enabling and disabling of deadline monitoring for one or several PDUs in COM. | COM_ReceptionDMControl is called when this action is configured.
              symbolic name reference BswMDisabledDMPduGroupRef [0..*]: set at link in variant link-time / pre-compile in variant pre-compile, destination=ComIPduGroup  # This is a reference to a PDU Group for which the Deadline Monitoring should be disabled.
              symbolic name reference BswMEnabledDMPduGroupRef [0..*]: set at link in variant link-time / pre-compile in variant pre-compile, destination=ComIPduGroup  # This is a reference to a PDU Group for which the Deadline Monitoring should be enabled.
            container BswMLinScheduleSwitch [0..1]  # This container includes all parameters related to a switch of LIN schedule table. LinSM_ScheduleRequest is called when this action is configured.
              symbolic name reference BswMLinScheduleRef: set at link in variant link-time / pre-compile in variant pre-compile, destination=LinSMSchedule  # This is a reference to the LIN schedule table that the LIN SM shall change to.
            container BswMNMControl [0..1]  # This container includes all parameters related to enabling and disabling of Network Management communication. Disabling of NM communication can be requested by DCM. | Nm_EnableCommunication or Nm_DisableCommunication is called when this action is configured.
              enumeration BswMNMAction: {BSWM_NM_DISABLE, BSWM_NM_ENABLE}, set at link in variant link-time / pre-compile in variant pre-compile  # This parameter specifies if the communication of the corresponding NM channel should be enabled or disabled.
              symbolic name reference BswMComMNetworkHandleRef: set at link in variant link-time / pre-compile in variant pre-compile, destination=ComMChannel  # This reference points to the unique channel defined by the ComMChannel and provides access to the unique channel index value in ComMChannelId.
            container BswMPduGroupSwitch [0..1]  # This container includes references to the PDU groups that shall be enabled and disabled. Com_IpduGroupControl is called when this action is configured.
              boolean BswMPduGroupSwitchReinit: set at link in variant link-time / pre-compile in variant pre-compile, default-value=false  # This parameter defines if the the values for the parameters like periodical timer, minimum delay timer etc is retainer or reinitialized during a PDU Group Switch.
              symbolic name reference BswMDisabledPduGroupRef [0..*]: set at link in variant link-time / pre-compile in variant pre-compile, destination=ComIPduGroup  # This is a reference to a PDU Group that should be disabled.
              symbolic name reference BswMEnabledPduGroupRef [0..*]: set at link in variant link-time / pre-compile in variant pre-compile, destination=ComIPduGroup  # This is a reference to a PDU Group that should be enabled.
            container BswMPduRouterControl [0..1]  # This container includes all parameters related to enabling and disabling of routing of Routing Path Groups in the PDU Router. PduR_EnableRouting or PduR_DisableRouting is called when this action is configured.
              enumeration BswPduRouterAction: {BSWM_PDUR_DISABLE, BSWM_PDUR_ENABLE}, set at link in variant link-time / pre-compile in variant pre-compile  # This parameter specifies if the routing of the corresponding PDU should be enabled or disabled.
              symbolic name reference BswMPduRoutingPathGroupRef [0..*]: set at link in variant link-time / pre-compile in variant pre-compile, destination=PduRRoutingPathGroup  # This is a reference to the PDU Routing Path Group for which the routing in the PDU Router should be enabled or disabled.
            container BswMResetSignalInitValues [0..1]  # This container includes all parameters needed to reset the value of one or several signals to its initial value.
              symbolic name reference BswMResetSignalInitValuesRef [0..*]: set at link in variant link-time / pre-compile in variant pre-compile, destination=ComIPduGroup  # This is a reference to a PDU Group for which the signal values should be reset to its initialization values.
            container BswMRteSwitch [0..1]  # This container defines a mode switch indication that the BswM provides to the SW-C that need to be notified about the mode switch. RTE_Switch is called when this action is configured.
              foreign reference BswMRteSwitchInterfaceRef: set at link in variant link-time / pre-compile in variant pre-compile, destination-type=MODE-SWITCH-INTERFACE  # This is a foreign reference to the Provided Port Prototype defined in the SW-C Template that is used for the indication. This Provided Port Prototype shall have a Mode Declaration Group as a Data Element.
              foreign reference BswMSwitchedMode: set at link in variant link-time / pre-compile in variant pre-compile, destination-type=MODE-DECLARATION  # This parameter contains the integer value that corresponds to a certain mode in a Mode Declaration Group.
            container BswMSchMSwitch [0..1]  # This container defines a mode switch indication that the BswM provides to the SW-C that need to be notified about the mode switch. SchM_Switch is called when this action is configured.
              foreign reference BswMSchMSwitchInterfaceRef: set at link in variant link-time / pre-compile in variant pre-compile, destination-type=MODE-SWITCH-INTERFACE  # This is a foreign reference to the Provided Port Prototype defined in the SW-C Template that is used for the indication. This Provided Port Prototype shall have a Mode Declaration Group as a Data Element.
              foreign reference BswMSchMSwitchedMode: set at link in variant link-time / pre-compile in variant pre-compile, destination-type=MODE-DECLARATION  # This parameter contains the integer value that corresponds to a certain mode in a Mode Declaration Group.
            container BswMTriggerIPduSend [0..1]  # This container includes all parameters related to the triggering of an I-PDU to be sent by COM. Com_TriggerIPDUSend is called when this action is configured.
              symbolic name reference BswMTriggeredIPduRef [0..*]: set at link in variant link-time / pre-compile in variant pre-compile, destination=ComIPdu  # This is a reference to an I-PDU that should be triggered for transmission.
            container BswMTriggerSlaveRTEStop [0..1]  # This container includes all parameters needed to stop the RTE on a slave core. This choice shall only be chosen if multicore is used.
              integer BswMCoreId: 0..18446744073709551615, set at link in variant link-time / pre-compile in variant pre-compile  # This parameter defines the identifier of the slave core that is used as input parameter for the BswM_TriggerStartUpPhase2 and BswM_TriggerSlaveRTEStop functions. The value of this parameter shall be synchronized with the OsApplicationCoreAssignment parameter.
            container BswMTriggerStartUpPhase2 [0..1]  # This container includes all parameters needed to start phase two on a slave core. This choice shall only be chosen if multicore is used.
              integer BswMCoreId: 0..18446744073709551615, set at link in variant link-time / pre-compile in variant pre-compile  # This parameter defines the identifier of the slave core that is used as input parameter for the BswM_TriggerStartUpPhase2 and BswM_TriggerSlaveRTEStop functions. The value of this parameter shall be synchronized with the OsApplicationCoreAssignment parameter.
            container BswMUserCallout [0..1]  # This container includes all details needed for a user defined function call.
              string BswMUserCalloutFunction: set at link in variant link-time / pre-compile in variant pre-compile  # This parameter specifies the complete function call including all parameters. The parameters are specified during configuration time, and cannot be changed during run time. Any return values passed by the callout will be ignored.
        container BswMActionList [0..*]  # Each instance of this container defines an action list that is invoked based on the BswM Rules. An action list contains a list of numbered action items to be processed. An action list can also include other action lists.
          enumeration BswMActionListExecution: {BSWM_CONDITION, BSWM_TRIGGER}, set at link in variant link-time / pre-compile in variant pre-compile  # This parameter controls if the corresponding action list shall be executed every time the rule is evaluated or only when the result of the evaluation changes.
          container BswMActionListItem [1..*]  # This container defines an item in an action list.
            boolean BswMAbortOnFail: set at link in variant link-time / pre-compile in variant pre-compile, default-value=false  # This parameter defines if the execution of the action list shall be aborted if this specific action returns E_NOT_OK. Note that this is only applicable for actions that have E_NOT_OK as a possible return value.
            integer BswMActionListItemIndex: 0..255, set at link in variant link-time / pre-compile in variant pre-compile  # This parameter defines the index of the action in the action list. It is used define in which order the actions shall be performed.
            boolean BswMReportFailToDem: set at link in variant link-time / pre-compile in variant pre-compile, default-value=false  # This parameter defines if a DEM event shall be reported if this specific action returns E_NOT_OK. Note that this is only applicable for actions that have E_NOT_OK as a possible return value.
            choice reference BswMActionListItemRef: set at link in variant link-time / pre-compile in variant pre-compile, destination=[BswMAction, BswMActionList, BswMRule]  # The action item can either be an atomic action or a reference to another action list or rule.
    container BswMGeneral  # General configuration parameters of the Basic SW Mode Manager.
      boolean BswMDevErrorDetect: set at pre-compile, default-value=false  # Switches the Development Error Detection and Notification ON or OFF. | true: Enabled false: Disabled
      float BswMMainFunctionPeriod [0..1]: set at link in variant link-time / pre-compile in variant pre-compile  # The cycle time of the periodic main function of BswM. Defined in seconds .
      boolean BswMVersionInfoApi: set at pre-compile, default-value=true  # Switches the possibility to read the published information with the service BswM_GetPublishedInformation(). | true: Enabled false: Disabled
  module definition Cal [0..1]: variants pre-compile  # Configuration of the Cal (CryptoAbstractionLibrary) module.
    container CalAsymDecrypt [0..1]  # Container for incorporation of AsymDecrypt primitives.
      integer CalAsymDecryptMaxCtxBufByteSize: 1..4294967295, set at pre-compile  # The maximum, in bytes, of all context buffers used in all CPL primitives which implement an asymmetrical decryption.
      integer CalAsymDecryptMaxKeySize: 1..4294967295, set at pre-compile  # The maximum, in bytes, of all key lengths used in all CPL primitives which implement an asymmetrical decryption.
      container CalAsymDecryptConfig [0..32]  # Container for configuration of service AsymDecrypt. The container name serves as a symbolic name for the identifier of a service configuration.
        string CalAsymDecryptInitConfiguration: set at pre-compile  # Name of a C symbol which contains the configuration of the underlying cryptographic primitive.
        string CalAsymDecryptPrimitiveName: set at pre-compile  # Name of the cryptographic primitive to use.
    container CalAsymEncrypt [0..1]  # Container for incorporation of AsymEncrypt primitives.
      integer CalAsymEncryptMaxCtxBufByteSize: 1..4294967295, set at pre-compile  # The maximum, in bytes, of all context buffers used in all CPL primitives which implement an asymmetrical encryption.
      integer CalAsymEncryptMaxKeySize: 1..4294967295, set at pre-compile  # The maximum, in bytes, of all key lengths used in all CPL primitives which implement an asymmetrical encryption.
      container CalAsymEncryptConfig [0..32]  # Container for configuration of service AsymEncrypt. The container name serves as a symbolic name for the identifier of a service configuration.
        string CalAsymEncryptInitConfiguration: set at pre-compile  # Name of a C symbol which contains the configuration of the underlying cryptographic primitive.
        string CalAsymEncryptPrimitiveName: set at pre-compile  # Name of the cryptographic primitive to use.
    container CalAsymPrivateKeyExtract [0..1]  # Container for incorporation of AsymPrivateKeyExtract primitives.
      integer CalAsymPrivateKeyExtractMaxCtxBufByteSize: 1..4294967295, set at pre-compile  # The maximum, in bytes, of all context buffers used in all CPL primitives which implement an asymmetrical private key extraction.
      integer CalAsymPrivateKeyExtractMaxKeySize: 1..4294967295, set at pre-compile  # The maximum, in bytes, of all key lengths used in all CPL primitives which implement an asymmetrical private key extraction.
      container CalAsymPrivateKeyExtractConfig [0..32]  # Container for configuration of service AsymPrivateKeyExtract. | The container name serves as a symbolic name for the identifier of a service configuration.
        string CalAsymPrivateKeyExtractInitConfiguration: set at pre-compile  # Name of a C symbol which contains the configuration of the underlying cryptographic primitive.
        string CalAsymPrivateKeyExtractPrimitiveName: set at pre-compile  # Name of the cryptographic primitive to use.
    container CalAsymPrivateKeyWrapAsym [0..1]  # Container for incorporation of AsymPrivateKeyWrapAsym primitives.
      integer CalAsymPrivateKeyWrapAsymMaxPrivKeySize: 1..4294967295, set at pre-compile  # The maximum length, in bytes, of all private information types used in all CPL primitives which implement an asymmetrical key wrapping.
      integer CalAsymPrivateKeyWrapAsymMaxPubKeySize: 1..4294967295, set at pre-compile  # The maximum length, in bytes, of all public key types used in all CPL primitives which implement an asymmetrical key wrapping.
      container CalAsymPrivateKeyWrapAsymConfig [0..32]  # Container for configuration of service AsymPrivateKeyWrapAsym. | The container name serves as a symbolic name for the identifier of a service configuration.
        string CalAsymPrivateKeyWrapAsymInitConfiguration: set at pre-compile  # Name of a C symbol which contains the configuration of the underlying cryptographic primitive.
        string CalAsymPrivateKeyWrapAsymPrimitiveName: set at pre-compile  # Name of the cryptographic primitive to use.
    container CalAsymPrivateKeyWrapSym [0..1]  # Container for incorporation of AsymPrivateKeyWrapSym primitives.
      integer CalAsymPrivateKeyWrapSymMaxPrivKeySize: 1..4294967295, set at pre-compile  # The maximum length, in bytes, of all private information types used in all CPL primitives which implement an asymmetrical key wrapping.
      integer CalAsymPrivateKeyWrapSymMaxSymKeySize: 1..4294967295, set at pre-compile  # The maximum, in bytes, of all key lengths used in all CPL primitives which implement an asymmetrical key wrapping.
      container CalAsymPrivateKeyWrapSymConfig [0..32]  # Container for configuration of service AsymPrivateKeyWrapSym. | The container name serves as a symbolic name for the identifier of a service configuration.
        string CalAsymPrivateKeyWrapSymInitConfiguration: set at pre-compile  # Name of a C symbol which contains the configuration of the underlying cryptographic primitive.
        string CalAsymPrivateKeyWrapSymPrimitiveName: set at pre-compile  # Name of the cryptographic primitive to use.
    container CalAsymPublicKeyExtract [0..1]  # Container for incorporation of AsymPublicKeyExtract primitives.
      integer CalAsymPublicKeyExtractMaxCtxBufByteSize: 1..4294967295, set at pre-compile  # The maximum, in bytes, of all context buffers used in all CPL primitives which implement an asymmetrical public key extraction.
      integer CalAsymPublicKeyExtractMaxKeySize: 1..4294967295, set at pre-compile  # The maximum, in bytes, of all key lengths used in all CPL primitives which implement an asymmetrical public key extraction.
      container CalAsymPublicKeyExtractConfig [0..32]  # Container for configuration of service AsymPublicKeyExtract. | The container name serves as a symbolic name for the identifier of a service configuration.
        string CalAsymPublicKeyExtractInitConfiguration: set at pre-compile  # Name of a C symbol which contains the configuration of the underlying cryptographic primitive.
        string CalAsymPublicKeyExtractPrimitiveName: set at pre-compile  # Name of the cryptographic primitive to use.
    container CalChecksum [0..1]  # Container for incorporation of Checksum primitives.
      integer CalChecksumMaxCtxBufByteSize: 1..4294967295, set at pre-compile  # The maximum, in bytes, of all context buffers used in all CPL primitives which implement a checksum computation.
      container CalChecksumConfig [0..32]  # Container for configuration of service Checksum. The container name serves as a symbolic name for the identifier of a service configuration.
        string CalChecksumInitConfiguration: set at pre-compile  # Name of a C symbol which contains the configuration of the underlying cryptographic primitive.
        string CalChecksumPrimitiveName: set at pre-compile  # Name of the cryptographic primitive to use.
    container CalGeneral  # Container for common configuration options.
      string CalMaxAlignScalarType: set at pre-compile  # The scalar type which has the maximum alignment restrictions on the given platform. | This type can be e.g. uint8, uint16 or uint32.
      boolean CalVersionInfoApi: set at pre-compile  # Pre-processor switch to enable and disable availability of the API Cal_GetVersionInfo(). True: API Cal_GetVersionInfo() is available. False: API Cal_GetVersionInfo() is not available.
    container CalHash [0..1]  # Container for incorporation of Hash primitives.
      integer CalHashMaxCtxBufByteSize: 1..4294967295, set at pre-compile  # The maximum, in bytes, of all context buffers used in all CPL primitives which implement a hash computation.
      container CalHashConfig [0..32]  # Configurations for the Hash service. The container name serves as a symbolic name for the identifier of a service configuration.
        string CalHashInitConfiguration: set at pre-compile  # Name of a C symbol which contains the configuration of the underlying cryptographic primitive.
        string CalHashPrimitiveName: set at pre-compile  # Name of the cryptographic primitive to use.
    container CalKeyDerive [0..1]  # Container for incorporation of KeyDerive primitives.
      integer CalKeyDeriveMaxCtxBufByteSize: 1..4294967295, set at pre-compile  # The maximum, in bytes, of all context buffers used in all CPL primitives which implement a key derivation.
      integer CalKeyDeriveMaxKeySize: 1..4294967295, set at pre-compile  # The maximum, in bytes, of all key lengths used in all CRL primitives which implement a key derivation.
      container CalKeyDeriveConfig [0..32]  # Container for configuration of service KeyDerive. The container name serves as a symbolic name for the identifier of a service configuration.
        string CalKeyDeriveInitConfiguration: set at pre-compile  # Name of a C symbol which contains the configuration of the underlying cryptographic primitive.
        string CalKeyDerivePrimitiveName: set at pre-compile  # Name of the cryptographic primitive to use.
    container CalKeyExchangeCalcPubVal [0..1]  # Container for incorporation of KeyExchangeCalcPubVal primitives.
      integer CalKeyExchangeCalcPubValMaxBaseTypeSize: 1..4294967295, set at pre-compile  # The maximum length, in bytes, of all base types used in all CPL primitives which implement a public value calculation.
      integer CalKeyExchangeCalcPubValMaxCtxBufByteSize: 1..4294967295, set at pre-compile  # The maximum, in bytes, of all context buffers used in all CPL primitives which implement a public value calculation.
      integer CalKeyExchangeCalcPubValMaxPrivateTypeSize: 1..4294967295, set at pre-compile  # The maximum length, in bytes, of all private information types used in all CPL primitives which implement a public value calculation.
      container CalKeyExchangeCalcPubValConfig [0..32]  # Container for configuration of service KeyExchangeCalcPubVal. The container name serves as a symbolic name for the identifier of a service configuration.
        string CalKeyExchangeCalcPubValInitConfiguration: set at pre-compile  # Name of a C symbol which contains the configuration of the underlying cryptographic primitive.
        string CalKeyExchangeCalcPubValPrimitiveName: set at pre-compile  # Name of the cryptographic primitive to use.
    container CalKeyExchangeCalcSecret [0..1]  # Container for incorporation of KeyExchangeCalcSecret primitives.
      integer CalKeyExchangeCalcSecretMaxBaseTypeSize: 1..4294967295, set at pre-compile  # The maximum length, in bytes, of all base types used in all CPL primitives which implement a shared secret calculation.
      integer CalKeyExchangeCalcSecretMaxCtxBufByteSize: 1..4294967295, set at pre-compile  # The maximum, in bytes, of all context buffers used in all CPL primitives which implement a shared secret calculation.
      integer CalKeyExchangeCalcSecretMaxPrivateTypeSize: 1..4294967295, set at pre-compile  # The maximum length, in bytes, of all private information types used in all CPL primitives which implement a shared secret calculation.
      container CalKeyExchangeCalcSecretConfig [0..32]  # Container for configuration of service KeyExchangeCalcSecret. The container name serves as a symbolic name for the identifier of a service configuration.
        string CalKeyExchangeCalcSecretInitConfiguration: set at pre-compile  # Name of a C symbol which contains the configuration of the underlying cryptographic primitive.
        string CalKeyExchangeCalcSecretPrimitiveName: set at pre-compile  # Name of the cryptographic primitive to use.
    container CalMacGenerate [0..1]  # Container for incorporation of MacGenerate primitives.
      integer CalMacGenerateMaxCtxBufByteSize: 1..4294967295, set at pre-compile  # The maximum, in bytes, of all context buffers used in all CPL primitives which implement a MAC generation.
      integer CalMacGenerateMaxKeySize: 1..4294967295, set at pre-compile  # The maximum, in bytes, of all key lengths used in all CPL primitives which implement a MAC generation.
      container CalMacGenerateConfig [0..32]  # Configurations for the MacGenerate service. The container name serves as a symbolic name for the identifier of a service configuration.
        string CalMacGenerateInitConfiguration: set at pre-compile  # Name of a C symbol which contains the configuration of the underlying cryptographic primitive.
        string CalMacGeneratePrimitiveName: set at pre-compile  # Name of the cryptographic primitive to use.
    container CalMacVerify [0..1]  # Container for incorporation of MacVerify primitives.
      integer CalMacVerifyMaxCtxBufByteSize: 1..4294967295, set at pre-compile  # The maximum, in bytes, of all context buffers used in all CPL primitives which implement a MAC verification.
      integer CalMacVerifyMaxKeySize: 1..4294967295, set at pre-compile  # The maximum, in bytes, of all key lengths used in all CPL primitives which implement a MAC verification.
      container CalMacVerifyConfig [0..32]  # Container for configuration of service MacVerify. The container name serves as a symbolic name for the identifier of a service configuration.
        string CalMacVerifyInitConfiguration: set at pre-compile  # Name of a C symbol which contains the configuration of the underlying cryptographic primitive.
        string CalMacVerifyPrimitiveName: set at pre-compile  # Name of the cryptographic primitive to use.
    container CalRandomGenerate [0..1]  # Container for incorporation of RandomGenerate primitives.
      container CalRandomGenerateConfig [0..32]  # Container for configuration of service RandomGenerate. The container name serves as a symbolic name for the identifier of a service configuration.
        string CalRandomGenerateInitConfiguration: set at pre-compile  # Name of a C symbol which contains the configuration of the underlying cryptographic primitive.
        string CalRandomGeneratePrimitiveName: set at pre-compile  # Name of the cryptographic primitive to use.
    container CalRandomSeed [0..1]  # Container for incorporation of RandomSeed primitives.
      integer CalRandomMaxCtxBufByteSize: 1..4294967295, set at pre-compile  # The maximum, in bytes, of all context buffers used in all CPL primitives which implement seeding or generating a random number.
      container CalRandomSeedConfig [0..32]  # Container for configuration of service RandomSeed. The container name serves as a symbolic name for the identifier of a service configuration.
        string CalRandomSeedInitConfiguration: set at pre-compile  # Name of a C symbol which contains the configuration of the underlying cryptographic primitive.
        string CalRandomSeedPrimitiveName: set at pre-compile  # Name of the cryptographic primitive to use.
    container CalSignatureGenerate [0..1]  # Container for incorporation of SignatureGenerate primitives
      integer CalSignatureGenerateMaxCtxBufByteSize: 1..4294967295, set at pre-compile  # The maximum, in bytes, of all context buffers used in all CPL primitives which implement a signature generation.
      integer CalSignatureGenerateMaxKeySize: 1..4294967295, set at pre-compile  # The maximum, in bytes, of all key lengths used in all CPL primitives which implement a signature generation.
      container CalSignatureGenerateConfig [0..32]  # Container for configuration of service SignatureGenerate. The container name serves as a symbolic name for the identifier of a service configuration.
        string CalSignatureGenerateInitConfiguration: set at pre-compile  # Name of a C symbol which contains the configuration of the underlying cryptographic primitive.
        string CalSignatureGeneratePrimitiveName: set at pre-compile  # Name of the cryptographic primitive to use.
    container CalSignatureVerify [0..1]  # Container for incorporation of SignatureVerify primitives.
      integer CalSignatureVerifyMaxCtxBufByteSize: 1..4294967295, set at pre-compile  # The maximum, in bytes, of all context buffers used in all CPL primitives which implement a signature verification.
      integer CalSignatureVerifyMaxKeySize: 1..4294967295, set at pre-compile  # The maximum, in bytes, of all key lengths used in all CPL primitives which implement a signature verification.
      container CalSignatureVerifyConfig [0..32]  # Container for configuration of service SignatureVerify. The container name serves as a symbolic name for the identifier of a service configuration.
        string CalSignatureVerifyInitConfiguration: set at pre-compile  # Name of a C symbol which contains the configuration of the underlying cryptographic primitive.
        string CalSignatureVerifyPrimitiveName: set at pre-compile  # Name of the cryptographic primitive to use.
    container CalSymBlockDecrypt [0..1]  # Container for incorporation of SymBlockDecrypt primitives.
      integer CalSymBlockDecryptMaxCtxBufByteSize: 1..4294967295, set at pre-compile  # The maximum, in bytes, of all context buffers used in all CPL primitives which implement a symmetrical block decryption.
      integer CalSymBlockDecryptMaxKeySize: 1..4294967295, set at pre-compile  # The maximum, in bytes, of all key lengths used in all CPL primitives which implement a symmetrical block decryption.
      container CalSymBlockDecryptConfig [0..32]  # Container for configuration of service SymBlockDecrypt. The container name serves as a symbolic name for the identifier of a service configuration.
        string CalSymBlockDecryptInitConfiguration: set at pre-compile  # Name of a C symbol which contains the configuration of the underlying cryptographic primitive.
        string CalSymBlockDecryptPrimitiveName: set at pre-compile  # Name of the cryptographic primitive to use.
    container CalSymBlockEncrypt [0..1]  # Container for incorporation of SymBlockEncrypt primitives.
      integer CalSymBlockEncryptMaxCtxBufByteSize: 1..4294967295, set at pre-compile  # The maximum, in bytes, of all context buffers used in all CPL primitives which implement a symmetrical block encryption.
      integer CalSymBlockEncryptMaxKeySize: 1..4294967295, set at pre-compile  # The maximum, in bytes, of all key lengths used in all CPL primitives which implement a symmetrical block encryption.
      container CalSymBlockEncryptConfig [0..32]  # Container for configuration of service SymBlockEncrypt. The container name serves as a symbolic name for the identifier of a service configuration.
        string CalSymBlockEncryptInitConfiguration: set at pre-compile  # Name of a C symbol which contains the configuration of the underlying cryptographic primitive.
        string CalSymBlockEncryptPrimitiveName: set at pre-compile  # Name of the cryptographic primitive to use.
    container CalSymDecrypt [0..1]  # Container for incorporation of SymDecrypt primitives
      integer CalSymDecryptMaxCtxBufByteSize: 1..4294967295, set at pre-compile  # The maximum, in bytes, of all context buffers used in all CPL primitives which implement a symmetrical decryption.
      integer CalSymDecryptMaxKeySize: 1..4294967295, set at pre-compile  # The maximum, in bytes, of all key lengths used in all CPL primitives which implement a symmetrical decryption.
      container CalSymDecryptConfig [0..32]  # Container for configuration of service SymDecrypt. | The container name serves as a symbolic name for the identifier of a service configuration.
        string CalSymDecryptInitConfiguration: set at pre-compile  # Name of a C symbol which contains the configuration of the underlying cryptographic primitive.
        string CalSymDecryptPrimitiveName: set at pre-compile  # Name of the cryptographic primitive to use.
    container CalSymEncrypt [0..1]  # Container for incorporation of SymEncrypt primitives.
      integer CalSymEncryptMaxCtxBufByteSize: 1..4294967295, set at pre-compile  # The maximum, in bytes, of all context buffers used in all CPL primitives which implement a symmetrical encryption.
      integer CalSymEncryptMaxKeySize: 1..4294967295, set at pre-compile  # The maximum, in bytes, of all key lengths used in all CPL primitives which implement a symmetrical encryption.
      container CalSymEncryptConfig [0..32]  # Container for configuration of service SymEncrypt. The container name serves as a symbolic name for the identifier of a service configuration.
        string CalSymBlockEncryptInitConfiguration: set at pre-compile  # Name of a C symbol which contains the configuration of the underlying cryptographic primitive.
        string CalSymEncryptPrimitiveName: set at pre-compile  # Name of the cryptographic primitive to use.
    container CalSymKeyExtract [0..1]  # Container for incorporation of SymKeyExtract primitives.
      integer CalSymKeyExtractMaxCtxBufByteSize: 1..4294967295, set at pre-compile  # The maximum, in bytes, of all context buffers used in all CPL primitives which implement a symmetrical key extraction.
      integer CalSymKeyExtractMaxKeySize: 1..4294967295, set at pre-compile  # The maximum, in bytes, of all key lengths used in all CPL primitives which implement a symmetrical key extraction.
      container CalSymKeyExtractConfig [0..32]  # Container for configuration of service SymKeyExtract. The container name serves as a symbolic name for the identifier of a service configuration.
        string CalSymKeyExtractInitConfiguration: set at pre-compile  # Name of a C symbol which contains the configuration of the underlying cryptographic primitive.
        string CalSymKeyExtractPrimitiveName: set at pre-compile  # Name of the cryptographic primitive to use.
    container CalSymKeyWrapAsym [0..1]  # Container for incorporation of SymKeyWrapAsym primitives.
      integer CalSymKeyWrapAsymMaxPubKeySize: 1..4294967295, set at pre-compile  # The maximum length, in bytes, of all public key types used in all CPL primitives which implement a symmetrical key wrapping.
      integer CalSymKeyWrapAsymMaxSymKeySize: 1..4294967295, set at pre-compile  # The maximum, in bytes, of all key lengths used in all CPL primitives which implement a symmetrical key wrapping.
      container CalSymKeyWrapAsymConfig [0..32]  # Container for configuration of service SymKeyWrapAsym. | The container name serves as a symbolic name for the identifier of a service configuration.
        string CalSymKeyWrapAsymInitConfiguration: set at pre-compile  # Name of a C symbol which contains the configuration of the underlying cryptographic primitive.
        string CalSymKeyWrapAsymPrimitiveName: set at pre-compile  # Name of the cryptographic primitive to use.
    container CalSymKeyWrapSym [0..1]  # Container for incorporation of SymKeyWrapSym primitives.
      integer CalSymKeyWrapSymMaxSymKeySize: 1..4294967295, set at pre-compile  # The maximum, in bytes, of all key lengths used in all CPL primitives which implement a symmetrical key wrapping.
      container CalSymKeyWrapSymConfig [0..32]  # Container for configuration of service SymKeyWrapSym. | The container name serves as a symbolic name for the identifier of a service configuration.
        string CalSymKeyWrapSymInitConfiguration: set at pre-compile  # Name of a C symbol which contains the configuration of the underlying cryptographic primitive.
        string CalSymKeyWrapSymPrimitiveName: set at pre-compile  # Name of the cryptographic primitive to use.
  module definition Can [0..*]: variants post-build/pre-compile  # This container holds the configuration of a single CAN Driver.
    container CanConfigSet: multiple-configuration-container=true  # This is the multiple configuration set container for CAN Driver
      container CanController [1..*]  # This container contains the configuration parameters of the CAN controller(s).
        enumeration CanBusoffProcessing: {INTERRUPT, POLLING}, set at pre-compile  # Enables / disables API Can_MainFunction_BusOff() for handling busoff events in polling mode.
        boolean CanControllerActivation: set at pre-compile  # Defines if a CAN controller is used in the configuration.
        integer CanControllerBaseAddress: 0..4294967295, set at pre-compile  # Specifies the CAN controller base address.
        integer CanControllerId: 0..255, set at pre-compile, symbolic-name-value=true  # This parameter provides the controller ID which is unique in a given CAN Driver. The value for this parameter starts with 0 and continue without any gaps.
        enumeration CanRxProcessing: {INTERRUPT, POLLING}, set at pre-compile  # Enables / disables API Can_MainFunction_Read() for handling PDU reception events in polling mode.
        enumeration CanTxProcessing: {INTERRUPT, POLLING}, set at pre-compile  # Enables / disables API Can_MainFunction_Write() for handling PDU transmission events in polling mode.
        enumeration CanWakeupProcessing: {INTERRUPT, POLLING}, set at pre-compile  # Enables / disables API Can_MainFunction_Wakeup() for handling wakeup events in polling mode.
        boolean CanWakeupSupport: set at pre-compile  # CAN driver support for wakeup over CAN Bus.
        reference CanCpuClockRef: set at pre-compile, destination=McuClockReferencePoint  # Reference to the CPU clock configuration, which is set in the MCU driver configuration
        symbolic name reference CanWakeupSourceRef [0..1]: set at pre-compile, destination=EcuMWakeupSource  # This parameter contains a reference to the Wakeup Source for this controller as defined in the ECU State Manager. | Implementation Type: reference to EcuM_WakeupSourceType
        container CanControllerBaudrateConfig [1..*]  # This container contains bit timing related configuration parameters of the CAN controller(s).
          integer CanControllerBaudRate: 0..2000, set at post-build in variant post-build / pre-compile in variant pre-compile  # Specifies the baudrate of the controller in kbps.
          integer CanControllerPropSeg: 0..255, set at post-build in variant post-build / pre-compile in variant pre-compile  # Specifies propagation delay in time quantas.
          integer CanControllerSeg1: 0..255, set at post-build in variant post-build / pre-compile in variant pre-compile  # Specifies phase segment 1 in time quantas.
          integer CanControllerSeg2: 0..255, set at post-build in variant post-build / pre-compile in variant pre-compile  # Specifies phase segment 2 in time quantas.
          integer CanControllerSyncJumpWidth: 0..255, set at post-build in variant post-build / pre-compile in variant pre-compile  # Specifies the synchronization jump width for the controller in time quantas.
        container CanFilterMask [0..*]  # This container contains the configuration (parameters) of the CAN Filter Mask(s).
          integer CanFilterMaskValue: 0..4294967295, set at post-build in variant post-build / pre-compile in variant pre-compile  # Describes a mask for hardware-based filtering of CAN identifiers. The CAN identifiers of incoming messages are masked with the appropriate CanFilterMaskValue. Bits holding a 0 mean don't care, i.e. do not compare the message's identifier in the respective bit position. | The mask shall be build by filling with leading 0. In case of CanIdType EXTENDED or MIXED a 29 bit mask shall be build. In case of CanIdType STANDARD a 11 bit mask shall be build
        container CanTTController [0..1]  # This container is only included and valid if TTCAN SWS is used and TTCAN is enabled. | This container contains the configuration parameters of the TTCAN controller(s) (which are needed in addition to the configuration parameters of the CAN controller(s)). CanTTController is only included, if the controller supports TTCAN.
          integer CanTTControllerApplWatchdogLimit: 0..255, set at post-build in variant post-build / pre-compile in variant pre-compile  # Defines the maximum time period (unit is 256 times NTU) after which the application has to serve the watchdog.
          integer CanTTControllerCycleCountMax: 0..63, set at post-build in variant post-build / pre-compile in variant pre-compile  # Defines the value for cycle_count_max. | Allowed values: 0x00: 1 basic cycle 0x01: 2 basic cycles 0x03: 4 basic cycles 0x07: 8 basic cycles 0x0F: 16 basic cycles 0x1F: 32 basic cycles 0x3F: 64 basic cycles
          integer CanTTControllerExpectedTxTrigger: 0..255, set at post-build in variant post-build / pre-compile in variant pre-compile  # Number of expected_tx_trigger.
          boolean CanTTControllerExternalClockSynchronisation: set at post-build in variant post-build / pre-compile in variant pre-compile  # Enables/disables the external clock synchronization. | TRUE: External clock synchronization enabled. FALSE: External clock synchronization disabled. This parameter shall only be configurable if parameter CanTTControllerLevel2 equals TRUE.
          boolean CanTTControllerGlobalTimeFiltering: set at post-build in variant post-build / pre-compile in variant pre-compile  # Enables/disables the global time filtering. | TRUE: Global time filtering enabled. FALSE: Global time filtering disabled. This parameter shall only be configurable if parameter CanTTControllerLevel2 equals TRUE.
          integer CanTTControllerInitialRefOffset: 0..127, set at post-build in variant post-build / pre-compile in variant pre-compile  # Defines the initial value for ref trigger offset.
          integer CanTTControllerInterruptEnable: 0..1023, set at post-build in variant post-build / pre-compile in variant pre-compile  # Enables/disables the respective interrupts. | Bit Position set to 1: Enable respective interrupt. Bit Position set to 0: Disable respective interrupt. Bit Position / Interrupt Source: 10: Application Watchdog. 9: Watch Trigger reached. 8: Initialization Watch Trigger reached. 7: Change of Error Level. 6: Tx Overflow. 5: Tx Underflow. 4: Global Time Error. 3: Gap. 2: Start of Cycle. 1: Time Discontinuity. 0: Master State Change. Bit position "1: Time Discontinuity" and "4: Global Time Error" shall only be configurable if parameter CanTTControllerLevel2 equals TRUE.
          boolean CanTTControllerLevel2: set at post-build in variant post-build / pre-compile in variant pre-compile  # Defines whether Level 2 or Level 1 is used. | TRUE: Level 2. FALSE: Level 1. If this parameter is set to FALSE then all parameters with dependency to CanTTControllerLevel2 need not be configured.
          float CanTTControllerNTUConfig: 0..100, set at post-build in variant post-build / pre-compile in variant pre-compile  # Defines the config value for NTU (network time unit). | Value given in microseconds. Together with the local oscillator period, the TUR (time unit ratio) can be derived from the NTU. This parameter shall only be configurable if parameter CanTTControllerLevel2 equals TRUE.
          enumeration CanTTControllerOperationMode: {CAN_TT_EVENT_SYNC_TIME_TRIGGERED, CAN_TT_EVENT_TRIGGERED, CAN_TT_TIME_TRIGGERED}, set at post-build in variant post-build / pre-compile in variant pre-compile  # Defines the operation mode.
          float CanTTControllerSyncDeviation: 0..100, set at post-build in variant post-build / pre-compile in variant pre-compile  # Defines the maximum synchronization deviation: | Given as a percentage value of the NTU (network time unit). This parameter shall only be configurable if parameter CanTTControllerLevel2 equals TRUE.
          boolean CanTTControllerTURRestore: set at post-build in variant post-build / pre-compile in variant pre-compile  # Enables/disables the TUR restore. | Note that the value configured for TUR can be derived from the value configured for NTU and the local oscillator preriod. TRUE: TUR restore enabled. FALSE: TUR restore disabled. This parameter shall only be configurable if parameter CanTTControllerLevel2 equals TRUE.
          boolean CanTTControllerTimeMaster: set at post-build in variant post-build / pre-compile in variant pre-compile  # Defines whether the controller acts as a potential time master. | TRUE: Potential time master. FALSE: Time slave.
          integer CanTTControllerTimeMasterPriority: 0..7, set at post-build in variant post-build / pre-compile in variant pre-compile  # Defines the time master priority.
          integer CanTTControllerTxEnableWindowLength: 1..16, set at post-build in variant post-build / pre-compile in variant pre-compile  # Length of the tx enable window given in CAN bit times. | Definition parameter "CanTTControllerTxEnableWindowlength" is used such that: Length of enable window = CanTTControllerTxEnableWindowLength + 1
          integer CanTTControllerWatchTriggerGapTimeMark: 0..65535, set at post-build in variant post-build / pre-compile in variant pre-compile  # watch trigger time mark after a gap
          integer CanTTControllerWatchTriggerTimeMark: 0..65535, set at post-build in variant post-build / pre-compile in variant pre-compile  # watch trigger time mark
          enumeration CanTTIRQProcessing: {INTERRUPT, POLLING}, set at post-build in variant post-build / pre-compile in variant pre-compile  # Enables / disables API Can_MainFunction_BusOff() for handling busoff events in polling mode.
      container CanHardwareObject [1..*]  # This container contains the configuration (parameters) of CAN Hardware Objects.
        enumeration CanHandleType: {BASIC, FULL}, set at post-build in variant post-build / pre-compile in variant pre-compile  # Specifies the type (Full-CAN or Basic-CAN) of a hardware object.
        enumeration CanIdType: {EXTENDED, MIXED, STANDARD}, set at post-build in variant post-build / pre-compile in variant pre-compile  # Specifies whether the IdValue is of type | - standard identifier - extended identifier - mixed mode ImplementationType: Can_IdType
        integer CanIdValue: 0..4294967295, set at post-build in variant post-build / pre-compile in variant pre-compile  # Specifies (together with the filter mask) the identifiers range that passes the hardware filter.
        integer CanObjectId: 0..65535, set at post-build in variant post-build / pre-compile in variant pre-compile, symbolic-name-value=true  # Holds the handle ID of HRH or HTH. The value of this parameter is unique in a given CAN Driver, and it should start with 0 and continue without any gaps. | The HRH and HTH Ids are defined under two different name-spaces. Example: HRH0-0, HRH1-1, HTH0-2, HTH1-3
        enumeration CanObjectType: {RECEIVE, TRANSMIT}, set at post-build in variant post-build / pre-compile in variant pre-compile  # Specifies if the HardwareObject is used as Transmit or as Receive object
        reference CanControllerRef: set at post-build in variant post-build / pre-compile in variant pre-compile, destination=CanController  # Reference to CAN Controller to which the HOH is associated to.
        reference CanFilterMaskRef [0..1]: set at post-build in variant post-build / pre-compile in variant pre-compile, destination=CanFilterMask  # Reference to the filter mask that is used for hardware filtering together with the CAN_ID_VALUE
        container CanTTHardwareObjectTrigger [0..*]  # This container is only included and valid if TTCAN SWS is used and TTCAN is enabled. | This container contains the configuration (parameters) of TTCAN triggers for Hardware Objects, which are additional to the configuration (parameters) of CAN Hardware Objects. CanTTHardwareObjectTrigger is only included, if the controller supports TTCAN.
          integer CanTTHardwareObjectBaseCycle: 0..63, set at post-build in variant post-build / pre-compile in variant pre-compile  # Defines the cycle_offset. | CanTTHardwareObjectBaseCycle must be not greater than cycle_count_max.
          integer CanTTHardwareObjectCycleRepetition: 1..64, set at post-build in variant post-build / pre-compile in variant pre-compile  # Defines the repeat_factor. | CanTTHardwareObjectCycleRepetition shall be a power of two (2), greater than cycle_offset but not greater than cycle_count_max + 1.
          integer CanTTHardwareObjectTimeMark: 0..65535, set at post-build in variant post-build / pre-compile in variant pre-compile  # Defines the point in time, when the trigger will be activated. | Value is given in cycle time.
          integer CanTTHardwareObjectTriggerId: 0..63, set at post-build in variant post-build / pre-compile in variant pre-compile, symbolic-name-value=true  # Sequential number which allows separation of different TTCAN triggers configured for one and the same hardware object.
          enumeration CanTTHardwareObjectTriggerType: {CAN_TT_RX_TRIGGER, CAN_TT_TX_REF_TRIGGER, CAN_TT_TX_REF_TRIGGER_GAP, CAN_TT_TX_TRIGGER_EXCLUSIVE, CAN_TT_TX_TRIGGER_MERGED, CAN_TT_TX_TRIGGER_SINGLE}, set at post-build in variant post-build / pre-compile in variant pre-compile  # Defines the type of the trigger associated with the hardware object. This parameter depends on plain CAN parameter CAN_OBJECT_TYPE. | If CAN_OBJECT_TYPE equals RECEIVE than this parameter is fixed to CAN_TT_RX_TRIGGER. If CAN_OBJECT_TYPE equals TRANSMIT than one of the following literals is configurable: CAN_TT_TX_REF_TRIGGER, CAN_TT_TX_REF_TRIGGER_GAP, CAN_TT_TX_TRIGGER_MERGED, CAN_TT_TX_TRIGGER_SINGLE, CAN_TT_TX_TRIGGER_EXCLUSIVE.
    container CanGeneral  # This container contains the parameters related each CAN Driver Unit.
      boolean CanDevErrorDetection: set at pre-compile  # Switches the Development Error Detection and Notification ON or OFF.
      boolean CanHardwareCancellation: set at pre-compile  # Specifies if hardware cancellation shall be supported.ON or OFF
      boolean CanIdenticalIdCancellation: set at pre-compile  # Enables/disables cancellation of pending PDUs with identical ID.
      integer CanIndex: 0..255, set at pre-compile  # Specifies the InstanceId of this module instance. If only one instance is present it shall have the Id 0.
      function name CanLPduReceiveCalloutFunction [0..1]: set at pre-compile  # This parameter defines the existence and the name of a callout function that is called after a successful | reception of a received CAN Rx L-PDU. If this parameter is omitted no callout shall take place.
      float CanMainFunctionBusoffPeriod [0..1]: 0.001..65.535, set at pre-compile  # This parameter describes the period for cyclic call to Can_MainFunction_Busoff. Unit is seconds.
      float CanMainFunctionModePeriod: 0.001..65.535, set at pre-compile  # This parameter describes the period for cyclic call to Can_MainFunction_Mode. Unit is seconds.
      float CanMainFunctionReadPeriod [0..*]: 0.001..65.535, set at pre-compile  # This parameter describes the period for cyclic call to Can_MainFunction_Read. Unit is seconds. Different poll-cycles will be configurable if more than one CanMainFunctionReadPeriod is configured. In this case multiple Can_MainFunction_Read() will be provided by the CAN Driver module.
      float CanMainFunctionWakeupPeriod [0..1]: 0.001..65.535, set at pre-compile  # This parameter describes the period for cyclic call to Can_MainFunction_Wakeup. Unit is seconds.
      float CanMainFunctionWritePeriod [0..*]: 0.001..65.535, set at pre-compile  # This parameter describes the period for cyclic call to Can_MainFunction_Write. Unit is seconds. Different poll-cycles will be configurable if more than one CanMainFunctionWritePeriod is configured. In this case multiple Can_MainFunction_Write() will be provided by the CAN Driver module.
      boolean CanMultiplexedTransmission: set at pre-compile  # Specifies if multiplexed transmission shall be supported.ON or OFF
      float CanTimeoutDuration: 0.001..65.535, set at pre-compile  # Specifies the maximum time for blocking function until a timeout is detected. Unit is seconds.
      boolean CanVersionInfoApi: set at pre-compile  # Switches the Can_GetVersionInfo() API ON or OFF.
      reference CanCounterRef: set at pre-compile, destination=OsCounter  # This parameter contains a reference to the counter, which is used by the CAN driver.
      reference CanMainFunctionReadPeriodRef [0..1]: set at pre-compile, destination=CanHardwareObject  # Reference to CAN Hardware Object which shall be polled with the configured CanMainFunctionReadPeriod. This reference shall only be configurable if more than one period is configured via CanMainFunctionReadPeriod.
      reference CanMainFunctionWritePeriodRef [0..1]: set at pre-compile, destination=CanHardwareObject  # Reference to CAN Hardware Object which shall be polled with the configured CanMainFunctionWritePeriod. This reference shall only be configurable if more than one period is configured via CanMainFunctionWritePeriod.
      reference CanSupportTTCANRef: set at pre-compile, destination=CanIfPrivateCfg  # The parameter refers to CanIfSupportTTCAN parameter in the CAN Interface Module configuration. | The CanIfSupportTTCAN parameter defines whether TTCAN is supported.
  module definition CanIf [0..1]: variants link-time/post-build/pre-compile  # This container includes all necessary configuration sub-containers according the CAN Interface configuration structure.
    container CanIfCtrlDrvCfg [1..*]  # Configuration parameters for all the underlying CAN Driver modules are aggregated under this container. For each CAN Driver module a seperate instance of this container has to be provided.
      boolean CanIfCtrlDrvRxIndication: set at link in variant link-time+post-build / pre-compile in variant pre-compile  # Selects whether receive indication notification is supported. | True: Enabled False: Disabled
      boolean CanIfCtrlDrvTxCancellation: set at pre-compile  # Selects whether transmit cancellation is supported and if the appropriate callback will be provided to the CAN Driver module. | True: Enabled False: Disabled
      boolean CanIfCtrlDrvTxConfirmation: set at link in variant link-time+post-build / pre-compile in variant pre-compile  # Selects whether transmit confirmation notification is supported.
      reference CanIfCtrlDrvInitHohConfigRef: set at link in variant link-time+post-build / pre-compile in variant pre-compile, destination=CanIfInitHohCfg  # Reference to the Init Hoh Configuration
      reference CanIfCtrlDrvNameRef: set at pre-compile, destination=CanGeneral  # CAN Interface Driver Reference. | This reference can be used to get any information (Ex. Driver Name, Vendor ID) from the CAN driver. The CAN Driver name can be derived from the ShortName of the CAN driver module.
      container CanIfCtrlCfg [1..*]  # This container contains the configuration (parameters) of an adressed CAN controller by an underlying CAN Driver module. This container is configurable per CAN controller.
        integer CanIfCtrlId: 0..65535, set at link in variant link-time+post-build / pre-compile in variant pre-compile  # This parameter abstracts from the CAN Driver specific parameter Controller. Each controller of all connected CAN Driver modules shall be assigned to one specific ControllerId of the CanIf. | Range: 0..number of configured controllers of all CAN Driver modules
        boolean CanIfCtrlWakeupSupport: set at link in variant link-time+post-build / pre-compile in variant pre-compile, default-value=false  # This parameter defines if a respective controller of the referenced CAN Driver modules is queriable for wake up events. | True: Enabled False: Disabled
        symbolic name reference CanIfCtrlCanCtrlIdRef: set at link in variant link-time+post-build / pre-compile in variant pre-compile, destination=CanController  # This parameter references to the logical handle of the underlying CAN controller from the CAN Driver module to be served by the CAN Interface module. | Range: 0..max. number of underlying supported CAN controllers
        symbolic name reference CanIfCtrlWakeupSourceInRef [0..1]: set at pre-compile, destination=EcuMWakeupSource  # This parameter contains a reference to the wake up source for the | controller as defined in the ECU State Manager. The multiplicity is 0..1 since the checking of the wake up source is selectable. This parameter allows mapping of incoming wake up source to a specific contoller. Implementation Type: reference to EcuM_WakeupSourceType
        symbolic name reference CanIfCtrlWakeupSourceOutRef [0..1]: set at pre-compile, destination=EcuMWakeupSource  # This parameter contains a reference to the wake up source for the | controller as defined in the ECU State Manager. The multiplicity is 0..1 since the checking of the wake up source is selectable. This parameter allows mapping of a controller to wake up source of EcuM. Implementation Type: reference to EcuM_WakeupSourceType
    container CanIfDispatchCfg  # Callback functions provided by upper layer modules of the CanIf. The callback functions defined in this container are common to all configured CAN Driver / CAN Transceiver Driver modules.
      function name CanIfDispatchUserCtrlBusOffName [0..1]: set at link in variant link-time+post-build / pre-compile in variant pre-compile, max-length=32, min-length=1  # This parameter defines the name of <User_ControllerBusOff>. | This parameter depends on the parameter CANIF_USERCTRLBUSOFF_UL. If CANIF_USERCTRLBUSOFF_UL equals CAN_SM the name of <User_ControllerBusOff> is fixed. If CANIF_USERCTRLBUSOFF_UL equals CDD, the name of <User_ControllerBusOff> is selectable.
      enumeration CanIfDispatchUserCtrlBusOffUL: {CAN_SM, CDD}, set at link in variant link-time+post-build / pre-compile in variant pre-compile  # This parameter defines the upper layer (UL) module to which the notifications of all ControllerBusOff events from the CAN Driver modules have to be routed via <User_ControllerBusOff>. | There is no possibility to configure no upper layer (UL) module as the provider of <User_ControllerBusOff>.
      function name CanIfDispatchUserCtrlModeIndicationName [0..1]: set at link in variant link-time+post-build / pre-compile in variant pre-compile, max-length=32, min-length=1  # This parameter defines the name of <User_ControllerModeIndication>. | This parameter depends on the parameter CANIF_USERCTRLMODEINDICATION_UL. If CANIF_USERCTRLMODEINDICATION_UL equals CAN_SM the name of <User_ControllerModeIndication> is fixed. If CANIF_USERCTRLMODEINDICATION_UL equals CDD, the name of <User_ControllerModeIndication> is selectable.
      enumeration CanIfDispatchUserCtrlModeIndicationUL: {CAN_SM, CDD}, set at link in variant link-time+post-build / pre-compile in variant pre-compile  # This parameter defines the upper layer (UL) module to which the notifications of all ControllerTransition events from the CAN Driver modules have to be routed | via <User_ControllerModeIndication>.
      function name CanIfDispatchUserSetWakeupEventName [0..1]: set at link in variant link-time+post-build / pre-compile in variant pre-compile, max-length=32, min-length=1  # This parameter defines the name of <User_SetWakeupEvent>. | This parameter depends on the parameter CANIF_USERSETWAKEUPEVENT_UL. CANIF_USERSETWAKEUPEVENT_UL equals ECUM the name of <User_SetWakeupEvent> is fixed. CANIF_USERSETWAKEUPEVENT_UL equals CDD, the name of <User_SetWakeupEvent> is selectable.
      enumeration CanIfDispatchUserSetWakeupEventUL [0..1]: {CDD, ECUM}, set at link in variant link-time+post-build / pre-compile in variant pre-compile  # This parameter defines the upper layer (UL) module to which the | notifications about positive former requested wake up sources have to be routed via <User_SetWakeupEvent>.
      function name CanIfDispatchUserTrcvModeIndicationName [0..1]: set at link in variant link-time+post-build / pre-compile in variant pre-compile, max-length=32, min-length=1  # This parameter defines the name of <User_TrcvModeIndication>. | This parameter depends on the parameter CANIF_USERTRCVMODEINDICATION_UL. If CANIF_USERTRCVMODEINDICATION_UL equals CAN_SM the name of <User_TrcvModeIndication> is fixed. If CANIF_USERTRCVMODEINDICATION_UL equals CDD, the name of <User_TrcvModeIndication> is selectable.
      enumeration CanIfDispatchUserTrcvModeIndicationUL [0..1]: {CAN_SM, CDD}, set at link in variant link-time+post-build / pre-compile in variant pre-compile  # This parameter defines the upper layer (UL) module to which the notifications of all TransceiverTransition events from the CAN Transceiver Driver modules have to be routed via <User_TrcvModeIndication>. If no UL module is configured, no upper layer callback function will be called.
      function name CanIfDispatchUserValidateWakeupEventName [0..1]: set at link in variant link-time+post-build / pre-compile in variant pre-compile, max-length=32, min-length=1  # This parameter defines the name of <User_ValidateWakeupEvent>. This | parameter depends on the parameter CANIF_USERVALIDATEWAKEUPEVENT_UL. CANIF_USERVALIDATEWAKEUPEVENT_UL equals ECUM the name of <User_ValidateWakeupEvent> is fixed. CANIF_USERVALIDATEWAKEUPEVENT_UL equals CDD, the name of <User_ValidateWakeupEvent> is selectable. If parameter CANIF_WAKEUP_CHECK_VALIDATION_API is disabled, no <User_ValidateWakeupEvent> API can be configured.
      enumeration CanIfDispatchUserValidateWakeupEventUL [0..1]: {CDD, ECUM}, set at link in variant link-time+post-build / pre-compile in variant pre-compile  # This parameter defines the upper layer (UL) module to which the notifications about positive former requested wake up sources have to be routed via <User_ValidateWakeupEvent>. If parameter CANIF_WAKEUP_CHECK_VALIDATION_API is disabled, this parameter cannot be configured.
    container CanIfInitCfg: multiple-configuration-container=true  # This container contains the init parameters of the CAN Interface. | At least one (if only on CanIf with one possible Configuration), but multiple (CanIf with different Configurations) instances of this container are possible.
      string CanIfInitCfgSet: set at link in variant link-time / post-build in variant post-build / pre-compile in variant pre-compile, max-length=32, min-length=1  # Selects the CAN Interface specific configuration setup. This type of the external data structure shall contain the post build initialization data for the CAN Interface for all underlying CAN Dirvers. | constant to CanIf_ConfigType
      container CanIfInitHohCfg [0..*]  # This container contains the references to the configuration setup of each underlying CAN Driver.
        reference CanIfInitRefCfgSet: set at link in variant link-time / post-build in variant post-build / pre-compile in variant pre-compile, destination=CanConfigSet  # Selects the CAN Interface specific configuration setup. This type of external data structure shall contain the post build initialization data for the CAN Interface for all underlying CAN Drivers.
        container CanIfHrhCfg [0..*]  # This container contains configuration parameters for each hardware receive object (HRH).
          boolean CanIfHrhSoftwareFilter: set at link in variant link-time+post-build / pre-compile in variant pre-compile, default-value=true  # Selects the hardware receive objects by using the HRH range/list from CAN Driver configuration to define, for which HRH a software filtering has to be performed at during receive processing. | True: Software filtering is enabled False: Software filtering is enabled
          reference CanIfHrhCanCtrlIdRef: set at link in variant link-time+post-build / pre-compile in variant pre-compile, destination=CanIfCtrlCfg  # Reference to controller Id to which the HRH belongs to. A controller can contain one or more HRHs.
          symbolic name reference CanIfHrhCanHandleTypeRef: set at link in variant link-time+post-build / pre-compile in variant pre-compile, destination=CanHardwareObject  # The parameter refers to a particular HRH object in the CAN Driver Module configuration. | The type of the HRH can either be Full-CAN or Basic-CAN. The type of HRHs is defined in the CAN Driver Module and hence it is derived from CAN Driver Configuration of a Hardware Object. If BasicCAN is configured, software filtering is enabled.
          symbolic name reference CanIfHrhIdSymRef: set at link in variant link-time / post-build in variant post-build / pre-compile in variant pre-compile, destination=CanHardwareObject  # The parameter refers to a particular HRH object in the CAN Driver Module configuration. | The HRH id is unique in a given CAN Driver. The HRH Ids are defined in the CAN Driver Module and hence it is derived from CAN Driver Configuration.
          container CanIfHrhRangeCfg [0..*]  # Defines the parameters required for configurating multiple CANID ranges for a given same HRH.
            integer CanIfHrhRangeRxPduLowerCanId: 0..536870911, set at link in variant link-time / post-build in variant post-build / pre-compile in variant pre-compile  # Lower CAN Identifier of a receive CAN L-PDU for identifier range definition, in which all CAN Ids shall pass the software filtering.
            enumeration CanIfHrhRangeRxPduRangeCanIdType: {EXTENDED, STANDARD}, set at link in variant link-time / post-build in variant post-build / pre-compile in variant pre-compile  # Specifies whether a configured Range of CAN Ids shall only consider standard CAN Ids or extended CAN Ids.
            integer CanIfHrhRangeRxPduUpperCanId: 0..536870911, set at link in variant link-time / post-build in variant post-build / pre-compile in variant pre-compile  # Upper CAN Identifier of a receive CAN L-PDU for identifier range definition, in which all CAN Ids shall pass the software filtering.
        container CanIfHthCfg [0..*]  # This container contains parameters related to each HTH.
          reference CanIfHthCanCtrlIdRef: set at link in variant link-time+post-build / pre-compile in variant pre-compile, destination=CanIfCtrlCfg  # Reference to controller Id to which the HTH belongs to. A controller can contain one or more HTHs.
          symbolic name reference CanIfHthCanHandleTypeRef: set at link in variant link-time+post-build / pre-compile in variant pre-compile, destination=CanHardwareObject  # The parameter refers to a particular HTH object in the CAN Driver Module configuration. | The type of the HTH can either be Full-CAN or Basic-CAN. The type of HTHs is defined in the CAN Driver Module and hence it is derived from CAN Driver Configuration of a Hardware Object.
          symbolic name reference CanIfHthIdSymRef: set at link in variant link-time+post-build / pre-compile in variant pre-compile, destination=CanHardwareObject  # The parameter refers to a particular HTH object in the CAN Driver Module configuration. | The HTH id is unique in a given CAN Driver. The HTH Ids are defined in the CAN Driver Module and hence it is derived from CAN Driver Configuration.
      container CanIfRxPduCfg [0..*]  # This container contains the configuration (parameters) of each receive CAN L-PDU. | The SHORT-NAME of "CanIfRxPduConfig" container itself represents the symolic name of Receive L-PDU.
        integer CanIfRxPduCanId [0..1]: 0..536870911, set at link in variant link-time / post-build in variant post-build / pre-compile in variant pre-compile  # CAN Identifier of Receive CAN L-PDUs used by the CAN Interface. Exa: Software Filtering. This parameter is used if exactly one Can Identifier is assigned to the Pdu. If a range is assigned then the CanIfRxPduCanIdRange parameter shall be used. | Range: 11 Bit For Standard CAN Identifier ... 29 Bit For Extended CAN identifier
        enumeration CanIfRxPduCanIdType: {EXTENDED_CAN, STANDARD_CAN}, set at link in variant link-time / post-build in variant post-build / pre-compile in variant pre-compile  # CAN Identifier of receive CAN L-PDUs used by the CAN Driver for CAN L-PDU reception.
        integer CanIfRxPduDlc: 0..8, set at link in variant link-time / post-build in variant post-build / pre-compile in variant pre-compile  # Data Length code of received CAN L-PDUs used by the CAN Interface. Exa: DLC check. | The data area size of a CAN L-PDU can have a range from 0 to 8 bytes.
        integer CanIfRxPduId: 0..4294967295, set at link in variant link-time / post-build in variant post-build / pre-compile in variant pre-compile, symbolic-name-value=true  # ECU wide unique, symbolic handle for receive CAN L-PDU. The CanIfRxPduId is configurable at pre-compile and post-built time. It shall fulfill ANSI/AUTOSAR definitions for constant defines. | Range: 0..max. number of defined CanRxPduIds
        boolean CanIfRxPduReadData: set at link in variant link-time / post-build in variant post-build / pre-compile in variant pre-compile, default-value=false  # Enables and disables the Rx buffering for reading of received L-PDU data. | True: Enabled False: Disabled
        boolean CanIfRxPduReadNotifyStatus: set at link in variant link-time / post-build in variant post-build / pre-compile in variant pre-compile, default-value=false  # Enables and disables receive indication for each receive CAN L-PDU for reading its notification status. | True: Enabled False: Disabled
        function name CanIfRxPduUserRxIndicationName [0..1]: set at link in variant link-time+post-build / pre-compile in variant pre-compile, max-length=32, min-length=1  # This parameter defines the name of the <User_RxIndication>. | This parameter depends on the parameter CANIF_RXPDU_USERRXINDICATION_UL. If CANIF_RXPDU_USERRXINDICATION_UL equals CAN_TP, CAN_NM, PDUR, XCP or J1939TP, the name of the <User_RxIndication> is fixed. If CANIF_RXPDU_USERRXINDICATION_UL equals CDD, the name of the <User_RxIndication> is selectable.
        enumeration CanIfRxPduUserRxIndicationUL [0..1]: {CAN_NM, CAN_TP, CDD, J1939TP, PDUR, XCP}, set at link in variant link-time / post-build in variant post-build / pre-compile in variant pre-compile  # This parameter defines the upper layer (UL) module to which the indication | of the successfully received CANRXPDUID has to be routed via <User_RxIndication>. This <User_RxIndication> has to be invoked when the indication of the configured CANRXPDUID will be received by an Rx indication event from the CAN Driver module. If no upper layer (UL) module is configured, no <User_RxIndication> has to be called in case of an Rx indication event of the CANRXPDUID from the CAN Driver module.
        reference CanIfRxPduBswSchExclAreaIdRef: set at pre-compile, destination=RteBswExclusiveAreaImpl  # Reference to an exclusive area Id defined within the BSW Scheduler.
        reference CanIfRxPduHrhIdRef [1..*]: set at link in variant link-time / post-build in variant post-build / pre-compile in variant pre-compile, destination=CanIfHrhCfg  # The HRH to which Rx L-PDU belongs to, is referred through this parameter.
        reference CanIfRxPduRef: set at pre-compile, destination=Pdu  # Reference to the "global" Pdu structure to allow harmonization of handle IDs in the COM-Stack.
        container CanIfRxPduCanIdRange [0..1]  # Optional container that allows to map a range of CAN Ids to one PduId.
          integer CanIfRxPduCanIdRangeLowerCanId: 0..536870911, set at link in variant link-time / post-build in variant post-build / pre-compile in variant pre-compile  # Lower CAN Identifier of a receive CAN L-PDU for identifier range definition, in which all CAN Ids are mapped to one PduId.
          integer CanIfRxPduCanIdRangeUpperCanId: 0..536870911, set at link in variant link-time / post-build in variant post-build / pre-compile in variant pre-compile  # Upper CAN Identifier of a receive CAN L-PDU for identifier range definition, in which all CAN Ids are mapped to one PduId.
        container CanIfRxPduDemEventParameterRefs [0..1]  # Container for the references to DemEventParameter elements which shall be invoked using the API Dem_ReportErrorStatus API in case the corresponding error occurs. The EventId is taken from the referenced DemEventParameter's DemEventId value. The standardized errors are provided in the container and can be extended by vendor-specific error references.
          symbolic name reference CANIF_E_INVALID_DLC [0..1]: set at link in variant link-time / post-build in variant post-build / pre-compile in variant pre-compile, destination=DemEventParameter  # Reference to the DemEventParameter which shall be issued when the error "Failed DLC Check" has occured.
        container CanIfTTRxFrameTriggering [0..1]  # This container is only included and valid if TTCAN Interface SWS is used and TTCAN is enabled. | Frame trigger for TTCAN reception. CanIfTTRxFrameTriggering is only included, if the controller supports TTCAN and a joblist is used for reception.
          integer CanTTRxJoblistTimeMark [0..1]: 0..65535, set at link in variant link-time / post-build in variant post-build / pre-compile in variant pre-compile  # Defines the point in time, when the joblist execution funciton (JLEF) shall be called for the referenced rx trigger. Value is given in cycle time. This parameter is only configurable if a joblist is enabled by parameter CanIfTTJobList.
          reference CanIfTTRxHwObjectTriggerIdRef: set at link in variant link-time / post-build in variant post-build / pre-compile in variant pre-compile, destination=CanTTHardwareObjectTrigger  # This parameter refers to a particular TTCAN hardware receive object Trigger of a hardware object in the TTCAN Driver Module, which is referred via plain CAN parameter CANIF_HRH_HANDLETYPE_REF. This parameter is only configurable if a joblist is enabled by parameter CanIfTTJobList.
      container CanIfTxPduCfg [0..*]  # This container contains the configuration (parameters) of a transmit CAN L-PDU. It has to be configured as often as a transmit CAN L-PDU is needed. | The SHORT-NAME of "CanIfTxPduConfig" container represents the symolic name of Transmit L-PDU.
        integer CanIfTxPduCanId: 0..536870911, set at link in variant link-time / post-build in variant post-build / pre-compile in variant pre-compile  # CAN Identifier of transmit CAN L-PDUs used by the CAN Driver for CAN L-PDU transmission. | Range: 11 Bit For Standard CAN Identifier ... 29 Bit For Extended CAN identifier
        enumeration CanIfTxPduCanIdType: {EXTENDED_CAN, STANDARD_CAN}, set at link in variant link-time / post-build in variant post-build / pre-compile in variant pre-compile  # Type of CAN Identifier of the transmit CAN L-PDU used by the CAN Driver module for CAN L-PDU transmission.
        integer CanIfTxPduDlc: 0..8, set at link in variant link-time / post-build in variant post-build / pre-compile in variant pre-compile  # Data length code (in bytes) of transmit CAN L-PDUs used by the CAN Driver for CAN L-PDU transmission. | The data area size of a CAN L-Pdu can have a range from 0 to 8 bytes.
        integer CanIfTxPduId: 0..4294967295, set at link in variant link-time / post-build in variant post-build / pre-compile in variant pre-compile, symbolic-name-value=true  # ECU wide unique, symbolic handle for transmit CAN L-PDU. The CanIfTxPduId is configurable at pre-compile and post-built time. | Range: 0..max. number of CantTxPduIds
        boolean CanIfTxPduReadNotifyStatus: set at link in variant link-time / post-build in variant post-build / pre-compile in variant pre-compile, default-value=false  # Enables and disables transmit confirmation for each transmit CAN L-PDU for reading its notification status. | True: Enabled False: Disabled
        enumeration CanIfTxPduType: {DYNAMIC, STATIC}, set at link in variant link-time / post-build in variant post-build / pre-compile in variant pre-compile  # Defines the type of each transmit CAN L-PDU.
        function name CanIfTxPduUserTxConfirmationName [0..1]: set at link in variant link-time+post-build / pre-compile in variant pre-compile, max-length=32, min-length=1  # This parameter defines the name of the <User_TxConfirmation>. This | parameter depends on the parameter CANIF_TXPDU_USERTXCONFIRMATION_UL. If CANIF_TXPDU_USERTXCONFIRMATION_UL equals CAN_TP, CAN_NM, PDUR, XCP or J1939TP, the name of the <User_TxConfirmation> is fixed. If CANIF_TXPDU_USERTXCONFIRMATION_UL equals CDD, the name of the <User_TxConfirmation> is selectable.
        enumeration CanIfTxPduUserTxConfirmationUL [0..1]: {CAN_NM, CAN_TP, CDD, J1939TP, PDUR, XCP}, set at link in variant link-time / post-build in variant post-build / pre-compile in variant pre-compile  # This parameter defines the upper layer (UL) module to which the confirmation of the successfully transmitted CANTXPDUID has to be routed via the <User_TxConfirmation>. | This <User_TxConfirmation> has to be invoked when the confirmation of the configured CANTXPDUID will be received by a Tx confirmation event from the CAN Driver module. If no upper layer (UL) module is configured, no <User_TxConfirmation> has to be called in case of a Tx confirmation event of the CANTXPDUID from the CAN Driver module.
        reference CanIfTxPduBswSchExclAreaIdRef: set at pre-compile, destination=RteBswExclusiveAreaImpl  # Reference to an exclusive area Id defined within the BSW Scheduler.
        reference CanIfTxPduHthIdRef: set at link in variant link-time / post-build in variant post-build / pre-compile in variant pre-compile, destination=CanIfHthCfg  # Handle, that defines the hardware object or the pool of hardware objects configured for transmission. | The parameter refers HTH Id, to which the L-PDU belongs to.
        reference CanIfTxPduRef: set at pre-compile, destination=Pdu  # Reference to the "global" Pdu structure to allow harmonization of handle IDs in the COM-Stack.
        container CanIfTTTxFrameTriggering [0..1]  # This container is only included and valid if TTCAN Interface SWS is used and TTCAN is enabled. | Frame trigger for TTCAN transmission. CanIfTTTxFrameTriggering is only included, if the controller supports TTCAN and a joblist is used.
          integer CanIfTTTxJoblistTimeMark [0..1]: 0..65535, set at link in variant link-time / post-build in variant post-build / pre-compile in variant pre-compile  # Defines the point in time, when the joblist execution funciton (JLEF) shall be called for the referenced tx frame trigger. | Value is given in cycle time. This parameter is only configurable if a joblist is enabled by parameter CanIfTTJobList.
          reference CanIfTTTxHwObjectTriggerIdRef: set at link in variant link-time / post-build in variant post-build / pre-compile in variant pre-compile, destination=CanTTHardwareObjectTrigger  # This parameter refers to a particular TTCAN hardware transmit object Trigger of a hardware object in the TTCAN Driver Module, | which is referred via plain CAN parameter CANIF_HTH_HANDLETYPE_REF. This parameter is only configurable if a joblist is enabled by parameter CanIfTTJobList.
        container CanIfTxPduDemEventParameterRefs [0..1]  # Container for the references to DemEventParameter elements which shall be invoked using the API Dem_ReportErrorStatus API in case the corresponding error occurs. The EventId is taken from the referenced DemEventParameter's DemEventId value. The standardized errors are provided in the container and can be extended by vendor-specific error references.
          symbolic name reference CANIF_E_STOPPED [0..1]: set at link in variant link-time / post-build in variant post-build / pre-compile in variant pre-compile, destination=DemEventParameter  # Reference to the DemEventParameter which shall be issued when the error "CAN Interface is in STOPPED mode" has occured.
    container CanIfPrivateCfg  # This container contains the private configuration (parameters) of the CAN Interface.
      boolean CanIfPrivateDlcCheck: set at pre-compile, default-value=true  # Selects whether the DLC check is supported. | True: Enabled False: Disabled
      enumeration CanIfPrivateSoftwareFilterType: {BINARY, INDEX, LINEAR, TABLE}, set at pre-compile  # Selects the desired software filter mechanism for reception only. | Each implemented software filtering method is identified by this enumeration number. Range: Types implemented software filtering methods
      boolean CanIfSupportTTCAN: set at pre-compile, default-value=false  # Defines whether TTCAN is supported. | TRUE: TTCAN is supported. FALSE: TTCAN is not supported, only normal CAN communication is possible.
      container CanIfTTGeneral [0..1]  # This container is only included and valid if TTCAN Interface SWS is used and TTCAN is enabled. | This container contains the parameters, which define if and in which way TTCAN is supported. CanIfTTGeneral is only included, if the controller supports TTCAN.
        boolean CanIfTTJoblist: set at pre-compile, default-value=false  # Defines whether TTCAN is processed via a joblist. | TRUE: Joblist is used. FALSE: No joblist is used. This parameter is only configurable if TTCAN is enabled by parameter CanIfSupportTTCAN.
        integer CanIfTTMaxIsrDelay: 0..65535, set at link in variant link-time / post-build in variant post-build / pre-compile in variant pre-compile  # Defines the maximum delay for the execution of the joblist execution function JLEF. This parameter is only configurable if a joblist is enabled by parameter CanIfTTJobList.
    container CanIfPublicCfg  # This container contains the public configuration (parameters) of the CAN Interface.
      boolean CanIfPublicCancelTransmitSupport: set at pre-compile  # Configuration parameter to enable/disable dummy API for upper layer modules which allows to request the cancellation of an I-PDU.
      string CanIfPublicCddHeaderFile [0..*]: set at pre-compile, max-length=32, min-length=1  # Defines header files for callback functions which shall be included in case of CDDs. Range of characters is 1.. 32.
      boolean CanIfPublicDevErrorDetect: set at pre-compile, default-value=true  # Enables and disables the development error detection and notification mechanism. | True: Enabled False: Disabled
      enumeration CanIfPublicHandleTypeEnum: {UINT16, UINT8}, set at pre-compile  # This parameter is used to configure the Can_HwHandleType. The Can_HwHandleType represents the hardware object handles of a CAN hardware unit. For CAN hardware units with more than 255 HW objects the extended range shall be used (UINT16).
      boolean CanIfPublicMultipleDrvSupport: set at pre-compile, default-value=true  # Selects support for multiple CAN Drivers. | True: Enabled False: Disabled
      integer CanIfPublicNumberOfCanHwUnits: 1..255, set at link in variant link-time+post-build / pre-compile in variant pre-compile, default-value=1  # Number of served CAN hardware units.
      boolean CanIfPublicReadRxPduDataApi: set at pre-compile, default-value=false  # Enables / Disables the API CanIf_ReadRxPduData() for reading received L-PDU data. | True: Enabled False: Disabled
      boolean CanIfPublicReadRxPduNotifyStatusApi: set at pre-compile, default-value=false  # Enables and disables the API for reading the received L-PDU data. | True: Enabled False: Disabled
      boolean CanIfPublicReadTxPduNotifyStatusApi: set at pre-compile, default-value=false  # Enables and disables the API for reading the notification status of transmit and receive L-PDUs. | True: Enabled False: Disabled
      boolean CanIfPublicSetDynamicTxIdApi: set at pre-compile, default-value=false  # Enables and disables the API for reconfiguration of the CAN Identifier for each Transmit L-PDU. | True: Enabled False: Disabled
      boolean CanIfPublicTxBuffering: set at pre-compile, default-value=false  # Enables and disables the buffering of transmit L-PDUs (rejected by the CanDrv) within the CAN Interface module. | True: Enabled False: Disabled
      boolean CanIfPublicTxConfirmPollingSupport: set at pre-compile  # Configuration parameter to enable/disable the API to poll for Tx Confirmation state.
      boolean CanIfPublicVersionInfoApi: set at pre-compile, default-value=true  # Enables and disables the API for reading the version information about the CAN Interface. | True: Enabled False: Disabled
      boolean CanIfPublicWakeupCheckValidApi: set at pre-compile, default-value=false  # Enables and disables the API for validating a former detected wakeup. | True: Enabled False: Disabled
      boolean CanIfPublicWakeupCheckValidByNM [0..1]: set at pre-compile, default-value=false  # If enabled, only NM messages shall validate a detected wake-up event | (see CANIF722) at the corresponding wake-up source in the CanIf. If disabled, all messages shall validate such a wake-up event. This parameter depends on CANIF_PUBLIC_WAKEUP_CHECK_VALID_API and shall only be configurable, if it is enabled. True: Enabled False: Disabled
    container CanIfTrcvDrvCfg [0..*]  # This container contains the configuration (parameters) of all addressed CAN transceivers by each underlying CAN Transceiver Driver module. For each CAN transceiver Driver a seperate instance of this container shall be provided.
      container CanIfTrcvCfg [1..*]  # This container contains the configuration (parameters) of one addressed CAN transceiver by the underlying CAN Transceiver Driver module. For each CAN transceiver a seperate instance of this container has to be provided.
        integer CanIfTrcvId: 0..65535, set at link in variant link-time+post-build / pre-compile in variant pre-compile  # This parameter abstracts from the CAN Transceiver Driver specific parameter Transceiver. Each transceiver of all connected CAN Transceiver Driver modules shall be assigned to one specific TransceiverId of the CanIf. | Range: 0..number of configured transceivers of all CAN Transceiver Driver modules
        boolean CanIfTrcvWakeupSupport: set at link in variant link-time+post-build / pre-compile in variant pre-compile, default-value=false  # This parameter defines if a respective transceiver of the referenced CAN Transceiver Driver modules is queriable for wake up events. | True: Enabled False: Disabled
        symbolic name reference CanIfTrcvCanTrcvIdRef: set at link in variant link-time+post-build / pre-compile in variant pre-compile, destination=CanTrcvChannel  # This parameter references to the logical handle of the underlying CAN transceiver from the CAN Transceiver Driver module to be served by the CAN Interface module. | Range: 0..max. number of underlying supported CAN transceivers
        symbolic name reference CanIfTrcvWakeupSourceInRef [0..1]: set at pre-compile, destination=EcuMWakeupSource  # This parameter contains a reference to the wake up source for the | transceiver as defined in the ECU State Manager. The multiplicity is 0..1 since the checking of the wake up source is selectable. This parameter allows mapping of incoming wake up source to a specific transceiver. Implementation Type: reference to EcuM_WakeupSourceType
        symbolic name reference CanIfTrcvWakeupSourceOutRef [0..1]: set at pre-compile, destination=EcuMWakeupSource  # This parameter contains a reference to the wake up source for the | transceiver as defined in the ECU State Manager. The multiplicity is 0..1 since the checking of the wake up source is selectable. This parameter allows mapping of a transceiver to wake up source of EcuM. Implementation Type: reference to EcuM_WakeupSourceType
  module definition CanNm [0..1]: variants link-time/post-build/pre-compile  # Configuration Parameters for the Can Nm module.
    container CanNmGlobalConfig: multiple-configuration-container=true  # This container contains the global configuration parameter of the CanNm. The parameters and the parameters of the sub containers shall be mapped to the C data type CanNm_ConfigType (for parameters where it is possible) which is passed to the CanNm_Init function. | This container is a MultipleConfigurationContainer (only for variant 3), i.e. this container and its sub-containers exit once per configuration set.
      boolean CanNmBusLoadReductionEnabled: set at pre-compile  # Pre-processor switch for enabling busload reduction support.
      boolean CanNmBusSynchronizationEnabled: set at pre-compile  # Pre-processor switch for enabling bus synchronization support. This feature is required for gateway nodes only. | calculationFormula = If (CanNmPassiveModeEnabled == False) then Equal(NmBusSynchronizationEnabled) else Equal(False)
      boolean CanNmComControlEnabled: set at pre-compile  # Pre-processor switch for enabling the Communication Control support. | calculationformula = Equal(NmComControlEnabled)
      boolean CanNmComUserDataSupport: set at pre-compile  # Enable/disable the user data support.
      boolean CanNmDevErrorDetect: set at pre-compile  # Pre-processor switch for enabling development error detection support.
      boolean CanNmImmediateRestartEnabled: set at pre-compile  # Pre-processor switch for enabling the asynchronous transmission of a NM PDU upon bus-communication request in Prepare-Bus-Sleep mode.
      boolean CanNmImmediateTxconfEnabled: set at pre-compile  # Enable/disable the immediate tx confirmation.
      float CanNmMainFunctionPeriod: 0.001..0.255, set at link in variant link-time+post-build / pre-compile in variant pre-compile  # Call cycle in seconds of CanNm_MainFunction.
      boolean CanNmNodeDetectionEnabled: set at pre-compile  # Precompile time switch to enable the node detection feature.
      integer CanNmNumberOfChannels: 1..255, set at pre-compile  # Number of Can NM channels allowed within one ECU.
      boolean CanNmPassiveModeEnabled: set at pre-compile  # Pre-processor switch for enabling support of the Passive Mode. | calculationFormula = Equal(NmPassiveModeEnabled)
      boolean CanNmPduRxIndicationEnabled: set at pre-compile  # Pre-processor switch for enabling the PDU Rx Indication. | calculationFormula = Equal(NmPduRxIndicationEnabled)
      boolean CanNmRemoteSleepIndEnabled: set at pre-compile  # Pre-processor switch for enabling remote sleep indication support. This feature is required for gateway nodes only. | calculationFormula = If (CanNmPassiveModeEnabled == False) then Equal(NmRemoteSleepIndEnabled) else Equal(False)
      boolean CanNmRepeatMsgIndEnabled: set at pre-compile  # Enable/disable the notification that a RepeatMessageRequest bit has been received. | calculationformula = Equal(NmRepeatMsgIndEnabled)
      boolean CanNmStateChangeIndEnabled: set at pre-compile  # Pre-processor switch for enabling the CAN NM state change notification. | calculationFormula = Equal(NmStateChangeIdEnabled)
      boolean CanNmUserDataEnabled: set at pre-compile  # Pre-processor switch for enabling user data support. | calculationFormula = Equal(NmUserDataEnabled)
      boolean CanNmVersionInfoApi: set at pre-compile  # Pre-processor switch for enabling version info API support.
      container CanNmChannelConfig [1..*]  # This container contains the channel specific configuration parameter of the CanNm.
        boolean CanNmBusLoadReductionActive: set at link in variant link-time+post-build / pre-compile in variant pre-compile  # This parameter defines if bus load reduction for the respective NM channel is active or not.
        float CanNmImmediateNmCycleTime [0..1]: 0.001..65.535, set at link in variant link-time+post-build / pre-compile in variant pre-compile  # Defines the immediate NM PDU cycle time in seconds which is used for CanNmImmediateNmTransmissions NM PDU transmissions. This parameter is only valid if CanNmImmediateNmTransmissions is greater one.
        integer CanNmImmediateNmTransmissions: 0..255, set at link in variant link-time+post-build / pre-compile in variant pre-compile  # Defines the number of immediate NM PDUs which shall be transmitted. If the value is zero no immediate NM PDUs are transmitted. The cycle time of immeditate NM PDUs is defined by CanNmImmediateNmCycleTime.
        float CanNmMsgCycleOffset: 0..65.535, set at link in variant link-time+post-build / pre-compile in variant pre-compile  # Time offset in the periodic transmission node. It determines the start delay of the transmission. Specified in seconds. | This parameter is only valid if CanNmPassiveModeEnabled is False.
        float CanNmMsgCycleTime: 0.001..65.535, set at link in variant link-time+post-build / pre-compile in variant pre-compile  # Period of a NM-message in seconds. It determines the periodic rate in the "periodic transmission mode with bus load reduction" and is the basis for transmit scheduling in the "periodic transmission mode without bus load reduction". | This parameter is only valid if CanNmPassiveModeEnabled is False.
        float CanNmMsgReducedTime: 0.001..65.535, set at link in variant link-time / pre-compile in variant pre-compile  # Node specific bus cycle time in the periodic transmission mode with bus load reduction. Specified in seconds. | This parameter is only valid if CanNmBusLoadReductionEnabled == True and CanNmBusLoadReductionActive == True and CanNmPassiveModeEnabled == False Otherwise this parameter is not used.
        float CanNmMsgTimeoutTime: 1..65.535, set at link in variant link-time+post-build / pre-compile in variant pre-compile  # Transmission Timeout of NM-message. If there is no transmission confirmation by the CAN Interface within this timeout, the CANNM module shall give an error notification. | This parameter is only valid if CANNM_PASSIVE_MODE_ENABLED is disabled.
        integer CanNmNodeId: 0..255, set at link in variant link-time+post-build / pre-compile in variant pre-compile  # Node identifier of local node. | This parameter is only valid if CanNmPassiveModeEnabled = False and CanNmNodeDetectionEnabled = True
        enumeration CanNmPduCbvPosition: {CANNM_PDU_BYTE_0, CANNM_PDU_BYTE_1, CANNM_PDU_OFF}, set at link in variant link-time+post-build / pre-compile in variant pre-compile  # Defines the position of the control bit vector within the NM PDU. | The value of the parameter represents the location of the control bit vector in the NM PDU (CanNmPduByte0 means byte 0, CanNmPduByte1 means byte 1, CanNmPduOff means source node identifier is not part of the NM PDU) if(CANNM_PDU_CBV_POSITION != CANNM_PDU_OFF && CANNM_PDU_NID_POSITION != CANNM_PDU_OFF) then CANNM_PDU_CBV_POSITION != CANNM_PDU_NID_POSITION if(CANNM_PDU_CBV_POSITION != CANNM_PDU_OFF && CANNM_PDU_NID_POSITION == CANNM_PDU_OFF) then CANNM_PDU_CBV_POSITION = CANNM_PDU_BYTE0 ImplementationType: CanNm_PduPositionType
        enumeration CanNmPduNidPosition: {CANNM_PDU_BYTE_0, CANNM_PDU_BYTE_1, CANNM_PDU_OFF}, set at link in variant link-time+post-build / pre-compile in variant pre-compile  # Defines the position of the source node identifier within the NM PDU. | The value of the parameter represents the location of the source node identifier in the NM PDU (CanNMPduByte0 means byte 0, CanNmPduByte1 means byte 1, CanNmPduOff means source node identifier is not part of the NM PDU) if(CANNM_PDU_NID_POSITION != CANNM_PDU_OFF && CANNM_PDU_CBV_POSITION != CANNM_PDU_OFF) then CANNM_PDU_NID_POSITION != CANNM_PDU_CBV_POSITION if(CANNM_PDU_NID_POSITION != CANNM_PDU_OFF && CANNM_PDU_CBV_POSITION == CANNM_PDU_OFF) then CANNM_PDU_NID_POSITION = CANNM_PDU_BYTE0 ImplementationType: CanNm_PduPositionType
        float CanNmRemoteSleepIndTime: 0.001..65.535, set at link in variant link-time+post-build / pre-compile in variant pre-compile  # Timeout for Remote Sleep Indication. | It defines the time in seconds how long it shall take to recognize that all other nodes are ready to sleep. Typically it should be equal to: n * CanNmMsgCycleTime, where n denotes the number of NM-Messages that are normally sent before Remote Sleep Indication is detected. The value of n decremented by one determines the amount of lost NM-Messages that can be tolerated by the Remote Sleep Indication procedure. The value 0 denotes that no Remote Sleep Indication functionality is configured.
        float CanNmRepeatMessageTime: 0..65.535, set at link in variant link-time+post-build / pre-compile in variant pre-compile  # Timeout for Repeat Message State. | It defines the time in seconds how long the NM shall stay in the Repeat Message State. Typically it should be equal to: n * CanNmMsgCycleTime, where n denotes the number of NM-Messages that are normally sent in the Repeat Message State. The value of n decremented by one determines the amount of lost NM-Messages that can be tolerated by the node detection procedure. The value 0 denotes that no Repeat Message State is configured. It means that Repeat Message State is transient what implicates that it is left immediately after entrance and in result no start-up stability is guaranteed and no node detection procedure is possible.
        float CanNmTimeoutTime: 0.002..65.535, set at link in variant link-time+post-build / pre-compile in variant pre-compile  # Network Timeout for NM-Messages. | It denotes the time in seconds how long the NM shall stay in the Network Mode before transition into Prepare Bus-Sleep Mode shall take place. It shall be equal for all nodes in the cluster. It shall be greater than CanNmMsgCycleTime. Typically it should be equal to: n * CanNmMsgCycleTime, where n denotes the number of NM-Message cycle times in the Ready Sleep State before transition into the Bus-Sleep Mode is initiated. The value of n decremented by one determines the amount of lost NM-Messages that can be tolerated by the coordination algorithm.
        integer CanNmUserDataLength: 0..8, set at link in variant link-time+post-build / pre-compile in variant pre-compile  # Defines the length of the user data contained in the NM PDU
        float CanNmWaitBusSleepTime: 0.001..65.535, set at link in variant link-time+post-build / pre-compile in variant pre-compile  # Timeout for bus calm down phase. | It denotes the time in seconds how long the NM shall stay in the Prepare Bus-Sleep Mode before transition into Bus-Sleep Mode shall take place. It shall be equal for all nodes in the cluster. It shall be long enough to make all Tx-buffer empty.
        symbolic name reference CanNmComMNetworkHandleRef: set at link in variant link-time+post-build / pre-compile in variant pre-compile, destination=ComMChannel  # This reference points to the unique channel defined by the ComMChannel and provides access to the unique channel index value in ComMChannelId.
        container CanNmRxPdu  # This container is used to configure the Rx PDU properties that are used for the CanNm Channel.
          integer CanNmRxPduId: 0..65535, set at link in variant link-time+post-build / pre-compile in variant pre-compile, symbolic-name-value=true  # This parameter defines the Rx PDU ID of the CanIf L-PDU range that is associated with this CanNmChannel instance.
          reference CanNmRxPduRef: set at link in variant link-time+post-build / pre-compile in variant pre-compile, destination=Pdu  # Reference to the global PDU that is used by this CanNmChannel instance.
        container CanNmTxPdu  # This container contains the CanNmTxConfirmationPduId and the CanNmTxPduRef.
          integer CanNmTxConfirmationPduId: 0..65535, set at link in variant link-time+post-build / pre-compile in variant pre-compile, symbolic-name-value=true  # Handle Id to be used by the Lower Layer to confirm the transmission of the CanNmTxPdu to the LowerLayer.
          reference CanNmTxPduRef: set at link in variant link-time / post-build in variant post-build / pre-compile in variant pre-compile, destination=Pdu  # The reference to the common PDU structure.
        container CanNmUserDataTxPdu [0..1]  # This optional container is used to configure the UserNm PDU. This container is only available if CanNmComUserDataSupport is enabled.
          integer CanNmTxUserDataPduId: 0..65535, set at link in variant link-time+post-build / pre-compile in variant pre-compile, symbolic-name-value=true  # This parameter defines the Handle ID of the NM User Data I-PDU.
          reference CanNmTxUserDataPduRef: set at link in variant link-time+post-build / pre-compile in variant pre-compile, destination=Pdu  # Reference to the NM User Data I-PDU in the global PDU collection.
      container CanNmDemEventParameterRefs [0..1]  # Container for the references to DemEventParameter elements which shall be invoked using the API Dem_ReportErrorStatus API in case the corresponding error occurs. The EventId is taken from the referenced DemEventParameter's DemEventId value. The standardized errors are provided in the container and can be extended by vendor specific error references.
        symbolic name reference CANNM_E_CANIF_TRANSMIT_ERROR [0..1]: set at link in variant link-time+post-build / pre-compile in variant pre-compile, destination=DemEventParameter  # Reference to the DemEventParameter which shall be issued when the error "CanIf_Transmit has failed" has occured.
        symbolic name reference CANNM_E_INIT_FAILED [0..1]: set at link in variant link-time+post-build / pre-compile in variant pre-compile, destination=DemEventParameter  # Reference to the DemEventParameter which shall be issued when the error "CanNm initialization has failed" has occured.
        symbolic name reference CANNM_E_NETWORK_TIMEOUT [0..1]: set at link in variant link-time+post-build / pre-compile in variant pre-compile, destination=DemEventParameter  # Reference to the DemEventParameter which shall be issued when the error "NM-Timeout Timer has abnormally expired outside of the Ready Sleep State" has occured.
  module definition CanSM [0..1]: variants link-time/post-build/pre-compile  # Configuration of the CanSM module
    container CanSMConfiguration: multiple-configuration-container=true  # This container contains the global parameters of the CanSM and sub containers, which are for the CAN network specific configuration.
      integer CanSMModeRequestRepetitionMax: 0..255, set at link in variant link-time / post-build in variant post-build / pre-compile in variant pre-compile  # Specifies the maximal amount of mode request repetitions without a respective mode indication from the CanIf module until the CanSM module reports a production error to the DEM and tries to go back to no communication.
      float CanSMModeRequestRepetitionTime: 0..65.535, set at link in variant link-time / post-build in variant post-build / pre-compile in variant pre-compile  # Specifies in which time duration the CanSM module shall repeat mode change requests by using the API of the CanIf module.
      container CanSMManagerNetwork [1..*]  # This container contains the CAN network specific parameters of each CAN network
        integer CanSMBorCounterL1ToL2: 0..255, set at link in variant link-time / post-build in variant post-build / pre-compile in variant pre-compile  # This threshold defines the count of bus-offs until the bus-off recovery switches from level 1 (short recovery time) to level 2 (long recovery time).
        integer CanSMBorCounterL2Err: 0..255, set at link in variant link-time / post-build in variant post-build / pre-compile in variant pre-compile  # This threshold defines the count of bus-offs until the bus-off recovery reports to the DEM the respective diagnostic event / production error as failed (ref. to CANSM301)
        float CanSMBorTimeL1: 0..65.535, set at link in variant link-time / post-build in variant post-build / pre-compile in variant pre-compile  # This time parameter defines in seconds the duration of the bus-off recovery time in level 1 (short recovery time).
        float CanSMBorTimeL2: 0..65.535, set at link in variant link-time / post-build in variant post-build / pre-compile in variant pre-compile  # This time parameter defines in seconds the duration of the bus-off recovery time in level 2 (long recovery time).
        float CanSMBorTimeTxEnsured: 0..65.535, set at link in variant link-time / post-build in variant post-build / pre-compile in variant pre-compile  # This parameter defines in seconds the duration of the bus-off event check. This check assesses, if the recovery has been successful after the recovery reenables the transmit path. If a new bus-off occurs during this time period, the CanSM assesses this bus-off as sequential bus-off without successful recovery. Because a bus-off only can be detected, when PDUs are transmitted, the time has to be great enough to ensure that PDUs are transmitted again (e. g. time period of the fastest cyclic transmitted PDU of the COM module / ComTxModeTimePeriodFactor).
        boolean CanSMBorTxConfirmationPolling: set at pre-compile  # This parameter shall configure, if the CanSM polls the CanIf_GetTxConfirmationState API to decide the bus-off state to be recovered instead of using the CanSMBorTimeTxEnsured parameter for this decision.
        integer CanSMNetworkIndex: 0..255, set at link in variant link-time / post-build in variant post-build / pre-compile in variant pre-compile, symbolic-name-value=true  # This parameter holds the unique channel index value. The value shall be the same as the ComMChannelId of the ComMChannel referenced by CanSMComMNetworkHandleRef. | Implementation Type: NetworkHandleType
        symbolic name reference CanSMComMNetworkHandleRef: set at link in variant link-time / post-build in variant post-build / pre-compile in variant pre-compile, destination=ComMChannel  # Unique handle to identify one certain CAN network. Reference to one of the network handles configured for the ComM.
        symbolic name reference CanSMTransceiverId: set at link in variant link-time / post-build in variant post-build / pre-compile in variant pre-compile, destination=CanTrcvChannel  # ID of the CAN transceiver assigned to the configured network handle. Reference to one of the transceivers managed by the CanIf module.
        container CanSMController [1..*]  # This container contains the controller IDs assigned to a CAN network.
          symbolic name reference CanSMControllerId: set at link in variant link-time / post-build in variant post-build / pre-compile in variant pre-compile, destination=CanController  # Unique handle to identify one certain CAN controller. Reference to one of the CAN controllers managed by the CanIf module.
        container CanSMDemEventParameterRefs [0..1]  # Container for the references to DemEventParameter elements which shall be invoked using the API Dem_ReportErrorStatus API in case the corresponding error occurs. The EventId is taken from the referenced DemEventParameter's DemEventId value. The standardized errors are provided in the container and can be extended by vendor specific error references.
          symbolic name reference CANSM_E_BUS_OFF [0..1]: set at link in variant link-time / post-build in variant post-build / pre-compile in variant pre-compile, destination=DemEventParameter  # Reference to configured DEM event to report bus off errors for this CAN network.
          symbolic name reference CANSM_E_MODE_REQUEST_TIMEOUT [0..1]: set at link in variant link-time / post-build in variant post-build / pre-compile in variant pre-compile, destination=DemEventParameter  # Reference to configured DEM event to report, if a CAN network is impacted of a mode request timeout.
    container CanSMGeneral  # Container for general pre-compile parameters of the CanSM module
      boolean CanSMDevErrorDetect: set at pre-compile  # Enables and disables the development error detection and notification mechanism.
      float CanSMMainFunctionTimePeriod: 0.001..65.535, set at pre-compile  # This parameter defines the cycle time of the function CanSM_MainFunction in seconds
      boolean CanSMVersionInfoApi: set at pre-compile  # Activate/Deactivate the version information API (CanSM_GetVersionInfo). | true: version information API activated false: version information API deactivated
  module definition CanTp [0..1]: variants post-build/pre-compile  # Configuration of the CanTp (CAN Transport Protocol) module.
    container CanTpConfig: multiple-configuration-container=true  # This container contains the configuration parameters and sub containers of the AUTOSAR CanTp module. This container is a MultipleConfigurationContainer, i.e. this container and its sub-containers exist once per configuration set.
      container CanTpChannel [1..*]  # This container contains the configuration parameters of the CanTp channel.
        enumeration CanTpChannelMode: {CANTP_MODE_FULL_DUPLEX, CANTP_MODE_HALF_DUPLEX}, set at pre-compile  # The CAN Transport Layer supports half and full duplex channel modes.
        container CanTpChannelDemEventParameterRefs [0..1]  # Container for the references to DemEventParameter elements which shall be invoked using the API Dem_ReportErrorStatus API in case the corresponding error occurs. The EventId is taken from the referenced DemEventParameter's DemEventId value. The standardized errors are provided in the container and can be extended by vendor specific error references.
          symbolic name reference CANTP_E_COM [0..1]: set at post-build in variant post-build / pre-compile in variant pre-compile, destination=DemEventParameter  # Reference to the DemEventParameter which shall be issued when any protocol timeout error or implementation specific error has occured.
          symbolic name reference CANTP_E_OPER_NOT_SUPPORTED [0..1]: set at post-build in variant post-build / pre-compile in variant pre-compile, destination=DemEventParameter  # Reference to the DemEventParameter which shall be issued when the error "Requested operation is not supported" has occured.
        container CanTpRxNSdu [0..*]  # The following parameters needs to be configured for each CAN N-SDU that the CanTp module receives via the CanTpChannel.
          integer CanTpBs [0..1]: 0..255, set at post-build in variant post-build / pre-compile in variant pre-compile  # Sets the maximum number of N-PDUs the CanTp receiver allows the sender to send, before waiting for an authorization to continue transmission of the following N-PDUs.For further details on this parameter value see ISO 15765-2 specification. | Note: For reasons of buffer length, the CAN Transport Layer can adapt the BS value within the limit of this maximum BS
          float CanTpNar [0..1]: set at post-build in variant post-build / pre-compile in variant pre-compile  # Value in seconds of the N_Ar timeout. N_Ar is the time for transmission of a CAN frame (any N_PDU) on the receiver side.
          float CanTpNbr: 0..Inf, set at post-build in variant post-build / pre-compile in variant pre-compile  # Value in seconds of the performance requirement for (N_Br + N_Ar). N_Br is the elapsed time between the receiving indication of a FF or CF or the transmit confirmation of a FC, until the transmit request of the next FC.
          float CanTpNcr [0..1]: set at post-build in variant post-build / pre-compile in variant pre-compile  # Value in seconds of the N_Cr timeout. N_Cr is the time until reception of the next Consecutive Frame N_PDU.
          enumeration CanTpRxAddressingFormat: {CANTP_EXTENDED, CANTP_MIXED, CANTP_STANDARD}, set at pre-compile  # Declares which communication addressing mode is supported for this Rx N-SDU. | Enum values: CanTpStandard. To use normal addressing format. CanTpExtended. To use extended addressing format. CanTpMixed. To use mixed addressing format.
          integer CanTpRxDl: 0..65535, set at pre-compile  # Data Length Code of this RxNsdu. In case of variable message length, this value indicates the minimum data length. | Depending on SF or FF N-SDU the value will be limited to 7 (6 for an extended addressing format) and 4095 respectively.
          enumeration CanTpRxPaddingActivation: {CANTP_OFF, CANTP_ON}, set at pre-compile  # Defines if the receive frame uses padding or not. | Definition of enumeration values: CanTpOn: The N-PDU received uses padding for SF, FC and the last CF. (N-PDU length is always 8 bytes) CanTpOff: The N-PDU received does not use padding for SF, CF and the last CF. (N-PDU length is dynamic)
          enumeration CanTpRxTaType: {CANTP_FUNCTIONAL, CANTP_PHYSICAL}, set at pre-compile  # Declares the communication type of this Rx N-SDU.
          integer CanTpRxWftMax [0..1]: 0..65535, set at post-build in variant post-build / pre-compile in variant pre-compile  # This parameter indicates how many Flow Control wait N-PDUs can be consecutively transmitted by the receiver. It is local to the node and is not transmitted inside the FC protocol data unit. | CanTpRxWftMax is used to avoid sender nodes being potentially hooked-up in case of a temporarily reception inability on the part of the receiver nodes, whereby the sender could be waiting continuously.
          float CanTpSTmin [0..1]: set at post-build in variant post-build / pre-compile in variant pre-compile  # Sets the duration of the minimum time the CanTp sender shall wait between the transmissions of two CF N-PDUs. | For further details on this parameter value see ISO 15765-2 specification.
          reference CanTpRxNSduRef: set at post-build in variant post-build / pre-compile in variant pre-compile, destination=Pdu  # Reference to a Pdu in the COM-Stack.
          container CanTpNAe [0..1]  # Contains the parameters needed to configure each RxNSdu or TxNSdu with CanTpAddressingFormat set to CanTpMixed.
            integer CanTpNAe: 0..255, set at pre-compile  # If an RxNsdu or a TxNsdu is configured for mixed addressing | format, this parameter contains the transport protocol address extension value.
          container CanTpNSa [0..1]  # Contains the parameters needed to configure each RxNSdu or TxNSdu with CanTpAddressingFormat set to CanTpExtended.
            integer CanTpNSa: 0..255, set at pre-compile  # If an RxNSdu or a TxNSdu is configured for extended addressing format, this parameter contains the transport protocol source address's value.
          container CanTpNTa [0..1]  # The following parameters need to be configured for each RxNsdu or TxNsdu with the CanTpAddressingFormat set to CanTpExtended.
            integer CanTpNTa: 0..255, set at pre-compile  # If an RxNsdu or a TxNsdu is configured for extended addressing format, this parameter contains the transport protocol target address's value.
          container CanTpRxNPdu  # Used for grouping of the ID of a PDU and the Reference to a PDU.
            integer CanTpRxNPduId: 0..65535, set at pre-compile, symbolic-name-value=true  # The N-PDU identifier attached to the RxNsdu is identified by CanTpRxNSduId. | Each RxNsdu identifier is linked to only one SF/FF/CF N-PDU identifier. Nevertheless, in the case of extended or mixed addressing format, the same N-PDU identifier can be used for several N-SDU identifiers. The distinction is made by the N_TA or N_AE value (first data byte of SF or FF frames).
            reference CanTpRxNPduRef: set at post-build in variant post-build / pre-compile in variant pre-compile, destination=Pdu  # Reference to a Pdu in the COM-Stack.
          container CanTpRxNSduDemEventParameterRefs [0..1]  # Container for the references to DemEventParameter elements which shall be invoked using the API Dem_ReportErrorStatus API in case the corresponding error occurs. The EventId is taken from the referenced DemEventParameter's DemEventId value. The standardized errors are provided in the container and can be extended by vendor specific error references.
            symbolic name reference CANTP_E_RX_COM [0..1]: set at post-build in variant post-build / pre-compile in variant pre-compile, destination=DemEventParameter  # Reference to the DemEventParameter which shall be issued when the error "Event reported on completion of a reception operation" has occured.
          container CanTpTxFcNPdu [0..1]  # Used for grouping of the ID of a PDU and the Reference to a PDU.
            integer CanTpTxFcNPduConfirmationPduId: 0..65535, set at pre-compile, symbolic-name-value=true  # Handle Id to be used by the CanIf to confirm the transmission of the CanTpTxFcNPdu to the CanIf module.
            reference CanTpTxFcNPduRef: set at post-build in variant post-build / pre-compile in variant pre-compile, destination=Pdu  # Reference to a Pdu in the COM-Stack.
        container CanTpTxNSdu [0..*]  # The following parameters needs to be configured for each CAN N-SDU that the CanTp module transmits via the CanTpChannel.
          float CanTpNas: set at post-build in variant post-build / pre-compile in variant pre-compile  # Value in second of the N_As timeout. N_As is the time for transmission of a CAN frame (any N_PDU) on the part of the sender.
          float CanTpNbs [0..1]: set at post-build in variant post-build / pre-compile in variant pre-compile  # Value in seconds of the N_Bs timeout. N_Bs is the time of transmission until reception of the next Flow Control N_PDU.
          float CanTpNcs [0..1]: set at post-build in variant post-build / pre-compile in variant pre-compile  # Value in seconds of the performance requirement of (N_Cs + N_As). N_Cs is the time which elapses between the transmit request of a CF N-PDU until the transmit request of the next CF N-PDU.
          boolean CanTpTc: set at pre-compile  # Preprocessor switch for enabling Transmit Cancellation.
          enumeration CanTpTxAddressingFormat: {CANTP_EXTENDED, CANTP_MIXED, CANTP_STANDARD}, set at pre-compile  # Declares which communication addressing format is supported for this TxNsdu. | Definition of Enumeration values: CanTpStandard to use normal addressing format. CanTpExtended to use extended addressing format (the N_TA container of this TxNsdu will be used). CanTpMixed to use mixed addressing format (the N_AE container of this TxNsdu will be used).
          integer CanTpTxDl: 0..65535, set at pre-compile  # Data Length Code of this TxNsdu. In case of variable length message, this value indicates the minimum data length.
          integer CanTpTxNSduId: 0..65535, set at pre-compile, symbolic-name-value=true  # Unique identifier to a structure that contains all useful information to process the transmission of a TxNsdu.
          enumeration CanTpTxPaddingActivation: {CANTP_OFF, CANTP_ON}, set at pre-compile  # Defines if the transmit frame use padding or not. | Definition of Enumeration values: CanTpOn The transmit N-PDU uses padding for SF, FC and the last CF. (N-PDU length is always 8 bytes) CanTpOff The transmit N-PDU does not use padding for SF, CF and the last CF. (N-PDU length is dynamic)
          enumeration CanTpTxTaType: {CANTP_FUNCTIONAL, CANTP_PHYSICAL}, set at pre-compile  # Declares the communication type of this TxNsdu. | Enumeration values: CanTpPhysical. Used for 1:1 communication. CanTpFunctional. Used for 1:n communication.
          reference CanTpTxNSduRef: set at post-build in variant post-build / pre-compile in variant pre-compile, destination=Pdu  # Reference to a Pdu in the COM-Stack.
          container CanTpNAe [0..1]  # Contains the parameters needed to configure each RxNSdu or TxNSdu with CanTpAddressingFormat set to CanTpMixed.
            integer CanTpNAe: 0..255, set at pre-compile  # If an RxNsdu or a TxNsdu is configured for mixed addressing | format, this parameter contains the transport protocol address extension value.
          container CanTpNSa [0..1]  # Contains the parameters needed to configure each RxNSdu or TxNSdu with CanTpAddressingFormat set to CanTpExtended.
            integer CanTpNSa: 0..255, set at pre-compile  # If an RxNSdu or a TxNSdu is configured for extended addressing format, this parameter contains the transport protocol source address's value.
          container CanTpNTa [0..1]  # The following parameters need to be configured for each RxNsdu or TxNsdu with the CanTpAddressingFormat set to CanTpExtended.
            integer CanTpNTa: 0..255, set at pre-compile  # If an RxNsdu or a TxNsdu is configured for extended addressing format, this parameter contains the transport protocol target address's value.
          container CanTpRxFcNPdu [0..1]  # Used for grouping of the ID of a PDU and the Reference to a PDU.
            integer CanTpRxFcNPduId: 0..65535, set at pre-compile, symbolic-name-value=true  # N-PDU identifier attached to the FC N-PDU of this TxNsdu identified by CanTpTxNSduId. | Each TxNsdu identifier is linked to one Rx FC N-PDU identifier only. However, in the case of extended addressing format, the same FC N-PDU identifier can be used for several N-SDU identifiers. The distinction is made by means of the N_TA value (first data byte of FC frames).
            reference CanTpRxFcNPduRef: set at post-build in variant post-build / pre-compile in variant pre-compile, destination=Pdu  # Reference to a Pdu in the COM-Stack.
          container CanTpTxNPdu  # Used for grouping of the ID of a PDU and the Reference to a PDU.
            integer CanTpTxNPduConfirmationPduId: 0..65535, set at pre-compile, symbolic-name-value=true  # Handle Id to be used by the CanIf to confirm the transmission of the CanTpTxNPdu to the CanIf module.
            reference CanTpTxNPduRef: set at post-build in variant post-build / pre-compile in variant pre-compile, destination=Pdu  # Reference to a Pdu in the COM-Stack.
          container CanTpTxNSduDemEventParameterRefs [0..1]  # Container for the references to DemEventParameter elements which shall be invoked using the API Dem_ReportErrorStatus API in case the corresponding error occurs. The EventId is taken from the referenced DemEventParameter's DemEventId value. The standardized errors are provided in the container and can be extended by vendor specific error references.
            symbolic name reference CANTP_E_TX_COM [0..1]: set at post-build in variant post-build / pre-compile in variant pre-compile, destination=DemEventParameter  # Reference to the DemEventParameter which shall be issued when the error "Event reported on completion of a transmission operation" has occured.
      container CanTpGeneral  # This container contains the general configuration parameters of the CanTp module.
        boolean CanTpChangeParameterRequestApi: set at pre-compile  # This parameter, if set to true, enables the CanTp_ChangeParameterRequest Api for this Module.
        boolean CanTpDevErrorDetect: set at pre-compile  # Switches the Development Error Detection and Notification ON or OFF
        float CanTpMainFunctionPeriod: 0..0.255, set at post-build in variant post-build / pre-compile in variant pre-compile  # Allow to configure the time for the MainFunction (as float in seconds). Please note: This period shall be the same as call cycle time of the periodic task were CanTp Main function is called.
        integer CanTpPaddingByte: 0..255, set at pre-compile  # Used for the initialization of unused bytes with a certain value
        boolean CanTpVersionInfoApi: set at pre-compile  # The function CanTp_GetVersionInfo is configurable (On/Off) by this configuration parameter.
  module definition CanTrcv [0..*]: variants pre-compile  # Configuration of the CanTrcv (CAN Transceiver driver) module.
    container CanTrcvChannel [1..*]  # Container gives CAN transceiver driver information about a single CAN | transceiver (channel).
      integer CanTrcvChannelId: 0..255, set at pre-compile, symbolic-name-value=true  # Unique identifier of the CAN Transceiver Channel.
      boolean CanTrcvChannelUsed: set at pre-compile, default-value=true  # Shall the related CAN transceiver channel be used?
      boolean CanTrcvControlsPowerSupply: set at pre-compile, default-value=false  # Is ECU power supply controlled by this transceiver? | TRUE = Controlled by transceiver. FALSE = Not controlled by transceiver.
      enumeration CanTrcvInitState: {CANTRCV_OP_MODE_NORMAL, CANTRCV_OP_MODE_SLEEP, CANTRCV_OP_MODE_STANDBY}, set at pre-compile, default-value=CANTRCV_OP_MODE_NORMAL  # State of CAN transceiver after call to CanTrcv_Init.
      integer CanTrcvMaxBaudrate: 0..1000, set at pre-compile  # Max baudrate for transceiver hardware type. Only used for validation purposes. Value shall be configured by configuration tool based on | transceiver hardware type.
      boolean CanTrcvWakeupByBusUsed [0..1]: set at pre-compile, default-value=false  # Is wake up by bus supported? If CAN transceiver hardware does not support wake up by bus value is always FALSE. If CAN transceiver hardware supports wake up by bus value is TRUE or FALSE depending whether it is used or not. | TRUE = Is used. FALSE = Is not used.
      choice container CanTrcvAccess  # Container gives CanTrcv Driver information about access to a single CAN transceiver.
        container CanTrcvDioAccess [0..1]  # Container gives CAN transceiver driver information about accessing ports and port pins. In addition relation between CAN transceiver hardware pin names and Dio port access information is given. | If a CAN transceiver hardware has no Dio interface, there is no instance of this container.
          container CanTrcvDioChannelAccess [1..*]  # Container gives DIO channel access by single Can transceiver channel.
            string CanTrcvHardwareInterfaceName: set at pre-compile  # CAN transceiver hardware interface name. It is typically the name of a pin. From a Dio point of view it is either a port, a single channel or a channel group. Depending on this fact either | CANTRCV_DIO_PORT_SYMBOLIC_NAME or CANTRCV_DIO_CHANNEL_SYMBOLIC_NAME or CANTRCV_DIO_CHANNEL_GROUP_SYMBOLIC_NAME shall reference a Dio configuration. The CAN transceiver driver implementation description shall list up this name for the appropriate CAN transceiver hardware.
            choice reference CanTrcvDioSymNameRef: set at pre-compile, destination=[DioChannel, DioChannelGroup, DioPort]  # Choice Reference to a DIO Port, DIO Channel or DIO Channel Group. This reference replaces the CANTRCV_DIO_PORT_SYM_NAME, CANTRCV_DIO_CHANNEL_SYM_NAME and CANTRCV_DIO_GROUP_SYM_NAME references in the Can Trcv SWS.
        container CanTrcvSpiSequence [0..1]  # Container gives CAN transceiver driver information about one SPI sequence. | One SPI sequence used by CAN transceiver driver is in exclusive use for it. No other driver is allowed to access this sequence. CAN transceiver driver may use one sequence to access n CAN transceiver hardwares chips of the same type or n sequences are used to access one single CAN transceiver hardware chip. If a CAN transceiver hardware has no SPI interface, there is no instance of this container.
          symbolic name reference CanTrcvSpiSequenceName: set at pre-compile, destination=SpiSequence  # Reference to a Spi sequence configuration container.
      container CanTrcvDemEventParameterRefs [0..1]  # Container for the references to DemEventParameter elements which shall be invoked using the API Dem_ReportErrorStatus API in case the corresponding error occurs. The EventId is taken from the referenced DemEventParameter's DemEventId value. The standardized errors are provided in the container and can be extended by vendor specific error references.
        symbolic name reference CANTRCV_X_Y_E_NO_TRCV_CONTROL_Z: set at pre-compile, destination=DemEventParameter  # Reference to the DemEventParameter which shall be issued when the error "No/incorrect communication to transceiver" has occured. The CanTrcv shall report for each configured Transceiver (channel), one specific error event which shall follow the below naming convention for the production error events: CANTRCV_X_Y_E_NO_TRCV_CONTROL_Z where: | X is the respective Vendor Identifier, Y is the respective CanTrcv type, Z is the respective Channel Identifier
    container CanTrcvGeneral  # Container gives CAN transceiver driver basic information.
      boolean CanTrcvDevErrorDetect: set at pre-compile  # Switches development error detection and notification on and off. | If switched on, #define CANTRCV_DEV _ERROR_DETECT ON shall be generated. If switched off, #define CANTRCV_DEV_ERROR _DETECT OFF shall be generated. Define shall be part of file CanTrcv_Cfg.h.
      boolean CanTrcvGetVersionInfo: set at pre-compile, default-value=false  # Switches version information API on and off. If switched off, function need not be present in compiled code.
      integer CanTrcvWaitCount: 0..4294967295, set at pre-compile, default-value=0  # Wait count for transceiver state changes.
      enumeration CanTrcvWakeUpSupport: {CANTRCV_WAKEUP_BY_POLLING, CANTRCV_WAKEUP_NOT_SUPPORTED}, set at pre-compile  # Informs whether wake up is supported by polling or not supported. In case no | wake up is supported by the hardware, setting has to be NOT_SUPPORTED. Only in the case of wake up supported by polling, function CanTrcv_MainFunction has to be present and to be invoked by the scheduler.
  module definition Cdd [0..1]  # The CDD module describes the minimal requirements that are necessary for the configuration of a CDD with respect to the surrounding standardized BSW modules.
    container CddComStackContribution [0..1]  # Contribution of COM Stack modules.
      container CddComIfUpperLayerContribution [0..1]  # Parameters that are necessary for the configuration of a Complex Device Driver that serves as the UpperLayer of the Com Interface module.
        container CddComIfUpperLayerPdu [1..*]  # This container specifies PDUs that are exchanged between the CDD and the standardized BSW module.
          integer CddComIfHandleId [0..1]: 0..65535, symbolic-name-value=true  # ECU wide unique, symbolic handle for the Pdu.
          reference CddComIfPduRef: destination=Pdu  # Reference to the "global" Pdu structure to allow harmonization of handle IDs in the COM-Stack.
      container CddComMLowerLayerContribution [0..1]  # Parameters that are necessary for the configuration of a Complex Device Driver that serves as the LowerLayer of the Communication Manager module.
        container CddComMLowerLayerChannel [1..*]  # This container contains the network specific parameters.
          reference CddComMLowerLayerChannelRef: destination=ComMChannel  # Unique handle to identify one certain network. Reference to one of the network handles configured for the ComM.
      container CddGenericNmLowerLayerContribution [0..1]  # Parameters that are necessary for the configuration of a Complex Device Driver that serves as the LowerLayer of the Generic NM module.
        container CddGenericNmLowerLayerChannel [1..*]  # NM Channel specific configuration parameters.
          reference CddGenericNmComMNetworkHandleRef: destination=ComMChannel  # This reference points to the unique channel defined by the ComMChannel and provides access to the unique channel index value in ComMChannelId.
      container CddPduRLowerLayerContribution [0..1]  # Parameters that are necessary for the configuration of a Complex Device Driver that serves as the LowerLayer of the Pdu Router module.
        container CddPduRLowerLayerPdu [1..*]  # This container specifies PDUs that are exchanged between the CDD and the standardized BSW module.
          integer CddPduRLowerLayerHandleId [0..1]: 0..65535, symbolic-name-value=true  # ECU wide unique, symbolic handle for the Pdu.
          reference CddPduRLowerLayerPduRef: destination=Pdu  # Reference to the "global" Pdu structure to allow harmonization of handle IDs in the COM-Stack.
      container CddPduRUpperLayerContribution [0..1]  # Parameters that are necessary for the configuration of a Complex Device Driver that serves as the UpperLayer of the Pdu Router module.
        container CddPduRUpperLayerPdu [1..*]  # This container specifies PDUs that are exchanged between the CDD and the standardized BSW module.
          integer CddPduRUpperLayerHandleId [0..1]: 0..65535, symbolic-name-value=true  # ECU wide unique, symbolic handle for the Pdu.
          reference CddPduRUpperLayerPduRef: destination=Pdu  # Reference to the "global" Pdu structure to allow harmonization of handle IDs in the COM-Stack.
    container CddEcucPartitionInteraction [0..1]  # This optional container holds the partition interaction configuration.
      function name CddPartitionStoppedFunctionName  # Function name to be called when the partition which is triggering the complex driver is stopped.
      reference CddEcucPartitionRef: destination=EcucPartition  # Reference to the "EcucPartition" which executes the software which triggers the CDD.
