[part 5 of 7: package /AUTOSAR/EcucDefs]
AUTOSAR XML (schema 4-2-1)
package /AUTOSAR/EcucDefs  (continued)
  module definition FrIf [0..1]: post-build-variant-support=true, variants link-time/post-build/pre-compile  # Configuration of the FrIf (FlexRay Interface) module.
    container FrIfConfig  # This container contains the configuration parameters and sub containers of the AUTOSAR FrIf module.
      integer FrIfMaxPduCnt [0..1]: 0..18446744073709551615, multiplicity set at link in variant link-time+post-build / pre-compile in variant pre-compile, set at link in variant link-time+post-build / pre-compile in variant pre-compile  # Maximum number of Pdus. This parameter is needed only in case of post-build loadable implementation using static memory allocation.
      container FrIfCluster [1..*]: multiplicity set at pre-compile  # This container specifies a FrIf Cluster and all related data which is required to enable communication of the Cluster. A Cluster may consist of more than one Controller.
        integer FrIfClstIdx: 0..63, set at link in variant link-time+post-build / pre-compile in variant pre-compile, symbolic-name-value=true  # This parameter provides a zero-based consecutive index of the FlexRay Clusters. Upper layer BSW modules and the FrIf itself use this index to identify a FlexRay Cluster.
        boolean FrIfDetectNITError: post-build-variant-value=true, set at link in variant link-time / post-build in variant post-build / pre-compile in variant pre-compile  # Indicates whether NIT error status of each cluster shall be detected or not.
        enumeration FrIfGChannels: {FR_CHANNEL_A, FR_CHANNEL_AB, FR_CHANNEL_B}, post-build-variant-value=true, set at link in variant link-time / post-build in variant post-build / pre-compile in variant pre-compile  # The channels that are used by the cluster. | Implementation Type: Fr_ChannelType
        integer FrIfGColdStartAttempts: 2..31, post-build-variant-value=true, set at link in variant link-time / post-build in variant post-build / pre-compile in variant pre-compile  # Maximum number of times a node in the cluster is permitted to attempt to start the cluster by initiating schedule synchronization
        integer FrIfGCycleCountMax: 7..63, post-build-variant-value=true, set at link in variant link-time / post-build in variant post-build / pre-compile in variant pre-compile  # Maximum cycle counter value in a given cluster. | Remark: Set to 63 for FlexRay Protocol 2.1 Rev. A compliance.
        integer FrIfGListenNoise: 2..16, post-build-variant-value=true, set at link in variant link-time / post-build in variant post-build / pre-compile in variant pre-compile  # Upper limit for the start up listen timeout and wake up listen timeout in the presence of noise. It is used as a multiplier of the node | parameter pdListenTimeout.
        integer FrIfGMacroPerCycle: 8..16000, post-build-variant-value=true, set at link in variant link-time / post-build in variant post-build / pre-compile in variant pre-compile  # Number of macroticks in a communication cycle. | Note: Lower limit 10 for FlexRay Protocol 2.1 Rev. A compliance
        integer FrIfGMaxWithoutClockCorrectFatal: 1..15, post-build-variant-value=true, set at link in variant link-time / post-build in variant post-build / pre-compile in variant pre-compile  # Threshold used for testing the vClockCorrectionFailed counter. Defines the number of consecutive even/odd Cycle pairs with missing clock correction terms that will cause the protocol to transition from the POC:normal active or POC:normal passive state into the POC:halt state. [Even/odd cycle pairs].
        integer FrIfGMaxWithoutClockCorrectPassive: 1..15, post-build-variant-value=true, set at link in variant link-time / post-build in variant post-build / pre-compile in variant pre-compile  # Threshold used for testing the vClockCorrectionFailed counter. Defines the number of consecutive even/odd Cycle pairs with missing clock correction terms that will cause the protocol to transition from the POC:normal active state to the POC:normal passive state. [Even/Odd cycle pairs]
        integer FrIfGNetworkManagementVectorLength: 0..12, post-build-variant-value=true, set at link in variant link-time / post-build in variant post-build / pre-compile in variant pre-compile  # Length of the Network Management vector in a cluster [bytes]
        integer FrIfGNumberOfMinislots: 0..7988, post-build-variant-value=true, set at link in variant link-time / post-build in variant post-build / pre-compile in variant pre-compile  # Number of minislots in the dynamic segment | Remark: Upper limit 7986 for FlexRay Protocol 2.1 Rev. A compliance
        integer FrIfGNumberOfStaticSlots: 2..1023, post-build-variant-value=true, set at link in variant link-time / post-build in variant post-build / pre-compile in variant pre-compile  # Number of static slots in the static segment
        integer FrIfGPayloadLengthStatic: 0..127, post-build-variant-value=true, set at link in variant link-time / post-build in variant post-build / pre-compile in variant pre-compile  # Payload length of a static frame [16 bit words]
        integer FrIfGSyncFrameIDCountMax: 2..15, post-build-variant-value=true, set at link in variant link-time / post-build in variant post-build / pre-compile in variant pre-compile  # Maximum number of distinct syncframe identifiers present in a given cluster. This parameter maps to FlexRay Protocol 2.1 Rev. A parameter gSyncNodeMax.
        integer FrIfGdActionPointOffset: 1..63, scope=ECU, post-build-variant-value=true, set at link in variant link-time / post-build in variant post-build / pre-compile in variant pre-compile  # Number of macroticks the action point is offset from the beginning of a static slot.
        enumeration FrIfGdBit: {T100NS, T200NS, T400NS}, post-build-variant-value=true, set at link in variant link-time / post-build in variant post-build / pre-compile in variant pre-compile  # Nominal bit time in seconds
        integer FrIfGdCasRxLowMax: 28..254, post-build-variant-value=true, set at link in variant link-time / post-build in variant post-build / pre-compile in variant pre-compile  # Upper limit of the CAS acceptance windows [gdBit] | Remark: Range 67 to 99 for FlexRay Protocol 2.1 Rev. A compliance
        float FrIfGdCycle: 2.4E-5..0.016, post-build-variant-value=true, set at link in variant link-time / post-build in variant post-build / pre-compile in variant pre-compile  # Length of the cycle, expressed in [s] | Remark: Lower limit 0.000024 for FlexRay Protocol 3.0 compliance.
        integer FrIfGdDynamicSlotIdlePhase: 0..2, post-build-variant-value=true, set at link in variant link-time / post-build in variant post-build / pre-compile in variant pre-compile  # Duration of the idle phase within a dynamic slot [Minislots].
        integer FrIfGdIgnoreAfterTx: 0..15, post-build-variant-value=true, set at link in variant link-time / post-build in variant post-build / pre-compile in variant pre-compile  # Duration for which the bitstrobing is paused after transmission [gdBit]. | Remark: Set to 0 for FlexRay Protocol 2.1 Rev. A compliance.
        float FrIfGdMacrotick: 1E-6..6E-6, post-build-variant-value=true, set at link in variant link-time / post-build in variant post-build / pre-compile in variant pre-compile  # Duration of the cluster wide nominal macrotick, expressed in s
        integer FrIfGdMiniSlotActionPointOffset: 1..31, post-build-variant-value=true, set at link in variant link-time / post-build in variant post-build / pre-compile in variant pre-compile  # Number of Macroticks the Minislot action point is offset from the beginning of a Minislot [Macroticks].
        integer FrIfGdMinislot: 2..63, scope=ECU, post-build-variant-value=true, set at link in variant link-time / post-build in variant post-build / pre-compile in variant pre-compile  # Duration of a minislot [Macroticks]
        integer FrIfGdNit: 2..15978, post-build-variant-value=true, set at link in variant link-time / post-build in variant post-build / pre-compile in variant pre-compile  # Duration of the Network Idle Time [Macroticks] | Remark: Upper limit 805 for FlexRay Protocol 2.1 Rev. A compliance.
        enumeration FrIfGdSampleClockPeriod: {T12_5NS, T25NS, T50NS}, post-build-variant-value=true, set at link in variant link-time / post-build in variant post-build / pre-compile in variant pre-compile  # Sample clock period
        integer FrIfGdStaticSlot: 3..664, post-build-variant-value=true, set at link in variant link-time / post-build in variant post-build / pre-compile in variant pre-compile  # Duration of a static slot [Macroticks]. | Remark: Range 4-661 for FlexRay Protocol 2.1 Rev. A compliance.
        integer FrIfGdSymbolWindow: 0..162, post-build-variant-value=true, set at link in variant link-time / post-build in variant post-build / pre-compile in variant pre-compile  # Duration of the symbol window [Macroticks]. | Remark: Range 0-142 for FlexRay Protocol 2.1 Rev. A compliance.
        integer FrIfGdSymbolWindowActionPointOffset: 1..63, post-build-variant-value=true, set at link in variant link-time / post-build in variant post-build / pre-compile in variant pre-compile  # Number of macroticks the action point offset is from the beginning of the symbol window [Macroticks]. | Remark: Set to GdActionPointOffset for FlexRay Protocol 2.1 Rev. A compliance.
        integer FrIfGdTSSTransmitter: 1..15, post-build-variant-value=true, set at link in variant link-time / post-build in variant post-build / pre-compile in variant pre-compile  # Number of bits in the Transmission Start Sequence [gdBits]. | Remark: Lower limit 3 for FlexRay Protocol 2.1 Rev. A compliance.
        integer FrIfGdWakeupRxIdle: 8..59, post-build-variant-value=true, set at link in variant link-time / post-build in variant post-build / pre-compile in variant pre-compile  # Number of bits used by the node to test the duration of the 'idle' or HIGH phase of a received wakeup [gdBit]. Remarks: This parameter maps to FlexRay Protocol 2.1 Rev. A parameter gdWakeupSymbolRxIdle. Lower limit 14 for FlexRay Protocol 2.1 Rev. A compliance.
        integer FrIfGdWakeupRxLow: 8..59, post-build-variant-value=true, set at link in variant link-time / post-build in variant post-build / pre-compile in variant pre-compile  # Number of bits used by the node to test the duration of the LOW phase of a received wakeup [gdBit]. | Remarks: This parameter maps to FlexRay Protocol 2.1 Rev. A parameter gdWakeupSymbolRxLow. Lower limit 11 for FlexRay Protocol 2.1 Rev. A compliance.
        integer FrIfGdWakeupRxWindow: 76..485, post-build-variant-value=true, set at link in variant link-time / post-build in variant post-build / pre-compile in variant pre-compile  # The size of the window used to detect wakeups [gdBit]. | Remarks: This parameter maps to FlexRay Protocol 2.1 Rev. A parameter gdWakeupSymbolRxWindow. Upper limit 301 for FlexRay Protocol 2.1 Rev. A compliance.
        integer FrIfGdWakeupTxActive: 15..60, post-build-variant-value=true, set at link in variant link-time / post-build in variant post-build / pre-compile in variant pre-compile  # Number of bits used by the node to transmit the LOW phase of awakeup symbol and the HIGH and LOW phases of a WUDOP [gdBit]. | Remarks: This parameter maps to FlexRay Protocol 2.1 Rev. A parameter gdWakeupSymbolTxLow.
        integer FrIfGdWakeupTxIdle: 45..180, post-build-variant-value=true, set at link in variant link-time / post-build in variant post-build / pre-compile in variant pre-compile  # Number of bits used by the node to transmit the 'idle' part of a | wakeup symbol [gdBit]. Remarks: This parameter maps to FlexRay Protocol 2.1 Rev. A parameter gdWakeupSymbolTxIdle.
        float FrIfMainFunctionPeriod: 0..Inf, set at link in variant link-time+post-build / pre-compile in variant pre-compile  # The execution cycle of the FrIf_MainFunction_<cluster>() in seconds. The FrIf does not require this information but the BSW scheduler, which invokes the cluster main functions, needs it in order to plan its tasks.
        integer FrIfSafetyMargin: 0..1024000, post-build-variant-value=true, set at link in variant link-time / post-build in variant post-build / pre-compile in variant pre-compile  # Additional timespan in macroticks which takes jitter into account to be able to set the JobListPointer to the next possible job which can be executed in case the FlexRay Job List Execution Function has be resynchronized.
        container FrIfClusterDemEventParameterRefs [0..1]  # Container for the references to DemEventParameter elements which shall be invoked using the API Dem_ReportErrorStatus API in case the corresponding error occurs. The EventId is taken from the referenced DemEventParameter's DemEventId value. The standardized errors are provided in the container and can be extended by vendor specific error references.
          symbolic name reference FRIF_E_ACS_CH_A [0..1]: multiplicity set at link in variant link-time / post-build in variant post-build / pre-compile in variant pre-compile, post-build-variant-multiplicity=true, post-build-variant-value=true, set at link in variant link-time / post-build in variant post-build / pre-compile in variant pre-compile, destination=DemEventParameter  # Reference to the DemEventParameter which shall be issued when an error in ACS on channel A was detected. If the reference is not configured the error shall not be reported (neither to DET nor to DEM).
          symbolic name reference FRIF_E_ACS_CH_B [0..1]: multiplicity set at link in variant link-time / post-build in variant post-build / pre-compile in variant pre-compile, post-build-variant-multiplicity=true, post-build-variant-value=true, set at link in variant link-time / post-build in variant post-build / pre-compile in variant pre-compile, destination=DemEventParameter  # Reference to the DemEventParameter which shall be issued when an error in ACS on channel B was detected. If the reference is not configured the error shall not be reported (neither to DET nor to DEM).
          symbolic name reference FRIF_E_NIT_CH_A [0..1]: multiplicity set at link in variant link-time / post-build in variant post-build / pre-compile in variant pre-compile, post-build-variant-multiplicity=true, post-build-variant-value=true, set at link in variant link-time / post-build in variant post-build / pre-compile in variant pre-compile, destination=DemEventParameter  # Reference to the DemEventParameter which shall be issued when an error in NIT on channel A was detected. If the reference is not configured the error shall not be reported (neither to DET nor to DEM).
          symbolic name reference FRIF_E_NIT_CH_B [0..1]: multiplicity set at link in variant link-time / post-build in variant post-build / pre-compile in variant pre-compile, post-build-variant-multiplicity=true, post-build-variant-value=true, set at link in variant link-time / post-build in variant post-build / pre-compile in variant pre-compile, destination=DemEventParameter  # Reference to the DemEventParameter which shall be issued when an error in NIT on channel B was detected. If the reference is not configured the error shall not be reported (neither to DET nor to DEM).
          symbolic name reference FRIF_E_SW_CH_A [0..1]: multiplicity set at link in variant link-time / post-build in variant post-build / pre-compile in variant pre-compile, post-build-variant-multiplicity=true, post-build-variant-value=true, set at link in variant link-time / post-build in variant post-build / pre-compile in variant pre-compile, destination=DemEventParameter  # Reference to the DemEventParameter which shall be issued when an error in SW on channel A was detected. If the reference is not configured the error shall not be reported (neither to DET nor to DEM).
          symbolic name reference FRIF_E_SW_CH_B [0..1]: multiplicity set at link in variant link-time / post-build in variant post-build / pre-compile in variant pre-compile, post-build-variant-multiplicity=true, post-build-variant-value=true, set at link in variant link-time / post-build in variant post-build / pre-compile in variant pre-compile, destination=DemEventParameter  # Reference to the DemEventParameter which shall be issued when an error in SW on channel B was detected. If the reference is not configured the error shall not be reported (neither to DET nor to DEM).
        container FrIfController [1..*]: multiplicity set at pre-compile  # This container contains the configuration of FlexRay CC.
          integer FrIfCtrlIdx: 0..31, scope=ECU, set at link in variant link-time+post-build / pre-compile in variant pre-compile, symbolic-name-value=true  # This parameter provides a zero-based consecutive index of the FlexRay Communication Controllers. Upper layer BSW modules and the FrIf itself use this index to identify a FlexRay CC.
          symbolic name reference FrIfFrCtrlRef: scope=ECU, post-build-variant-value=true, set at link in variant link-time / post-build in variant post-build / pre-compile in variant pre-compile, destination=FrController  # Reference to a Controller, which is handled by a specific Driver. This reference is unique for the ECU.
          container FrIfFrameTriggering [1..*]: multiplicity set at link in variant link-time / post-build in variant post-build / pre-compile in variant pre-compile  # A Frame triggering contains the communication parameters of the FlexRay Frame as well as a reference to the Frame Construction Plan.
            boolean FrIfAllowDynamicLSduLength: post-build-variant-value=true, set at link in variant link-time / post-build in variant post-build / pre-compile in variant pre-compile  # Allows L-PDU length reduction ('FrIfLSduLength' defines max. length) and indicates that the related CC buffer has to be reconfigured for the actual length and Header-CRC before transmission of the L-PDU.
            boolean FrIfAlwaysTransmit: post-build-variant-value=true, set at link in variant link-time / post-build in variant post-build / pre-compile in variant pre-compile  # Defines whether the driver's API function Fr_TransmitTxLPdu() shall always be called for this L-PDU.
            integer FrIfBaseCycle: 0..63, post-build-variant-value=true, set at link in variant link-time / post-build in variant post-build / pre-compile in variant pre-compile  # This parameter contains the FlexRay Base Cycle used to transmit this FlexRay Frame.
            enumeration FrIfChannel: {FRIF_CHANNEL_A, FRIF_CHANNEL_AB, FRIF_CHANNEL_B}, post-build-variant-value=true, set at link in variant link-time / post-build in variant post-build / pre-compile in variant pre-compile  # This parameter contains the FlexRay Channel used to transmit this FlexRay Frame.
            integer FrIfCycleRepetition: 1..64, post-build-variant-value=true, set at link in variant link-time / post-build in variant post-build / pre-compile in variant pre-compile  # This parameter contains the FlexRay Cycle Repetition used to transmit this FlexRay Frame.. | possible Values: 1,2,4,8,16,32,64
            integer FrIfLSduLength: 0..254, post-build-variant-value=true, set at link in variant link-time / post-build in variant post-build / pre-compile in variant pre-compile  # The payload length of the Frame is given here. This parameter is required for validation if configured PDUs and update information fits into the Frame at configuration time [bytes].
            integer FrIfMessageId [0..1]: 0..65535, multiplicity set at link in variant link-time / post-build in variant post-build / pre-compile in variant pre-compile, post-build-variant-multiplicity=true, post-build-variant-value=true, set at link in variant link-time / post-build in variant post-build / pre-compile in variant pre-compile  # The first two bytes of the payload segment of the FlexRay frame format for frames transmitted in the | dynamic segment can be used as receiver filterable data called the message ID.
            boolean FrIfPayloadPreamble: post-build-variant-value=true, set at link in variant link-time / post-build in variant post-build / pre-compile in variant pre-compile  # Switching the Payload Preamble bit.
            integer FrIfSlotId: 1..2047, post-build-variant-value=true, set at link in variant link-time / post-build in variant post-build / pre-compile in variant pre-compile  # This parameter contains the FlexRay Slot ID used to transmit this FlexRay Frame.
            reference FrIfFrameStructureRef: post-build-variant-value=true, set at link in variant link-time / post-build in variant post-build / pre-compile in variant pre-compile, destination=FrIfFrameStructure  # Reference to the Construction Plan of the FlexRay Frame.
            container FrIfFrameTriggeringDemEventParameterRefs [0..1]  # Container for the references to DemEventParameter elements which shall be invoked using the API Dem_ReportErrorStatus API in case the corresponding error occurs. The EventId is taken from the referenced DemEventParameter's DemEventId value. The standardized errors are provided in the container and can be extended by vendor specific error references.
              symbolic name reference FRIF_E_LPDU_SLOTSTATUS [0..1]: multiplicity set at link in variant link-time / post-build in variant post-build / pre-compile in variant pre-compile, post-build-variant-multiplicity=true, post-build-variant-value=true, set at link in variant link-time / post-build in variant post-build / pre-compile in variant pre-compile, destination=DemEventParameter  # Reference to DEM event Id that is reported when FlexRay driver module detects slot errors. If this parameter is not configured, no event reporting happens.
          container FrIfLPdu [1..*]: multiplicity set at link in variant link-time / post-build in variant post-build / pre-compile in variant pre-compile  # Reference to a L-PDU index
            integer FrIfLPduIdx: 0..4095, set at link in variant link-time+post-build / pre-compile in variant pre-compile, symbolic-name-value=true  # This parameter identifies the L-PDU in the interaction between FlexRay Interface and FlexRay Driver.
            boolean FrIfReconfigurable: post-build-variant-value=true, set at link in variant link-time / post-build in variant post-build / pre-compile in variant pre-compile  # This parameter specifies that this LPdu is reconfigurable using FrIf_ReconfigLPdu. This means that this LPdu can be assigned to a different FrameTriggering at runtime. However, this reconfiguration is limited by hardware constraints. The direction of the LPdu cannot be reconfigured.
            reference FrIfVBTriggeringRef: post-build-variant-value=true, set at link in variant link-time / post-build in variant post-build / pre-compile in variant pre-compile, destination=FrIfFrameTriggering  # Reference to the assigned Frame triggering.
          container FrIfTransceiver [1..2]  # Up to two FlexRay Transceivers may connect a Controller to a Cluster. This container realizes a Controller-Transceiver assignment.
            enumeration FrIfClusterChannel: {FRIF_CHANNEL_A, FRIF_CHANNEL_B}, post-build-variant-value=true, set at link in variant link-time / post-build in variant post-build / pre-compile in variant pre-compile  # This parameter identifies to which one of the two Channels (A, B, A and B) of the Cluster the Transceiver is connected. FrIfClusterChannel shall map to Fr_ChannelType: FRIF_CHANNEL_A == FR_CHANNEL_A FRIF_CHANNEL_B == FR_CHANNEL_B FR_CHANNEL_AB shall not be used.
            symbolic name reference FrIfFrTrcvChannelRef: scope=ECU, post-build-variant-value=true, set at link in variant link-time / post-build in variant post-build / pre-compile in variant pre-compile, destination=FrTrcvChannel  # Reference to a Transceiver Driver Channel. This reference is unique for the ECU.
        container FrIfJobList  # This container specifies a list of all FlexRay Jobs of the Cluster to be performed by FrIf_JobListExec_<ClstIdx>().
          symbolic name reference FrIfAbsTimerRef: post-build-variant-value=true, set at link in variant link-time / post-build in variant post-build / pre-compile in variant pre-compile, destination=FrAbsoluteTimer  # Reference to the absolute timer to be used to trigger the interrupt whose ISR contains the FrIf_JobListExec_<ClstIdx>() function.
          container FrIfJob [1..*]: multiplicity set at link in variant link-time / post-build in variant post-build / pre-compile in variant pre-compile  # A job may contain more than one operation that are executed at a specific point in time.
            integer FrIfCycle: 0..63, post-build-variant-value=true, set at link in variant link-time / post-build in variant post-build / pre-compile in variant pre-compile  # The FlexRay Cycle in which the communication operation will execute this job
            integer FrIfMacrotick: 0..10240000, post-build-variant-value=true, set at link in variant link-time / post-build in variant post-build / pre-compile in variant pre-compile  # Macrotick offset in the Cycle [Macrotick]
            integer FrIfMaxIsrDelay: 0..10240000, post-build-variant-value=true, set at link in variant link-time / post-build in variant post-build / pre-compile in variant pre-compile  # The maximum delay in macroticks the FrIf_JoblistExec_<cluster>() function is processed after the absolute timer interrupt was triggered.
            container FrIfCommunicationOperation [1..*]: multiplicity set at link in variant link-time / post-build in variant post-build / pre-compile in variant pre-compile  # A separate operation which is part of a FlexRay Job and defines what type of action is executed.
              enumeration FrIfCommunicationAction: {DECOUPLED_TRANSMISSION, FREE_OP_A, FREE_OP_B, PREPARE_LPDU, RECEIVE_AND_INDICATE, RECEIVE_AND_STORE, RX_INDICATION, TX_CONFIRMATION}, post-build-variant-value=true, set at link in variant link-time / post-build in variant post-build / pre-compile in variant pre-compile  # The action to be performed in the FlexRay Operation
              integer FrIfCommunicationOperationIdx: 0..255, post-build-variant-value=true, set at link in variant link-time / post-build in variant post-build / pre-compile in variant pre-compile  # For each FlexRay Communication Job, this index spans a range of zero-based consecutive values and thus defines the order of the FlexRay Communication Operation in the respective FlexRay Communication Job.
              integer FrIfRxComOpMaxLoop [0..1]: 1..512, multiplicity set at link in variant link-time / post-build in variant post-build / pre-compile in variant pre-compile, post-build-variant-multiplicity=true, post-build-variant-value=true, set at link in variant link-time / post-build in variant post-build / pre-compile in variant pre-compile  # Defines the maximum number of loops for the receive RECEIVE_AND_INDICATE (Use case: emptying a FIFO). | Please note that the parameter is mandatory if FrIfCommunicationAction parameter is set to RECEIVE_AND_INDICATE. For all other operations this parameter can be ignored.
              reference FrIfLPduIdxRef: post-build-variant-value=true, set at link in variant link-time / post-build in variant post-build / pre-compile in variant pre-compile, destination=FrIfLPdu  # Reference to a L-PDu index
      container FrIfFrameStructure [1..*]: multiplicity set at link in variant link-time / post-build in variant post-build / pre-compile in variant pre-compile  # The Frame structure specifies a Construction Plan how a Frame is assembled with PDUs and their respective Update-Bits.
        enumeration FrIfByteOrder: {BIG_ENDIAN, LITTLE_ENDIAN}, post-build-variant-value=true, set at link in variant link-time / post-build in variant post-build / pre-compile in variant pre-compile  # This parameter defines the ByteOrder of all Pdus that are mapped into the Frame. | The absolute position of a Pdu in the Frame is determined by the definition of the ByteOrder parameter: If BIG_ENDIAN is specified, the FrIfPduOffset indicates the position of the most significant bit in the Frame. If LITTLE_ENDIAN is specified, the FrIfPduOffset indicates the position of the least significant bit in the Frame.
        container FrIfPdusInFrame [1..*]: multiplicity set at link in variant link-time / post-build in variant post-build / pre-compile in variant pre-compile  # This container holds all the information about a PDU in a FlexRay Frame.
          integer FrIfPduOffset: 0..253, post-build-variant-value=true, set at link in variant link-time / post-build in variant post-build / pre-compile in variant pre-compile  # The value specifies the offset of the PDU within the Frame [bytes].
          integer FrIfPduUpdateBitOffset [0..1]: 0..2031, multiplicity set at link in variant link-time / post-build in variant post-build / pre-compile in variant pre-compile, post-build-variant-multiplicity=true, post-build-variant-value=true, set at link in variant link-time / post-build in variant post-build / pre-compile in variant pre-compile  # This value specifies where the PDU's Update-Bit is stored in the Frame (bit location of PDU's Update-Bit in the FlexRay Frame).
          reference FrIfPduRef: post-build-variant-value=true, set at link in variant link-time / post-build in variant post-build / pre-compile in variant pre-compile, destination=FrIfPdu  # This is the reference to the local definition of a PDU.
      container FrIfPdu [1..*]: multiplicity set at link in variant link-time / post-build in variant post-build / pre-compile in variant pre-compile  # Contains PDU information. A PDU may be either a transmission PDU or a reception PDU.
        choice container FrIfPduDirection  # A PDU is either transmit or receive
          container FrIfRxPdu [0..1]  # Receive PDU
            function name FrIfRxIndicationName [0..1]: scope=ECU, multiplicity set at link in variant link-time / post-build in variant post-build / pre-compile in variant pre-compile, post-build-variant-multiplicity=true, post-build-variant-value=true, set at link in variant link-time / post-build in variant post-build / pre-compile in variant pre-compile  # This parameter defines the name of the <User_RxIndication>. This parameter depends on the parameter FRIF_USERRXINDICATION_UL. If FRIF_USERRXINDICATION_UL equals FR_TP, FR_NM, PDUR or XCP, the name of the <User_RxIndication> is fixed. If FRIF_USERRXINDICATION_UL equals CDD, the name of the <User_RxIndication> is selectable.
            enumeration FrIfUserRxIndicationUL: {CDD, FR_AR_TP, FR_NM, FR_TP, PDUR, XCP}, scope=ECU, post-build-variant-value=true, set at link in variant link-time / post-build in variant post-build / pre-compile in variant pre-compile  # This parameter defines the upper layer (UL) module to which the indication of the successfully received FRIFRXPDU has to be routed via <User_RxIndication>. This <User_RxIndication> has to be invoked when the indication of the configured FRIFRXPDU will be received by a Rx indication event from the FR Driver module. If no upper layer (UL) module is configured, no <User_RxIndication> has to be called in case of a Rx indication event of the FRIFRXPDU from the FR Driver module.
            reference FrIfRxPduRef: scope=ECU, post-build-variant-value=true, set at link in variant link-time / post-build in variant post-build / pre-compile in variant pre-compile, destination=Pdu  # Reference to the external PDU definition.
          container FrIfTxPdu [0..1]  # This container specifies transmission PDUs.
            boolean FrIfConfirm: post-build-variant-value=true, set at link in variant link-time / post-build in variant post-build / pre-compile in variant pre-compile  # Defines whether the transmission of a PDU should be checked and confirmed to the PDU owning BSW module.
            integer FrIfCounterLimit: 1..255, post-build-variant-value=true, set at link in variant link-time / post-build in variant post-build / pre-compile in variant pre-compile  # This value states the maximum number of indication of ready PDU data to the FrIf (i.e. maximum number of invocations of FrIf_Transmit) without an intermediate transmission of the PDU.
            boolean FrIfImmediate: post-build-variant-value=true, set at link in variant link-time / post-build in variant post-build / pre-compile in variant pre-compile  # Defines whether the PDU is transmitted immediate or decoupled.
            boolean FrIfNoneMode [0..1]: multiplicity set at link in variant link-time / post-build in variant post-build / pre-compile in variant pre-compile, post-build-variant-multiplicity=true, post-build-variant-value=true, set at link in variant link-time / post-build in variant post-build / pre-compile in variant pre-compile, default-value=false  # Using the "None-Mode" which means that there is no API FrIf_Transmit call of the upper layer for this PDU.
            function name FrIfTxConfirmationName [0..1]: scope=ECU, multiplicity set at link in variant link-time / post-build in variant post-build / pre-compile in variant pre-compile, post-build-variant-multiplicity=true, post-build-variant-value=true, set at link in variant link-time / post-build in variant post-build / pre-compile in variant pre-compile  # This parameter defines the name of the <User_TxConfirmation>. This parameter depends on the parameter FrIfUserTxUL. If FrIfUserTxUL equals FR_TP, FR_AR_TP, FR_NM, PDUR, FR_TSYN or XCP, the name of the <User_TxConfirmation> is fixed. If FrIfUserTxUL equals CDD, the name of the <User_TxConfirmation> is selectable.
            integer FrIfTxPduId: 0..65535, scope=ECU, set at link in variant link-time+post-build / pre-compile in variant pre-compile, symbolic-name-value=true  # The global PDU identifier, which has to be used by the upper layer BSW module. The identifier has to be zero based and consecutive.
            function name FrIfUserTriggerTransmitName [0..1]: scope=ECU, multiplicity set at link in variant link-time / post-build in variant post-build / pre-compile in variant pre-compile, post-build-variant-multiplicity=true, post-build-variant-value=true, set at link in variant link-time / post-build in variant post-build / pre-compile in variant pre-compile  # This parameter defines the name of the <User_TriggerTransmit>. This parameter depends on the parameter FrIfUserTxUL. If FrIfUserTxUL equals FR_TP, FR_NM, PDUR, FR_TSYN or XCP the name of the <User_TriggerTransmit> is fixed. If FrIfUserTxUL equals CDD, the name of the <User_TriggerTransmit> is selectable.
            enumeration FrIfUserTxUL: {CDD, FR_AR_TP, FR_NM, FR_TP, FR_TSYN, PDUR, XCP}, scope=ECU, post-build-variant-value=true, set at link in variant link-time / post-build in variant post-build / pre-compile in variant pre-compile  # This parameter defines the upper layer (UL) module to which the trigger of the Pdu to be transmitted (via the <User_TriggerTransmit>) or the confirmation of the successfully transmitted Pdu has to be routed (via the <User_TxConfirmation>). Please note that handle IDs which are used in callback functions are defined by the upper layer module.
            reference FrIfTxPduRef: scope=ECU, post-build-variant-value=true, set at link in variant link-time / post-build in variant post-build / pre-compile in variant pre-compile, destination=Pdu  # Reference to the external PDU definition.
    container FrIfGeneral  # This container contains the general configuration parameters of the FlexRay Interface.
      integer FrIfAbsTimerIdx: 1..15, set at pre-compile  # Maximum number of supported absolute timers.
      boolean FrIfAllSlotsSupport: scope=ECU, set at pre-compile  # Configuration parameter to enable/disable FrIf support to enable/disable of switching from key-slot / single-slot mode to all slot mode.
      boolean FrIfCancelTransmitSupport: scope=ECU, set at pre-compile  # Configuration parameter to enable/disable FrIf support to request the cancellation of the I-PDU transmission to FrDrv.
      boolean FrIfDevErrorDetect: scope=ECU, set at pre-compile  # Switches the Development Error Detection and Notification on or off | true: Development Error Detection and Notification on false: Development Error Detection and Notification off
      boolean FrIfDisableLPduSupport: set at pre-compile  # Configuration parameter to enable/disable FrIf support to disables the hardware resource of a LPdu for transmission/reception.
      boolean FrIfDisableTransceiverBranchSupport: scope=ECU, set at pre-compile  # Configuration parameter to enable/disable FrIf support to disable branches of an active star.
      boolean FrIfEnableTransceiverBranchSupport: scope=ECU, set at pre-compile  # Configuration parameter to enable/disable FrIf support to enable branches of an active star.
      string FrIfFreeOpAApiName [0..1]: scope=ECU, multiplicity set at pre-compile, set at pre-compile  # API name that is called when FREE_OP_A is selected as communication operation. See also chapter 8.8.3 Configurable Interfaces.
      string FrIfFreeOpBApiName [0..1]: scope=ECU, multiplicity set at pre-compile, set at pre-compile  # API name that is called when FREE_OP_B is selected as communication operation. See also chapter 8.8.3 Configurable Interfaces.
      string FrIfFreeOpsHeader [0..1]: multiplicity set at pre-compile, set at pre-compile  # Defines header file for configurable FREE_OP_A / FREE_OP_B functions.
      boolean FrIfGetClockCorrectionSupport: scope=ECU, set at pre-compile  # Configuration parameter to enable/disable FrIf support to enable/disable of polling the FlexRay Driver to getting CC clock correction values.
      boolean FrIfGetGetChannelStatusSupport: scope=ECU, set at pre-compile  # Configuration parameter to enable/disable FrIf support to enable/disable of polling the FlexRay Driver to getting error information about the FlexRay communications bus.
      boolean FrIfGetNmVectorSupport: scope=ECU, set at pre-compile  # Configuration parameter to enable/disable FrIf support to request the FlexRay hardware NMVector.
      boolean FrIfGetNumOfStartupFramesSupport: scope=ECU, set at pre-compile  # Configuration parameter to enable/disable FrIf support to enable/disable of polling the FlexRay Driver for the actual number of received startup frames on the bus.
      boolean FrIfGetSyncFrameListSupport: scope=ECU, set at pre-compile  # Configuration parameter to enable/disable FrIf support to enable/disable of polling the FlexRay Driver to getting a list of actual received sync frames.
      boolean FrIfGetTransceiverErrorSupport: scope=ECU, set at pre-compile  # Configuration parameter to enable/disable FrIf support to get the FlexRay Transceiver errors by calling the FlexRay Transceiver module.
      boolean FrIfGetWakeupRxStatusSupport: scope=ECU, set at pre-compile  # Configuration parameter to enable/disable FrIf support to get the wakeup received information from the FlexRay controller.
      integer FrIfNumClstSupported: 1..15, set at pre-compile  # Maximum number of FlexRay Clusters that the FlexRay Interface supports.
      integer FrIfNumCtrlSupported: 1..15, set at pre-compile  # Maximum number of FlexRay CCs that the FlexRay Interface supports
      string FrIfPublicCddHeaderFile [0..*]: multiplicity set at pre-compile, set at pre-compile  # Defines header files for callback functions which shall be included in case of CDDs. Range of characters is 1.. 32.
      boolean FrIfReadCCConfigApi: scope=ECU, set at pre-compile  # Configuration parameter to enable/disable the optional FrIf_ReadCCConfig API.
      boolean FrIfReconfigLPduSupport: scope=ECU, set at pre-compile  # Configuration parameter to enable/disable FrIf support to enable/disable the reconfiguration of a given LPdu according to the parameters (FrameId, Channel, CycleRepetition, CycleOffset, PayloadLength, HeaderCRC) at runtime.
      integer FrIfUnusedBitValue [0..1]: 0..1, multiplicity set at pre-compile, set at pre-compile  # Set unused bits to a defined value.
      boolean FrIfVersionInfoApi: set at pre-compile  # Enables/disables the existence of the FrIf_GetVersionInfo() API service | true: FrIf_GetVersionInfo() API service exists false: FrIf_GetVersionInfo() API service does not exist
  module definition FrNm [0..1]: post-build-variant-support=true, variants link-time/post-build/pre-compile  # The Flexray Nm module
    container FrNmChannelConfig  # This container contains the configuration parameters for all FlexRay NM channels.
      container FrNmChannel [1..*]: multiplicity set at pre-compile  # This container contains the configuration parameters for a FlexRay NM Channel.
        container FrNmChannelIdentifiers  # This container contains instance specific identifiers related to the respective FlexRay Channel.
          boolean FrNmActiveWakeupBitEnabled [0..1]: multiplicity set at link in variant link-time+post-build / pre-compile in variant pre-compile, set at link in variant link-time+post-build / pre-compile in variant pre-compile, default-value=false  # Enables/Disables the handling of the Active Wakeup Bit in the FrNm module.
          integer FrNmCarWakeUpBitPosition [0..1]: 0..7, multiplicity set at link in variant link-time+post-build / pre-compile in variant pre-compile, set at link in variant link-time+post-build / pre-compile in variant pre-compile  # Specifies the Bit position of the CWU within the NM-Message.
          integer FrNmCarWakeUpBytePosition [0..1]: 2..7, multiplicity set at link in variant link-time+post-build / pre-compile in variant pre-compile, set at link in variant link-time+post-build / pre-compile in variant pre-compile  # Specifies the Byte position of the CWU within the NM-Message.
          boolean FrNmCarWakeUpFilterEnabled [0..1]: multiplicity set at link in variant link-time+post-build / pre-compile in variant pre-compile, set at link in variant link-time+post-build / pre-compile in variant pre-compile  # If CWU filtering is supported, only the CWU bit within the NM message with source node identifier | FrNmCarWakeUpFilterNodeId is considered as CWU request. FALSE - CWU Filtering is not supported TRUE - CWU Filtering is supported
          integer FrNmCarWakeUpFilterNodeId [0..1]: 0..255, multiplicity set at link in variant link-time+post-build / pre-compile in variant pre-compile, set at link in variant link-time+post-build / pre-compile in variant pre-compile  # Source node identifier for CWU filtering. If CWU filtering is supported, only the CWU bit within the NM | message with source node identifier FrNmCarWakeUpFilterNodeId is considered as CWU request.
          boolean FrNmCarWakeUpRxEnabled: set at link in variant link-time+post-build / pre-compile in variant pre-compile  # Enables or disables support of CarWakeUp bit evaluation in received NM messages. | FALSE - CarWakeUp not supported TRUE - CarWakeUp supported
          boolean FrNmControlBitVectorActive: set at link in variant link-time+post-build / pre-compile in variant pre-compile  # This parameter is used to activate or deactivate the control bit vector support for a Fr Nm Channel.
          integer FrNmNodeId: 0..255, post-build-variant-value=true, set at link in variant link-time / post-build in variant post-build / pre-compile in variant pre-compile  # NM node identifier configured for the respective FlexRay Channel. | It is used for identifying the respective NM node in the NM-cluster. It must be unique for each NM node within one NM cluster.
          enumeration FrNmPduScheduleVariant: {FRNM_PDU_SCHEDULE_VARIANT_1, FRNM_PDU_SCHEDULE_VARIANT_2, FRNM_PDU_SCHEDULE_VARIANT_3, FRNM_PDU_SCHEDULE_VARIANT_4, FRNM_PDU_SCHEDULE_VARIANT_5, FRNM_PDU_SCHEDULE_VARIANT_6, FRNM_PDU_SCHEDULE_VARIANT_7}, origin=ECUC_AUTOSAR, set at link in variant link-time+post-build / pre-compile in variant pre-compile  # This parameter defines the PDU scheduling variant that should be used for this channel. | Option 1 NM-Vote and NM-Data in static segment (one PDU) Option 2 NM-Vote and NM-Data in dynamic segment (one PDU) Option 3 NM-Vote and NM-Data in static segment (separate PDU) Option 4 NM-Vote in static segment and NM-Data in dynamic segment Option 5 NM-Vote in dynamic segment and NM-Data in static segment Option 6 NM-Vote and NM-Data in dynamic segment (separate PDU) Option 7 Combined NM-Vote and CBV in static segment and NM-Data in dynamic segment
          boolean FrNmPnEnabled: post-build-variant-value=true, set at link in variant link-time / post-build in variant post-build / pre-compile in variant pre-compile, default-value=false  # Enables or disables support of partial networking. | false: Partial networking Range not supported true: Partial networking supported
          boolean FrNmPnEraCalcEnabled [0..1]: multiplicity set at link in variant link-time+post-build / pre-compile in variant pre-compile, set at link in variant link-time+post-build / pre-compile in variant pre-compile, default-value=false  # Specifies if FrNm calculates the PN request information for external requests. (ERA) | false: PN request are not calculated true: PN request are calculated
          boolean FrNmSynchronizationPointEnabled: set at link in variant link-time+post-build / pre-compile in variant pre-compile  # This parameter defines if this channel shall provide the synchronization point indication to the NM Interface.
          reference FrNmPnEraRxNSduRef [0..1]: multiplicity set at link in variant link-time+post-build / pre-compile in variant pre-compile, set at link in variant link-time+post-build / pre-compile in variant pre-compile, destination=Pdu  # Reference to a Pdu in the COM-Stack. | Only one SduRef is required for FrNm because the EIRA is the aggregation over all FlexRay Channels.
          symbolic name reference FrNmChannelHandle: scope=ECU, post-build-variant-value=true, set at link in variant link-time / post-build in variant post-build / pre-compile in variant pre-compile, destination=FrIfCluster  # Channel identifier configured for the respective instance of the NM. | The FrNmChannelHandle shall be encoded in the FrNmRxPduId parameter which is passed to FrNm_RxIndication() function called by the FrIf.
          symbolic name reference FrNmComMNetworkHandleRef: post-build-variant-value=true, set at link in variant link-time / post-build in variant post-build / pre-compile in variant pre-compile, destination=ComMChannel  # This reference points to the unique channel defined by the ComMChannel and provides access to the unique channel index value in ComMChannelId.
          container FrNmRxPdu [1..*]  # This container describes the FlexRay NM RX PDU:s.
            boolean FrNmRxPduContainsData: post-build-variant-value=true, set at link in variant link-time / post-build in variant post-build / pre-compile in variant pre-compile  # This parameter defines if the PDU contains NM Data.
            boolean FrNmRxPduContainsVote: post-build-variant-value=true, set at link in variant link-time / post-build in variant post-build / pre-compile in variant pre-compile  # This parameter defines if the PDU contains NM Vote information.
            integer FrNmRxPduId: 0..65535, set at link in variant link-time+post-build / pre-compile in variant pre-compile, symbolic-name-value=true  # PDU identifier configured for the respective FlexRay Channel. | It is used for referring to the FlexRay Interface receive function. It must be consistent with the value configured in the FlexRay Interface. This ID is used for the combined reception of NM Vote and NM Data or for the reception of the NM Vote if NM Data is received in a separate PDU. ImplementationType: PduIdType
            reference FrNmRxPduRef: scope=ECU, post-build-variant-value=true, set at link in variant link-time / post-build in variant post-build / pre-compile in variant pre-compile, destination=Pdu  # The reference to a PDU in the global PDU structure described in the AUTOSAR ECU Configuration Specification. This reference will be used by the FrIf module to derive the PDU Id.
          container FrNmTxPdu [0..4]  # This container describes the FlexRay NM TX PDU:s.
            integer FrNmTxConfirmationPduId: 0..65535, set at link in variant link-time+post-build / pre-compile in variant pre-compile, symbolic-name-value=true  # Handle Id used by the Lower Layer when calling FrNm_TriggerTransmit() or FrNm_TxConfirmation().
            boolean FrNmTxPduContainsData: post-build-variant-value=true, set at link in variant link-time / post-build in variant post-build / pre-compile in variant pre-compile  # This parameted defines if the PDU contains NM Data.
            boolean FrNmTxPduContainsVote: post-build-variant-value=true, set at link in variant link-time / post-build in variant post-build / pre-compile in variant pre-compile  # This parameted defines if the PDU contains NM Vote information.
            reference FrNmTxPduRef: scope=ECU, post-build-variant-value=true, set at link in variant link-time / post-build in variant post-build / pre-compile in variant pre-compile, destination=Pdu  # The reference to a PDU in the global PDU structure described in the AUTOSAR ECU Configuration Specification. This reference is used to derive the PDU Id that is defined by the FrIf module.
          container FrNmUserDataTxPdu [0..1]  # This optional container is used to configure the UserNm PDU. This container is only available if FrNmComUserDataSupport is enabled.
            integer FrNmTxUserDataPduId: 0..65535, set at link in variant link-time+post-build / pre-compile in variant pre-compile, symbolic-name-value=true  # This parameter defines the Handle ID of the NM User Data I-PDU.
            reference FrNmTxUserDataPduRef: post-build-variant-value=true, set at link in variant link-time / post-build in variant post-build / pre-compile in variant pre-compile, destination=Pdu  # Reference to the NM User Data I-PDU in the global PDU collection.
        container FrNmChannelTiming  # This container contains instance-specific timing related to the respective FlexRay Channel.
          enumeration FrNmDataCycle: {FRNM_CYCLE_VALUE_1, FRNM_CYCLE_VALUE_16, FRNM_CYCLE_VALUE_2, FRNM_CYCLE_VALUE_32, FRNM_CYCLE_VALUE_4, FRNM_CYCLE_VALUE_64, FRNM_CYCLE_VALUE_8}, set at link in variant link-time+post-build / pre-compile in variant pre-compile  # Number of FlexRay Schedule Cycles needed to transmit the NM Data of all ECUs on the FlexRay bus
          float FrNmMainFunctionPeriod: 0.001..0.02, set at link in variant link-time+post-build / pre-compile in variant pre-compile  # This parameter defines the processing cycle of the main function of FrNm module in seconds.
          float FrNmMsgTimeoutTime [0..1]: 0..65.535, multiplicity set at link in variant link-time / post-build in variant post-build / pre-compile in variant pre-compile, post-build-variant-multiplicity=true, post-build-variant-value=true, set at link in variant link-time / post-build in variant post-build / pre-compile in variant pre-compile, default-value=0  # Timeout of a NM-message. It determines in seconds how long the NM shall wait with notification of transmission failure while communication errors occur on the bus.
          integer FrNmReadySleepCnt: 0..65535, set at link in variant link-time+post-build / pre-compile in variant pre-compile  # FrNm switches to bus sleep mode at the end of the FrNmReadySleepCnt+1 repetition cycle without any NM vote. E.g. on a value of "1", the NM-State Machine will leave the Ready Sleep State after two NM Repetition Cycles with no "keep awake" votes.
          float FrNmRemoteSleepIndTime: 0..65.535, set at link in variant link-time+post-build / pre-compile in variant pre-compile  # Timeout for Remote Sleep Indication. It defines the time in seconds how long it shall take to recognize that all other nodes are ready to sleep. | The value "0" denotes that no Remote Sleep Indication functionality is configured.
          float FrNmRepeatMessageTime: 0..65.535, scope=ECU, set at link in variant link-time+post-build / pre-compile in variant pre-compile  # Timeout for Repeat Message State. Defines the time in seconds how long the NM shall stay in the Repeat Message State. | The value "0" denotes that no Repeat Message State is configured, which means that Repeat Message State is transient and implies that it is left immediately after entry and consequently no startup stability is guaranteed and no node detection procedure is possible.
          enumeration FrNmRepetitionCycle: {FRNM_CYCLE_VALUE_1, FRNM_CYCLE_VALUE_16, FRNM_CYCLE_VALUE_2, FRNM_CYCLE_VALUE_32, FRNM_CYCLE_VALUE_4, FRNM_CYCLE_VALUE_64, FRNM_CYCLE_VALUE_8}, set at link in variant link-time+post-build / pre-compile in variant pre-compile  # Number of Flexray Schedule Cycles used to repeat the transmission of the Nm vote of all ECUs on the Flexray Bus.
          boolean FrNmVoteInhibitionEnabled: set at pre-compile  # Pre-processor switch for enabling the inhibition of vote changes from the next-to-last repetition cycle to the last repetition cycle before the Ready Sleep Counter expires.
          enumeration FrNmVotingCycle: {FRNM_CYCLE_VALUE_1, FRNM_CYCLE_VALUE_16, FRNM_CYCLE_VALUE_2, FRNM_CYCLE_VALUE_32, FRNM_CYCLE_VALUE_4, FRNM_CYCLE_VALUE_64, FRNM_CYCLE_VALUE_8}, set at link in variant link-time+post-build / pre-compile in variant pre-compile  # Number of FlexRay Schedule Cycles needed to transmit the Nm vote of all ECUs on the FlexRay Bus.
    container FrNmGlobalConfig  # This container contains all global configuration parameters for the FrNm module.
      container FrNmGlobalConstants  # This container contains module constants related to the FlexRay NM functionality.
        integer FrNmNumberOfClusters: 1..255, set at link in variant link-time+post-build / pre-compile in variant pre-compile  # Number of AUTOSAR FR NM clusters allowed within one ECU.
      container FrNmGlobalFeatures  # This container contains module features related to the FlexRay NM functionality.
        boolean FrNmBusSynchronizationEnabled: set at pre-compile  # Pre-processor switch for enabling the bus synchronization.
        boolean FrNmComUserDataSupport: set at pre-compile  # Enable/disable the user data support.
        boolean FrNmControlBitVectorEnabled: set at pre-compile  # Pre-processor switch for enabling control bit vector support. | calculationFormula = If (FrNmNodeDetectionEnabled == False) then Equal(False) else Equal(False or True)
        boolean FrNmCoordinatorSyncSupport: set at pre-compile  # Enables/disables the coordinator synchronization support.
        boolean FrNmCycleCounterEmulation: set at pre-compile  # Pre-processor switch for enabling the cycle counter emulation.
        boolean FrNmDualChannelPduEnable: set at pre-compile  # Pre-processor switch for enabling the support of dual channel transmission and reception of NM messages.
        boolean FrNmHwVoteEnable: set at pre-compile  # Pre-processor switch for enabling the processing of FlexRay Hardware aggregated NM-Votes. This switch enables/disables the optional API FrIf_GetNmVector.
        boolean FrNmNodeDetectionEnabled: set at pre-compile  # Pre-processor switch for enabling node detection support. | calculationFormula = If (FrNmPassiveModeEnabled == False) then Equal(NmNodeDetectionEnabled) else Equal(False)
        boolean FrNmPassiveModeEnabled: set at pre-compile  # Pre-processor switch for enabling Passive Node Configuration support. | calculationFormula = Equal(NmPassiveModeEnabled)
        boolean FrNmPduRxIndicationEnabled: set at pre-compile  # Pre-processor switch for enabling PDU reception indication.
        boolean FrNmPnEiraCalcEnabled [0..1]: multiplicity set at link in variant link-time+post-build / pre-compile in variant pre-compile, set at link in variant link-time+post-build / pre-compile in variant pre-compile, default-value=false  # Specifies if FrNm calculates the PN request information for internal an external requests. (EIRA) | true: PN request are calculated false: PN request are not calculated
        float FrNmPnResetTime [0..1]: 0.001..65.535, multiplicity set at link in variant link-time+post-build / pre-compile in variant pre-compile, set at link in variant link-time+post-build / pre-compile in variant pre-compile  # Specifies the runtime of the reset timer in seconds. This reset time is valid for the reset of PN requests in the EIRA and in the ERA. The value shall be the same for every channel. Thus it is a global config parameter.
        boolean FrNmRemoteSleepIndicationEnabled: set at pre-compile  # Pre-processor switch for enabling remote sleep indication. | calculationFormula = If (FrNmPassiveModeEnabled == True) then Equal(False) else Equal(False or True)
        boolean FrNmRepeatMessageBitEnabled: set at pre-compile  # Pre-processor switch for enabling the repeat message bit support.
        boolean FrNmSourceNodeIdentifierEnabled: set at pre-compile  # Pre-processor switch for enabling SourceNodeIdentifier support.
        boolean FrNmStateChangeIndicationEnabled: set at pre-compile  # Pre-processor switch for enabling state change indication.
        boolean FrNmUserDataEnabled: set at pre-compile  # Pre-processor switch for enabling user data support.
        boolean FrNmVotingNextToLastRepetitionCycleDisable: set at pre-compile  # Pre-processor switch for disabling vote changes in the last two | repetition cycles before the Ready Sleep Counter expires.
        reference FrNmPnEiraRxNSduRef [0..1]: multiplicity set at link in variant link-time+post-build / pre-compile in variant pre-compile, set at link in variant link-time+post-build / pre-compile in variant pre-compile, destination=Pdu  # Reference to a Pdu in the COM-Stack. | Only one SduRef is required for FrNm because the EIRA is the aggregation over all FlexRay Channels.
        container FrNmPnInfo [0..1]  # PN information configuration
          integer FrNmPnInfoLength: 1..7, set at link in variant link-time+post-build / pre-compile in variant pre-compile, default-value=1  # Specifies the length of the PN request information in the NM message.
          integer FrNmPnInfoOffset: 1..7, set at link in variant link-time+post-build / pre-compile in variant pre-compile, default-value=1  # Specifies the offset of the PN request information in the NM message.
          container FrNmPnFilterMaskByte [0..7]  # Filter mask byte configuration
            integer FrNmPnFilterMaskByteIndex: 0..6, set at link in variant link-time+post-build / pre-compile in variant pre-compile  # Index of the filter mask byte. Specifies the position within the filter mask byte array.
            integer FrNmPnFilterMaskByteValue: 0..255, post-build-variant-value=true, set at link in variant link-time / post-build in variant post-build / pre-compile in variant pre-compile, default-value=0  # Parameter to configure the filter mask byte.
      container FrNmGlobalProperties  # This container contains module properties related to the FlexRay NM functionality.
        boolean FrNmDevErrorDetect: set at pre-compile  # Pre-processor switch for enabling development error detection
        boolean FrNmMainAcrossFrCycle: set at link in variant link-time+post-build / pre-compile in variant pre-compile  # Parameter describing if the execution of FrNm_Main function crosses the FlexRay cycle boundary or not.
        boolean FrNmVersionInfoApi: set at pre-compile  # Pre-processor switch for enabling version info API support.
  module definition FrSM [0..1]: post-build-variant-support=true, variants link-time/post-build/pre-compile  # Configuration of the FlexRay State Manager
    container FrSMConfig  # This container comprises the cluster specific configuration of the FlexRay State Manager.
      container FrSMCluster [1..*]  # This container specifies a FlexRay cluster and all related data. A FlexRay cluster may consist of more than one controller per ECU.
        boolean FrSMCheckWakeupReason: post-build-variant-value=true, set at link in variant link-time / post-build in variant post-build / pre-compile in variant pre-compile  # If FrSMCheckWakeupReason is true, the FrSM will check the wakeup reason in order to skip the wakeup in case of wakeup by bus. If FrSMCheckWakeupReason is false, the FrSM will always try to perform a wakeup.
        boolean FrSMDelayStartupWithoutWakeup: post-build-variant-value=true, set at link in variant link-time / post-build in variant post-build / pre-compile in variant pre-compile  # If true, timer t1 shall be started instead of immediately calling FrIf_AllowColdstart in case of a startup without wakeup.
        float FrSMDurationT1: 0..Inf, post-build-variant-value=true, set at link in variant link-time / post-build in variant post-build / pre-compile in variant pre-compile  # The duration of timer t1 in seconds. | A value of 0 shall imply that the timer is not used.
        float FrSMDurationT2: 0..Inf, post-build-variant-value=true, set at link in variant link-time / post-build in variant post-build / pre-compile in variant pre-compile  # The duration of timer t2 in seconds. | A value of 0 shall imply that the timer is not used. The value of this parameter shall be larger than the value of FrSMDurationT1 parameter.
        float FrSMDurationT3: 0..Inf, post-build-variant-value=true, set at link in variant link-time / post-build in variant post-build / pre-compile in variant pre-compile  # The duration of timer t3 in seconds. The value of this parameter shall be larger than the value of FrSMDurationT1 parameter. | A value of 0 shall imply that the timer is not used. It shall only be possible to configure a value 0 if no FrNm is used.
        boolean FrSMIsColdstartEcu: post-build-variant-value=true, set at link in variant link-time / post-build in variant post-build / pre-compile in variant pre-compile  # True: The ECU is a coldstart node for this FlexRay cluster. | False: The ECU is no coldstart node for this FlexRay cluster.
        boolean FrSMIsWakeupEcu: post-build-variant-value=true, set at link in variant link-time / post-build in variant post-build / pre-compile in variant pre-compile  # True: FrSM shall perform a wakeup for this cluster. | False: FrSM shall never perform a wakeup for this FlexRay cluster.
        float FrSMMainFunctionCycleTime: 0..Inf, set at link in variant link-time+post-build / pre-compile in variant pre-compile  # This parameter defines the cycle time in seconds of the periodic calling of FrSM main function.
        integer FrSMMinNumberOfColdstarter [0..1]: 0..255, multiplicity set at link in variant link-time / post-build in variant post-build / pre-compile in variant pre-compile, post-build-variant-multiplicity=true, post-build-variant-value=true, set at link in variant link-time / post-build in variant post-build / pre-compile in variant pre-compile  # This parameter defines the number of coldstarter that should not be underrun. If this parameter is not configured the mainfunction shall not check the number of startup frames.
        integer FrSMNumWakeupPatterns: 0..65535, post-build-variant-value=true, set at link in variant link-time / post-build in variant post-build / pre-compile in variant pre-compile  # Maximum number of Wakeup Patterns the node may send before going to FRSM_STARTUP.
        integer FrSMStartupRepetitions [0..1]: 0..65535, multiplicity set at link in variant link-time / post-build in variant post-build / pre-compile in variant pre-compile, post-build-variant-multiplicity=true, post-build-variant-value=true, set at link in variant link-time / post-build in variant post-build / pre-compile in variant pre-compile  # The number of times an ECU may repeat the startup procedure for a FlexRay cluster.
        integer FrSMStartupRepetitionsWithWakeup [0..1]: 0..65535, multiplicity set at link in variant link-time / post-build in variant post-build / pre-compile in variant pre-compile, post-build-variant-multiplicity=true, post-build-variant-value=true, set at link in variant link-time / post-build in variant post-build / pre-compile in variant pre-compile  # The number of times an ECU may repeat the startup procedure including a wakeup for a FlexRay cluster.
        float FrSMTrcvStdbyDelay [0..1]: 0..Inf, multiplicity set at link in variant link-time / post-build in variant post-build / pre-compile in variant pre-compile, post-build-variant-multiplicity=true, post-build-variant-value=true, set at link in variant link-time / post-build in variant post-build / pre-compile in variant pre-compile  # The duration of timer t_TrcvStdbyDelay in seconds. The granularity of this parameter shall be restricted to full FlexRay cycles (FrIfGdCycle). | A value of 0 shall imply that the timer is not used.
        symbolic name reference FrSMComMNetworkHandleRef: set at link in variant link-time+post-build / pre-compile in variant pre-compile, destination=ComMChannel  # Reference to the unique handle to identify one certain FlexRay network correspond to one of the network handles of the ComM configuration.
        symbolic name reference FrSMFrIfClusterRef: post-build-variant-value=true, set at link in variant link-time / post-build in variant post-build / pre-compile in variant pre-compile, destination=FrIfCluster  # References the cluster configuration in the FlexRay Interface configuration. | Note that the assigned controllers and transceivers are defined in the FrIf configuration and can be accessed via this reference.
        container FrSMClusterDemEventParameterRefs [0..1]  # Container for the references to DemEventParameter elements which shall be invoked using the API Dem_ReportErrorStatus in case the corresponding error occurs. The EventId is taken from the referenced DemEventParameter's DemEventId value. | The standardized errors are provided in this container and can be extended by vendor specific error references.
          symbolic name reference FRSM_E_CLUSTER_STARTUP: set at link in variant link-time+post-build / pre-compile in variant pre-compile, destination=DemEventParameter  # Reference to the DemEventParameter which shall be issued when the error "FRSM_E_CLUSTER_STARTUP" has occurred. If the reference is not configured the error shall be reported as DET error.
          symbolic name reference FRSM_E_CLUSTER_SYNC_LOSS: set at link in variant link-time+post-build / pre-compile in variant pre-compile, destination=DemEventParameter  # Reference to the DemEventParameter which shall be issued when the error "FRSM_E_CLUSTER_SYNC_LOSS" has occurred. If the reference is not configured the error shall be reported as DET error.
    container FrSMGeneral  # This container contains the general configuration parameters of the FlexRay State Manager.
      boolean FrSMAllSlotsSupport [0..1]: multiplicity set at pre-compile, set at pre-compile  # Configuration parameter to enable/disable FrSM support to enable/disable the switching from key-slot/single-slot mode to all-slot mode.
      string FrSMCddHeaderFile [0..1]: multiplicity set at pre-compile, set at pre-compile  # This parameter defines header files for callback functions which are implemented by CDD, e.g. <Cdd>_SyncLossErrorIndication.
      boolean FrSMDevErrorDetect: set at pre-compile, default-value=false  # Enables and disables the development error detection and | notification mechanism.
      function name FrSMSyncLossErrorIndicationName [0..1]: multiplicity set at link in variant link-time+post-build / pre-compile in variant pre-compile, set at link in variant link-time+post-build / pre-compile in variant pre-compile  # Name of <Cdd>_SyncLossErrorIndication function that shall be called on loss of synchronization. If this parameter is omitted no indication shall take place.
      boolean FrSMVersionInfoApi: set at pre-compile, default-value=false  # Enables and disables the version info API
  module definition FrTSyn [0..1]: post-build-variant-support=true, variants post-build/pre-compile  # This represents the specific configuration variant for the TSyn on Flexray.
    container FrTSynGeneral  # This container holds the general parameters of the Flexray-specific Synchronized Time-base Manager
      boolean FrTSynDevErrorDetect: set at pre-compile  # Switch for enabling the development error detection.
      float FrTSynMainFunctionPeriod: 0..Inf, set at pre-compile  # Schedule period of the main function FrTSyn_MainFunction. Unit: [s].
      boolean FrTSynVersionInfo: set at pre-compile  # Activate/Deactivate the version information API (FrTSyn_GetVersionInfo). True: version information API activated False: version information API deactivated.
      container FrTSynGlobalTimeOfsDataIDList  # The DataIDList for OFS messages ensures the identification of data elements due to CRC calculation process.
        container FrTSynGlobalTimeOfsDataIDListElement [16..16]  # Element of the DataIDList for OFS messages ensures the identification of data elements due to CRC calculation process.
          integer FrTSynGlobalTimeOfsDataIDListIndex: 0..15, set at pre-compile  # Index of the DataIDList for OFS messages ensures the identification of data elements due to CRC calculation process.
          integer FrTSynGlobalTimeOfsDataIDListValue: 0..255, set at pre-compile  # Value of the DataIDList for OFS messages ensures the identification of data elements due to CRC calculation process.
      container FrTSynGlobalTimeSyncDataIDList  # The DataIDList for SYNC messages ensures the identification of data elements due to CRC calculation process.
        container FrTSynGlobalTimeSyncDataIDListElement [16..16]  # Element of the DataIDList for SYNC messages ensures the identification of data elements due to CRC calculation process.
          integer FrTSynGlobalTimeSyncDataIDListIndex: 0..15, set at pre-compile  # Index of the DataIDList for SYNC messages ensures the identification of data elements due to CRC calculation process.
          integer FrTSynGlobalTimeSyncDataIDListValue: 0..255, set at pre-compile  # Value of the DataIDList for SYNC messages ensures the identification of data elements due to CRC calculation process.
    container FrTSynGlobalTimeDomain [1..*]  # This represents the existence of a global time domain on Flexray. The FrTSyn module can administrate several global time domains at the same time that in itself form a hierarchy of domains and sub-domains. | If the FrTSyn exists it is assumed that at least one global time domain exists.
      integer FrTSynGlobalTimeDomainId: 0..31, set at pre-compile  # The global time domain ID.
      integer FrTSynGlobalTimeSequenceCounterJumpWidth: 1..15  # The SequenceCounterJumpWidth specifies the maximum allowed gap of the Sequence Counter between two SYNC resp. two OFS messages.
      symbolic name reference FrTSynSynchronizedTimeBaseRef: set at pre-compile, destination=StbMSynchronizedTimeBase  # Mandatory reference to the required synchronized time-base.
      container FrTSynGlobalTimeMaster [0..1]  # Configuration of the global time master. Each global time domain is required to have exactly one global time master. This master may or may not exist on the configured ECU.
        enumeration FrTSynGlobalTimeTxCrcSecured: {CRC_NOT_SUPPORTED, CRC_SUPPORTED}, set at pre-compile  # This represents the configuration of whether or not CRC is supported.
        float FrTSynGlobalTimeTxPeriod: 0..Inf, set at pre-compile  # This represents the TX period. Unit: seconds
        container FrTSynGlobalTimeMasterPdu  # This container carries all properties required to configure the PDU sent by the global time master for the given global time domain.
          integer FrTSynGlobalTimeMasterConfirmationHandleId: 0..65535, set at pre-compile, symbolic-name-value=true  # This represents the handle ID of the PDU that contains the global time information.
          reference FrTSynGlobalTimePduRef: post-build-variant-value=true, set at post-build in variant post-build / pre-compile in variant pre-compile, destination=Pdu  # This represents the reference to the Pdu taken to transmit the global time information. The global time master of a global time domain acts as the sender of the Pdu while all the time slaves are supposed to receive the Pdu.
      container FrTSynGlobalTimeSlave [0..1]  # This represents the time slave for the enclosing global time domain.
        enumeration FrTSynRxCrcValidated: {CRC_IGNORED, CRC_NOT_VALIDATED, CRC_VALIDATED}, set at pre-compile  # This parameter controls whether or not CRC validation shall be supported.
        container FrTSynGlobalTimeSlavePdu  # This container carries all properties required to configure the PDU received by the time slave for the given global time domain.
          integer FrTSynGlobalTimeSlaveHandleId: 0..65535, set at pre-compile, symbolic-name-value=true  # This represents the handle ID of the PDU that contains the global time information.
          reference FrTSynGlobalTimePduRef: post-build-variant-value=true, set at post-build in variant post-build / pre-compile in variant pre-compile, destination=Pdu  # This represents the reference to the Pdu taken to transmit the global time information. The global time master of a global time domain acts as the sender of the Pdu while all the time slaves are supposed to receive the Pdu.
  module definition FrTp [0..1]: post-build-variant-support=true, variants post-build/pre-compile  # Configuration of the FlexRay Transport Protocol module according to ISO 10681-2.
    container FrTpGeneral  # This container contains the general configuration parameters of the FlexRay Transport Protocol module.
      boolean FrTpAckRt: set at pre-compile  # Preprocessor switch for enabling the Acknowledgement and retry mechanisms. | True: Acknowledge and Retry is enabled False: Acknowledge and Retry is disabled
      integer FrTpChanNum: 1..32, set at pre-compile  # Preprocessor switch for defining the number of concurrent channels the module supports. Up to 32 channels shall be definable here.
      boolean FrTpChangeParamApi: set at pre-compile  # Preprocessor switch for enabling the API to change FrTp communication | parameters. True: ChangeParameter API is enabled False: ChangeParameter API is disabled.
      boolean FrTpDevErrorDetect: set at pre-compile  # Preprocessor switch for enabling development error detection. | True: Development Error Detection is enabled False: Development Error Detection is disabled
      boolean FrTpFullDuplexEnable: set at pre-compile, default-value=false  # Preprocessor switch for enabling full duplex mechanisms for all channels. | True: Full duplex is enabled False: Fullduplex is disabled (Half duplex is enabled)
      float FrTpMainFuncCycle: 0..Inf, set at pre-compile  # This parameter contains the calling period of the TPs Main Function. The parameter is specified in seconds.
      boolean FrTpTransmitCancellation: set at pre-compile, default-value=false  # Preprocessor switch for enabling Transmit Cancellation and Receive Cancellation. | True: Transmit/Receive Cancellation is enabled False: Transmit/Receive Cancellation is disabled
      boolean FrTpUnknownMsgLength: set at pre-compile  # Preprocessor switch to support data transfer with unknown message length. | True: Transmission with unknown message length is enabled False: Transmission with unknown message length is disabled
      boolean FrTpVersionInfoApi: set at pre-compile  # Preprocessor switch for enabling the Version info API. | True: Version Info API is enabled False: Version Info API is disabled
    container FrTpMultipleConfig  # This container contains the configuration parameters and sub containers of the AUTOSAR FrTp module.
      integer FrTpMaxConnectionCnt [0..1]: 0..18446744073709551615, multiplicity set at pre-compile, set at pre-compile  # Maximum number of TP connections. This parameter is needed only in case of post-build loadable implementation using static memory allocation.
      container FrTpConnection [1..*]: multiplicity set at post-build in variant post-build / pre-compile in variant pre-compile  # This container contains the connection specific parameters to transfer N-PDUs via FlexRay TP.
        boolean FrTpBandwidthLimitation: post-build-variant-value=true, set at post-build in variant post-build / pre-compile in variant pre-compile  # This parameter indicates whether the connection requires a bandwidth limitation or not. If FrTpBandwidthLimitation=True the sender shall send a StartFrame always on the first PDU of a PDU-Pool.
        integer FrTpLa: 0..65535, post-build-variant-value=true, set at post-build in variant post-build / pre-compile in variant pre-compile  # This parameter defines the Local Address for the respective connection. When the local instance is the sender, this is the Source Address within the TP frame. When the local instance is the receiver, this is the Target Address within the TP frame.
        boolean FrTpMultipleReceiverCon: post-build-variant-value=true, set at post-build in variant post-build / pre-compile in variant pre-compile  # This parameter defines, whether this connection is an 1:1 ('false') or an 1:n ('true') connection. If data segmentation is required this parameter is used to check whether segmentation is possible or not. If the connection is 1:n segmentation is not possible and an error will occur.
        integer FrTpRa: 0..65535, post-build-variant-value=true, set at post-build in variant post-build / pre-compile in variant pre-compile  # This parameter defines the Remote Address for the respective connection. When the local instance is the sender, this is the Target Address within the TP frame. When the local instance is the receiver, this is the Source Address within the TP frame.
        reference FrTpConCtrlRef: post-build-variant-value=true, set at post-build in variant post-build / pre-compile in variant pre-compile, destination=FrTpConnectionControl  # FrTpConnectionControlReference: | This parameter defines a reference to a connection control container.
        reference FrTpRxPduPoolRef [0..1]: multiplicity set at post-build in variant post-build / pre-compile in variant pre-compile, post-build-variant-multiplicity=true, post-build-variant-value=true, set at post-build in variant post-build / pre-compile in variant pre-compile, destination=FrTpRxPduPool  # This parameter defines a reference to a RxPduPool.
        reference FrTpTxPduPoolRef [0..1]: multiplicity set at post-build in variant post-build / pre-compile in variant pre-compile, post-build-variant-multiplicity=true, post-build-variant-value=true, set at post-build in variant post-build / pre-compile in variant pre-compile, destination=FrTpTxPduPool  # This parameter defines a reference to a TxPduPool.
        container FrTpRxSdu [0..1]  # This parameter defines the Rx Service Data Unit Identifier (Sdu Id) which uniquely identifies a data transfer (inter-module communication) between FrTp and PDUR.
          integer FrTpRxSduId: 0..65535, set at pre-compile, symbolic-name-value=true  # This unique identifier is used for change parameter request or receive cancellation from PduR to FrTp. | ImplementationType: PduIdType
          reference FrTpRxSduRef: post-build-variant-value=true, set at post-build in variant post-build / pre-compile in variant pre-compile, destination=Pdu  # Reference to a PDU in the global PDU structure.
        container FrTpTxSdu [0..1]  # This parameter defines the Tx Service Data Unit Identifier (Sdu Id) which uniquely identifies a data transfer (inter-module communication) between FrTp and PDUR.
          integer FrTpTxSduId: 0..65535, set at pre-compile, symbolic-name-value=true  # This is a unique identifier for a to be transmitted message from the PduR to the FrTp. | ImplementationType: PduIdType
          reference FrTpTxSduRef: post-build-variant-value=true, set at post-build in variant post-build / pre-compile in variant pre-compile, destination=Pdu  # Reference to a PDU in the global PDU structure.
      container FrTpConnectionControl [1..*]: multiplicity set at post-build in variant post-build / pre-compile in variant pre-compile  # This container contains the configuration parameters to control a FlexRay TP connection.
        enumeration FrTpAckType: {FRTP_ACK_WITH_RT, FRTP_NO}, post-build-variant-value=true, set at post-build in variant post-build / pre-compile in variant pre-compile  # This parameter defines the type of acknowledgement which is used for the specific channel.
        integer FrTpMaxAr: 0..255, post-build-variant-value=true, set at post-build in variant post-build / pre-compile in variant pre-compile  # This parameter defines the maximum number of trying to send a frame when a TIMEOUT AR occurs.
        integer FrTpMaxAs: 0..255, post-build-variant-value=true, set at post-build in variant post-build / pre-compile in variant pre-compile  # This parameter defines the maximum number of trying to send a frame when a TIMEOUT AS occurs.
        integer FrTpMaxBufferSize: 1..65535, post-build-variant-value=true, set at post-build in variant post-build / pre-compile in variant pre-compile  # Limits the maximal buffer size the FrTp can choose in order to limit the amount of Tx buffer that will be requested at the sender side in a segmented transfer.
        integer FrTpMaxFCWait: 0..255, post-build-variant-value=true, set at post-build in variant post-build / pre-compile in variant pre-compile  # This parameter defines the maximum number of FlowControl N-PDUs with FlowState "WAIT"
        integer FrTpMaxFrIf: 0..255, post-build-variant-value=true, set at post-build in variant post-build / pre-compile in variant pre-compile  # This parameter defines the maximum number of trying to send a frame when the FrIf returns an error.
        integer FrTpMaxNbrOfNPduPerCycle: 0..31, post-build-variant-value=true, set at post-build in variant post-build / pre-compile in variant pre-compile  # This parameter is part of the ISO 10681-2 protocol's FlowControl parameter "Bandwidth Control (BC)". It limits the number of N-Pdus the sender is allowed to transmit within a FlexRay cycle.
        integer FrTpMaxRn: 0..255, post-build-variant-value=true, set at post-build in variant post-build / pre-compile in variant pre-compile  # This parameter defines the maximum number of retries (if retry is configured).
        integer FrTpSCexp: 0..7, post-build-variant-value=true, set at post-build in variant post-build / pre-compile in variant pre-compile  # This parameter is part of the ISO 10681-2 protocol's FlowControl parameter "Bandwidth Control (BC)". It represents the exponent to calculate the minimum number of "Separation Cycles" the sender has to wait for the next transmission of an FrTp N-Pdu.
        float FrTpTimeBr: 0..0.255, post-build-variant-value=true, set at post-build in variant post-build / pre-compile in variant pre-compile  # This parameter defines the time in seconds the FrTp requires to transmit a corresponding FlowControl Frame. According to ISO 10681-2 this parameter is a performance requirement.
        float FrTpTimeCs: 0..65.535, post-build-variant-value=true, set at post-build in variant post-build / pre-compile in variant pre-compile  # This parameter defines the time in seconds between the sending of two CFs or between the sending of a CF and LF or between the reception of a FC and sending of the next CF.
        float FrTpTimeFrIf: 0..0.255, post-build-variant-value=true, set at post-build in variant post-build / pre-compile in variant pre-compile  # This parameter defines the time in seconds of waiting for the next try (if retry is activated) to send via FrIf_Transmit.
        float FrTpTimeoutAr: 0..65.535, post-build-variant-value=true, set at post-build in variant post-build / pre-compile in variant pre-compile  # This parameter states the timeout in seconds between the PDU transmit request of the Transport Layer to the FlexRay Interface and the corresponding confirmation of the FlexRay Interface on the receiver side (for FC or AF).
        float FrTpTimeoutAs: 0..65.535, post-build-variant-value=true, set at post-build in variant post-build / pre-compile in variant pre-compile  # This parameter specifies the timeout in seconds the FrIf shall confirm a transmitted Pdu to the FrTp.
        float FrTpTimeoutBr: 0..65.535, post-build-variant-value=true, set at post-build in variant post-build / pre-compile in variant pre-compile  # This parameter specifies the timeout in seconds between the PDU receive indication of the Transport Layer to the FlexRay Interface and the corresponding PDU transmission of the FlexRay Interface on the receiver side.
        float FrTpTimeoutBs: 0..65.535, post-build-variant-value=true, set at post-build in variant post-build / pre-compile in variant pre-compile  # This parameter defines the timeout in seconds for waiting for an FC or AF on the sender side in a 1:1 connection.
        float FrTpTimeoutCr: 0..65.535, post-build-variant-value=true, set at post-build in variant post-build / pre-compile in variant pre-compile  # This parameter defines the timeout value in seconds a receiver is waiting for a CF or a LF.
        float FrTpTimeoutCs: 0..65.535, post-build-variant-value=true, set at post-build in variant post-build / pre-compile in variant pre-compile  # This parameter specifies the timeout in seconds to transmit the next ConsecutiveFrame N-PDU or the last frame N-PDU after receiving the flow control frame (CTS) from the sender side.
      container FrTpRxPduPool [0..*]: multiplicity set at post-build in variant post-build / pre-compile in variant pre-compile  # This container contains all Pdus that are assigned to that Pdu Pool.
        container FrTpRxPdu [1..*]: multiplicity set at post-build in variant post-build / pre-compile in variant pre-compile  # Container to hold the PDU parameters. | ImplementationType: PduInfoType
          integer FrTpRxPduId: 0..65535, set at pre-compile, symbolic-name-value=true  # This is a unique identifier for a received message which is forwarded from the FrIf to the FrTp. | ImplementationType: PduIdType
          reference FrTpRxPduRef: post-build-variant-value=true, set at post-build in variant post-build / pre-compile in variant pre-compile, destination=Pdu  # Reference to a PDU in the global PDU structure.
      container FrTpTxPduPool [0..*]: multiplicity set at post-build in variant post-build / pre-compile in variant pre-compile  # This container contains all Pdus that are assigned to that Pdu Pool.
        container FrTpTxPdu [1..*]: multiplicity set at post-build in variant post-build / pre-compile in variant pre-compile  # Container to hold the PDU parameters. | ImplementationType: PduInfoType
          integer FrTpTxConfirmationPduId: 0..65535, set at pre-compile, symbolic-name-value=true  # Handle Id to be used by the FrIf to confirm the transmission of the FrTpTxPdu to the FrIf module (FrTp_TxConfirmation) and for TriggerTransmit (FrTp_TriggerTransmit).
          reference FrTpTxPduRef: post-build-variant-value=true, set at post-build in variant post-build / pre-compile in variant pre-compile, destination=Pdu  # Reference to a PDU in the global PDU structure.
  module definition FrTrcv [0..*]: variants pre-compile  # Configuration of the FrTrcv (FlexRay Transceiver driver) module.
    container FrTrcvChannel [1..*]  # Container gives FlexRay transceiver driver information about a single FlexRay transceiver channel. | Any FlexRay transceiver driver has such FlexRay transceiver channels.
      integer FrTrcvChannelId: 0..255, set at pre-compile, symbolic-name-value=true  # Unique identifier of the FlexRay Transceiver Channel.
      boolean FrTrcvChannelUsed: set at pre-compile, default-value=true  # Shall the related FlexRay transceiver channel be used?
      boolean FrTrcvControlsPowerSupply: set at pre-compile, default-value=false  # Is ECU power supply controlled by this transceiver?
      function name FrTrcvEnableInterruptCallout [0..1]: multiplicity set at pre-compile, set at pre-compile  # This parameter defines the existence and the name of a callout function that enables the interrupt pin for the wakeup. If this parameter is omitted no callout shall take place.
      enumeration FrTrcvInitState: {FRTRCV_TRCVMODE_NORMAL, FRTRCV_TRCVMODE_RECEIVEONLY, FRTRCV_TRCVMODE_SLEEP, FRTRCV_TRCVMODE_STANDBY}, set at pre-compile, default-value=FRTRCV_OP_MODE_NORMAL  # State of FlexRay transceiver after power on. | ImplementationType: FrTrcv_TrcvModeType
      enumeration FrTrcvMaxBaudrate: {FR_10M, FR_2M5, FR_5M0}, set at pre-compile  # Max baudrate for transceiver hardware type. Only used for validation purposes. Value shall be configured by configuration tool based on | FRTRCV_HARDWARE_NAME and internal information about ability of this hardware typel.
      boolean FrTrcvWakeupByBusUsed: set at pre-compile  # Is wake up by node supported? If FlexRay transceiver hardware does not support wake up by node value is always FALSE. If FlexRay transceiver hardware supports wake up by node value is TRUE or FALSE depending whether it is used or not.
      symbolic name reference FrTrcvIcuChannelRef [0..1]: scope=ECU, multiplicity set at pre-compile, set at pre-compile, destination=IcuChannel  # Reference to the IcuChannel to enable/disable the interrupts for wakeups.
      symbolic name reference FrTrcvWakeupSourceRef [0..1]: scope=ECU, multiplicity set at pre-compile, set at pre-compile, destination=EcuMWakeupSource  # Reference to a wakeup source in the EcuM configuration. If | FrTrcvWakeUpSupport is configured as FRTRCV_WAKEUP_NOT_SUPPORTED the FrTrcvWakeupSourceRef is not needed. Implementation Type: reference to EcuM_WakeupSourceType
      choice container FrTrcvAccess
        container FrTrcvDioAccess [0..1]  # Container gives FR transceiver driver information about accessing ports and port pins. If a FR transceiver hardware has no Dio interface, there is no instance of this container.
          container FrTrcvDioChannelAccess [1..*]  # In this Container the relation between FR transceiver hardware pin names and Dio port access information is given.
            string FrTrcvHardwareInterfaceName: set at pre-compile  # FR transceiver hardware interface name. It is typically the name of a pin. From a Dio point of view it is either a port, a single channel or a channel group. Depending on this fact either FRTRCV_DIO_PORT_SYMBOLIC_NAME or FRTRCV_DIO_CHANNEL_SYMBOLIC_NAME or FRTRCV_DIO_CHANNEL_GROUP_SYMBOLIC_NAME shall reference a Dio configuration. The FR transceiver driver implementation description shall list up this name for the appropriate FR transceiver hardware.
            choice reference FrTrcvDioSymNameRef: set at pre-compile, destination=[DioChannel, DioChannelGroup, DioPort]  # Choice Reference to a DIO Port, DIO Channel or DIO Channel Group. This reference replaces the FRTRCV_DIO_PORT_SYM_NAME, FRTRCV_DIO_CHANNEL_SYM_NAME and FRTRCV_DIO_GROUP_SYM_NAME references in the Fr Trcv SWS.
        container FrTrcvSpiSequence [0..1]  # Container gives FlexRay transceiver driver information about one SPI sequence. One SPI sequence used by FlexRay transceiver driver is in exclusive use for it. No other driver is allowed to access this sequence. FlexRay transceiver driver may use one sequence to access n FlexRay transceiver hardwares chips of the same type or n sequences are used to access one single FlexRay transceiver hardware chip. If a FlexRay transceiver hardware has no SPI interface, there is no instance of this container.
          reference FrTrcvSpiSequenceName: set at pre-compile, destination=SpiSequence  # Reference to a Spi sequence configuration container.
      container FrTrcvBranchIdContainer [1..*]  # Only one SymbolicNameValue can be defined per container. Therefore this container is necessary.
        integer FrTrcvBranchId: 0..255, set at pre-compile, symbolic-name-value=true  # Unique branch id. It is used by CDDs and internally.
      container FrTrcvChannelDemEventParameterRefs [0..1]  # Container for the references to DemEventParameter elements which shall be invoked using the API Dem_ReportErrorStatus API in case the corresponding error occurs. The EventId is taken from the referenced DemEventParameter's DemEventId value. The standardized errors are provided in the container and can be extended by vendor specific error references.
        symbolic name reference FRTRCV_E_FR_BUSERROR_TRCV [0..1]: scope=ECU, multiplicity set at pre-compile, set at pre-compile, destination=DemEventParameter  # Reference to configured DEM event to report "Error Status of Class B (SPI) transceiver bus errors where TrcvIdx is the transceiver index"
        symbolic name reference FRTRCV_E_FR_ERRN_TRCV [0..1]: scope=ECU, multiplicity set at pre-compile, set at pre-compile, destination=DemEventParameter  # Reference to configured DEM event to report "Error Status of Class A (GPIO) transceiver"
    container FrTrcvGeneral  # Container gives FlexRay transceiver driver basic information.
      function name FrTrcvDemReportErrorStatusConfiguration [0..1]: multiplicity set at pre-compile, set at pre-compile  # Name of a C function which substitutes Dem_ReportErrorStatus.
      boolean FrTrcvDevErrorDetect: set at pre-compile  # Switches development error detection and notification on and off. | If switched on, #define FRTRCV_DEV _ERROR_DETECT ON shall be generated. If switched off, #define FRTRCV_DEV_ERROR _DETECT OFF shall be generated. Define shall be part of file FrTrcv_Cfg.h.
      boolean FrTrcvErrorCheckDuringCommunication: set at pre-compile  # Enable a functionality to check transceiver's state during communication.
      boolean FrTrcvErrorCheckInInit: set at pre-compile  # Enable a functionality to check transceiver's state while initialization process of FrTrcv.
      boolean FrTrcvGetVersionInfo: set at pre-compile  # Switches version information API on and off. If switched off, function need not be present in compiled code.
      integer FrTrcvIndex: 0..255, set at pre-compile  # Specifies the InstanceId of this module instance. If only one instance is present it shall have the Id 0.
      float FrTrcvMainFunctionCycleTime: 0..Inf, set at pre-compile  # Cyclic call time for function FrTrcvMainFunction in seconds. A call time of 0ms indicates no calls for this function. In this case function need not be present in compiled code.
      integer FrTrcvRetryCountInInit: 0..255, set at pre-compile  # Specifies the number of retry count when error occurs while initialization process of FrTrcv.
      enumeration FrTrcvTimerType [0..1]: {None, Timer_1us16bit}, multiplicity set at pre-compile, set at pre-compile  # Type of the Time Service Predefined Timer.
      float FrTrcvWaitTime [0..1]: 0..2.55E-4, multiplicity set at pre-compile, set at pre-compile  # Wait time for transceiver state changes in seconds.
      enumeration FrTrcvWakeUpSupport: {FRTRCV_WAKEUP_BY_POLLING, FRTRCV_WAKEUP_NOT_SUPPORTED}, set at pre-compile  # Informs whether wake up is supported by polling or whether it is not supported. | In case no wake up is supported by FlexRay transceiver hardware setting has to be always NO. Only in case wake up is supported by polling main function FlexRayTrcv_main has to be present in source code. In case of support for wake up either by polling wake up ability may be switched on or off for each channel of one FlexRay transceiver channel independently by FrTrcvWakeupByBusUsed.
  module definition Gpt [0..1]: post-build-variant-support=true, variants post-build/pre-compile  # Configuration of the Gpt (General Purpose Timer) module.
    container GptChannelConfigSet  # This container is the base of a Configuration Set which contains the configured GPT channels. This way, different configuration sets can be defined for post-build process.
      container GptChannelConfiguration [1..*]  # Configuration of an individual GPT channel.
        integer GptChannelId: 0..4294967295, scope=ECU, post-build-variant-value=true, set at post-build in variant post-build / pre-compile in variant pre-compile, symbolic-name-value=true  # Channel Id of the GPT channel. This value will be assigned to the symbolic name derived of the GptChannelConfiguration container short name.
        enumeration GptChannelMode: {GPT_CH_MODE_CONTINUOUS, GPT_CH_MODE_ONESHOT}, scope=ECU, post-build-variant-value=true, set at post-build in variant post-build / pre-compile in variant pre-compile  # Specifies the behavior of the timer channel after the target time is reached.
        float GptChannelTickFrequency: 0..Inf, scope=ECU, post-build-variant-value=true, set at post-build in variant post-build / pre-compile in variant pre-compile  # Specifies the tick frequency of the timer channel in Hz.
        integer GptChannelTickValueMax: 0..18446744073709551615, scope=ECU, post-build-variant-value=true, set at post-build in variant post-build / pre-compile in variant pre-compile  # Maximum value in ticks, the timer channel is able to count. With the next tick, the timer rolls over to zero.
        boolean GptEnableWakeup: post-build-variant-value=true, set at post-build in variant post-build / pre-compile in variant pre-compile  # Enables wakeup capability of MCU for a channel.
        function name GptNotification [0..1]: multiplicity set at post-build in variant post-build / pre-compile in variant pre-compile, post-build-variant-multiplicity=true, post-build-variant-value=true, set at post-build in variant post-build / pre-compile in variant pre-compile  # Function pointer to callback function (for non-wakeup notification)
        reference GptChannelClkSrcRef: post-build-variant-value=true, set at post-build in variant post-build / pre-compile in variant pre-compile, destination=GptClockReferencePoint  # Reference to the GptClockReferencePoint from which the channel | clock is derived.
        container GptWakeupConfiguration [0..1]  # Function pointer to callback function (for wakeup notification).
          symbolic name reference GptWakeupSourceRef: post-build-variant-value=true, set at post-build in variant post-build / pre-compile in variant pre-compile, destination=EcuMWakeupSource  # In case the wakeup-capability is true this value is transmitted to the Ecu State Manager. | Implementation Type: reference to EcuM_WakeupSourceType
    container GptConfigurationOfOptApiServices  # This container contains all configuration switches for configuring optional API services of the GPT driver.
      boolean GptDeinitApi: set at pre-compile  # Adds / removes the service Gpt_DeInit() from the code.
      boolean GptEnableDisableNotificationApi: set at pre-compile  # Adds / removes the services Gpt_EnableNotification() and Gpt_DisableNotification from the code.
      boolean GptTimeElapsedApi: set at pre-compile  # Adds / removes the service Gpt_GetTimeElapsed() from the code
      boolean GptTimeRemainingApi: set at pre-compile  # Adds / removes the service Gpt_GetTimeRemaining() from the code.
      boolean GptVersionInfoApi: set at pre-compile  # Adds / removes the service Gpt_GetVersionInfo() from the code.
      boolean GptWakeupFunctionalityApi: set at pre-compile  # Adds / removes the services Gpt_SetMode(), Gpt_EnableWakeup() Gpt_DisableWakeup() and Gpt_CheckWakeup() from the code.
    container GptDriverConfiguration  # This container contains the module-wide configuration (parameters) of the GPT Driver
      boolean GptDevErrorDetect: set at pre-compile  # Enables/Disables development error detection.
      boolean GptPredefTimer100us32bitEnable: scope=ECU, set at pre-compile  # Enables/disables the GPT Predef Timer 100µs32bit.
      enumeration GptPredefTimer1usEnablingGrade: {GPT_PREDEF_TIMER_1US_16BIT_ENABLED, GPT_PREDEF_TIMER_1US_16_24BIT_ENABLED, GPT_PREDEF_TIMER_1US_16_24_32BIT_ENABLED, GPT_PREDEF_TIMER_1US_DISABLED}, scope=ECU, set at pre-compile  # Specifies the grade of enabling the GPT Predef Timers with 1µs tick duration.
      boolean GptReportWakeupSource: set at pre-compile  # Enables/Disables wakeup source reporting.
      container GptClockReferencePoint [1..*]  # This container contains a parameter, which represents a reference to a container of the type McuClockReferencePoint (defined in module MCU). | A container is needed to support multiple clock references (hardware dependent).
        reference GptClockReference: set at pre-compile, destination=McuClockReferencePoint  # Reference to a container of the type McuClockReferencePoint, to select an input clock. | The configuration editor for the GPT module can support the integrator by only allowing a selection of those clock reference points that can be connected physically to the GPT hardware peripheral. The desired frequency (desired by GPT) has to be the same as the selected and provided frequency of the MCU configuration. This has to be checked automatically.
  module definition Icu [0..*]: post-build-variant-support=true, variants post-build/pre-compile  # Configuration of the Icu (Input Capture Unit) module.
    container IcuConfigSet  # This container contains the configuration parameters and sub containers of the AUTOSAR Icu module.
      integer IcuMaxChannel: 0..65535, post-build-variant-value=true, set at post-build in variant post-build / pre-compile in variant pre-compile  # This parameter contains the number of Channels configured. It will be gathered by tools during the configuration stage. | calculationFormula = Number of configured Icu Channels Implementation Type: Icu_ChannelType
      container IcuChannel [1..*]  # Configuration of an individual ICU channel.
        integer IcuChannelId: 0..65535, scope=ECU, set at pre-compile, symbolic-name-value=true  # Channel Id of the ICU channel. This value will be assigned to the symbolic name derived of the IcuChannel container short name.
        enumeration IcuDefaultStartEdge: {ICU_BOTH_EDGES, ICU_FALLING_EDGE, ICU_RISING_EDGE}, post-build-variant-value=true, set at post-build in variant post-build / pre-compile in variant pre-compile  # Configures the default-activation-edge which shall be used for this channel if there was no activation-edge configured by the call of service Icu_SetActivationCondition(). | In case the Measurement Mode is "IcuSignalMeasurement" and the properties "DutyCycle" or "Period" are set, the edge configured here is used as Default Period Start Edge. Implementation Type: Icu_ActivationType
        enumeration IcuMeasurementMode: {ICU_MODE_EDGE_COUNTER, ICU_MODE_SIGNAL_EDGE_DETECT, ICU_MODE_SIGNAL_MEASUREMENT, ICU_MODE_TIMESTAMP}, post-build-variant-value=true, set at post-build in variant post-build / pre-compile in variant pre-compile  # Configures the measurement mode of this channel. | Implementation Type: Icu_MeasurementModeType
        boolean IcuWakeupCapability: post-build-variant-value=true, set at post-build in variant post-build / pre-compile in variant pre-compile  # Information about the wakeup-capability of this channel. | true: Channel is wakeup capable. false: Channel is not wakeup capable.
        container IcuSignalEdgeDetection [0..1]  # This container contains the configuration (parameters) in case the measurement mode is "IcuSignalEdgeDetection"
          function name IcuSignalNotification [0..1]: multiplicity set at post-build in variant post-build / pre-compile in variant pre-compile, post-build-variant-multiplicity=true, post-build-variant-value=true, set at post-build in variant post-build / pre-compile in variant pre-compile  # Notification function for signal notification.
        container IcuSignalMeasurement [0..1]  # This container contains the configuration (parameters) in case the measurement mode is "IcuSignalMeasurement"
          enumeration IcuSignalMeasurementProperty: {ICU_DUTY_CYCLE, ICU_HIGH_TIME, ICU_LOW_TIME, ICU_PERIOD_TIME}, post-build-variant-value=true, set at post-build in variant post-build / pre-compile in variant pre-compile  # Configures the property that could be measured in case the mode is "IcuSignalMeasurement". | This property can not be changed during runtime. Implementation Type: Icu_SignalMeasurementPropertyType
        container IcuTimestampMeasurement [0..1]  # This container contains the configuration (parameters) in case the measurement mode is "IcuTimestamp"
          enumeration IcuTimestampMeasurementProperty: {ICU_CIRCULAR_BUFFER, ICU_LINEAR_BUFFER}, post-build-variant-value=true, set at post-build in variant post-build / pre-compile in variant pre-compile  # Configures the handling of the buffer in case the mode is "Timestamp" | Implementation Type: Icu_TimestampBufferType
          function name IcuTimestampNotification [0..1]: multiplicity set at post-build in variant post-build / pre-compile in variant pre-compile, post-build-variant-multiplicity=true, post-build-variant-value=true, set at post-build in variant post-build / pre-compile in variant pre-compile  # Notification function if the number of requested timestamps | (Notification interval > 0) are acquired.
        container IcuWakeup [0..1]  # This container contains the configuration (parameters) needed to configure a wakeup capable channel
          symbolic name reference IcuChannelWakeupInfo [0..1]: multiplicity set at post-build in variant post-build / pre-compile in variant pre-compile, post-build-variant-multiplicity=true, post-build-variant-value=true, set at post-build in variant post-build / pre-compile in variant pre-compile, destination=EcuMWakeupSource  # If the wakeup-capability is true the wakeup source referenced is transmitted to the ECU State Manager (EcuM) . | Implementation Type: reference to EcuM_WakeupSourceType
    container IcuGeneral  # Configuration of general ICU parameters.
      boolean IcuDevErrorDetect: set at pre-compile  # Switches the Development Error Detection and Notification | on or off. true: Enabled. false: Disabled.
      integer IcuIndex: 0..255, set at pre-compile  # Specifies the InstanceId of this module instance. If only one instance is present it shall have the Id 0.
      boolean IcuReportWakeupSource: set at pre-compile  # Switch for enabling Wakeup source reporting. | true: Report Wakeup source. false: Do not report Wakeup source.
    container IcuOptionalApis  # This container contains all configuration switches for configuring optional API services of the ICU driver.
      boolean IcuDeInitApi: set at pre-compile  # Adds / removes the service Icu_DeInit() from the code. | true: Icu_DeInit() can be used. false: Icu_DeInit() can not be used.
      boolean IcuDisableWakeupApi: set at pre-compile  # Adds / removes the service Icu_DisableWakeup() from the code. | true: Icu_DisableWakeup() can be used. false: Icu_DisableWakeup() can not be used.
      boolean IcuEdgeCountApi: set at pre-compile  # Adds / removes all services related to the edge counting functionality as listed below, from the code: Icu_ResetEdgeCount(), Icu_EnableEdgeCount(), Icu_DisableEdgeCount(), Icu_GetEdgeNumbers(). | true: The services listed above can be used. false: The services listed above can not be used.
      boolean IcuEdgeDetectApi: set at pre-compile  # Adds / removes the services related to the edge detection functionality, from the code: | Icu_EnableEdgeDetection() and Icu_DisableEdgeDetection(). true: These services can be used. false: These services can not be used.
      boolean IcuEnableWakeupApi: set at pre-compile  # Adds / removes the service Icu_EnableWakeup() from the code. | true: Icu_EnableWakeup() can be used. false: Icu_EnableWakeup() can not be used.
      boolean IcuGetDutyCycleValuesApi: set at pre-compile  # Adds / removes the service Icu_GetDutyCycleValues() from the code. | true: Icu_GetDutyCycleValues() can be used. false: Icu_GetDutyCycleValues() can not be used.
      boolean IcuGetInputStateApi: set at pre-compile  # Adds / removes the service Icu_GetInputState() from the code. | true: Icu_GetInputState() can be used. false: Icu_GetInputState() can not be used.
      boolean IcuGetTimeElapsedApi: set at pre-compile  # Adds / removes the service Icu_GetTimeElapsed() from the code. | true: Icu_GetTimeElapsed() can be used. false: Icu_GetTimeElapsed() can not be used.
      boolean IcuGetVersionInfoApi: set at pre-compile  # Adds / removes the service Icu_GetVersionInfo() from the code. | true: Icu_GetVersionInfo() can be used. false: Icu_GetVersionInfo() can not be used.
      boolean IcuSetModeApi: set at pre-compile  # Adds / removes the service Icu_SetMode() from the code. | true: Icu_SetMode() can be used. false: Icu_SetMode() can not be used.
      boolean IcuSignalMeasurementApi: set at pre-compile  # Adds / removes the services Icu_StartSignalMeasurement() and Icu_StopSignalMeasurement() from the code. | true: Icu_StartSignalMeasurement() and Icu_StopSignalMeasurement() can be used. false: Icu_StartSignalMeasurement() and Icu_StopSignalMeasurement() can not be used.
      boolean IcuTimestampApi: set at pre-compile  # Adds / removes all services related to the timestamping functionality as listed below from the code: Icu_StartTimestamp(), Icu_StopTimestamp(), Icu_GetTimestampIndex(). | true: The services listed above can be used. false: The services listed above can not be used.
      boolean IcuWakeupFunctionalityApi: set at pre-compile  # Adds / removes the service Icu_CheckWakeup() from the code. | true: Icu_CheckWakeup() can be used. false: Icu_CheckWakeup() cannot be used.
  module definition IpduM [0..1]: post-build-variant-support=true, variants link-time/post-build/pre-compile  # Configuration of the IpduM (Ipdu Multiplexer) module.
    container IpduMConfig  # This container contains the sub containers of the IpduM module. | * The IpduMTxPathway subcontainer includes information about sent I-PDUs. * The IpduMRxPathway includes information about received I-PDUs. * The IpduMTxContainerPdu and IpduMTxContainedPdu include information about the sending of ContainerPdus. * The IpduMRxContainerPdu and IpduMRxContainedPdu include information about the reception of ContainerPdus.
      integer IpduMMaxTxBufferSize [0..1]: 0..65535, multiplicity set at link in variant link-time+post-build / pre-compile in variant pre-compile, set at link in variant link-time+post-build / pre-compile in variant pre-compile  # Maximum total size of all Tx buffers. This parameter is needed only in case of post-build loadable implementation using static memory allocation.
      integer IpduMMaxTxPathwayCnt [0..1]: 0..65535, multiplicity set at link in variant link-time+post-build / pre-compile in variant pre-compile, set at link in variant link-time+post-build / pre-compile in variant pre-compile  # Maximum number of transmitted IPdus. This parameter is needed only in case of post-build loadable implementation using static memory allocation.
      container IpduMContainedRxPdu [0..*]: multiplicity set at link in variant link-time / post-build in variant post-build / pre-compile in variant pre-compile  # Configuration of a received contained Pdu.
        integer IpduMContainedPduHeaderId: 1..4294967295, post-build-variant-value=true, set at link in variant link-time / post-build in variant post-build / pre-compile in variant pre-compile  # Header Id which is part of the ContainerPdu when this ContainedPdu is inside.
        reference IpduMContainedRxInContainerPduRef [0..1]: multiplicity set at link in variant link-time / post-build in variant post-build / pre-compile in variant pre-compile, post-build-variant-multiplicity=true, destination=IpduMContainerRxPdu  # Optional reference to a container Pdu this contained Pdu may be transported in. | The reference may be omitted in case IpduMContainerRxAcceptContainedPdu=IPDUM_ACCEPT_ALL.
        reference IpduMContainedRxPduRef: scope=ECU, post-build-variant-value=true, set at link in variant link-time / post-build in variant post-build / pre-compile in variant pre-compile, destination=Pdu  # Reference to the Pdu which represents this ContainedPdu and is used for reception indication.
      container IpduMContainedTxPdu [0..*]: multiplicity set at link in variant link-time / post-build in variant post-build / pre-compile in variant pre-compile  # Configuration of a sender ContainedPdu.
        integer IpduMContainedPduHeaderId: 1..4294967295, post-build-variant-value=true, set at link in variant link-time / post-build in variant post-build / pre-compile in variant pre-compile  # Header Id which is part of the ContainerPdu when this ContainedPdu is inside.
        enumeration IpduMContainedTxPduCollectionSemantics: {IPDUM_COLLECT_LAST_IS_BEST, IPDUM_COLLECT_QUEUED}, post-build-variant-value=true, set at link in variant link-time / post-build in variant post-build / pre-compile in variant pre-compile  # Defines whether this IpduMContainedTxPdu shall be collected using a last-is-best or queued semantics.
        boolean IpduMContainedTxPduConfirmation [0..1]: set at pre-compile, default-value=false  # This Parameter determines whether for this contained I-PDU a TxConfirmation shall be provided. If set to TRUE a TxConfirmation is issued. It is not used when an I-PDU is requested using the trigger transmit API. | If this Parameter is omitted, the default value shall be used.
        integer IpduMContainedTxPduHandleId: 0..65535, scope=ECU, symbolic-name-value=true  # Handle Id of the ContainedPdu.
        float IpduMContainedTxPduSendTimeout [0..1]: 0..65.535, multiplicity set at link in variant link-time / post-build in variant post-build / pre-compile in variant pre-compile, post-build-variant-multiplicity=true, post-build-variant-value=true, set at link in variant link-time / post-build in variant post-build / pre-compile in variant pre-compile  # Defines a ContainedPdu specific sender timeout which can reduce the ContainerPdu timer when this ContainedPdu is put inside the ContainerPdu. | Defined in seconds.
        enumeration IpduMContainedTxPduTrigger: {IPDUM_TRIGGER_ALWAYS, IPDUM_TRIGGER_NEVER}, post-build-variant-value=true, set at link in variant link-time / post-build in variant post-build / pre-compile in variant pre-compile  # Defines whether this Pdu triggers the sending of the ContainerPdu.
        reference IpduMContainedTxInContainerPduRef: post-build-variant-value=true, set at link in variant link-time / post-build in variant post-build / pre-compile in variant pre-compile, destination=IpduMContainerTxPdu  # Reference to the container Pdu which this contained Pdu shall be collected in.
        reference IpduMContainedTxPduRef: scope=ECU, post-build-variant-value=true, set at link in variant link-time / post-build in variant post-build / pre-compile in variant pre-compile, destination=Pdu  # Reference to the Pdu which represents this ContainedPdu and is used for transmission.
      container IpduMContainerRxPdu [0..*]: multiplicity set at link in variant link-time / post-build in variant post-build / pre-compile in variant pre-compile  # Configuration of a receiver ContainerPdu which may collect several ContainedPdus.
        enumeration IpduMContainerHeaderSize: {IPDUM_HEADERTYPE_LONG, IPDUM_HEADERTYPE_SHORT}, post-build-variant-value=true, set at link in variant link-time / post-build in variant post-build / pre-compile in variant pre-compile  # Defines the layout of the header information (header id and length).
        enumeration IpduMContainerPduProcessing: {IPDUM_PROCESSING_DEFERRED, IPDUM_PROCESSING_IMMEDIATE}, post-build-variant-value=true, set at link in variant link-time / post-build in variant post-build / pre-compile in variant pre-compile  # Defines whether the handling of this ContainerPdu shall be done in the context of the caller (IMMEDIATE) or in the next IpduM main function (DEFERRED).
        integer IpduMContainerQueueSize [0..1]: 1..255, multiplicity set at link in variant link-time / post-build in variant post-build / pre-compile in variant pre-compile, post-build-variant-multiplicity=true, post-build-variant-value=true, set at link in variant link-time / post-build in variant post-build / pre-compile in variant pre-compile, default-value=1  # Defines a local queue for handling of each ContainerPdu. | Defined in number of instances of this ContainerPdu.
        enumeration IpduMContainerRxAcceptContainedPdu: {IPDUM_ACCEPT_ALL, IPDUM_ACCEPT_CONFIGURED}, post-build-variant-value=true, set at link in variant link-time / post-build in variant post-build / pre-compile in variant pre-compile  # Defines for the received IpduMRxContainerPdu whether the list of referencing IpduMRxContainedPdus (via the reference IpduMRxContainedPduContainerRef) is a closed set.
        integer IpduMContainerRxHandleId: 0..65535, scope=ECU, post-build-variant-value=true, set at link in variant link-time / post-build in variant post-build / pre-compile in variant pre-compile, symbolic-name-value=true  # Handle Id used by the PduR for RxIndication.
        reference IpduMContainerRxPduRef: scope=ECU, post-build-variant-value=true, set at link in variant link-time / post-build in variant post-build / pre-compile in variant pre-compile, destination=Pdu  # Reference to the Pdu which represents the container and is used for reception.
      container IpduMContainerTxPdu [0..*]: multiplicity set at link in variant link-time / post-build in variant post-build / pre-compile in variant pre-compile  # Configuration of a transmitted container Pdu.
        enumeration IpduMContainerHeaderSize: {IPDUM_HEADERTYPE_LONG, IPDUM_HEADERTYPE_SHORT}, post-build-variant-value=true, set at link in variant link-time / post-build in variant post-build / pre-compile in variant pre-compile  # Defines the layout of the header information (header id and length).
        integer IpduMContainerQueueSize [0..1]: 1..255, multiplicity set at link in variant link-time / post-build in variant post-build / pre-compile in variant pre-compile, post-build-variant-multiplicity=true, post-build-variant-value=true, set at link in variant link-time / post-build in variant post-build / pre-compile in variant pre-compile, default-value=1  # Defines a local queue for handling of each ContainerPdu. | Defined in number of instances of this ContainerPdu.
        float IpduMContainerTxConfirmationTimeout [0..1]: 0..65.535, multiplicity set at link in variant link-time / post-build in variant post-build / pre-compile in variant pre-compile, post-build-variant-multiplicity=true, post-build-variant-value=true, set at link in variant link-time / post-build in variant post-build / pre-compile in variant pre-compile  # This timeout (in seconds) defines the timeout period for monitoring the reception of the TxConfirmation. It is not used when an I-PDU is requested using the trigger transmit API. | If this Parameter is omitted, the default value shall be used.
        boolean IpduMContainerTxFirstContainedPduTrigger: post-build-variant-value=true, set at link in variant link-time / post-build in variant post-build / pre-compile in variant pre-compile  # Defines if the transmission of this IpduMContainerTxPdu shall be requested right after the first IpduMContainedTxPdu was put into it.
        integer IpduMContainerTxHandleId [0..1]: 0..65535, scope=ECU, post-build-variant-value=true, set at link in variant link-time / post-build in variant post-build / pre-compile in variant pre-compile, symbolic-name-value=true  # Handle Id used by the PduR for TxConfirmation and for TriggerTransmit of the ContainerPdu.
        float IpduMContainerTxSendTimeout [0..1]: 0..65.535, multiplicity set at link in variant link-time / post-build in variant post-build / pre-compile in variant pre-compile, post-build-variant-multiplicity=true, post-build-variant-value=true, set at link in variant link-time / post-build in variant post-build / pre-compile in variant pre-compile  # When this timeout expires the ContainerPdu is triggered for sending. The respective timer is started when the first Pdu is put into the ContainerPdu. | Defined in seconds.
        integer IpduMContainerTxSizeThreshold [0..1]: 0..4294967295, multiplicity set at link in variant link-time / post-build in variant post-build / pre-compile in variant pre-compile, post-build-variant-multiplicity=true, post-build-variant-value=true, set at link in variant link-time / post-build in variant post-build / pre-compile in variant pre-compile  # Defines the size threshold in bytes which, when exceeded, triggers the sending of the ContainerPdu although the maxium Pdu size (PduLength parameter of Pdu object) has not been reached yet.
        enumeration IpduMContainerTxTriggerMode: {IPDUM_DIRECT, IPDUM_TRIGGERTRANSMIT}, post-build-variant-value=true, set at link in variant link-time / post-build in variant post-build / pre-compile in variant pre-compile  # Defines whether this ContainerPdu is fetched via trigger transmit.
        reference IpduMContainerTxPduRef: scope=ECU, post-build-variant-value=true, set at link in variant link-time / post-build in variant post-build / pre-compile in variant pre-compile, destination=Pdu  # Reference to the Pdu which represents the container and is used for transmission.
      container IpduMRxPathway [0..*]: multiplicity set at link in variant link-time / post-build in variant post-build / pre-compile in variant pre-compile  # Contains the configuration parameters received I-PDUs by the IpduM module.
        container IpduMRxIndication  # Contains the configuration for incoming RxIndication calls.
          enumeration IpduMByteOrder: {BIG_ENDIAN, LITTLE_ENDIAN}, post-build-variant-value=true, set at link in variant link-time / post-build in variant post-build / pre-compile in variant pre-compile  # This parameter defines the ByteOrder for all segments (static and dynamic part) and for the selectorField within the MultiplexedPdu. | The absolute position of a segment in the MultiplexedIPdu is determined by the definition of the ByteOrder parameter: If BIG_ENDIAN is specified, the SegmentPosition indicates the bit position of the most significant bit in an IPDU. If LITTLE_ENDIAN is specified, the SegmentPosition indicates the bit position of the least significant bit in an IPDU.
          integer IpduMRxHandleId: 0..65535, scope=ECU, set at link in variant link-time+post-build / pre-compile in variant pre-compile, symbolic-name-value=true  # This is the I-PDU ID of the incoming I-PDU. If an incoming RxIndication's I-PDU ID matches this value then it is unpacked according to the specification in this container.
          reference IpduMRxIndicationPduRef: scope=ECU, post-build-variant-value=true, set at link in variant link-time / post-build in variant post-build / pre-compile in variant pre-compile, destination=Pdu  # Reference to the received Pdu representation in the ECU Configuration Description exchange file.
          container IpduMRxDynamicPart [0..*]: multiplicity set at link in variant link-time / post-build in variant post-build / pre-compile in variant pre-compile  # This container contains the configuration for the dynamic part of incoming RxIndication calls. When an incoming received I-PDU's selector field matches the IpduMRxSelectorValue, the new outgoing I-PDU for the dynamic part is constructed as defined by the segments (defined in the IpduMDynamicSegment container) and sent out with the I-PDU ID referenced by IpduMOutgoingDynamicPduRef. | In case no dynamic part shall be extracted from this received I-PDU this container does not exist. This use-case can occur in case a MultiplexedIPdu is received by an ECU which is only interested in the static part of the MultiplexedIPdu.
            integer IpduMRxSelectorValue: 0..65535, post-build-variant-value=true, set at link in variant link-time / post-build in variant post-build / pre-compile in variant pre-compile  # This is the selector value that this container refers to.
            reference IpduMOutgoingDynamicPduRef: scope=ECU, post-build-variant-value=true, set at link in variant link-time / post-build in variant post-build / pre-compile in variant pre-compile, destination=Pdu  # When the new I-PDU is sent out it is sent with this I-PDU ID. Reference to the sent PDU representation in the ECU Configuration Description exchange file.
          container IpduMRxDynamicSegment [0..*]: multiplicity set at link in variant link-time / post-build in variant post-build / pre-compile in variant pre-compile  # The dynamic part of the multiplexed incoming I-Pdu (referenced by IpduMRxIndicationPduRef) can be separated into several segments. | For each segment one IpduMRxDynamicSegment container shall be created that contains the location and the length of the segment. Please note that each configured segment will be copied into the destination I-Pdu that is referenced in the IpduMRxDynamicPart container and will be copied from the same location in the multiplexed incoming I-Pdu. The segment layout for all dynamic Parts is always identical.
            integer IpduMSegmentLength: 1..2032, post-build-variant-value=true, set at link in variant link-time / post-build in variant post-build / pre-compile in variant pre-compile  # Length of the segment in bits.
            integer IpduMSegmentPosition: 0..2031, post-build-variant-value=true, set at link in variant link-time / post-build in variant post-build / pre-compile in variant pre-compile  # Segments bit position in the multiplexed Pdu.
          container IpduMRxStaticPart [0..1]  # This container contains the configuration for the static part of incoming RxIndication calls. On reception, the new outgoing I-PDU for the static part is constructed as defined by the segments (defined in the IpduMStaticSegment container) and sent out with the I-PDU ID referenced by IpduMOutgoingStaticPduRef.
            reference IpduMOutgoingStaticPduRef: scope=ECU, post-build-variant-value=true, set at link in variant link-time / post-build in variant post-build / pre-compile in variant pre-compile, destination=Pdu  # When the new I-PDU is sent out it is sent with this I-PDU ID. Reference to the sent Pdu representation in the ECU Configuration Description exchange file.
          container IpduMRxStaticSegment [0..*]: multiplicity set at link in variant link-time / post-build in variant post-build / pre-compile in variant pre-compile  # The static part of the multiplexed incoming I-Pdu (referenced by IpduMRxIndicationPduRef) can be separated into several segments. | For each segment one IpduMRxStaticSegment container shall be created that contains the location and the length of the segment. Please note that each configured segment will be copied into the destination I-Pdu that is referenced in the IpduMRxStaticPart container and will be copied from the same location in the multiplexed incoming I-Pdu.
            integer IpduMSegmentLength: 1..2032, post-build-variant-value=true, set at link in variant link-time / post-build in variant post-build / pre-compile in variant pre-compile  # Length of the segment in bits.
            integer IpduMSegmentPosition: 0..2031, post-build-variant-value=true, set at link in variant link-time / post-build in variant post-build / pre-compile in variant pre-compile  # Segments bit position in the multiplexed Pdu.
          container IpduMSelectorField  # This contains the location and the length of the selector field.
            integer IpduMSelectorFieldLength: 1..16, post-build-variant-value=true, set at link in variant link-time / post-build in variant post-build / pre-compile in variant pre-compile  # Length of the selector field in bits.
            integer IpduMSelectorFieldPosition: 0..2031, post-build-variant-value=true, set at link in variant link-time / post-build in variant post-build / pre-compile in variant pre-compile  # Selector field bit position in the multiplexed Pdu. | Range: 0..7 for CAN/ LIN I-PDUs, 0..63 for CAN FD I-PDUs, 0..253 for FlexRay I-PDUs.
      container IpduMTxPathway [0..*]: multiplicity set at link in variant link-time / post-build in variant post-build / pre-compile in variant pre-compile  # Contains the configuration parameters transmitted I-PDUs by the IpduM module.
        container IpduMTxRequest  # This container is used to specify the configuration for Transmit requests. | There will be one instance of this container for each I-PDU that can be requested for transmission (the outgoing I-PDUs) by the IpduM.
          enumeration IpduMByteOrder: {BIG_ENDIAN, LITTLE_ENDIAN}, post-build-variant-value=true, set at link in variant link-time / post-build in variant post-build / pre-compile in variant pre-compile  # This parameter defines the ByteOrder for all segments (static and dynamic part) and for the selectorField within the MultiplexedPdu. | The absolute position of a segment in the MultiplexedIPdu is determined by the definition of the ByteOrder parameter: If BIG_ENDIAN is specified, the SegmentPosition indicates the bit position of the most significant bit in an IPDU. If LITTLE_ENDIAN is specified, the SegmentPosition indicates the bit position of the least significant bit in an IPDU.
          integer IpduMIPduUnusedAreasDefault [0..1]: 0..255, multiplicity set at link in variant link-time / post-build in variant post-build / pre-compile in variant pre-compile, post-build-variant-multiplicity=true, post-build-variant-value=true, set at link in variant link-time / post-build in variant post-build / pre-compile in variant pre-compile  # IpduM module fills not used areas of an I-PDU with this bit-pattern | If this attribute is omitted the IpduM module does not fill the I-PDU.
          integer IpduMTxConfirmationPduId [0..1]: 0..65535, multiplicity set at link in variant link-time+post-build / pre-compile in variant pre-compile, set at link in variant link-time+post-build / pre-compile in variant pre-compile, symbolic-name-value=true  # Handle Id used by the PduR for confirmation (IpduM_TxConfirmation) and for TriggerTransmit (IpduM_TriggerTransmit). | The existence of this parameter is essential for the PduR generation tool to actually find a symbolicNameValue for the OutgoingPdu.
          float IpduMTxConfirmationTimeout [0..1]: 0..3600, multiplicity set at link in variant link-time / post-build in variant post-build / pre-compile in variant pre-compile, post-build-variant-multiplicity=true, post-build-variant-value=true, set at link in variant link-time / post-build in variant post-build / pre-compile in variant pre-compile  # This timeout (in seconds) defines the timeout period for monitoring the reception of the TxConfirmation. | It is not used when an I-PDU is requested using the trigger transmit API.
          enumeration IpduMTxTriggerMode: {DYNAMIC_PART_TRIGGER, NONE, STATIC_OR_DYNAMIC_PART_TRIGGER, STATIC_PART_TRIGGER}, post-build-variant-value=true, set at link in variant link-time / post-build in variant post-build / pre-compile in variant pre-compile  # Selects whether to send the multiplexed I-PDU immediately or at some later date.
          reference IpduMInitialDynamicPart: post-build-variant-value=true, set at link in variant link-time / post-build in variant post-build / pre-compile in variant pre-compile, destination=IpduMTxDynamicPart  # Reference to the dynamic part that shall be used to initialize this multiplexed TX-I-PDU.
          reference IpduMOutgoingPduRef: scope=ECU, post-build-variant-value=true, set at link in variant link-time / post-build in variant post-build / pre-compile in variant pre-compile, destination=Pdu  # Reference to the PDU defining the outgoing I-PDU. | When the outgoing I-PDU is sent this is the I-PDU ID to give it. It is the IpduM I-PDU ID of the assembled I-PDU.
          container IpduMSelectorField  # This contains the location and the length of the selector field.
            integer IpduMSelectorFieldLength: 1..16, post-build-variant-value=true, set at link in variant link-time / post-build in variant post-build / pre-compile in variant pre-compile  # Length of the selector field in bits.
            integer IpduMSelectorFieldPosition: 0..2031, post-build-variant-value=true, set at link in variant link-time / post-build in variant post-build / pre-compile in variant pre-compile  # Selector field bit position in the multiplexed Pdu. | Range: 0..7 for CAN/ LIN I-PDUs, 0..63 for CAN FD I-PDUs, 0..253 for FlexRay I-PDUs.
          container IpduMTxDynamicPart [1..*]: multiplicity set at link in variant link-time / post-build in variant post-build / pre-compile in variant pre-compile  # Configuration parameters for an instance of a TxRequest call into the IpduM. When a Tx Request with the IpduMTxDynamicHandleId is received by the IpduM, all segments (defined in the IpduMDynamicSegment container) are copied from the incoming I-PDU into the outgoing I-PDU buffer and then the send mode honored. This container is used by the dynamic part of a TxRequest configuration. Therefore, for each outgoing I-PDU there will be one instance of this container for the dynamic part.
            boolean IpduMJitUpdate [0..1]: multiplicity set at link in variant link-time / post-build in variant post-build / pre-compile in variant pre-compile, post-build-variant-multiplicity=true, post-build-variant-value=true, set at link in variant link-time / post-build in variant post-build / pre-compile in variant pre-compile, default-value=false  # If configured to true fetch the data of this part Just-In-Time via the triggerTransmit API of the PduR.
            boolean IpduMTxDynamicConfirmation: post-build-variant-value=true, set at link in variant link-time / post-build in variant post-build / pre-compile in variant pre-compile  # A transmit request can be confirmed by the lower layer. If this parameter is set to true a confirmation of the I-PDU in COM representing the dynamic part is generated.
            integer IpduMTxDynamicHandleId: 0..65535, scope=ECU, set at link in variant link-time+post-build / pre-compile in variant pre-compile, symbolic-name-value=true  # This defines an incoming handle id. When the handle of an incoming Tx Request matches this id, the configured dynamic segments are copied and the IpduMTxTriggerMode is honored.
            reference IpduMTxDynamicPduRef: scope=ECU, post-build-variant-value=true, set at link in variant link-time / post-build in variant post-build / pre-compile in variant pre-compile, destination=Pdu  # Reference to the Pdu representation in the ECU Configuration Description exchange file to be transmitted.
          container IpduMTxDynamicSegment [1..*]: multiplicity set at link in variant link-time / post-build in variant post-build / pre-compile in variant pre-compile  # The dynamic part of the multiplexed outgoing I-Pdu (referenced by IpduMOutgoingPduRef) can be separated into several segments. | For each segment one IpduMTxDynamicSegment container shall be created that contains the location and the length of the segment. Please note that each configured segment will be copied out of the source I-Pdu that is referenced in the IpduMTxDynamicPart container and will be copied to the same location in the multiplexed outgoing I-Pdu. The segment layout for all dynamic Parts is always identical.
            integer IpduMSegmentLength: 1..2032, post-build-variant-value=true, set at link in variant link-time / post-build in variant post-build / pre-compile in variant pre-compile  # Length of the segment in bits.
            integer IpduMSegmentPosition: 0..2031, post-build-variant-value=true, set at link in variant link-time / post-build in variant post-build / pre-compile in variant pre-compile  # Segments bit position in the multiplexed Pdu.
          container IpduMTxStaticPart [0..1]  # Configuration parameters for an instance of a Tx_Request call into the IpduM. When a Tx Request with the IpduMTxStaticHandleId is received by the IpduM, all segments (defined in the IpduMStaticSegment container) are copied from the incoming I-PDU into the outgoing I-PDU buffer and then the send mode honored. This container is used for the static part of a TxRequest configuration. Therefore, for each outgoing I-PDU there will be one instance of this container for the static part if it exists.
            boolean IpduMJitUpdate [0..1]: multiplicity set at link in variant link-time / post-build in variant post-build / pre-compile in variant pre-compile, post-build-variant-multiplicity=true, post-build-variant-value=true, set at link in variant link-time / post-build in variant post-build / pre-compile in variant pre-compile, default-value=false  # If configured to true fetch the data of this part Just-In-Time via the triggerTransmit API of the PduR.
            boolean IpduMTxStaticConfirmation: post-build-variant-value=true, set at link in variant link-time / post-build in variant post-build / pre-compile in variant pre-compile  # A transmit request can be confirmed by the lower layer. If this parameter is set to true a confirmation of the I-PDU in COM representing the static part is generated.
            integer IpduMTxStaticHandleId: 0..65535, scope=ECU, set at link in variant link-time+post-build / pre-compile in variant pre-compile, symbolic-name-value=true  # This defines an incoming handle id. When the handle of an incoming Tx Request matches this id, the configured static segments are copied and the IpduMTxTriggerMode is honored.
            reference IpduMTxStaticPduRef: scope=ECU, post-build-variant-value=true, set at link in variant link-time / post-build in variant post-build / pre-compile in variant pre-compile, destination=Pdu  # Reference to the Pdu representation in the ECU Configuration Description exchange file to be transmitted.
          container IpduMTxStaticSegment [0..*]: multiplicity set at link in variant link-time / post-build in variant post-build / pre-compile in variant pre-compile  # The static part of the multiplexed outgoing I-Pdu (referenced by IpduMOutgoingPduRef) can be separated into several segments. | For each segment one IpduMTxStaticSegment container shall be created that contains the location and the length of the segment. Please note that each segment in the source I-Pdu that is referenced in the IpduMTxStaticPart container will be copied to the same location in the multiplexed outgoing I-Pdu.
            integer IpduMSegmentLength: 1..2032, post-build-variant-value=true, set at link in variant link-time / post-build in variant post-build / pre-compile in variant pre-compile  # Length of the segment in bits.
            integer IpduMSegmentPosition: 0..2031, post-build-variant-value=true, set at link in variant link-time / post-build in variant post-build / pre-compile in variant pre-compile  # Segments bit position in the multiplexed Pdu.
    container IpduMGeneral  # Contains the general configuration parameters of IpduM.
      float IpduMConfigurationTimeBase: 0..3600, set at pre-compile  # The cycle time with which IpduM_MainFunction should be invoked (in seconds).
      boolean IpduMDevErrorDetect: set at pre-compile  # Active/Deactivate the detection of development errors, for production code this parameter has to be False. | True: error detection activated False: error detection deactivated
      enumeration IpduMHeaderByteOrder [0..1]: {IPDUM_BIG_ENDIAN, IPDUM_LITTLE_ENDIAN}, post-build-variant-value=true, set at pre-compile  # This parameter defines the ByteOrder of the headers inside a Container I-PDU.
      boolean IpduMStaticPartExists: set at pre-compile  # This is to allow optimizations in the case the IpduM will never be used with a static part. | Note that this is a pre-compile option. If this is set to False then it will not be possible to add static parts after compilation. True: A static part may exist. False: A static part will never exist.
      boolean IpduMVersionInfoApi: set at pre-compile  # Active/Deactivate the version information API. | true: version information activated false: version information deactivated
    container IpduMPublishedInformation  # Additional published parameters not covered by | CommonPublishedInformation container. Note that these parameters do not have any configuration class setting, since they are published information.
      boolean IpduMRxDirectComInvocation: set at published-information  # If set to TRUE the COM invocation optimization as defined in | IPDUM140 is implemented.
  module definition J1939Dcm [0..1]: post-build-variant-support=true, variants link-time/post-build/pre-compile  # The SAE J1939 Dcm module
    container J1939DcmConfigSet  # This container contains the configuration parameters and sub containers of the AUTOSAR J1939Dcm module.
      container J1939DcmChannel [1..*]  # Contains the J1939DcmChannel parameters.
        enumeration J1939DcmBusType: {J1939DCM_ISO9141, J1939DCM_J1587, J1939DCM_J1850, J1939DCM_J1922, J1939DCM_J1939_NETWORK_1, J1939DCM_J1939_NETWORK_2, J1939DCM_J1939_NETWORK_3, J1939DCM_OTHER}, set at pre-compile  # Identifies the communication port
        symbolic name reference J1939DcmComMChannelRef: scope=ECU, post-build-variant-value=true, set at link in variant link-time / post-build in variant post-build / pre-compile in variant pre-compile, destination=ComMChannel  # Reference to the ComMChannel.
      container J1939DcmNode [1..*]  # Contains the parameters for the support of a logical J1939 node (identified by an ECU address).
        integer J1939DcmSPNsInDataStream [0..*]: 0..524287, multiplicity set at pre-compile, set at pre-compile  # Defines the SPNs available in data stream for use in DM24.
        symbolic name reference J1939DcmNmNodeRef: set at link in variant link-time+post-build / pre-compile in variant pre-compile, destination=J1939NmNode  # Reference to the corresponding J1939Nm node.
        symbolic name reference J1939DcmNodeRmUserRef: post-build-variant-value=true, set at link in variant link-time / post-build in variant post-build / pre-compile in variant pre-compile, destination=J1939RmUser  # Reference to the J1939RmUser used by J1939Dcm.
        container J1939DcmDiagnosticMessageSupport [1..*]  # Contains parameters to configure the diagnostic message support
          enumeration J1939DcmDmxSupport: {J1939DCM_DM01_SUPPORT, J1939DCM_DM02_SUPPORT, J1939DCM_DM03_SUPPORT, J1939DCM_DM04_SUPPORT, J1939DCM_DM05_SUPPORT, J1939DCM_DM06_SUPPORT, J1939DCM_DM07_SUPPORT, J1939DCM_DM08_SUPPORT, J1939DCM_DM09_SUPPORT, J1939DCM_DM10_SUPPORT, J1939DCM_DM11_SUPPORT, J1939DCM_DM12_SUPPORT, J1939DCM_DM13_SUPPORT, J1939DCM_DM14_SUPPORT, J1939DCM_DM15_SUPPORT, J1939DCM_DM16_SUPPORT, J1939DCM_DM17_SUPPORT, J1939DCM_DM18_SUPPORT, J1939DCM_DM19_SUPPORT, J1939DCM_DM20_SUPPORT, J1939DCM_DM21_SUPPORT, J1939DCM_DM22_SUPPORT, J1939DCM_DM23_SUPPORT, J1939DCM_DM24_SUPPORT, J1939DCM_DM25_SUPPORT, J1939DCM_DM26_SUPPORT, J1939DCM_DM27_SUPPORT, J1939DCM_DM28_SUPPORT, J1939DCM_DM29_SUPPORT, J1939DCM_DM30_SUPPORT, J1939DCM_DM31_SUPPORT, J1939DCM_DM32_SUPPORT, J1939DCM_DM33_SUPPORT, J1939DCM_DM34_SUPPORT, J1939DCM_DM35_SUPPORT, J1939DCM_DM36_SUPPORT, J1939DCM_DM37_SUPPORT, J1939DCM_DM38_SUPPORT, J1939DCM_DM39_SUPPORT, J1939DCM_DM40_SUPPORT, J1939DCM_DM41_SUPPORT, J1939DCM_DM42_SUPPORT, J1939DCM_DM43_SUPPORT, J1939DCM_DM44_SUPPORT, J1939DCM_DM45_SUPPORT, J1939DCM_DM46_SUPPORT, J1939DCM_DM47_SUPPORT, J1939DCM_DM48_SUPPORT, J1939DCM_DM49_SUPPORT, J1939DCM_DM50_SUPPORT, J1939DCM_DM51_SUPPORT, J1939DCM_DM52_SUPPORT, J1939DCM_DM53_SUPPORT, J1939DCM_DM54_SUPPORT, J1939DCM_DM55_SUPPORT, J1939DCM_DM56_SUPPORT, J1939DCM_DM57_SUPPORT}, set at pre-compile  # This parameter is used to identify the actual DMx message.
          reference J1939DcmDiagnosticMessageSupportChannelRef: set at link in variant link-time+post-build / pre-compile in variant pre-compile, destination=J1939DcmChannel  # Reference to J1939DcmChannel for which this diagnostic message is supported.
          container J1939DcmRxPdu [0..1]  # Contains parameters to configure the J1939DcmRxPdu.
            integer J1939DcmRxPduId: 0..65535, scope=ECU, set at link in variant link-time+post-build / pre-compile in variant pre-compile, symbolic-name-value=true  # The I-PDU identifier used for communication with PduR.
            reference J1939DcmRxPduRef: post-build-variant-value=true, set at link in variant link-time / post-build in variant post-build / pre-compile in variant pre-compile, destination=Pdu  # Reference to the global Pdu element in the Ecuc module.
          container J1939DcmTxPdu [0..1]  # Contains parameters to configure the J1939DcmTxPdu.
            integer J1939DcmTxPduId: 0..65535, scope=ECU, set at link in variant link-time+post-build / pre-compile in variant pre-compile, symbolic-name-value=true  # The I-PDU identifier used to identify the Tx message.
            reference J1939DcmTxPduRef: post-build-variant-value=true, set at link in variant link-time / post-build in variant post-build / pre-compile in variant pre-compile, destination=Pdu  # Reference to the global Pdu element in the Ecuc module.
    container J1939DcmGeneral  # Contains the general configuration parameters of the module.
      integer J1939DcmCommonBufferSize: 1..65535, set at pre-compile  # Size of common buffer (in Bytes). The buffer size should be as large as the longest command or response message.
      integer J1939DcmDM01BufferSize [0..1]: 1..65535, multiplicity set at pre-compile, set at pre-compile  # Size of DM01 buffer (in Bytes). The buffer size should be as large as the longest DM01 response message.
      boolean J1939DcmDevErrorDetect: set at pre-compile  # Pre-processor switch for enabling development error detection support.
      float J1939DcmMainFunctionPeriod: 0.001..0.255, scope=ECU, set at link in variant link-time+post-build / pre-compile in variant pre-compile  # Call cycle in seconds of J1939Dcm_MainFunction.
      integer J1939DcmMaxDTCsPerMainFunction [0..1]: 1..255, multiplicity set at pre-compile, set at pre-compile  # Maximum threshold of DTCs filtered in a single MainFunction cycle.
      integer J1939DcmMaxFreezeFramesPerMainFunction [0..1]: 1..255, multiplicity set at pre-compile, set at pre-compile  # Maximum threshold of FreezeFrames filtered in a single MainFunction cycle.
      integer J1939DcmMaxRatiosPerMainFunction [0..1]: 1..255, multiplicity set at pre-compile, set at pre-compile  # Maximum threshold of Ratios filtered in a single MainFunction cycle.
      boolean J1939DcmVersionInfoApi: set at pre-compile  # Pre-processor switch for enabling version info API support.
  module definition J1939Nm [0..1]: post-build-variant-support=true, variants link-time/post-build/pre-compile  # Configuration of the J1939 Network Management module.
    container J1939NmConfigSet  # This container is a MultipleConfigurationContainer, i.e. this container and its sub-containers exist once per configuration set.
      container J1939NmChannel [1..*]: multiplicity set at link in variant link-time / post-build in variant post-build / pre-compile in variant pre-compile  # Physical CAN channel handled by J1939Nm.
        symbolic name reference J1939NmComMNetworkHandleRef: set at link in variant link-time+post-build / pre-compile in variant pre-compile, destination=ComMChannel  # Reference to the channel defined by the ComMChannel providing access to the unique channel index ComMChannelId.
        container J1939NmRxPdu  # Contains the configuration of the I-PDU used to receive the AddressClaimed PG.
          integer J1939NmRxPduId: 0..65535, scope=ECU, set at link in variant link-time+post-build / pre-compile in variant pre-compile, symbolic-name-value=true  # The I-PDU identifier used for RxIndication from CanIf.
          reference J1939NmRxPduRef: set at link in variant link-time+post-build / pre-compile in variant pre-compile, destination=Pdu  # Reference to the Pdu object representing the I-PDU.
        container J1939NmTxPdu  # Contains the configuration of the I-PDU used to transmit the AddressClaimed PG.
          integer J1939NmTxPduId: 0..65535, scope=ECU, set at link in variant link-time+post-build / pre-compile in variant pre-compile, symbolic-name-value=true  # The I-PDU identifier used for TxConfirmation from CanIf.
          reference J1939NmTxPduRef: set at link in variant link-time+post-build / pre-compile in variant pre-compile, destination=Pdu  # Reference to the Pdu object representing the I-PDU.
      container J1939NmNode [1..*]: multiplicity set at link in variant link-time / post-build in variant post-build / pre-compile in variant pre-compile  # Logical node representing one function handled by J1939Nm.
        integer J1939NmNodeId: 0..255, scope=ECU, set at pre-compile, symbolic-name-value=true  # Unique identifier of this node. May be chosen to be identical with J1939NmNodePreferredAddress, if the same address shall not be used by different nodes on different channels.
        boolean J1939NmNodeNameArbitraryAddressCapable: set at pre-compile  # Arbitrary Address Capable field of the NAME of this node.
        integer J1939NmNodeNameECUInstance: 0..7, post-build-variant-value=true, set at link in variant link-time / post-build in variant post-build / pre-compile in variant pre-compile  # ECU Instance field of the NAME of this node.
        integer J1939NmNodeNameFunction: 0..255, post-build-variant-value=true, set at link in variant link-time / post-build in variant post-build / pre-compile in variant pre-compile  # Function field of the NAME of this node.
        integer J1939NmNodeNameFunctionInstance: 0..31, post-build-variant-value=true, set at link in variant link-time / post-build in variant post-build / pre-compile in variant pre-compile  # Function Instance field of the NAME of this node.
        integer J1939NmNodeNameIdentityNumber: 0..2097151, post-build-variant-value=true, set at link in variant link-time / post-build in variant post-build / pre-compile in variant pre-compile  # Identity Number field of the NAME of this node.
        integer J1939NmNodeNameIndustryGroup: 0..7, post-build-variant-value=true, set at link in variant link-time / post-build in variant post-build / pre-compile in variant pre-compile  # Industry Group field of the NAME of this node.
        integer J1939NmNodeNameManufacturerCode: 0..2047, post-build-variant-value=true, set at link in variant link-time / post-build in variant post-build / pre-compile in variant pre-compile  # Manufacturer Code field of the NAME of this node.
        integer J1939NmNodeNameVehicleSystem: 0..127, post-build-variant-value=true, set at link in variant link-time / post-build in variant post-build / pre-compile in variant pre-compile  # Vehicle System field of the NAME of this node.
        integer J1939NmNodeNameVehicleSystemInstance: 0..15, post-build-variant-value=true, set at link in variant link-time / post-build in variant post-build / pre-compile in variant pre-compile  # Vehicle System Instance field of the NAME of this node.
        integer J1939NmNodePreferredAddress: 0..253, scope=ECU, post-build-variant-value=true, set at link in variant link-time / post-build in variant post-build / pre-compile in variant pre-compile  # Source address of this node used for address claiming.
        boolean J1939NmNodeStartUpDelay: set at pre-compile  # If enabled, the communication will start after a delay of 250ms after transmission of the initial AddressClaimed. If disabled, communication will start immediately at start-up. | Please note: According to J1939/81, the 250ms delay is not required for single address CAs with desired source addresses in the ranges 0..127 or 248..253.
        reference J1939NmNodeChannelRef [1..*]: multiplicity set at link in variant link-time+post-build / pre-compile in variant pre-compile, set at link in variant link-time+post-build / pre-compile in variant pre-compile, destination=J1939NmChannel  # Reference to the channels this node has access to.
    container J1939NmDemEventParameterRefs [0..1]  # Container for the references to DemEventParameter elements which shall be invoked using the API Dem_ReportErrorStatus in case the corresponding error occurs. The EventId is taken from the referenced DemEventParameter's DemEventId value. The standardized errors are provided in the container and can be extended by vendor specific error references.
      symbolic name reference J1939NM_E_ADDRESS_LOST: set at pre-compile, destination=DemEventParameter  # Reference to the DemEventParameter which shall be issued when the ECU failed to claim one of its addresses.
    container J1939NmGeneral  # Contains the general configuration parameters of the module.
      float J1939NmBusOffDelayTickPeriod [0..1]: 0.001..0.255, multiplicity set at link in variant link-time+post-build / pre-compile in variant pre-compile, set at link in variant link-time+post-build / pre-compile in variant pre-compile, default-value=0.02  # Duration of ticks that are used to time BusOff delays after conflicting address claims. This parameter should be synchronized with the main function period of the CAN State Manager.
      boolean J1939NmDevErrorDetect: set at pre-compile  # Pre-processor switch for enabling development error detection support.
      float J1939NmMainFunctionPeriod: 0.001..0.255, scope=ECU, set at link in variant link-time+post-build / pre-compile in variant pre-compile  # Call cycle in seconds of J1939Nm_MainFunction.
      float J1939NmTxConfirmationTimeout: 0..65.535, set at link in variant link-time+post-build / pre-compile in variant pre-compile  # Time in seconds to wait for a confirmation after transmission of a message. The behaviour when the time elapses depends on the transmitted message.
      function name J1939NmUserCallout [0..1]: multiplicity set at pre-compile, set at pre-compile  # Pre-processor switch for enabling the <User_AddressClaimedIndication> and defining the name of the callout function.
      string J1939NmUserCalloutHeaderFile [0..1]: multiplicity set at pre-compile, set at pre-compile  # Header file which is included by J1939Nm when J1939NmUserCallout is enabled. This header file must provide the prototype of the <User_AddressClaimedIndication> defined in J1939NmUserCallout.
      boolean J1939NmVersionInfoApi: set at pre-compile  # Pre-processor switch for enabling version info API support.
  module definition J1939Rm [0..1]: post-build-variant-support=true, variants link-time/post-build/pre-compile  # Configuration of the J1939 Request Manager.
    container J1939RmConfigSet  # This container contains the configuration parameters and sub containers of the AUTOSAR J1939Rm module.
      container J1939RmChannel [1..*]: multiplicity set at link in variant link-time / post-build in variant post-build / pre-compile in variant pre-compile  # Contains the parameters for a CAN channel supported by the J1939 Request Manager.
        integer J1939RmAckQueueSize: 0..255, set at link in variant link-time+post-build / pre-compile in variant pre-compile  # Number of transmitted acknowledgements that can be stored.
        integer J1939RmRequestQueueSize: 0..255, set at link in variant link-time+post-build / pre-compile in variant pre-compile  # Number of transmitted requests that can be stored.
        integer J1939RmRequestTimeoutMonitors: 0..255, set at link in variant link-time+post-build / pre-compile in variant pre-compile  # Number of transmitted requests that can be monitored for timeout.
        symbolic name reference J1939RmComMNetworkHandleRef: set at link in variant link-time+post-build / pre-compile in variant pre-compile, destination=ComMChannel  # Reference to the channel defined by the ComMChannel providing access to the unique channel index ComMChannelId.
        container J1939RmAckmRxPdu [0..1]  # Contains the configuration of the I-PDU used to receive the Acknowledgement PG.
          integer J1939RmAckmRxPduId: 0..65535, scope=ECU, set at link in variant link-time+post-build / pre-compile in variant pre-compile, symbolic-name-value=true  # The I-PDU identifier used for RxIndication from PduR.
          reference J1939RmAckmRxPduRef: set at link in variant link-time+post-build / pre-compile in variant pre-compile, destination=Pdu  # Reference to the Pdu object representing the I-PDU.
        container J1939RmAckmTxPdu [0..1]  # Contains the configuration of the I-PDU used to transmit the Acknowledgement PG.
          integer J1939RmAckmTxPduId: 0..65535, scope=ECU, set at link in variant link-time+post-build / pre-compile in variant pre-compile, symbolic-name-value=true  # The I-PDU identifier used for TxConfirmation from PduR.
          reference J1939RmAckmTxPduRef: set at link in variant link-time+post-build / pre-compile in variant pre-compile, destination=Pdu  # Reference to the Pdu object representing the I-PDU.
        container J1939RmRqstRxPdu [0..1]  # Contains the configuration of the I-PDU used to receive the Request PG.
          integer J1939RmRqstRxPduId: 0..65535, scope=ECU, set at link in variant link-time+post-build / pre-compile in variant pre-compile, symbolic-name-value=true  # The I-PDU identifier used for RxIndication from PduR.
          reference J1939RmRqstRxPduRef: set at link in variant link-time+post-build / pre-compile in variant pre-compile, destination=Pdu  # Reference to the Pdu object representing the I-PDU.
        container J1939RmRqstTxPdu [0..1]  # Contains the configuration of the I-PDU used to transmit the Request PG.
          integer J1939RmRqstTxPduId: 0..65535, scope=ECU, set at link in variant link-time+post-build / pre-compile in variant pre-compile, symbolic-name-value=true  # The I-PDU identifier used for TxConfirmation from PduR.
          reference J1939RmRqstTxPduRef: set at link in variant link-time+post-build / pre-compile in variant pre-compile, destination=Pdu  # Reference to the Pdu object representing the I-PDU.
      container J1939RmNode [1..*]: multiplicity set at link in variant link-time / post-build in variant post-build / pre-compile in variant pre-compile  # Contains the parameters for the support of a logical J1939 node (identified by an ECU address).
        reference J1939RmNodeChannelRef [1..*]: multiplicity set at link in variant link-time+post-build / pre-compile in variant pre-compile, set at link in variant link-time+post-build / pre-compile in variant pre-compile, destination=J1939RmChannel  # Reference to the channels this node has access to.
        symbolic name reference J1939RmNmNodeRef: set at link in variant link-time+post-build / pre-compile in variant pre-compile, destination=J1939NmNode  # Reference to the corresponding J1939Nm node.
        container J1939RmUser [1..*]: multiplicity set at link in variant link-time / post-build in variant post-build / pre-compile in variant pre-compile  # Contains the configuration of a module that uses the request and acknowledgement interfaces of J1939Rm.
          boolean J1939RmUserAckIndication: set at pre-compile  # Enable AckIndication for this module. In case of CDD, the name is <apiServicePrefix>_AckIndication. In case of RTE, the port is defined as J1939RmRPort<J1939RmUserId>, and the operation is called AckIndication. This parameter shall not be set for J1939RmUserType J1939RM_USER_J1939NM, J1939RM_USER_J1939DCM, or J1939RM_USER_COM.
          integer J1939RmUserAckPGN [0..*]: 0..262143, multiplicity set at link in variant link-time / post-build in variant post-build / pre-compile in variant pre-compile, post-build-variant-multiplicity=true, post-build-variant-value=true, set at link in variant link-time / post-build in variant post-build / pre-compile in variant pre-compile  # PGN supported to be acknowledged to this module. The PGNs supported by different modules should usually be disjunctive. This parameter shall not be set for J1939RmUserType J1939RM_USER_J1939NM, J1939RM_USER_J1939DCM, and J1939RM_USER_COM.
          integer J1939RmUserId [0..1]: 0..65535, scope=ECU, multiplicity set at pre-compile, set at pre-compile, symbolic-name-value=true  # Identifier used by a module using J1939Rm. This parameter is only required when the module uses transmission of requests.
          integer J1939RmUserPGN [0..*]: 0..262143, multiplicity set at link in variant link-time / post-build in variant post-build / pre-compile in variant pre-compile, post-build-variant-multiplicity=true, post-build-variant-value=true, set at link in variant link-time / post-build in variant post-build / pre-compile in variant pre-compile  # PGN supported to be requested from this module. The PGNs supported by different modules should usually be disjunctive. This parameter is predefined to AC (0x0EE00) for J1939RmUserType J1939RM_USER_J1939NM and is derived from the J1939Dcm PDUs in the system description for J1939RmUserType J1939RM_USER_J1939DCM. It shall not be set for J1939RmUserType J1939RM_USER_COM.
          boolean J1939RmUserRequestIndication: set at pre-compile  # Enable RequestIndication for this module. In case of J1939Nm or J1939Dcm, the name is fixed. In case of CDD, the name is <apiServicePrefix>_RequestIndication. In case of RTE, the port is defined as J1939RmRPort<J1939RmUserId>, and the operation is called RequestIndication. This parameter shall not be set for J1939RmUserType J1939RM_USER_COM.
          boolean J1939RmUserSendAck: set at pre-compile  # Enable the SendAck API for this module. In case of RTE, the port is defined as J1939RmPPort<J1939RmUserId>, and the operation is called SendAck. This parameter shall not be set for J1939RmUserType J1939RM_USER_J1939NM or J1939RM_USER_COM.
          boolean J1939RmUserSendRequest: set at pre-compile  # Enable the SendRequest API for this module. In case of RTE, the port is defined as J1939RmPPort<J1939RmUserId>, and the operation is called SendRequest. This parameter shall not be set for J1939RmUserType J1939RM_USER_J1939NM, J1939RM_USER_J1939DCM, or J1939RM_USER_COM.
          boolean J1939RmUserTimeoutSupervision: set at pre-compile  # Enable RequestTimeoutIndication and CancelRequestTimeout for this module. RequestTimeoutIndication: In case of CDD, the name is <apiServicePrefix>_RequestTimeoutIndication. | In case of RTE, the port is defined as J1939RmRPort<J1939RmUserId>, and the operation is called RequestTimeoutIndication. CancelRequestTimeout: In case of RTE, the port is defined as J1939RmPPort<J1939RmUserId>, and the operation is called CancelRequestTimeout. This parameter shall not be set for J1939RmUserType J1939RM_USER_J1939NM, J1939RM_USER_J1939DCM, or J1939RM_USER_COM.
          enumeration J1939RmUserType: {J1939RM_USER_CDD, J1939RM_USER_COM, J1939RM_USER_J1939DCM, J1939RM_USER_J1939NM, J1939RM_USER_RTE}, set at pre-compile  # Type of module using J1939Rm.
          foreign reference J1939RmUserCddRef [0..1]: multiplicity set at pre-compile, set at pre-compile, destination-type=ECUC-MODULE-CONFIGURATION-VALUES  # Reference to the CDD module description. This parameter is only required for J1939RmUserType J1939RM_USER_CDD.
          container J1939RmComIPdu [0..*]: multiplicity set at link in variant link-time / post-build in variant post-build / pre-compile in variant pre-compile  # Contains the configuration of an I-PDU that is to be transmitted on request by COM. This configuration container is only relevant for J1939RmUserType J1939RM_USER_COM.
            integer J1939RmComIPduPGN: 0..262143, post-build-variant-value=true, set at link in variant link-time / post-build in variant post-build / pre-compile in variant pre-compile  # PGN of the COM I-PDU.
            reference J1939RmComIPduRef: set at link in variant link-time+post-build / pre-compile in variant pre-compile, destination=Pdu  # Reference to the Pdu object representing the I-PDU.
    container J1939RmGeneral  # Contains the general configuration parameters of the module.
      boolean J1939RmDevErrorDetect: set at pre-compile  # Pre-processor switch for enabling development error detection support.
      float J1939RmMainFunctionPeriod: 0.001..0.255, scope=ECU, set at link in variant link-time+post-build / pre-compile in variant pre-compile  # Execution cycle of J1939Rm_MainFunction in seconds.
      boolean J1939RmSupportAckIndication: set at pre-compile  # Pre-processor switch for enabling support of acknowledgement indications.
      boolean J1939RmSupportAckTransmission: set at pre-compile  # Pre-processor switch for enabling support of acknowledgement transmission.
      boolean J1939RmSupportRequestIndication: set at pre-compile  # Pre-processor switch for enabling support of request indications.
      boolean J1939RmSupportRequestTransmission: set at pre-compile  # Pre-processor switch for enabling support of request transmission.
      boolean J1939RmSupportTimeoutSupervision: set at pre-compile  # Pre-processor switch for enabling support of request timeout supervision.
      float J1939RmTxConfirmationTimeout: 0..65.535, set at link in variant link-time+post-build / pre-compile in variant pre-compile  # Time in seconds to wait for a confirmation after transmission of a message. The behaviour when the time elapses depends on the transmitted message.
      boolean J1939RmVersionInfoApi: set at pre-compile  # Pre-processor switch for enabling version info API support.
  module definition J1939Tp [0..1]: post-build-variant-support=true, variants link-time/post-build/pre-compile  # Configuration of the J1939Tp (J1939 Transport Protocol) module.
    container J1939TpConfiguration  # This container contains the configuration parameters and sub containers of the J1939Tp module that define the communication paths.
      container J1939TpRxChannel [0..*]  # This container describes a reception channel of the J1939Tp module. A channel referencing N-PDUs without MetaData is used for all N-SDUs that share the same source address (SA) and the same destination address (BAM: DA = 0xFF, CMDT: DA != 0xFF). A channel with N-PDUs with MetaData is used for all possible source and destination addresses.
        boolean J1939TpRxCancellationSupport [0..1]: multiplicity set at pre-compile, set at pre-compile, default-value=false  # Enable receive cancellation using the API J1939Tp_CancelReceive() for this channel.
        integer J1939TpRxDa [0..1]: 0..253, multiplicity set at post-build in variant link-time+post-build / pre-compile in variant pre-compile, post-build-variant-multiplicity=true, post-build-variant-value=true, set at post-build in variant link-time+post-build / pre-compile in variant pre-compile  # Destination address (DA) of this channel. This parameter is only required for channels with fixed DA which use N-PDUs with MetaData containing the DA.
        boolean J1939TpRxDynamicBlockCalculation [0..1]: multiplicity set at pre-compile, set at pre-compile, default-value=false  # Enable dynamic calculation of "number of packets that can be sent" value in TP.CM_CTS, based on the size of buffers in upper layers reported via StartOfReception and PduR_J1939TpCopyRxData.
        integer J1939TpRxDynamicBufferRatio [0..1]: 0..100, multiplicity set at pre-compile, set at pre-compile, default-value=80  # Percentage of available buffer that shall be used for retry. | This parameter is only applicable when "J1939TpRxRetrySupport" and "J1939TpRxDynamicBlockCalculation" are enabled.
        integer J1939TpRxPacketsPerBlock [0..1]: 1..255, multiplicity set at pre-compile, set at pre-compile, default-value=16  # Number of TP.DT frames the receiving J1939Tp module allows the sender to send before waiting for another TP.CM_CTS. This parameter is transmitted in the TP.CM_CTS frame, and is thus only relevant for reception of messages via CMDT. When J1939TpRxDynamicBlockCalculation is enabled, this parameter specifies a maximum for the calculated value. For further details on this parameter value see SAE J1939/21.
        enumeration J1939TpRxProtocolType [0..1]: {J1939TP_PROTOCOL_BAM, J1939TP_PROTOCOL_CMDT}, multiplicity set at pre-compile, set at pre-compile  # Protocol type used by this channel. This parameter is only required for channels with fixed destination address.
        boolean J1939TpRxRetrySupport [0..1]: multiplicity set at pre-compile, set at pre-compile, default-value=false  # Enable support for triggering repetition of failed transmission using TP.CM_CTS with a packet number that has already been sent. Retransmission is triggered when a sequence number is missing or a timeout occurs during reception.
        integer J1939TpRxSa [0..1]: 0..253, multiplicity set at post-build in variant link-time+post-build / pre-compile in variant pre-compile, post-build-variant-multiplicity=true, post-build-variant-value=true, set at post-build in variant link-time+post-build / pre-compile in variant pre-compile  # Source address (SA) of this channel. This parameter is only required for channels with fixed SA which use N-PDUs with MetaData.
        container J1939TpRxCmNPdu  # This N-PDU represents the TP.CM frame of a J1939 transport protocol session. TP.CM is used both by BAM and CMDT to initialize the connection. For CMDT, it is also used to abort the connection.
          integer J1939TpRxCmNPduId: 0..65535, scope=ECU, set at pre-compile, symbolic-name-value=true  # The N-PDU identifier used for communication with CanIf.
          reference J1939TpRxCmNPduRef: post-build-variant-value=true, set at post-build in variant link-time+post-build / pre-compile in variant pre-compile, destination=Pdu  # Reference to the Pdu object representing the N-PDU.
        container J1939TpRxDtNPdu  # This N-PDU represents the TP.DT frame of a J1939 transport protocol session. TP.DT is used both by BAM and CMDT to transfer the contents of an N-SDU.
          integer J1939TpRxDtNPduId: 0..65535, scope=ECU, set at pre-compile, symbolic-name-value=true  # The N-PDU identifier used for communication with CanIf.
          reference J1939TpRxDtNPduRef: post-build-variant-value=true, set at post-build in variant link-time+post-build / pre-compile in variant pre-compile, destination=Pdu  # Reference to the Pdu object representing the N-PDU.
        container J1939TpRxPg [1..*]  # Parameter group received by the J1939 transport layer.
          boolean J1939TpRxPgDynLength: set at pre-compile  # This flag is set to TRUE when the N-SDU refers to a PGN with variable length. | Please note: When this attribute is TRUE, the sub container J1939TpRxDirectNPdu is required.
          integer J1939TpRxPgPGN: 0..262143, set at pre-compile  # PGN of the referenced N-SDUs.
          container J1939TpRxDirectNPdu [0..1]  # This N-PDU represents the short frame that is used for a dynamic length PGN when it has a length of less that 8 bytes. | Please note: This sub container is only necessary when J1939TpRxPgDynLength is TRUE.
            integer J1939TpRxDirectNPduId: 0..65535, scope=ECU, set at pre-compile, symbolic-name-value=true  # The N-PDU identifier used for communication with CanIf.
            reference J1939TpRxDirectNPduRef: post-build-variant-value=true, set at post-build in variant link-time+post-build / pre-compile in variant pre-compile, destination=Pdu  # Reference to the Pdu object representing the N-PDU.
          container J1939TpRxNSdu [1..*]  # This container describes the parameters that are relevant for the reception of a specific N-SDU.
            integer J1939TpRxNSduId: 0..65535, scope=ECU, set at pre-compile, symbolic-name-value=true  # This is a unique identifier for a received N-SDU. This Id is used in the CancelReceive and ChangeParameter API call.
            reference J1939TpRxNSduRef: post-build-variant-value=true, set at post-build in variant link-time+post-build / pre-compile in variant pre-compile, destination=Pdu  # Reference to the Pdu object representing the N-SDU.
        container J1939TpTxFcNPdu [0..1]  # This N-PDU represents the TP.CM frame that is used in reverse direction for a J1939 transport protocol session using the CMDT protocol type. TP.CM in reverse direction is used for intermediate and final acknowledgement of received data and to abort the connection. | Please note: This sub container is only required when J1939TpRxProtocolType is J1939TP_PROTOCOL_CMDT or when it is not configured at all.
          integer J1939TpTxFcNPduTxConfId: 0..65535, scope=ECU, set at pre-compile, symbolic-name-value=true  # The N-PDU identifier used for Tx confirmation from CanIf.
          reference J1939TpTxFcNPduRef: post-build-variant-value=true, set at post-build in variant link-time+post-build / pre-compile in variant pre-compile, destination=Pdu  # Reference to the Pdu object representing the N-PDU. | Please note: When two channels have identical but exchanged source and destination addresses, the Pdu referenced by this parameter is shared with J1939TpTxCmNPduRef of the corresponding J1939TpTxChannel.
      container J1939TpTxChannel [0..*]  # This container describes a transmission channel of the J1939Tp module. A channel referencing N-PDUs without MetaData is used for all N-SDUs that share the same source address (SA) and the same destination address (BAM: DA = 0xFF, CMDT: DA != 0xFF). A channel with N-PDUs with MetaData is used for all possible source and destination addresses.
        boolean J1939TpTxCancellationSupport [0..1]: multiplicity set at pre-compile, set at pre-compile, default-value=false  # Enable transmit cancellation using the API J1939Tp_CancelTransmit() for this channel.
        integer J1939TpTxDa [0..1]: 0..253, multiplicity set at post-build in variant link-time+post-build / pre-compile in variant pre-compile, post-build-variant-multiplicity=true, post-build-variant-value=true, set at post-build in variant link-time+post-build / pre-compile in variant pre-compile  # Destination address (DA) of this channel. This parameter is only required for channels with fixed DA which use N-PDUs with MetaData containing the DA.
        boolean J1939TpTxDynamicBlockCalculation [0..1]: multiplicity set at pre-compile, set at pre-compile, default-value=false  # Enable dynamic calculation of "maximum number of packets that can be sent" value in TP.CM_RTS, based on the available amount of data in upper layers reported via PduR_J1939TpCopyTxData.
        integer J1939TpTxMaxPacketsPerBlock [0..1]: 1..255, multiplicity set at pre-compile, set at pre-compile, default-value=255  # Maximum number of TP.DT frames the transmitting J1939Tp module is ready to send before waiting for another TP.CM_CTS. This parameter is transmitted in the TP.CM_RTS frame, and is thus only relevant for transmission of messages via CMDT. When J1939TpTxDynamicBlockCalculation is enabled, this parameter specifies a maximum for the calculated value. For further details on this parameter value see SAE J1939/21.
        enumeration J1939TpTxProtocolType [0..1]: {J1939TP_PROTOCOL_BAM, J1939TP_PROTOCOL_CMDT}, multiplicity set at pre-compile, set at pre-compile  # Protocol type used by this channel. This parameter is only required for channels with fixed destination address.
        boolean J1939TpTxRetrySupport [0..1]: multiplicity set at pre-compile, set at pre-compile, default-value=false  # Enable support for repetition of failed transmission using TP.CM_CTS with a packet number that has already been sent. Retransmission is handled via the retry feature of PduR_J1939TpCopyTxData.
        integer J1939TpTxSa [0..1]: 0..253, multiplicity set at post-build in variant link-time+post-build / pre-compile in variant pre-compile, post-build-variant-multiplicity=true, post-build-variant-value=true, set at post-build in variant link-time+post-build / pre-compile in variant pre-compile  # Source address (SA) of this channel. This parameter is only required for channels with fixed SA which use N-PDUs with MetaData.
        container J1939TpRxFcNPdu [0..1]  # This N-PDU represents the TP.CM frame that is used in reverse direction for a J1939 transport protocol session using the CMDT protocol type. TP.CM in reverse direction is used for intermediate and final acknowledgement of received data and to abort the connection. | Please note: This sub container is only required when J1939TpRxProtocolType is J1939TP_PROTOCOL_CMDT or when it is not configured at all.
          integer J1939TpRxFcNPduId: 0..65535, scope=ECU, set at pre-compile, symbolic-name-value=true  # The N-PDU identifier used for communication with CanIf.
          reference J1939TpRxFcNPduRef: post-build-variant-value=true, set at post-build in variant link-time+post-build / pre-compile in variant pre-compile, destination=Pdu  # Reference to the Pdu object representing the N-PDU. | Please note: When two channels have identical but exchanged source and destination addresses, the Pdu referenced by this parameter is shared with J1939TpRxCmNPduRef of the corresponding J1939TpRxChannel.
        container J1939TpTxCmNPdu  # This N-PDU represents the TP.CM frame of a J1939 transport protocol session. TP.CM is used both by BAM and CMDT to initialize the connection. For CMDT, it is also used to abort the connection.
          integer J1939TpTxCmNPduTxConfId: 0..65535, scope=ECU, set at pre-compile, symbolic-name-value=true  # The N-PDU identifier used for Tx confirmation from CanIf.
          reference J1939TpTxCmNPduRef: post-build-variant-value=true, set at post-build in variant link-time+post-build / pre-compile in variant pre-compile, destination=Pdu  # Reference to the Pdu object representing the N-PDU.
        container J1939TpTxDtNPdu  # This N-PDU represents the TP.DT frame of a J1939 transport protocol session. TP.DT is used both by BAM and CMDT to transfer the contents of an N-SDU.
          integer J1939TpTxDtNPduTxConfId: 0..65535, scope=ECU, set at pre-compile, symbolic-name-value=true  # The N-PDU identifier used for Tx confirmation from CanIf.
          reference J1939TpTxDtNPduRef: post-build-variant-value=true, set at post-build in variant link-time+post-build / pre-compile in variant pre-compile, destination=Pdu  # Reference to the Pdu object representing the N-PDU.
        container J1939TpTxPg [1..*]  # Parameter group transmitted by the J1939 transport layer.
          boolean J1939TpTxPgDynLength: set at pre-compile  # This flag is set to TRUE when the N-SDU refers to a PGN with variable length. | Please note: When this attribute is TRUE, the sub container J1939TpTxDirectNPdu is required.
          integer J1939TpTxPgPGN: 0..262143, set at pre-compile  # PGN of the referenced N-SDUs.
          container J1939TpTxDirectNPdu [0..1]  # This N-PDU represents the short frame that is used for a dynamic length PGN when it has a length of less that 8 bytes. | Please note: This sub container is only necessary when J1939TpTxPgDynLength is TRUE.
            integer J1939TpTxDirectNPduTxConfId: 0..65535, scope=ECU, set at pre-compile, symbolic-name-value=true  # The N-PDU identifier used for Tx confirmation from CanIf.
            reference J1939TpTxDirectNPduRef: post-build-variant-value=true, set at post-build in variant link-time+post-build / pre-compile in variant pre-compile, destination=Pdu  # Reference to the Pdu object representing the N-PDU.
          container J1939TpTxNSdu [1..*]  # This container describes the parameters that are relevant for the transmission of a specific N-SDU.
            integer J1939TpTxNSduId: 0..65535, scope=ECU, set at pre-compile, symbolic-name-value=true  # The N-SDU identifier used for communication with PduR.
            reference J1939TpTxNSduRef: post-build-variant-value=true, set at post-build in variant link-time+post-build / pre-compile in variant pre-compile, destination=Pdu  # Reference to the Pdu object representing the N-SDU.
    container J1939TpGeneral  # This container describes the general configuration parameters of the J1939Tp module.
      boolean J1939TpCancellationSupport [0..1]: multiplicity set at pre-compile, set at pre-compile, default-value=false  # Enable transmit and receive cancellation. | The APIs J1939Tp_CancelTransmit() and J1939Tp_CancelReceive() will only be available when this parameter is enabled.
      boolean J1939TpDevErrorDetect: set at pre-compile  # Switches the Development Error Detection and Notification.
      float J1939TpMainFunctionPeriod: 0..0.255, scope=ECU, set at pre-compile  # Allow to configure the time for the MainFunction (in seconds). | Please note: This configuration value shall be equal to the value in the ScheduleManager module.
      float J1939TpTxConfTimeout: 0..65.535, set at pre-compile  # Timeout in seconds for the CanIf Tx confirmation. After this time the J1939Tp assumes that an N-PDU could not be transmitted. | Please note: The Tx confirmation timeout should be set to a value that enabled detection of a lost Tx confirmation in time, and that ensures that normal transmission delay caused by lower message priority does not lead to an error.
      boolean J1939TpVersionInfoApi: set at pre-compile  # The function J1939Tp_GetVersionInfo is configurable (On/Off) by this configuration parameter.
  module definition LdCom [0..1]: post-build-variant-support=true, variants link-time/post-build/pre-compile  # Configuration of the AUTOSAR LdCom module.
    container LdComConfig  # This container contains the configuration parameters and sub containers of the AUTOSAR LdCom module.
      container LdComIPdu [0..*]: multiplicity set at link in variant link-time / post-build in variant post-build / pre-compile in variant pre-compile  # Contains the configuration parameters of the IPdu inside LdCom.
        enumeration LdComApiType: {LDCOM_IF, LDCOM_TP}, scope=ECU, set at link in variant link-time+post-build / pre-compile in variant pre-compile  # Defines if this I-PDU is a normal I-PDU that shall be sent unfragmented or if this is a large I-PDU that shall be sent via the Transport Protocol of the underlying bus. | This setting is used by RTE to invoke the proper API.
        integer LdComHandleId: 0..65535, scope=ECU, set at link in variant link-time+post-build / pre-compile in variant pre-compile, symbolic-name-value=true  # This is the ID used by RTE to invoke LdCom. | A corresponding shortName is created, which is used for the invocations of the RTE. The same ID is used for invocations by PduR.
        enumeration LdComIPduDirection: {LDCOM_RECEIVE, LDCOM_SEND}, set at link in variant link-time+post-build / pre-compile in variant pre-compile  # The direction defines if this IPdu, and therefore the contributing signal, shall be sent or received.
        function name LdComRxCopyRxData [0..1]: scope=ECU, multiplicity set at link in variant link-time+post-build / pre-compile in variant pre-compile, set at link in variant link-time+post-build / pre-compile in variant pre-compile  # Only on receiver side: Name of Rte_LdComCbkCopyRxData callback function to be called.
        function name LdComRxIndication [0..1]: scope=ECU, multiplicity set at link in variant link-time+post-build / pre-compile in variant pre-compile, set at link in variant link-time+post-build / pre-compile in variant pre-compile  # Only on receiver side: Name of Rte_LdComCbkRxIndication callback function to be called.
        function name LdComRxStartOfReception [0..1]: scope=ECU, multiplicity set at link in variant link-time+post-build / pre-compile in variant pre-compile, set at link in variant link-time+post-build / pre-compile in variant pre-compile  # Only on receiver side: Name of Rte_LdComCbkStartOfReception callback function to be called.
        function name LdComTpRxIndication [0..1]: scope=ECU, multiplicity set at link in variant link-time+post-build / pre-compile in variant pre-compile, set at link in variant link-time+post-build / pre-compile in variant pre-compile  # Only on receiver side: Name of Rte_LdComCbkTpRxIndication callback function to be called.
        function name LdComTpTxConfirmation [0..1]: scope=ECU, multiplicity set at link in variant link-time+post-build / pre-compile in variant pre-compile, set at link in variant link-time+post-build / pre-compile in variant pre-compile  # Only on sender side: Name of Rte_LdComCbkTpTxConfirmation callback function to be called.
        function name LdComTxConfirmation [0..1]: scope=ECU, multiplicity set at link in variant link-time+post-build / pre-compile in variant pre-compile, set at link in variant link-time+post-build / pre-compile in variant pre-compile  # Only on sender side: Name of Rte_LdComCbkTxConfirmation callback function to be called.
        function name LdComTxCopyTxData [0..1]: scope=ECU, multiplicity set at link in variant link-time+post-build / pre-compile in variant pre-compile, set at link in variant link-time+post-build / pre-compile in variant pre-compile  # Only on sender side: Name of Rte_LdComCbkCopyTxData callback function to be called.
        function name LdComTxTriggerTransmit [0..1]: scope=ECU, multiplicity set at link in variant link-time+post-build / pre-compile in variant pre-compile, set at link in variant link-time+post-build / pre-compile in variant pre-compile  # Only on sender side: Name of Rte_LdComCbkTriggerTransmit callback function to be called. If defined TriggerTransmit has to be supported for this signal.
        foreign reference LdComSystemTemplateSignalRef [0..1]: scope=ECU, multiplicity set at link in variant link-time / post-build in variant post-build / pre-compile in variant pre-compile, post-build-variant-multiplicity=true, post-build-variant-value=true, set at link in variant link-time / post-build in variant post-build / pre-compile in variant pre-compile, destination-type=I-SIGNAL-TO-I-PDU-MAPPING  # Reference to the ISignalToIPduMapping that contains a reference to the ISignal (System Template) which this LdCom signal represents.
        reference LdComPduRef: scope=ECU, set at link in variant link-time+post-build / pre-compile in variant pre-compile, destination=Pdu  # Reference to the global Pdu.
    container LdComGeneral  # Contains the general configuration parameters of the LdCom module.
      boolean LdComDevErrorDetect: set at pre-compile  # Switches the Development Error Detection and Notification ON or OFF. | * true: Enabled * false: Disabled
      boolean LdComVersionInfoApi: set at pre-compile  # Activate/Deactivate the version information API (LdCom_GetVersionInfo). | * True: version information API activated * False: version information API deactivated
  module definition Lin [0..*]: post-build-variant-support=true, variants post-build/pre-compile  # Configuration of the Lin (LIN driver) module.
    container LinDemEventParameterRefs [0..1]  # Container for the references to DemEventParameter elements which shall be invoked using the API Dem_ReportErrorStatus API in case the corresponding error occurs. The EventId is taken from the referenced DemEventParameter's DemEventId value. The standardized errors are provided in the container and can be extended by vendor specific error references.
      symbolic name reference LIN_E_TIMEOUT [0..1]: multiplicity set at pre-compile, set at pre-compile, destination=DemEventParameter  # Reference to the DemEventParameter which shall be issued when the error "Timeout caused by hardware error" has occurred. If the reference is not configured the error shall be reported as DET error.
    container LinGeneral  # This container contains the parameters related to each LIN Driver Unit.
      boolean LinDevErrorDetect: set at pre-compile  # Switches the Development Error Detection and Notification ON or OFF.
      integer LinIndex: 0..255, set at pre-compile  # Specifies the InstanceId of this module instance. If only one instance is present it shall have the Id 0.
      integer LinTimeoutDuration: 0..65535, set at pre-compile  # Specifies the maximum number of loops for blocking function until a timeout is raised in short term wait loops
      boolean LinVersionInfoApi: set at pre-compile  # Switches the Lin_GetVersionInfo function ON or OFF.
    container LinGlobalConfig  # This container contains the global configuration parameter of the Lin driver.
      container LinChannel [1..*]  # This container contains the configuration (parameters) of the LIN Controller(s).
        integer LinChannelBaudRate: 1000..20000, post-build-variant-value=true, set at post-build in variant post-build / pre-compile in variant pre-compile  # Specifies the baud rate of the LIN channel
        integer LinChannelId: 0..65535, set at pre-compile, symbolic-name-value=true  # Identifies the LIN channel. Replaces LIN_CHANNEL_INDEX_NAME from the LIN SWS.
        boolean LinChannelWakeupSupport: set at pre-compile  # Specifies if the LIN hardware channel supports wake up functionality
        reference LinClockRef: post-build-variant-value=true, set at post-build in variant post-build / pre-compile in variant pre-compile, destination=McuClockReferencePoint  # Reference to the LIN clock source configuration, which is set in the MCU driver configuration.
        symbolic name reference LinChannelEcuMWakeupSource [0..1]: multiplicity set at pre-compile, set at pre-compile, destination=EcuMWakeupSource  # This parameter contains a reference to the Wakeup Source for this controller as defined in the ECU State Manager.
