[part 1 of 7: package /AUTOSAR/EcucDefs]
AUTOSAR XML (schema 4-2-1)
# The material contained in this specification is protected by copyright and
# other types of Intellectual Property Rights. The commercial exploitation of
# the material contained in this specification requires a license to such
# Intellectual Property Rights.
# This specification may be utilized or reproduced without any modification, in
# any form or by any means, for informational purposes only.
# For any other purpose, no part of the specification may be utilized or
# reproduced, in any form or by any means, without permission in writing from
# the publisher.
# licensed under the same rules as applicable to the AUTOSAR Standard.
package /AUTOSAR/EcucDefs
  ecuc definition collection AUTOSARParameterDefinition: module=[Adc, BswM, Cal, Can, CanIf, CanNm, CanSM, CanTSyn, CanTp, CanTrcv, Cdd, Com, ComM, CorTst, Crc, Csm, Dbg, Dcm, Dem, Det, Dio, Dlt, DoIP, Ea, EcuC, EcuM, Eep, Eth, EthIf, EthSM, EthSwt, EthTSyn, EthTrcv, Fee, FiM, Fls, FlsTst, Fr, FrArTp, FrIf, FrNm, FrSM, FrTSyn, FrTp, FrTrcv, Gpt, Icu, IpduM, J1939Dcm, J1939Nm, J1939Rm, J1939Tp, LdCom, Lin, LinIf, LinNm, LinSM, LinTp, LinTrcv, Mcu, MemIf, MemMap, Nm, NvM, Ocu, Os, PduR, Port, Pwm, RamTst, Rte, Sd, SecOC, SoAd, Spi, StbM, TcpIp, Tm, UdpNm, Wdg, WdgIf, WdgM, Xcp, Xfrm]
  module definition Adc [0..1]: post-build-variant-support=true, variants post-build/pre-compile  # Configuration of the Adc (Analog Digital Conversion) module.
    container AdcConfigSet  # This container contains the configuration parameters and sub containers of the AUTOSAR Adc module.
      container AdcHwUnit [1..*]  # This container contains the Driver configuration (parameters) depending on grouping of channels | This container could contain HW specific parameters which are not defined in the Standardized Module Definition. They must be added in the Vendor Specific Module Definition.
        enumeration AdcClockSource [0..1]: multiplicity set at post-build in variant post-build / pre-compile in variant pre-compile, post-build-variant-multiplicity=true, post-build-variant-value=true, set at post-build in variant post-build / pre-compile in variant pre-compile  # The ADC module specific clock input for the conversion unit can | statically be configured to select different clock sources if provided by hardware. Enumeration literals are defined vendor specific.
        enumeration AdcHwUnitId: post-build-variant-value=true, set at post-build in variant post-build / pre-compile in variant pre-compile  # Description: Numeric ID of the HW Unit. This symbolic name allows accessing Hw Unit data. Enumeration literals are defined vendor specific.
        integer AdcPrescale [0..1]: 0..65535, multiplicity set at post-build in variant post-build / pre-compile in variant pre-compile, post-build-variant-multiplicity=true, post-build-variant-value=true, set at post-build in variant post-build / pre-compile in variant pre-compile  # Optional ADC module specific clock prescale factor, if supported by hardware. | ImplementationType: Adc_PrescaleType
        container AdcChannel [1..*]  # This container contains the channel configuration (parameters) depending on the hardware capability. | The organization of this data structure could contain dependencies to the microcontroller so this is left up to the implementer and its location is left up to the configuration. Note: Since a AdcChannel can be part of several AdcGroups, this container is not realized as a subcontainer of AdcGroup but instead as a subcontainer of AdcHwUnit.
          integer AdcChannelConvTime [0..1]: 0..18446744073709551615, multiplicity set at post-build in variant post-build / pre-compile in variant pre-compile, post-build-variant-multiplicity=true, post-build-variant-value=true, set at post-build in variant post-build / pre-compile in variant pre-compile  # Configuration of conversion time, i.e. the time during which the analogue value is converted into digital representation, (in clock cycles) for each channel, if supported by hardware. | ImplementationType: Adc_ConversionTimeType
          integer AdcChannelHighLimit [0..1]: 0..18446744073709551615, multiplicity set at pre-compile, set at pre-compile  # High limit - used for limit checking.
          integer AdcChannelId: 0..1024, post-build-variant-value=true, set at post-build in variant post-build / pre-compile in variant pre-compile  # This parameter defines the assignment of the channel to the physical ADC hardware channel. | ImplementationType: Adc_ChannelType
          boolean AdcChannelLimitCheck [0..1]: multiplicity set at pre-compile, set at pre-compile  # Enables or disables limit checking for an ADC channel.
          integer AdcChannelLowLimit [0..1]: 0..18446744073709551615, multiplicity set at pre-compile, set at pre-compile  # Low limit - used for limit checking.
          enumeration AdcChannelRangeSelect [0..1]: {ADC_RANGE_ALWAYS, ADC_RANGE_BETWEEN, ADC_RANGE_NOT_BETWEEN, ADC_RANGE_NOT_OVER_HIGH, ADC_RANGE_NOT_UNDER_LOW, ADC_RANGE_OVER_HIGH, ADC_RANGE_UNDER_LOW}, multiplicity set at pre-compile, set at pre-compile  # In case of active limit checking: defines which conversion values are taken into account related to the boarders defined with AdcChannelLowLimit and AdcChannelHighLimit. | Implementation Type: Adc_ChannelRangeSelectType
          enumeration AdcChannelRefVoltsrcHigh [0..1]: multiplicity set at post-build in variant post-build / pre-compile in variant pre-compile, post-build-variant-multiplicity=true, post-build-variant-value=true, set at post-build in variant post-build / pre-compile in variant pre-compile  # Upper reference voltage source for each channel. | Enumeration literals are defined vendor specific.
          enumeration AdcChannelRefVoltsrcLow [0..1]: multiplicity set at post-build in variant post-build / pre-compile in variant pre-compile, post-build-variant-multiplicity=true, post-build-variant-value=true, set at post-build in variant post-build / pre-compile in variant pre-compile  # Lower reference voltage source for each channel. | Enumeration literals are defined vendor specific.
          integer AdcChannelResolution [0..1]: 1..63, multiplicity set at post-build in variant post-build / pre-compile in variant pre-compile, post-build-variant-multiplicity=true, post-build-variant-value=true, set at post-build in variant post-build / pre-compile in variant pre-compile  # Channel resolution in bits. | ImplementationType: Adc_ResolutionType
          integer AdcChannelSampTime [0..1]: 0..18446744073709551615, multiplicity set at post-build in variant post-build / pre-compile in variant pre-compile, post-build-variant-multiplicity=true, post-build-variant-value=true, set at post-build in variant post-build / pre-compile in variant pre-compile  # Configuration of sampling time, i.e. the time during which the value is sampled, (in clock cycles) for each channel, if supported by hardware. | ImplementationType: Adc_SamplingTimeType
        container AdcGroup [1..*]  # This container contains the Group configuration (parameters).
          enumeration AdcGroupAccessMode: {ADC_ACCESS_MODE_SINGLE, ADC_ACCESS_MODE_STREAMING}, post-build-variant-value=true, set at post-build in variant post-build / pre-compile in variant pre-compile  # Type of access mode to group conversion results. | ImplementationType: Adc_GroupAccessModeType
          enumeration AdcGroupConversionMode: {ADC_CONV_MODE_CONTINUOUS, ADC_CONV_MODE_ONESHOT}, post-build-variant-value=true, set at post-build in variant post-build / pre-compile in variant pre-compile  # Type of conversion mode supported by the driver. | ImplementationType: Adc_GroupConvModeType
          integer AdcGroupId: 0..1023, set at pre-compile, symbolic-name-value=true  # Numeric ID of the group. This parameter is the symbolic name to be used on the API. This symbolic name allows accessing Channel Group data. This value will be assigned to the symbolic name derived of the AdcGroup container shortName. | ImplementationType: Adc_GroupType
          integer AdcGroupPriority [0..1]: 0..255, multiplicity set at post-build in variant post-build / pre-compile in variant pre-compile, post-build-variant-multiplicity=true, post-build-variant-value=true, set at post-build in variant post-build / pre-compile in variant pre-compile  # Priority level of the AdcGroup. | ImplementationType: Adc_GroupPriorityType
          enumeration AdcGroupReplacement [0..1]: {ADC_GROUP_REPL_ABORT_RESTART, ADC_GROUP_REPL_SUSPEND_RESUME}, multiplicity set at post-build in variant post-build / pre-compile in variant pre-compile, post-build-variant-multiplicity=true, post-build-variant-value=true, set at post-build in variant post-build / pre-compile in variant pre-compile  # Replacement mechanism, which is used on ADC group level, if a group conversion is interrupted by a group which has a higher priority. | ImplementationType: Adc_GroupReplacementType
          enumeration AdcGroupTriggSrc: {ADC_TRIGG_SRC_HW, ADC_TRIGG_SRC_SW}, post-build-variant-value=true, set at post-build in variant post-build / pre-compile in variant pre-compile  # Type of source event that starts a group conversion. | ImplementationType: Adc_TriggerSourceType
          enumeration AdcHwTrigSignal [0..1]: {ADC_HW_TRIG_BOTH_EDGES, ADC_HW_TRIG_FALLING_EDGE, ADC_HW_TRIG_RISING_EDGE}, multiplicity set at post-build in variant post-build / pre-compile in variant pre-compile, post-build-variant-multiplicity=true, post-build-variant-value=true, set at post-build in variant post-build / pre-compile in variant pre-compile  # Configures on which edge of the hardware trigger signal the driver should react, i.e. start the conversion (only if supported by the ADC hardware). | ImplementationType: Adc_HwTriggerSignalType
          integer AdcHwTrigTimer [0..1]: 0..18446744073709551615, multiplicity set at post-build in variant post-build / pre-compile in variant pre-compile, post-build-variant-multiplicity=true, post-build-variant-value=true, set at post-build in variant post-build / pre-compile in variant pre-compile  # Reload value of the ADC module embedded timer (only if supported by ADC hardware). | ImplementationType: Adc_HwTriggerTimerType
          function name AdcNotification [0..1]: multiplicity set at post-build in variant post-build / pre-compile in variant pre-compile, post-build-variant-multiplicity=true, post-build-variant-value=true, set at post-build in variant post-build / pre-compile in variant pre-compile  # Callback function for each group
          enumeration AdcStreamingBufferMode: {ADC_STREAM_BUFFER_CIRCULAR, ADC_STREAM_BUFFER_LINEAR}, post-build-variant-value=true, set at post-build in variant post-build / pre-compile in variant pre-compile  # Configure streaming buffer as "linear buffer" (i.e. the ADC Driver stops the conversion as soon as the stream buffer is full) or as "ring buffer" (wraps around if the end of the stream buffer is reached). | ImplementationType: Adc_StreamBufferModeType
          integer AdcStreamingNumSamples: 1..255, post-build-variant-value=true, set at post-build in variant post-build / pre-compile in variant pre-compile, default-value=1  # Number of ADC values to be acquired per channel in streaming access mode. | Note: in single access mode this parameter assumes value 1, since only one sample per channel is processed. ImplementationType: Adc_StreamNumSampleType
          reference AdcGroupDefinition [1..*]: multiplicity set at post-build in variant post-build / pre-compile in variant pre-compile, post-build-variant-multiplicity=true, post-build-variant-value=true, set at post-build in variant post-build / pre-compile in variant pre-compile, destination=AdcChannel  # Assignment of AdcChannels to a AdcGroups. | ImplementationType: Adc_GroupDefType
    container AdcGeneral  # General configuration (parameters) of the ADC Driver software module.
      boolean AdcDeInitApi: set at pre-compile  # Adds / removes the service Adc_DeInit() from the code. | true: Adc_DeInit() can be used. false: Adc_DeInit() can not be used.
      boolean AdcDevErrorDetect: set at pre-compile  # Switches the Development Error Detection and Notification ON or OFF. | true: Enabled. false: Disabled.
      boolean AdcEnableLimitCheck: set at pre-compile  # Enables or disables limit checking feature in the ADC driver.
      boolean AdcEnableQueuing: set at pre-compile  # Determines, if the queuing mechanism is active in case of priority mechanism disabled. | Note: If priority mechanism is enabled, queuing mechanism is always active and the parameter ADC_ENABLE_QUEUING is not evaluated. true: Enabled. false: Disabled.
      boolean AdcEnableStartStopGroupApi: set at pre-compile  # Adds / removes the services Adc_StartGroupConversion() and Adc_StopGroupConversion() from the code. | true: Adc_StartGroupConversion() and Adc_StopGroupConversion() can be used. false: Adc_StartGroupConversion() and Adc_StopGroupConversion() can not be used.
      boolean AdcGrpNotifCapability: set at pre-compile  # Determines, if the group notification mechanism (the functions to enable and disable the notifications) is available at runtime. | true: Enabled. false: Disabled.
      boolean AdcHwTriggerApi: set at pre-compile  # Adds / removes the services Adc_EnableHardwareTrigger() and Adc_DisableHardwareTrigger() from the code. | true: Adc_EnableHardwareTrigger() and Adc_DisableHardwareTrigger() can be used. false: Adc_EnableHardwareTrigger() and Adc_DisableHardwareTrigger() can not be used.
      boolean AdcLowPowerStatesSupport [0..1]: multiplicity set at pre-compile, set at pre-compile, default-value=false  # Adds / removes all power state management related APIs (ADC_SetPowerState, ADC_GetCurrentPowerState, ADC_GetTargetPowerState, ADC_PreparePowerState, ADC_Main_PowerTransitionManager), indicating if the HW offers low power state management.
      boolean AdcPowerStateAsynchTransitionMode [0..1]: multiplicity set at pre-compile, set at pre-compile, default-value=false  # Enables / disables support of the ADCDriver to the asynchronous power state transition.
      enumeration AdcPriorityImplementation: {ADC_PRIORITY_HW, ADC_PRIORITY_HW_SW, ADC_PRIORITY_NONE}, set at pre-compile  # Determines whether a priority mechanism is available for prioritization of the conversion requests and if available, the type of prioritization mechanism. The selection applies for groups with trigger source software and trigger source hardware. Two | types of prioritization mechanism can be selected. The hardware prioritization mechanism (AdcPriorityHw) uses the ADC hardware features for prioritization of the software conversion requests and hardware trigger signals for groups with trigger source hardware. The mixed hardware and software prioritization mechanism (AdcPriorityHwSw) uses the ADC hardware features for prioritization of ADC hardware trigger for groups with trigger source hardware and a software implemented prioritization mechanism for groups with trigger source software. The group priorities for software triggered groups are typically configured with lower priority levels than the group priorities for hardware triggered groups. ImplementationType: Adc_PriorityImplementationType
      boolean AdcReadGroupApi: set at pre-compile  # Adds / removes the service Adc_ReadGroup() and from the code. | true: Adc_ReadGroup() can be used. false: Adc_ReadGroup() can not be used.
      enumeration AdcResultAlignment: {ADC_ALIGN_LEFT, ADC_ALIGN_RIGHT}, set at pre-compile  # Alignment of ADC raw results in ADC result buffer (left/right alignment). | Implementation Type: Adc_ResultAlignmentType
      boolean AdcVersionInfoApi: set at pre-compile  # Adds / removes the service Adc_GetVersionInfo() from the code. | true: Adc_GetVersionInfo() can be used. false: Adc_GetVersionInfor() can not be used.
      container AdcPowerStateConfig [0..*]  # Each instance of this parameter defines a power state and the callback to be called when this power state is reached.
        integer AdcPowerState: 0..18446744073709551615, set at pre-compile, symbolic-name-value=true  # Each instance of this parameter describes a different power state supported by the ADC HW. It should be defined by the HW supplier and used by the ADCDriver to reference specific HW configurations which set the ADC HW module in the referenced power state. | At least the power mode corresponding to full power state shall be always configured.
        function name AdcPowerStateReadyCbkRef: set at pre-compile  # Each instance of this parameter contains a reference to a power mode callback defined in a CDD or IoHwAbs component.
    container AdcPublishedInformation  # Additional published parameters not covered by "Common" Published Information. Note that these parameters have "PUBLISHED-INFORMATION" configuration class setting, since they are published information.
      boolean AdcChannelValueSigned: set at published-information  # Information whether the result value of the ADC driver has sign information (true) or not (false). If the result shall be interpreted as signed value it shall apply to C-language rules.
      boolean AdcGroupFirstChannelFixed: set at published-information  # Information whether the first channel of an ADC Channel group can be configured (false) or is fixed (true) to a value determined by the ADC HW Unit.
      integer AdcMaxChannelResolution: 1..63, set at published-information  # Maximum Channel resolution in bits (does not specify accuracy).
  module definition BswM [0..1]: post-build-variant-support=true, variants link-time/post-build/pre-compile  # Configuration of the BswM (Basic SW Mode Manager) module.
    container BswMConfig [1..*]  # This container contains the configuration parameters and sub containers of the AUTOSAR BswM module. | This container exists once per partition and post build configuration. This container does not have multipleConfigurationContainer=true due to compatibility issues in AUTOSAR R4.1. This restriction will no longer apply in R4.2. e.g. in an Ecu with two post build configurations and two partitions there would be 4 instances of the container BswMConfig, for all the combinations of partition and post build config one instance. Hint: the two instances (due to partitions) being part of the same post build config are referenced from the same instance of the EcuMConfiguration (via the reference EcuMFlexModuleConfigurationRef).
      reference BswMPartitionRef [0..1]: multiplicity set at pre-compile, set at pre-compile, destination=EcucPartition  # This references the partition the BswM shall run inside.
      container BswMArbitration  # This container includes all configuration sub-containers and parameters related to the mode arbitration functionality of the BswM.
        container BswMLogicalExpression [0..*]: multiplicity set at pre-compile  # This container describes the logical expressions that can be used for the mode arbitration. The logical expressions are built of a set of arguments and a logical operator. | Each argument can either be a mode condition or a sub-expression to allow definition of more complex logical expressions. There may be an unlimited number of arguments in each logical expression. Note that the order of evaluation of the expressions is not defined.
          enumeration BswMLogicalOperator [0..1]: {BSWM_AND, BSWM_NAND, BSWM_OR, BSWM_XOR}, multiplicity set at link in variant link-time+post-build / pre-compile in variant pre-compile, set at link in variant link-time+post-build / pre-compile in variant pre-compile  # This parameter specifies the logical operator to be used in the logical expression. If the expression only consists of a single condition this parameter shall not be used.
          choice reference BswMArgumentRef [1..*]: multiplicity set at link in variant link-time+post-build / pre-compile in variant pre-compile, set at link in variant link-time+post-build / pre-compile in variant pre-compile, destination=[BswMLogicalExpression, BswMModeCondition]  # This is a choice reference either to a mode condition or a sub-expression. | In case the BswMLogicalExpression.BswMLogicalOperator equals BSWM_NAND only two operands are supported.
        container BswMModeCondition [0..*]: multiplicity set at pre-compile  # This container describes the BswM mode conditions that can be used either by itself to form a rule or as a part of a logical expression.
          enumeration BswMConditionType: {BSWM_EQUALS, BSWM_EQUALS_NOT}, set at link in variant link-time+post-build / pre-compile in variant pre-compile  # This parameter specifies what kind of comparison that is made for the evaluation of the mode condition.
          reference BswMConditionMode: set at link in variant link-time+post-build / pre-compile in variant pre-compile, destination=BswMModeRequestPort  # This parameter references the mode request port that is used for the condition.
          choice container BswMConditionValue [0..1]  # This container holds the parameters and references necessary to identify the mode type and the value that the mode request is compared to.
            container BswMBswMode [0..1]  # This container defines the value and type of a mode in the BSW. The mode value is defined by configuring either BswMBswRequestedMode or BswMCompuScaleModeValue.
              string BswMBswRequestedMode [0..1]: multiplicity set at link in variant link-time+post-build / pre-compile in variant pre-compile, set at link in variant link-time+post-build / pre-compile in variant pre-compile  # This parameter contains the symbolic name (as a string) of a certain mode/state that can be requested/indicated by the BSW modules.
              container BswMCompuScaleModeValue [0..1]  # This container contains parameters used to define a mode value.
                string BswMCompuConstText: post-build-variant-value=true, set at link in variant link-time / post-build in variant post-build / pre-compile in variant pre-compile  # The value of this parameter shall match the VT member of a CompuConst defined within the referenced CompuMethod (BswMCompuMethodRef). The interval value of the corresponding CompuScale shall be used as the mode request value.
                foreign reference BswMCompuMethodRef: post-build-variant-value=true, set at link in variant link-time / post-build in variant post-build / pre-compile in variant pre-compile, destination-type=COMPU-METHOD  # This is a foreign reference to the CompuMethod used for mode requests. The CompuMethod category shall be TEXTTABLE.
            container BswMModeDeclaration [0..1]  # When the mode corresponds to a mode request or mode indication interface the mode is defined by a mode declaration. The mode declarations are defined in the SW-C Template and hence a foreign reference to the corresponding Mode Declaration is used.
              foreign reference BswMModeValueRef: set at link in variant link-time+post-build / pre-compile in variant pre-compile, destination-type=MODE-DECLARATION  # This is a foreign reference to the Mode Declaration used for the mode requests corresponding to this condition.
        container BswMModeRequestPort [0..*]: multiplicity set at pre-compile  # Each instance of this container defines a mode request interface that is used to requests or indicate modes from/to the BswM. These interfaces are implemented as ports or as ordinary C-functions based upon if the request is made by an SW-C or a BSW module. | There are different types of mode requests: 1. Mode requests from the SW-C:s 2. Mode Requests from other BSW modules such as the DCM. 3. State/mode indications from the RTE or other BSW modules such as the bus specific State Managers. Note that the BswM treats all request and indications in the exact same way.
          enumeration BswMRequestProcessing: {BSWM_DEFERRED, BSWM_IMMEDIATE}, set at link in variant link-time+post-build / pre-compile in variant pre-compile  # This parameter defines if the processing of the mode arbitration shall be done immediately when a mode request is received or if it shall be deferred to the processing of the main function of BswM.
          container BswMModeInitValue [0..1]  # This container defines the initial mode value that is used by BswM for the corresponding mode request after initialization. The initial mode value is defined by configuring either BswMBswModeInitValue or BswMCompuScaleModeValue. This container is optional.
            string BswMBswModeInitValue [0..1]: multiplicity set at link in variant link-time / post-build in variant post-build / pre-compile in variant pre-compile, post-build-variant-multiplicity=true, post-build-variant-value=true, set at link in variant link-time / post-build in variant post-build / pre-compile in variant pre-compile  # This parameter defines the initial mode value that is used by BswM for the corresponding mode request after initialization.
            container BswMCompuScaleModeValue [0..1]  # This container contains parameters used to define a mode value.
              string BswMCompuConstText: post-build-variant-value=true, set at link in variant link-time / post-build in variant post-build / pre-compile in variant pre-compile  # The value of this parameter shall match the VT member of a CompuConst defined within the referenced CompuMethod (BswMCompuMethodRef). The interval value of the corresponding CompuScale shall be used as the mode request value.
              foreign reference BswMCompuMethodRef: post-build-variant-value=true, set at link in variant link-time / post-build in variant post-build / pre-compile in variant pre-compile, destination-type=COMPU-METHOD  # This is a foreign reference to the CompuMethod used for mode requests. The CompuMethod category shall be TEXTTABLE.
          choice container BswMModeRequestSource  # This choice container specifies the source of the mode request or state/mode indication. The requester of a mode can be both SW-C:s and other BSW Modules, such as the bus specific State Managers.
            container BswMBswMModeRequest [0..1]  # The source of the mode request is a BswM on another partition. This container is only relevant for multi-partition systems.
              foreign reference BswMBswMModeDeclarationGroupRef: set at link in variant link-time+post-build / pre-compile in variant pre-compile, destination-type=MODE-DECLARATION-GROUP  # This is a foreign reference to the Mode Declaration Group Prototype.
            container BswMBswMModeSwitchNotification [0..1]  # This indicates that another BswM has switched a mode. This container is only relevant for multi-partition systems.
              foreign reference BswMBswMModeDeclarationGroupRef: set at link in variant link-time+post-build / pre-compile in variant pre-compile, destination-type=MODE-DECLARATION-GROUP  # This is a foreign reference to the Mode Declaration Group Prototype.
            container BswMBswModeNotification [0..1]  # This is a mode request source emanating from another BSW Module.
              foreign reference BswMBswModeDeclarationGroupPrototypeRef: set at link in variant link-time+post-build / pre-compile in variant pre-compile, destination-type=MODE-DECLARATION-GROUP-PROTOTYPE  # This is a foreign reference to the Mode Declaration Group Prototype.
            container BswMCanSMIcomIndication [0..1]  # This is an indication from CanSM of the configuration Id of the Icom configuration
              boolean BswMCanSMIcomIndicationSwitchError: set at link in variant link-time+post-build / pre-compile in variant pre-compile, default-value=false  # When this parameter is set to true, then this mode request source corresponds to error indications from the CanSM. Otherwise, this mode request source corresponds to error-free indications from the CanSM.
              symbolic name reference BswMCanSMChannelRef: set at link in variant link-time+post-build / pre-compile in variant pre-compile, destination=ComMChannel  # This is a reference to the CAN channel handle that the mode request corresponds to.
            container BswMCanSMIndication [0..1]  # This is an indication of the current state of the CAN State Manager.
              symbolic name reference BswMCanSMChannelRef: set at link in variant link-time+post-build / pre-compile in variant pre-compile, destination=ComMChannel  # This is a reference to the CAN channel handle that the mode request corresponds to.
            container BswMComMIndication [0..1]  # This is an indication of the current communication mode of a channel in the Communication Manager.
              symbolic name reference BswMComMChannelRef: set at link in variant link-time+post-build / pre-compile in variant pre-compile, destination=ComMChannel  # This is a reference to the Communication Manager channel handle that the indication corresponds to.
            container BswMComMInitiateReset [0..1]  # This is an indication from the ComM to signal a shutdown.
            container BswMComMPncRequest [0..1]  # This is a request of the current communication mode of a Partial Network Cluster in the Communication Manager.
              symbolic name reference BswMComMPncRef: set at link in variant link-time+post-build / pre-compile in variant pre-compile, destination=ComMPnc  # This is a reference to the Communication Manager PNC handle of the Partial Network Cluster that the request corresponds to.
            container BswMDcmApplicationUpdatedIndication [0..1]  # This is a request to update application data from the DCM. This container does not contain any parameters since there are no further configuration needed for this type of request.
            container BswMDcmComModeRequest [0..1]  # The source of the mode request is the Diagnostic Communication Manager.
              symbolic name reference BswMDcmComMChannelRef: set at link in variant link-time+post-build / pre-compile in variant pre-compile, destination=ComMChannel  # This is a reference from DcmModeRequest to the ComM channel that the indication corresponds to.
            container BswMEcuMIndication [0..1]  # This is a notification of the current operation mode of the ECU State Manager. This container does not contain any parameters since there are no further configuration needed for this type of request.
            container BswMEcuMRUNRequestIndication [0..1]  # This is an indication of the current State of the RUN Request Protocol.
              enumeration BswMEcuMRUNRequestProtocolPort: {POST_RUN, RUN}, set at link in variant link-time+post-build / pre-compile in variant pre-compile  # Identifies the EcuM State which is related to the mode request.
            container BswMEcuMWakeupSource [0..1]  # This is a notification of the current state of an ECU State Manager wakeup source.
              symbolic name reference BswMEcuMWakeupSrcRef: set at link in variant link-time+post-build / pre-compile in variant pre-compile, destination=EcuMWakeupSource  # This is a reference to the ECU State Manager Wakeup Source that the indication corresponds to.
            container BswMEthSMIndication [0..1]  # This is an indication of the current state of the Ethernet State Manager.
              symbolic name reference BswMEthSMChannelRef: set at link in variant link-time+post-build / pre-compile in variant pre-compile, destination=ComMChannel  # This is a reference to the Ethernet channel handle that the mode request corresponds to.
            container BswMFrSMIndication [0..1]  # This is an indication of the current state of the FlexRay State Manager.
              symbolic name reference BswMFrSMChannelRef: set at link in variant link-time+post-build / pre-compile in variant pre-compile, destination=ComMChannel  # This is a reference to the FlexRay Cluster handle that the mode request corresponds to.
            container BswMGenericRequest [0..1]  # This mode request originates from a requester that is not among the list of standardized mode requesters (i.e. the different resource managers).
              integer BswMModeRequesterId: 0..65535, set at link in variant link-time+post-build / pre-compile in variant pre-compile  # This parameters identifies the different users of the generic mode request interface. | The allowable range of this parameter shall coincide with the range of BswM_UserType (which can be platform-dependent).
              integer BswMRequestedModeMax: 0..65535, set at link in variant link-time+post-build / pre-compile in variant pre-compile  # This parameter defines the upper limit for the modes requested by this mode requester. | The allowable range of this parameter shall coincide with the range of BswM_ModeType (which can be platform-dependent).
            container BswMJ1939DcmBroadcastStatus [0..1]  # This is a notification of the desired broadcast status per network, triggered via DM13.
              symbolic name reference BswMJ1939DcmChannelRef: set at link in variant link-time+post-build / pre-compile in variant pre-compile, destination=ComMChannel  # Reference to the channel represented by the nth bit in the networkMask parameter to J1939DcmBroadcastStatus.
            container BswMJ1939NmIndication [0..1]  # This is an indication of the current state of the J1939 network management module.
              symbolic name reference BswMJ1939NmChannelRef: set at link in variant link-time+post-build / pre-compile in variant pre-compile, destination=ComMChannel  # This is a reference to the J1939Nm channel handle that the mode request corresponds to.
              symbolic name reference BswMJ1939NmNodeRef: set at link in variant link-time+post-build / pre-compile in variant pre-compile, destination=J1939NmNode  # This is a reference to the node that the mode request corresponds to.
            container BswMLinSMIndication [0..1]  # This is an indication of the current state of the LIN State Manager.
              symbolic name reference BswMLinSMChannelRef: set at link in variant link-time+post-build / pre-compile in variant pre-compile, destination=ComMChannel  # This is a reference to the LIN channel handle that the mode request corresponds to.
            container BswMLinScheduleIndication [0..1]  # This is an indication of the currently active LIN Schedule Table for a specific LIN Interface.
              symbolic name reference BswMLinSMChannelRef: post-build-variant-value=true, set at link in variant link-time / post-build in variant post-build / pre-compile in variant pre-compile, destination=ComMChannel  # This is a reference to the LIN channel handle that the mode request corresponds to.
              symbolic name reference BswMLinScheduleRef: post-build-variant-value=true, set at link in variant link-time / post-build in variant post-build / pre-compile in variant pre-compile, destination=LinSMSchedule  # This is a reference to the LIN Schedule Table handle that the mode request corresponds to.
            container BswMLinTpModeRequest [0..1]  # This is a LinTp mode request from the LinIf. This port corresponds to a call of the BswM_LinTp_RequestMode API.
              symbolic name reference BswMLinTpChannelRef: set at link in variant link-time+post-build / pre-compile in variant pre-compile, destination=ComMChannel  # This is a reference to the LIN Interface Channel that the mode | request corresponds to.
            container BswMModeSwitchErrorEvent [0..1]  # This is a notification that an error occurred because the partition containing the mode users of the Mode Declaration Group Prototype was restarted by the RTE. Because the Mode Machine Instance holding the current mode can reside on that terminated partition, the Mode Manager has to be informed about | the loss of this partition.
              reference BswMRteSwitchPortRef: post-build-variant-value=true, set at link in variant link-time / post-build in variant post-build / pre-compile in variant pre-compile, destination=BswMSwitchPort  # This is a reference to the BswMSwitchPort.
            container BswMNvMJobModeIndication [0..1]  # Indicates the current status of the multiblock job. The job is identified via BswMNvmService, e.g. 0x0c for NvmReadAll, 0x0d for NvmWriteAll. Possible Values are: | NvM_RequestResultType NVM_REQ_OK NVM_REQ_NOT_OK NVM_REQ_PENDING NVM_REQ_INTEGRITY_FAILED NVM_REQ_BLOCK_SKIPPED NVM_REQ_NV_INVALIDATED NVM_REQ_CANCELED NVM_REQ_REDUNDANCY_FAILED NVM_REQ_RESTORED_FROM_ROM
              enumeration BswMNvmService: {NvmReadAll, NvmWriteAll}, set at link in variant link-time+post-build / pre-compile in variant pre-compile  # Identifies the Nvm job which is related to the mode request.
            container BswMNvMRequest [0..1]  # Via this Mode Request Source the NvM indicates the current status of the specified block. Possible Values are: | NvM_RequestResultType NVM_REQ_OK NVM_REQ_NOT_OK NVM_REQ_PENDING NVM_REQ_INTEGRITY_FAILED NVM_REQ_BLOCK_SKIPPED NVM_REQ_NV_INVALIDATED NVM_REQ_CANCELED NVM_REQ_REDUNDANCY_FAILED NVM_REQ_RESTORED_FROM_ROM
              symbolic name reference BswMNvMBlockRef: set at link in variant link-time+post-build / pre-compile in variant pre-compile, destination=NvMBlockDescriptor  # This is a reference to the NvM Block Descriptor that the request corresponds to.
            container BswMPartitionRestarted [0..1]  # This is a notification that an error occured because the partition containing the BswM was restarted by the RTE. The Mode Users may lie in another (still running) partition. So the BswM has to be informed that the start of its partition is no normal startup but a restart of a single partition. This information can be used inside the Rules. This ModeIndication has to be used by the Restart Task of the particular partition.
            container BswMSdClientServiceCurrentState [0..1]  # Used by Service Discovery module to indicate current state of the Client Service (available/down).
              symbolic name reference BswMSdClientMethodsRef: set at link in variant link-time+post-build / pre-compile in variant pre-compile, destination=SdClientService  # This is a reference to a client service in the Sd module.
            container BswMSdConsumedEventGroupCurrentState [0..1]  # Used by Service Discovery to indicate current status of the EventHandler (requested/released).
              symbolic name reference BswMSdConsumedEventGroupRef: set at link in variant link-time+post-build / pre-compile in variant pre-compile, destination=SdConsumedEventGroup  # This is a reference to an eventGroup that is defined within a client service in the Sd module.
            container BswMSdEventHandlerCurrentState [0..1]  # Used by Service Discovery to indicate current status of the EventHandler (requested/released).
              symbolic name reference BswMSdEventHandlerRef: set at link in variant link-time+post-build / pre-compile in variant pre-compile, destination=SdEventHandler  # This is a reference to an event handler that is defined within a server service in the Sd module.
            container BswMSwcModeNotification [0..1]  # This is a mode switch notification associated with a RTE switch interface.
              foreign reference BswMSwcModeNotificationModeDeclarationGroupPrototypeRef: set at link in variant link-time+post-build / pre-compile in variant pre-compile, destination-type=MODE-DECLARATION-GROUP-PROTOTYPE  # This is a foreign reference to the ModeDeclarationGroupPrototype.
            container BswMSwcModeRequest [0..1]  # The source of the mode request is a SW Component.
              foreign reference BswMSwcModeRequestVariableDataPrototypeRef: post-build-variant-value=true, set at link in variant link-time / post-build in variant post-build / pre-compile in variant pre-compile, destination-type=VARIABLE-DATA-PROTOTYPE  # This is a reference to the VariableDataPrototype.
            container BswMWdgMRequestPartitionReset [0..1]  # This is a Partition Reset request from from the WdgM. This port | corresponds to a call of the BswM_WdgM_RequestPartitionReset API.
              reference BswMWdgMRequestPartitionResetRef: set at link in variant link-time+post-build / pre-compile in variant pre-compile, destination=EcucPartition  # This is a reference to the partition that shall be reset.
        container BswMRule [0..*]: multiplicity set at link in variant link-time / post-build in variant post-build / pre-compile in variant pre-compile  # Each instance of this container describes a BswM arbitration rule. The rule either consists of a simple mode condition or a more complex logical expression. This container also references the action lists that shall be invoked when the rule is evaluated to True or False.
          boolean BswMNestedExecutionOnly: set at link in variant link-time+post-build / pre-compile in variant pre-compile, default-value=false  # This parameter defines for its related Rule if the Rule is an Independent rule or a Subordinate rule; | false: an Independent rule, i.e. to be evaluated each time applicable (both as standalone Rule driven by its own BswMModeRequestSource and when referenced by another Rule). true: a Subordinated rule, to be evaluated ONLY as a result of being referenced in one or more Action Lists.
          enumeration BswMRuleInitState: {BSWM_FALSE, BSWM_TRUE, BSWM_UNDEFINED}, set at link in variant link-time+post-build / pre-compile in variant pre-compile  # This parameter is a part of the reset/initialization behavior of BswM. | Action lists are executed when the result of a rule evaluation have changed since the last evaluation. This parameter defines the "previous evaluation result" of a rule to be used after initialization of the BswM. If this parameter is set to BSWM_UNDEFINED, the evaluation result is always treated as changed at the first evaluation of the rule after initialization. If this parameter is set to BSWM_TRUE, the evaluation result is treated as changed if the rule is evaluated to false. If this parameter is set to BSWM_FALSE, the evaluation result is treated as changed if the rule is evaluated to true.
          reference BswMRuleExpressionRef: set at link in variant link-time+post-build / pre-compile in variant pre-compile, destination=BswMLogicalExpression  # This is a reference to the logical expression that is evaluated for each rule.
          reference BswMRuleFalseActionList [0..1]: multiplicity set at link in variant link-time / post-build in variant post-build / pre-compile in variant pre-compile, post-build-variant-multiplicity=true, post-build-variant-value=true, set at link in variant link-time / post-build in variant post-build / pre-compile in variant pre-compile, destination=BswMActionList  # This is a reference to the action list that shall be executed when the rule is evaluated to False
          reference BswMRuleTrueActionList [0..1]: multiplicity set at link in variant link-time / post-build in variant post-build / pre-compile in variant pre-compile, post-build-variant-multiplicity=true, post-build-variant-value=true, set at link in variant link-time / post-build in variant post-build / pre-compile in variant pre-compile, destination=BswMActionList  # This is a reference to the action list that shall be executed when the rule is evaluated to True
      container BswMDataTypeMappingSets [0..1]  # Collection of references to DataTypeMappingSet.
        foreign reference BswMDataTypeMappingSetRef [1..*]: multiplicity set at link in variant link-time+post-build / pre-compile in variant pre-compile, set at link in variant link-time+post-build / pre-compile in variant pre-compile, destination-type=DATA-TYPE-MAPPING-SET  # Reference to DataTypeMappingSet.
      container BswMModeControl  # This container includes all configuration sub-containers and parameters related to the mode control functionality of the BswM.
        container BswMAction [0..*]: multiplicity set at pre-compile  # Each container of this type defines an action. These actions can be part of one or several action lists.
          choice container BswMAvailableActions  # Choice container including the available actions to be used in the action lists.
            container BswMComMAllowCom [0..1]  # This container includes all parameters for the action to allow or to block communication for a ComM Channel. ComM_CommunicationAllowed is called when this action is configured.
              boolean BswMComAllowed: set at link in variant link-time+post-build / pre-compile in variant pre-compile  # The parameter BswMComMAllowChannelRef refers to a channel which will allow or block communication using the function ComM_CommunicationAllowed(). | This parameter corresponds to the parameter "Allowed" of the function ComM_CommunicationAllowed().
              symbolic name reference BswMComMAllowChannelRef: set at link in variant link-time+post-build / pre-compile in variant pre-compile, destination=ComMChannel  # This is a reference to the ComM Channel for which communication shall be allowed or blocked. | This reference corresponds to the parameter "Channel" of the function ComM_CommunicationAllowed().
            container BswMComMModeLimitation [0..1]  # This container includes all parameters related to a limitation of communication mode for a ComM Channel. ComM_LimitChannelToNoComMode is called when this action is configured.
              boolean BswMComMLimitMode: set at link in variant link-time+post-build / pre-compile in variant pre-compile  # The function ComM_LimitChannelToNoComMode() takes in this boolean parameter to limit the channel's com mode to no-com mode. | This parameter corresponds to the parameter "Status" of the function ComM_LimitChannelToNoComMode.
              symbolic name reference BswMComMLimitChannelRef: set at link in variant link-time+post-build / pre-compile in variant pre-compile, destination=ComMChannel  # This is a reference to the ComM channel for which the communication mode should be limited. | This reference corresponds to the parameter "Channel" of the function ComM_LimitChannelToNoComMode.
            container BswMComMModeSwitch [0..1]  # This container includes all parameters related to a switch of communication mode for a ComM User. ComM_RequestComMode is called when this action is configured.
              enumeration BswMComMRequestedMode: {BSWM_FULL_COM, BSWM_NO_COM}, set at link in variant link-time+post-build / pre-compile in variant pre-compile  # This parameter specifies if the requested communication mode. | This parameter corresponds to the parameter "ComMode" of the function ComM_RequestComMode.
              symbolic name reference BswMComMUserRef: set at link in variant link-time+post-build / pre-compile in variant pre-compile, destination=ComMUser  # This is a reference to the ComM User that is associated to the Communication channel for which the communication mode should be requested. | This reference corresponds to the parameter "User" of the function ComM_RequestComMode.
            container BswMCoreHaltMode [0..1]  # This container includes all parameters related to a switch of the activation state of core Halt.
              string BswMCoreHaltActivationState: set at pre-compile  # Different possibilities are offered depending on the OS implementation and the CPU HW. The HALT modes addressed by this parameter are defined as names (strings) in the OS implementation. Different implementation may implement different HALT modes and subsequently different names.
              symbolic name reference BswMTargetCoreRef: set at link in variant link-time+post-build / pre-compile in variant pre-compile, destination=EcucCoreDefinition  # This is a reference to the core on which the Core Halt process must be influenced.
            container BswMDeadlineMonitoringControl [0..1]  # This container includes all parameters related to enabling and disabling of deadline monitoring for one or several PDUs in COM. | COM_ReceptionDMControl is called when this action is configured.
              symbolic name reference BswMDisabledDMPduGroupRef [0..*]: multiplicity set at link in variant link-time / post-build in variant post-build / pre-compile in variant pre-compile, post-build-variant-multiplicity=true, post-build-variant-value=true, set at link in variant link-time / post-build in variant post-build / pre-compile in variant pre-compile, destination=ComIPduGroup  # This is a reference to a PDU Group for which the Deadline Monitoring should be disabled. | Together with the BswMEnabledDMPduGroupRef this reference corresponds to the parameter "ipduGroupVector" of the function COM_ReceptionDMControl.
              symbolic name reference BswMEnabledDMPduGroupRef [0..*]: multiplicity set at link in variant link-time / post-build in variant post-build / pre-compile in variant pre-compile, post-build-variant-multiplicity=true, post-build-variant-value=true, set at link in variant link-time / post-build in variant post-build / pre-compile in variant pre-compile, destination=ComIPduGroup  # This is a reference to a PDU Group for which the Deadline Monitoring should be enabled. | Together with the BswMDisabledDMPduGroupRef this reference corresponds to the parameter "ipduGroupVector" of the function COM_ReceptionDMControl.
            container BswMEcuMGoDown [0..1]  # This container defines the UserId which shall be forwarded to the GoDown request.
              symbolic name reference BswMEcuMUserIdRef: set at link in variant link-time+post-build / pre-compile in variant pre-compile, destination=EcuMFlexUserConfig  # This is a reference to a EcuM UserId.
            container BswMEcuMGoHalt [0..1]  # This container defines the action to trigger the EcuM_GoHalt from BswM.
            container BswMEcuMGoPoll [0..1]  # This container defines the action to trigger the EcuM_GoPoll from BswM.
            container BswMEcuMSelectShutdownTarget [0..1]  # This container defines the shutdown target.
              enumeration BswMEcuMShutdownTarget: {OFF, RESET, SLEEP}, set at link in variant link-time+post-build / pre-compile in variant pre-compile  # This parameter contains the shutdown target that the BswM selects at the EcuM.
              symbolic name reference BswMEcuMResetModeRef [0..1]: multiplicity set at link in variant link-time+post-build / pre-compile in variant pre-compile, set at link in variant link-time+post-build / pre-compile in variant pre-compile, destination=EcuMResetMode  # This is a reference to a reset mode.
              symbolic name reference BswMEcuMSleepModeRef [0..1]: multiplicity set at link in variant link-time+post-build / pre-compile in variant pre-compile, set at link in variant link-time+post-build / pre-compile in variant pre-compile, destination=EcuMSleepMode  # This is a reference to a sleep mode.
            container BswMEcuMStateSwitch [0..1]  # This container defines the action to switch a State of the ECU State Manager.
              enumeration BswMEcuMState: {POST_RUN, RUN, SHUTDOWN, SLEEP, STARTUP}, set at link in variant link-time+post-build / pre-compile in variant pre-compile  # This parameter corresponds to the parameter "State" of the function EcuM_ SetState ().
            container BswMFrSMAllSlots [0..1]  # This container includes all parameter(s) for the action to request an exit from Flexray KeySlotOnlyMode. FrSM_AllSlots shall be called when this action is executed.
              symbolic name reference BswMFrSMAllSlotsNetworkHandleRef: set at link in variant link-time+post-build / pre-compile in variant pre-compile, destination=ComMChannel  # This references the FlexRay cluster. The reference corresponds to the parameter "NetworkHandle" of the function FrSM_AllSlots.
            container BswMJ1939DcmStateSwitch [0..1]  # This container includes all parameters related to a switch of the J1939 Diagnostic Communication Managers network state for a J1939 node. J1939Dcm_SetState is called when this action is configured.
              enumeration BswMJ1939DcmRequestedState: {J1939DCM_STATE_OFFLINE, J1939DCM_STATE_ONLINE}, set at link in variant link-time+post-build / pre-compile in variant pre-compile  # This parameter describes the communication state of the J1939 Diagnostic Communication Manager and corresponds to the parameter "newState" of the function J1939Dcm_SetState.
              symbolic name reference BswMJ1939DcmChannelRef: set at link in variant link-time+post-build / pre-compile in variant pre-compile, destination=ComMChannel  # This reference points to the unique channel defined by the ComMChannel and provides access to the unique channel index value in ComMChannelId. | This reference corresponds to the parameter "channel" of the function J1939Dcm_SetState.
              symbolic name reference BswMJ1939DcmNodeRef: set at link in variant link-time+post-build / pre-compile in variant pre-compile, destination=J1939NmNode  # This reference points to a J1939NmNode and provides access to the unique J1939NmNodeId.This reference corresponds to the parameter "node" of the function J1939Dcm_SetState.
            container BswMJ1939RmStateSwitch [0..1]  # This container includes all parameters related to a switch of the J1939 Request Managers network state for a J1939 node. J1939Rm_SetState is called when this action is configured.
              enumeration BswMJ1939RmRequestedState: {J1939RM_STATE_OFFLINE, J1939RM_STATE_ONLINE}, set at link in variant link-time+post-build / pre-compile in variant pre-compile  # This parameter describes the communication state of the J1939 Request Manager and corresponds to the parameter "new state" of the function J1939Rm_SetState.
              symbolic name reference BswMJ1939RmChannelRef: set at link in variant link-time+post-build / pre-compile in variant pre-compile, destination=ComMChannel  # This reference points to the unique channel defined by the ComMChannel and provides access to the unique channel index value in ComMChannelId. | This reference corresponds to the parameter "channel" of the function J1939Rm_SetState.
              symbolic name reference BswMJ1939RmNodeRef: set at link in variant link-time+post-build / pre-compile in variant pre-compile, destination=J1939NmNode  # This reference points to a J1939NmNode and provides access to the unique J1939NmNodeId. | This reference corresponds to the parameter "node" of the function J1939Rm_SetState.
            container BswMLinScheduleSwitch [0..1]  # This container includes all parameters related to a switch of LIN schedule table. LinSM_ScheduleRequest is called when this action is configured. | The configuration for the "network" parameter can be accessed via the reference LinSMComMNetworkHandleRef contained in the parent container LinSMChannel of the container referenced by BswMLinScheduleRef.
              symbolic name reference BswMLinScheduleRef: post-build-variant-value=true, set at link in variant link-time / post-build in variant post-build / pre-compile in variant pre-compile, destination=LinSMSchedule  # This is a reference to the LIN schedule table that the LIN SM shall change to. | This reference corresponds to the parameter "schedule" of the function LinSM_ScheduleRequest.
            container BswMNMControl [0..1]  # This container includes all parameters related to enabling and disabling of Network Management communication. Disabling of NM communication can be requested by DCM. | Nm_EnableCommunication or Nm_DisableCommunication is called when this action is configured.
              enumeration BswMNMAction: {BSWM_NM_DISABLE, BSWM_NM_ENABLE}, set at link in variant link-time+post-build / pre-compile in variant pre-compile  # This parameter specifies if the communication of the corresponding NM channel should be enabled or disabled.
              symbolic name reference BswMComMNetworkHandleRef: set at link in variant link-time+post-build / pre-compile in variant pre-compile, destination=ComMChannel  # This reference points to the unique channel defined by the ComMChannel and provides access to the unique channel index value in ComMChannelId. | This reference corresponds to the parameter "NetworkHandle" of the function Nm_EnableCommunication and Nm_DisableCommunication.
            container BswMPduGroupSwitch [0..1]  # This container includes references to the PDU groups that shall be enabled and disabled. Com_IpduGroupControl is called when this action is configured.
              boolean BswMPduGroupSwitchReinit [0..1]: multiplicity set at link in variant link-time / post-build in variant post-build / pre-compile in variant pre-compile, post-build-variant-multiplicity=true, post-build-variant-value=true, set at link in variant link-time / post-build in variant post-build / pre-compile in variant pre-compile, default-value=false  # This parameter defines if the values for the parameters like periodical timer, minimum delay timer etc is retainer or reinitialized during a PDU Group Switch. | This parameter corresponds to the parameter "initialize" of the function Com_IpduGroupControl.
              symbolic name reference BswMDisabledPduGroupRef [0..*]: multiplicity set at link in variant link-time / post-build in variant post-build / pre-compile in variant pre-compile, post-build-variant-multiplicity=true, post-build-variant-value=true, set at link in variant link-time / post-build in variant post-build / pre-compile in variant pre-compile, destination=ComIPduGroup  # This is a reference to a PDU Group that should be disabled. | Together with the BswMEnabledIPduGroupRef this reference corresponds to the parameter "ipduGroupVector" of the function Com_IpduGroupControl.
              symbolic name reference BswMEnabledPduGroupRef [0..*]: multiplicity set at link in variant link-time / post-build in variant post-build / pre-compile in variant pre-compile, post-build-variant-multiplicity=true, post-build-variant-value=true, set at link in variant link-time / post-build in variant post-build / pre-compile in variant pre-compile, destination=ComIPduGroup  # This is a reference to a PDU Group that should be enabled. | Together with the BswMDisabledIPduGroupRef this reference corresponds to the parameter "ipduGroupVector" of the function Com_IpduGroupControl.
            container BswMPduRouterControl [0..1]  # This container includes all parameters related to enabling and disabling of routing of Routing Path Groups in the PDU Router. PduR_EnableRouting or PduR_DisableRouting is called when this action is configured.
              enumeration BswMPduRouterAction: {BSWM_PDUR_DISABLE, BSWM_PDUR_ENABLE}, post-build-variant-value=true, set at link in variant link-time / post-build in variant post-build / pre-compile in variant pre-compile  # This parameter specifies if the routing of the corresponding PDU should be enabled or disabled.
              boolean BswMPduRouterDisableInitBuffer [0..1]: multiplicity set at link in variant link-time / post-build in variant post-build / pre-compile in variant pre-compile, post-build-variant-multiplicity=true, post-build-variant-value=true, set at link in variant link-time / post-build in variant post-build / pre-compile in variant pre-compile  # When BswPduRouterAction is set to BSWM_PDUR_DISABLE and this parameter is set to true, then the call to PduR_DisableRouting will be invoked with parameter "initialize" set to true, otherwise false.
              symbolic name reference BswMPduRoutingPathGroupRef [1..*]: multiplicity set at link in variant link-time / post-build in variant post-build / pre-compile in variant pre-compile, post-build-variant-multiplicity=true, post-build-variant-value=true, set at link in variant link-time / post-build in variant post-build / pre-compile in variant pre-compile, destination=PduRRoutingPathGroup  # This is a reference to the PDU Routing Path Group for which the routing in the PDU Router should be enabled or disabled. | This reference corresponds to the parameter "id" of the function PduR_EnableRouting and PduR_DisableRouting.
            container BswMRequestRemoteMode [0..1]  # This container defines all information that are needed when a BswM wants to request a mode at another BswM which runs inside another partition.
              foreign reference BswMModeDeclarationGroupPrototypeRef: set at link in variant link-time+post-build / pre-compile in variant pre-compile, destination-type=MODE-DECLARATION-GROUP-PROTOTYPE  # This is the reference to the ModeDeclarationGroup Prototype for that a mode shall be requested at another BswM.
              foreign reference BswMRequestedRemoteMode: set at link in variant link-time+post-build / pre-compile in variant pre-compile, destination-type=MODE-DECLARATION  # This parameter contains the integer value that corresponds to a certain mode in a Mode Declaration Group.
              reference BswMEcuCPartitionRef: set at link in variant link-time+post-build / pre-compile in variant pre-compile, destination=EcucPartition  # This is a reference to the EcuCPartition the other BswM belongs to.
            container BswMRteModeRequest [0..1]  # This container defines a mode request that the BswM may send to a SW-C which is acting as a mode-manager. RTE_Write is called when this action is configured.
              foreign reference BswMRequestedModeRef: set at link in variant link-time+post-build / pre-compile in variant pre-compile, destination-type=MODE-DECLARATION  # This is a foreign reference to the Mode Declaration used for the mode request
              reference BswMRteModeRequestPortRef: set at link in variant link-time+post-build / pre-compile in variant pre-compile, destination=BswMRteModeRequestPort  # This is a reference to a BswMRteModeRequestPort.
            container BswMRteSwitch [0..1]  # This container defines a mode switch indication that the BswM provides to the SW-C that need to be notified about the mode switch. RTE_Switch is called when this action is configured.
              foreign reference BswMSwitchedMode: set at link in variant link-time+post-build / pre-compile in variant pre-compile, destination-type=MODE-DECLARATION  # This parameter contains the integer value that corresponds to a certain mode in a Mode Declaration Group.
              reference BswMRteSwitchPortRef: set at link in variant link-time+post-build / pre-compile in variant pre-compile, destination=BswMSwitchPort  # This is a reference to the BswMSwitchPort.
            container BswMSchMSwitch [0..1]  # This container defines a mode switch indication that the BswM provides to the SW-C that need to be notified about the mode switch. SchM_Switch is called when this action is configured.
              foreign reference BswMSchMModeDeclarationGroupRef: set at link in variant link-time+post-build / pre-compile in variant pre-compile, destination-type=MODE-DECLARATION-GROUP  # This is the reference to a ModeDeclarationGroup to define a ModeDeclarationGroupPrototype in the role BswModuleDescription.providedModeGroup.
              foreign reference BswMSchMSwitchedMode: set at link in variant link-time+post-build / pre-compile in variant pre-compile, destination-type=MODE-DECLARATION  # This parameter contains the integer value that corresponds to a certain mode in a Mode Declaration Group.
            container BswMSdClientServiceModeRequest [0..1]  # This container includes all parameters related to the selection of an client service of Sd. Sd_ClientServiceSetState is called when this action is configured.
              enumeration BswMSdClientServiceState: {BSWM_SD_CLIENT_SERVICE_RELEASED, BSWM_SD_CLIENT_SERVICE_REQUESTED}, set at link in variant link-time+post-build / pre-compile in variant pre-compile  # This parameter specifies if the corresponding client service shall be released or requested.
              symbolic name reference BswMSdClientMethodsRef: set at link in variant link-time+post-build / pre-compile in variant pre-compile, destination=SdClientService  # This is a reference to a client service in the Sd module.
            container BswMSdConsumedEventGroupModeRequest [0..1]  # This container includes all parameters related to the selection of a consumed EventGroup of Sd. Sd_ConsumedEventGroupSetState is called when this action is configured.
              enumeration BswMSdConsumedEventGroupState: {BSWM_SD_CONSUMED_EVENTGROUP_RELEASED, BSWM_SD_CONSUMED_EVENTGROUP_REQUESTED}, set at link in variant link-time+post-build / pre-compile in variant pre-compile  # This parameter specifies if the corresponding consumed event group shall be released or requested.
              symbolic name reference BswMSdConsumedEventGroupRef: set at link in variant link-time+post-build / pre-compile in variant pre-compile, destination=SdConsumedEventGroup  # This is a reference to an eventGroup that is defined within a client service in the Sd module.
            container BswMSdServerServiceModeRequest [0..1]  # This container includes all parameters related to the selection of a server service of Sd. Sd_ServerServiceSetState is called when this action is configured.
              enumeration BswMSdServerServiceState: {BSWM_SD_SERVER_SERVICE_AVAILABLE, BSWM_SD_SERVER_SERVICE_DOWN}, set at link in variant link-time+post-build / pre-compile in variant pre-compile  # This parameter specifies if the corresponding server service shall be down or available.
              symbolic name reference BswMSdServerMethodsRef: set at link in variant link-time+post-build / pre-compile in variant pre-compile, destination=SdServerService  # This is a reference to a server service in the Sd module.
            container BswMSwitchIPduMode [0..1]  # This container includes all parameters related to the selection of the transmission mode an I-PDU to be sent by COM. Com_SwitchIpduTxMode is called when this action is configured.
              boolean BswMSwitchIPduModeValue: post-build-variant-value=true, set at link in variant link-time / post-build in variant post-build / pre-compile in variant pre-compile  # This parameter defines which transmission mode shall be selected during this call. | This parameter corresponds to the parameter "truefalsemode" of the function Com_SwitchIpduTxMode.
              symbolic name reference BswMSwitchIPduModeRef: post-build-variant-value=true, set at link in variant link-time / post-build in variant post-build / pre-compile in variant pre-compile, destination=ComIPdu  # This is a reference to an I-PDU for which the transmission mode shall be set. | This reference corresponds to the parameter "PduId" of the function Com_SwitchIpduTxMode.
            container BswMTriggerIPduSend [0..1]  # This container includes all parameters related to the triggering of an I-PDU to be sent by COM. Com_TriggerIPDUSend is called when this action is configured.
              symbolic name reference BswMTriggeredIPduRef [1..*]: multiplicity set at link in variant link-time / post-build in variant post-build / pre-compile in variant pre-compile, post-build-variant-multiplicity=true, post-build-variant-value=true, set at link in variant link-time / post-build in variant post-build / pre-compile in variant pre-compile, destination=ComIPdu  # This is a reference to an I-PDU that should be triggered for transmission. | This reference corresponds to the parameter "PduId" of the function Com_TriggerIPDUSend.
            container BswMTriggerSlaveRTEStop [0..1]  # This container includes all parameters needed to stop the RTE on a slave core. This choice shall only be chosen if multicore is used.
              symbolic name reference BswMCoreRef [0..1]: multiplicity set at link in variant link-time+post-build / pre-compile in variant pre-compile, set at link in variant link-time+post-build / pre-compile in variant pre-compile, destination=EcucCoreDefinition  # This reference points to the identifier of the slave core that is used as input parameter for the BswM_TriggerStartUpPhase2 and BswM_TriggerSlaveRTEStop functions. The value of this parameter shall be synchronized with the OsApplicationCoreAssignment parameter.
            container BswMTriggerStartUpPhase2 [0..1]  # This container includes all parameters needed to start phase two on a slave core. This choice shall only be chosen if multicore is used.
              symbolic name reference BswMCoreRef [0..1]: multiplicity set at link in variant link-time+post-build / pre-compile in variant pre-compile, set at link in variant link-time+post-build / pre-compile in variant pre-compile, destination=EcucCoreDefinition  # This reference points to the identifier of the slave core that is used as input parameter for the BswM_TriggerStartUpPhase2 and BswM_TriggerSlaveRTEStop functions. The value of this parameter shall be synchronized with the OsApplicationCoreAssignment parameter.
            container BswMUserCallout [0..1]  # This container includes all details needed for a user defined function call.
              string BswMUserCalloutFunction: set at link in variant link-time+post-build / pre-compile in variant pre-compile  # This parameter specifies the complete function call including all parameters. The parameters are specified during configuration time, and cannot be changed during run time. Any return values passed by the callout will be ignored. | Example usage can be: Actions to initialize other BSW modules Action to call Rte_Start() Action to call Rte_Stop() Action to call NvM_ReadAll() Action to call NvM_WriteAll()
        container BswMActionList [0..*]: multiplicity set at link in variant link-time / post-build in variant post-build / pre-compile in variant pre-compile  # Each instance of this container defines an action list that is invoked based on the BswM Rules. An action list contains a list of numbered action items to be processed. An action list can also include other action lists.
          enumeration BswMActionListExecution: {BSWM_CONDITION, BSWM_TRIGGER}, set at link in variant link-time+post-build / pre-compile in variant pre-compile  # This parameter controls if the corresponding action list shall be executed every time the rule is evaluated or only when the result of the evaluation changes. This parameter does not have an effect when this action list is executed within another action list.
          container BswMActionListItem [1..*]: multiplicity set at link in variant link-time / post-build in variant post-build / pre-compile in variant pre-compile  # This container defines an item in an action list.
            boolean BswMAbortOnFail: post-build-variant-value=true, set at link in variant link-time / post-build in variant post-build / pre-compile in variant pre-compile, default-value=false  # This parameter defines if the execution of the action list shall be aborted if this specific action returns E_NOT_OK. Note that this is only applicable for actions that have E_NOT_OK as a possible return value.
            integer BswMActionListItemIndex: 0..255, post-build-variant-value=true, set at link in variant link-time / post-build in variant post-build / pre-compile in variant pre-compile  # This parameter defines the index of the action in the action list. It is used define in which order the actions shall be performed.
            choice reference BswMActionListItemRef: post-build-variant-value=true, set at link in variant link-time / post-build in variant post-build / pre-compile in variant pre-compile, destination=[BswMAction, BswMActionList, BswMRule]  # The action item can either be an atomic action or a reference to another action list or rule.
            symbolic name reference BswMReportFailToDemRef [0..1]: multiplicity set at link in variant link-time / post-build in variant post-build / pre-compile in variant pre-compile, post-build-variant-multiplicity=true, post-build-variant-value=true, set at link in variant link-time / post-build in variant post-build / pre-compile in variant pre-compile, destination=DemEventParameter  # If the reference is given, the DEM event shall be reported failed if this specific action returns E_NOT_OK; it shall be reported passed if this specific action returns E_OK.
        container BswMRteModeRequestPort [0..*]: multiplicity set at pre-compile  # This container defines a mode request port which the BswM may utilize to send a mode request to a SW-C which is acting as a mode-manager. If this container is referenced by a BswMRteModeRequest, the BswM shall create a corresponding PPort in its service description.
          foreign reference BswMRteModeRequestPortInterfaceMappingRef [0..1]: multiplicity set at link in variant link-time+post-build / pre-compile in variant pre-compile, set at link in variant link-time+post-build / pre-compile in variant pre-compile, destination-type=VARIABLE-AND-PARAMETER-INTERFACE-MAPPING  # This is a foreign reference to the variable and parameter interface mapping used for the mode request.
          instance reference BswMRteModeRequestPortInterfaceRef: set at link in variant link-time+post-build / pre-compile in variant pre-compile, destination-context=SW-COMPONENT-PROTOTYPE* PORT-PROTOTYPE, destination-type=VARIABLE-DATA-PROTOTYPE  # This is an instance reference to the variable data prototype used for the mode request.
        container BswMSwitchPort [0..*]: multiplicity set at pre-compile  # This container includes a reference to mode switch interface which the BswM must instantiate for the creation of a PPortPrototype in its SWCD.
          foreign reference BswMModeSwitchInterfaceRef: set at link in variant link-time+post-build / pre-compile in variant pre-compile, destination-type=MODE-SWITCH-INTERFACE  # Reference to the ModeSwitchInterface of this BswMModeSwitchPort.
    container BswMGeneral  # General configuration parameters of the Basic SW Mode Manager.
      boolean BswMCanSMEnabled: set at pre-compile, default-value=false  # enable/disable CanSM module related BswM API: | true: Enabled false: Disabled
      boolean BswMCanSMIcomEnabled: set at pre-compile, default-value=false  # enable/disable CanSM Icom related BswM API: | true: Enabled false: Disabled
      boolean BswMComMEnabled: set at pre-compile, default-value=false  # enable/disable ComM module related BswM API: | true: Enabled false: Disabled
      boolean BswMDcmEnabled: set at pre-compile, default-value=false  # enable/disable Dcm module related BswM API: | true: Enabled false: Disabled
      boolean BswMDevErrorDetect: set at pre-compile, default-value=false  # Switches the Development Error Detection and Notification ON or OFF. | true: Enabled false: Disabled
      boolean BswMEcuMEnabled: set at pre-compile, default-value=false  # enable/disable EcuM module related BswM API: | true: Enabled false: Disabled
      boolean BswMEthSMEnabled: set at pre-compile, default-value=false  # enable/disable EthSM module related BswM API: | true: Enabled false: Disabled
      boolean BswMFrSMEnabled: set at pre-compile, default-value=false  # enable/disable FrSM module related BswM API: | true: Enabled false: Disabled
      boolean BswMGenericRequestEnabled: set at pre-compile, default-value=false  # enable/disable Generic Request related BswM API: | true: Enabled false: Disabled
      boolean BswMJ1939DcmEnabled [0..1]: multiplicity set at pre-compile, set at pre-compile, default-value=false  # Enable/disable J1939Dcm module related BswM API: | true: Enabled false: Disabled
      boolean BswMJ1939NmEnabled: set at pre-compile, default-value=false  # Enable/disable J1939Nm module related BswM API. | true: Enabled false: Disabled
      boolean BswMLinSMEnabled: set at pre-compile, default-value=false  # enable/disable LinSM module related BswM API: | true: Enabled false: Disabled
      boolean BswMLinTPEnabled: set at pre-compile, default-value=false  # enable/disable LinTP module related BswM API: | true: Enabled false: Disabled
      float BswMMainFunctionPeriod [0..1]: 0..Inf, multiplicity set at link in variant link-time+post-build / pre-compile in variant pre-compile, set at link in variant link-time+post-build / pre-compile in variant pre-compile  # The cycle time of the periodic main function of BswM. Defined in seconds .
      boolean BswMNvMEnabled: set at pre-compile, default-value=false  # enable/disable NvM module related BswM API: | true: Enabled false: Disabled
      boolean BswMSchMEnabled: set at pre-compile, default-value=false  # enable/disable SchM module related BswM API: | true: Enabled false: Disabled
      boolean BswMVersionInfoApi: set at pre-compile, default-value=true  # Switches the possibility to read the version information with the service BswM_GetVersionInfo(). | true: Enabled false: Disabled
      boolean BswMWdgMEnabled: set at pre-compile, default-value=false  # enable/disable WdgM module related BswM API: | true: Enabled false: Disabled
      container BswMUserIncludeFiles [0..1]  # Collection of header file names which shall be included by the BswM.
        string BswMUserIncludeFile [1..*]: multiplicity set at pre-compile, set at pre-compile  # Header file name which shall be included by the BswM. | The value of this parameter shall be used as h-char-sequence or q-char-sequence according to ISO C90 section 6.10.2 "source file inclusion". The parameter value MUST NOT represent a path, since ISO C90 does not specify how such a path is treated (i.e., this is implementation defined (and additionally depends on the operating system and the underlying file system)).
  module definition Cal [0..1]: variants pre-compile  # Configuration of the Cal (CryptoAbstractionLibrary) module.
    container CalAsymDecrypt [0..1]  # Container for incorporation of AsymDecrypt primitives.
      integer CalAsymDecryptMaxCtxBufByteSize: 1..4294967295, set at pre-compile  # The maximum, in bytes, of all context buffers used in all CPL primitives which implement an asymmetrical decryption.
      integer CalAsymDecryptMaxKeySize: 1..4294967295, set at pre-compile  # The maximum, in bytes, of all key lengths used in all CPL primitives which implement an asymmetrical decryption.
      container CalAsymDecryptConfig [0..32]  # Container for configuration of service AsymDecrypt. The container name serves as a symbolic name for the identifier of a service configuration.
        string CalAsymDecryptInitConfiguration: set at pre-compile  # Name of a C symbol which contains the configuration of the underlying cryptographic primitive.
        string CalAsymDecryptPrimitiveName: set at pre-compile  # Name of the cryptographic primitive to use.
    container CalAsymEncrypt [0..1]  # Container for incorporation of AsymEncrypt primitives.
      integer CalAsymEncryptMaxCtxBufByteSize: 1..4294967295, set at pre-compile  # The maximum, in bytes, of all context buffers used in all CPL primitives which implement an asymmetrical encryption.
      integer CalAsymEncryptMaxKeySize: 1..4294967295, set at pre-compile  # The maximum, in bytes, of all key lengths used in all CPL primitives which implement an asymmetrical encryption.
      container CalAsymEncryptConfig [0..32]  # Container for configuration of service AsymEncrypt. The container name serves as a symbolic name for the identifier of a service configuration.
        string CalAsymEncryptInitConfiguration: set at pre-compile  # Name of a C symbol which contains the configuration of the underlying cryptographic primitive.
        string CalAsymEncryptPrimitiveName: set at pre-compile  # Name of the cryptographic primitive to use.
    container CalAsymPrivateKeyExtract [0..1]  # Container for incorporation of AsymPrivateKeyExtract primitives.
      integer CalAsymPrivateKeyExtractMaxCtxBufByteSize: 1..4294967295, set at pre-compile  # The maximum, in bytes, of all context buffers used in all CPL primitives which implement an asymmetrical private key extraction.
      integer CalAsymPrivateKeyExtractMaxKeySize: 1..4294967295, set at pre-compile  # The maximum, in bytes, of all key lengths used in all CPL primitives which implement an asymmetrical private key extraction.
      container CalAsymPrivateKeyExtractConfig [0..32]  # Container for configuration of service AsymPrivateKeyExtract. | The container name serves as a symbolic name for the identifier of a service configuration.
        string CalAsymPrivateKeyExtractInitConfiguration: set at pre-compile  # Name of a C symbol which contains the configuration of the underlying cryptographic primitive.
        string CalAsymPrivateKeyExtractPrimitiveName: set at pre-compile  # Name of the cryptographic primitive to use.
    container CalAsymPrivateKeyWrapAsym [0..1]  # Container for incorporation of AsymPrivateKeyWrapAsym primitives.
      integer CalAsymPrivateKeyWrapAsymMaxCtxBufByteSize: 1..4294967295, set at pre-compile  # The maximum, in bytes, of all context buffers used in all CPL primitives which implement a asymmetrical wrapping of the private part of an asymmetric key.
      integer CalAsymPrivateKeyWrapAsymMaxPrivKeySize: 1..4294967295, set at pre-compile  # The maximum length, in bytes, of all private information types used in all CPL primitives which implement an asymmetrical key wrapping.
      integer CalAsymPrivateKeyWrapAsymMaxPubKeySize: 1..4294967295, set at pre-compile  # The maximum length, in bytes, of all public key types used in all CPL primitives which implement an asymmetrical key wrapping.
      container CalAsymPrivateKeyWrapAsymConfig [0..32]  # Container for configuration of service AsymPrivateKeyWrapAsym. | The container name serves as a symbolic name for the identifier of a service configuration.
        string CalAsymPrivateKeyWrapAsymInitConfiguration: set at pre-compile  # Name of a C symbol which contains the configuration of the underlying cryptographic primitive.
        string CalAsymPrivateKeyWrapAsymPrimitiveName: set at pre-compile  # Name of the cryptographic primitive to use.
    container CalAsymPrivateKeyWrapSym [0..1]  # Container for incorporation of AsymPrivateKeyWrapSym primitives.
      integer CalAsymPrivateKeyWrapSymMaxCtxBufByteSize: 1..4294967295, set at pre-compile  # The maximum, in bytes, of all context buffers used in all CPL primitives which implement a symmetrical wrapping of the private part of an asymmetric key.
      integer CalAsymPrivateKeyWrapSymMaxPrivKeySize: 1..4294967295, set at pre-compile  # The maximum length, in bytes, of all private information types used in all CPL primitives which implement an asymmetrical key wrapping.
      integer CalAsymPrivateKeyWrapSymMaxSymKeySize: 1..4294967295, set at pre-compile  # The maximum, in bytes, of all key lengths used in all CPL primitives which implement an asymmetrical key wrapping.
      container CalAsymPrivateKeyWrapSymConfig [0..32]  # Container for configuration of service AsymPrivateKeyWrapSym. | The container name serves as a symbolic name for the identifier of a service configuration.
        string CalAsymPrivateKeyWrapSymInitConfiguration: set at pre-compile  # Name of a C symbol which contains the configuration of the underlying cryptographic primitive.
        string CalAsymPrivateKeyWrapSymPrimitiveName: set at pre-compile  # Name of the cryptographic primitive to use.
    container CalAsymPublicKeyExtract [0..1]  # Container for incorporation of AsymPublicKeyExtract primitives.
      integer CalAsymPublicKeyExtractMaxCtxBufByteSize: 1..4294967295, set at pre-compile  # The maximum, in bytes, of all context buffers used in all CPL primitives which implement an asymmetrical public key extraction.
      integer CalAsymPublicKeyExtractMaxKeySize: 1..4294967295, set at pre-compile  # The maximum, in bytes, of all key lengths used in all CPL primitives which implement an asymmetrical public key extraction.
      container CalAsymPublicKeyExtractConfig [0..32]  # Container for configuration of service AsymPublicKeyExtract. | The container name serves as a symbolic name for the identifier of a service configuration.
        string CalAsymPublicKeyExtractInitConfiguration: set at pre-compile  # Name of a C symbol which contains the configuration of the underlying cryptographic primitive.
        string CalAsymPublicKeyExtractPrimitiveName: set at pre-compile  # Name of the cryptographic primitive to use.
    container CalChecksum [0..1]  # Container for incorporation of Checksum primitives.
      integer CalChecksumMaxCtxBufByteSize: 1..4294967295, set at pre-compile  # The maximum, in bytes, of all context buffers used in all CPL primitives which implement a checksum computation.
      container CalChecksumConfig [0..32]  # Container for configuration of service Checksum. The container name serves as a symbolic name for the identifier of a service configuration.
        string CalChecksumInitConfiguration: set at pre-compile  # Name of a C symbol which contains the configuration of the underlying cryptographic primitive.
        string CalChecksumPrimitiveName: set at pre-compile  # Name of the cryptographic primitive to use.
    container CalCompression [0..1]  # Container for incorporation of Compression primitives.
      integer CalCompressMaxCtxBufByteSize: 1..4294967295, set at pre-compile  # The maximum, in bytes, of all context buffers used in all CPL primitives which implement a compression computation.
      container CalCompressionConfig [0..32]  # Container for configuration of service Compression. The container name serves as a symbolic name for the identifier of a service configuration.
        string CalCompressInitConfiguration: set at pre-compile  # Name of a C symbol which contains the configuration of the underlying cryptographic primitive.
        string CalCompressPrimitiveName: set at pre-compile  # Name of the cryptographic primitive to use.
    container CalDecompression [0..1]  # Container for incorporation of Decompression primitives.
      integer CalDecompressMaxCtxBufByteSize: 1..4294967295, set at pre-compile  # The maximum, in bytes, of all context buffers used in all CPL primitives which implement a decompression computation.
      container CalDecompressionConfig [0..32]  # Container for configuration of service Decompression. The container name serves as a symbolic name for the identifier of a service configuration.
        string CalDecompressInitConfiguration: set at pre-compile  # Name of a C symbol which contains the configuration of the underlying cryptographic primitive.
        string CalDecompressPrimitiveName: set at pre-compile  # Name of the cryptographic primitive to use.
    container CalGeneral  # Container for common configuration options.
      string CalMaxAlignScalarType: set at pre-compile  # The scalar type which has the maximum alignment restrictions on the given platform. | This type can be e.g. uint8, uint16 or uint32.
      boolean CalVersionInfoApi: set at pre-compile  # Pre-processor switch to enable and disable availability of the API Cal_GetVersionInfo(). True: API Cal_GetVersionInfo() is available. False: API Cal_GetVersionInfo() is not available.
    container CalHash [0..1]  # Container for incorporation of Hash primitives.
      integer CalHashMaxCtxBufByteSize: 1..4294967295, set at pre-compile  # The maximum, in bytes, of all context buffers used in all CPL primitives which implement a hash computation.
      container CalHashConfig [0..32]  # Configurations for the Hash service. The container name serves as a symbolic name for the identifier of a service configuration.
        string CalHashInitConfiguration: set at pre-compile  # Name of a C symbol which contains the configuration of the underlying cryptographic primitive.
        string CalHashPrimitiveName: set at pre-compile  # Name of the cryptographic primitive to use.
    container CalKeyDerive [0..1]  # Container for incorporation of KeyDerive primitives.
      integer CalKeyDeriveMaxCtxBufByteSize: 1..4294967295, set at pre-compile  # The maximum, in bytes, of all context buffers used in all CPL primitives which implement a key derivation.
      integer CalKeyDeriveMaxKeySize: 1..4294967295, set at pre-compile  # The maximum, in bytes, of all key lengths used in all CRL primitives which implement a key derivation.
      container CalKeyDeriveConfig [0..32]  # Container for configuration of service KeyDerive. The container name serves as a symbolic name for the identifier of a service configuration.
        string CalKeyDeriveInitConfiguration: set at pre-compile  # Name of a C symbol which contains the configuration of the underlying cryptographic primitive.
        string CalKeyDerivePrimitiveName: set at pre-compile  # Name of the cryptographic primitive to use.
    container CalKeyExchangeCalcPubVal [0..1]  # Container for incorporation of KeyExchangeCalcPubVal primitives.
      integer CalKeyExchangeCalcPubValMaxBaseTypeSize: 1..4294967295, set at pre-compile  # The maximum length, in bytes, of all base types used in all CPL primitives which implement a public value calculation.
      integer CalKeyExchangeCalcPubValMaxCtxBufByteSize: 1..4294967295, set at pre-compile  # The maximum, in bytes, of all context buffers used in all CPL primitives which implement a public value calculation.
      integer CalKeyExchangeCalcPubValMaxPrivateTypeSize: 1..4294967295, set at pre-compile  # The maximum length, in bytes, of all private information types used in all CPL primitives which implement a public value calculation.
      container CalKeyExchangeCalcPubValConfig [0..32]  # Container for configuration of service KeyExchangeCalcPubVal. The container name serves as a symbolic name for the identifier of a service configuration.
        string CalKeyExchangeCalcPubValInitConfiguration: set at pre-compile  # Name of a C symbol which contains the configuration of the underlying cryptographic primitive.
        string CalKeyExchangeCalcPubValPrimitiveName: set at pre-compile  # Name of the cryptographic primitive to use.
    container CalKeyExchangeCalcSecret [0..1]  # Container for incorporation of KeyExchangeCalcSecret primitives.
      integer CalKeyExchangeCalcSecretMaxBaseTypeSize: 1..4294967295, set at pre-compile  # The maximum length, in bytes, of all base types used in all CPL primitives which implement a shared secret calculation.
      integer CalKeyExchangeCalcSecretMaxCtxBufByteSize: 1..4294967295, set at pre-compile  # The maximum, in bytes, of all context buffers used in all CPL primitives which implement a shared secret calculation.
      integer CalKeyExchangeCalcSecretMaxPrivateTypeSize: 1..4294967295, set at pre-compile  # The maximum length, in bytes, of all private information types used in all CPL primitives which implement a shared secret calculation.
      container CalKeyExchangeCalcSecretConfig [0..32]  # Container for configuration of service KeyExchangeCalcSecret. The container name serves as a symbolic name for the identifier of a service configuration.
        string CalKeyExchangeCalcSecretInitConfiguration: set at pre-compile  # Name of a C symbol which contains the configuration of the underlying cryptographic primitive.
        string CalKeyExchangeCalcSecretPrimitiveName: set at pre-compile  # Name of the cryptographic primitive to use.
    container CalMacGenerate [0..1]  # Container for incorporation of MacGenerate primitives.
      integer CalMacGenerateMaxCtxBufByteSize: 1..4294967295, set at pre-compile  # The maximum, in bytes, of all context buffers used in all CPL primitives which implement a MAC generation.
      integer CalMacGenerateMaxKeySize: 1..4294967295, set at pre-compile  # The maximum, in bytes, of all key lengths used in all CPL primitives which implement a MAC generation.
      container CalMacGenerateConfig [0..32]  # Configurations for the MacGenerate service. The container name serves as a symbolic name for the identifier of a service configuration.
        string CalMacGenerateInitConfiguration: set at pre-compile  # Name of a C symbol which contains the configuration of the underlying cryptographic primitive.
        string CalMacGeneratePrimitiveName: set at pre-compile  # Name of the cryptographic primitive to use.
    container CalMacVerify [0..1]  # Container for incorporation of MacVerify primitives.
      integer CalMacVerifyMaxCtxBufByteSize: 1..4294967295, set at pre-compile  # The maximum, in bytes, of all context buffers used in all CPL primitives which implement a MAC verification.
      integer CalMacVerifyMaxKeySize: 1..4294967295, set at pre-compile  # The maximum, in bytes, of all key lengths used in all CPL primitives which implement a MAC verification.
      container CalMacVerifyConfig [0..32]  # Container for configuration of service MacVerify. The container name serves as a symbolic name for the identifier of a service configuration.
        string CalMacVerifyInitConfiguration: set at pre-compile  # Name of a C symbol which contains the configuration of the underlying cryptographic primitive.
        string CalMacVerifyPrimitiveName: set at pre-compile  # Name of the cryptographic primitive to use.
    container CalRandomGenerate [0..1]  # Container for incorporation of RandomGenerate primitives.
      container CalRandomGenerateConfig [0..32]  # Container for configuration of service RandomGenerate. The container name serves as a symbolic name for the identifier of a service configuration.
        string CalRandomGenerateInitConfiguration: set at pre-compile  # Name of a C symbol which contains the configuration of the underlying cryptographic primitive.
        string CalRandomGeneratePrimitiveName: set at pre-compile  # Name of the cryptographic primitive to use.
    container CalRandomSeed [0..1]  # Container for incorporation of RandomSeed primitives.
      integer CalRandomMaxCtxBufByteSize: 1..4294967295, set at pre-compile  # The maximum, in bytes, of all context buffers used in all CPL primitives which implement seeding or generating a random number.
      container CalRandomSeedConfig [0..32]  # Container for configuration of service RandomSeed. The container name serves as a symbolic name for the identifier of a service configuration.
        string CalRandomSeedInitConfiguration: set at pre-compile  # Name of a C symbol which contains the configuration of the underlying cryptographic primitive.
        string CalRandomSeedPrimitiveName: set at pre-compile  # Name of the cryptographic primitive to use.
    container CalSignatureGenerate [0..1]  # Container for incorporation of SignatureGenerate primitives
      integer CalSignatureGenerateMaxCtxBufByteSize: 1..4294967295, set at pre-compile  # The maximum, in bytes, of all context buffers used in all CPL primitives which implement a signature generation.
      integer CalSignatureGenerateMaxKeySize: 1..4294967295, set at pre-compile  # The maximum, in bytes, of all key lengths used in all CPL primitives which implement a signature generation.
      container CalSignatureGenerateConfig [0..32]  # Container for configuration of service SignatureGenerate. The container name serves as a symbolic name for the identifier of a service configuration.
        string CalSignatureGenerateInitConfiguration: set at pre-compile  # Name of a C symbol which contains the configuration of the underlying cryptographic primitive.
        string CalSignatureGeneratePrimitiveName: set at pre-compile  # Name of the cryptographic primitive to use.
    container CalSignatureVerify [0..1]  # Container for incorporation of SignatureVerify primitives.
      integer CalSignatureVerifyMaxCtxBufByteSize: 1..4294967295, set at pre-compile  # The maximum, in bytes, of all context buffers used in all CPL primitives which implement a signature verification.
      integer CalSignatureVerifyMaxKeySize: 1..4294967295, set at pre-compile  # The maximum, in bytes, of all key lengths used in all CPL primitives which implement a signature verification.
      container CalSignatureVerifyConfig [0..32]  # Container for configuration of service SignatureVerify. The container name serves as a symbolic name for the identifier of a service configuration.
        string CalSignatureVerifyInitConfiguration: set at pre-compile  # Name of a C symbol which contains the configuration of the underlying cryptographic primitive.
        string CalSignatureVerifyPrimitiveName: set at pre-compile  # Name of the cryptographic primitive to use.
    container CalSymBlockDecrypt [0..1]  # Container for incorporation of SymBlockDecrypt primitives.
      integer CalSymBlockDecryptMaxCtxBufByteSize: 1..4294967295, set at pre-compile  # The maximum, in bytes, of all context buffers used in all CPL primitives which implement a symmetrical block decryption.
      integer CalSymBlockDecryptMaxKeySize: 1..4294967295, set at pre-compile  # The maximum, in bytes, of all key lengths used in all CPL primitives which implement a symmetrical block decryption.
      container CalSymBlockDecryptConfig [0..32]  # Container for configuration of service SymBlockDecrypt. The container name serves as a symbolic name for the identifier of a service configuration.
        string CalSymBlockDecryptInitConfiguration: set at pre-compile  # Name of a C symbol which contains the configuration of the underlying cryptographic primitive.
        string CalSymBlockDecryptPrimitiveName: set at pre-compile  # Name of the cryptographic primitive to use.
    container CalSymBlockEncrypt [0..1]  # Container for incorporation of SymBlockEncrypt primitives.
      integer CalSymBlockEncryptMaxCtxBufByteSize: 1..4294967295, set at pre-compile  # The maximum, in bytes, of all context buffers used in all CPL primitives which implement a symmetrical block encryption.
      integer CalSymBlockEncryptMaxKeySize: 1..4294967295, set at pre-compile  # The maximum, in bytes, of all key lengths used in all CPL primitives which implement a symmetrical block encryption.
      container CalSymBlockEncryptConfig [0..32]  # Container for configuration of service SymBlockEncrypt. The container name serves as a symbolic name for the identifier of a service configuration.
        string CalSymBlockEncryptInitConfiguration: set at pre-compile  # Name of a C symbol which contains the configuration of the underlying cryptographic primitive.
        string CalSymBlockEncryptPrimitiveName: set at pre-compile  # Name of the cryptographic primitive to use.
    container CalSymDecrypt [0..1]  # Container for incorporation of SymDecrypt primitives
      integer CalSymDecryptMaxCtxBufByteSize: 1..4294967295, set at pre-compile  # The maximum, in bytes, of all context buffers used in all CPL primitives which implement a symmetrical decryption.
      integer CalSymDecryptMaxKeySize: 1..4294967295, set at pre-compile  # The maximum, in bytes, of all key lengths used in all CPL primitives which implement a symmetrical decryption.
      container CalSymDecryptConfig [0..32]  # Container for configuration of service SymDecrypt. | The container name serves as a symbolic name for the identifier of a service configuration.
        string CalSymDecryptInitConfiguration: set at pre-compile  # Name of a C symbol which contains the configuration of the underlying cryptographic primitive.
        string CalSymDecryptPrimitiveName: set at pre-compile  # Name of the cryptographic primitive to use.
    container CalSymEncrypt [0..1]  # Container for incorporation of SymEncrypt primitives.
      integer CalSymEncryptMaxCtxBufByteSize: 1..4294967295, set at pre-compile  # The maximum, in bytes, of all context buffers used in all CPL primitives which implement a symmetrical encryption.
      integer CalSymEncryptMaxKeySize: 1..4294967295, set at pre-compile  # The maximum, in bytes, of all key lengths used in all CPL primitives which implement a symmetrical encryption.
      container CalSymEncryptConfig [0..32]  # Container for configuration of service SymEncrypt. The container name serves as a symbolic name for the identifier of a service configuration.
        string CalSymEncryptInitConfiguration: set at pre-compile  # Name of a C symbol which contains the configuration of the underlying cryptographic primitive.
        string CalSymEncryptPrimitiveName: set at pre-compile  # Name of the cryptographic primitive to use.
    container CalSymKeyExtract [0..1]  # Container for incorporation of SymKeyExtract primitives.
      integer CalSymKeyExtractMaxCtxBufByteSize: 1..4294967295, set at pre-compile  # The maximum, in bytes, of all context buffers used in all CPL primitives which implement a symmetrical key extraction.
      integer CalSymKeyExtractMaxKeySize: 1..4294967295, set at pre-compile  # The maximum, in bytes, of all key lengths used in all CPL primitives which implement a symmetrical key extraction.
      container CalSymKeyExtractConfig [0..32]  # Container for configuration of service SymKeyExtract. The container name serves as a symbolic name for the identifier of a service configuration.
        string CalSymKeyExtractInitConfiguration: set at pre-compile  # Name of a C symbol which contains the configuration of the underlying cryptographic primitive.
        string CalSymKeyExtractPrimitiveName: set at pre-compile  # Name of the cryptographic primitive to use.
    container CalSymKeyWrapAsym [0..1]  # Container for incorporation of SymKeyWrapAsym primitives.
      integer CalSymKeyWrapAsymMaxCtxBufByteSize: 1..4294967295, set at pre-compile  # The maximum, in bytes, of all context buffers used in all CPL primitives which implement a asymmetrical wrapping of a symmetric key.
      integer CalSymKeyWrapAsymMaxPubKeySize: 1..4294967295, set at pre-compile  # The maximum length, in bytes, of all public key types used in all CPL primitives which implement a symmetrical key wrapping.
      integer CalSymKeyWrapAsymMaxSymKeySize: 1..4294967295, set at pre-compile  # The maximum, in bytes, of all key lengths used in all CPL primitives which implement a symmetrical key wrapping.
      container CalSymKeyWrapAsymConfig [0..32]  # Container for configuration of service SymKeyWrapAsym. | The container name serves as a symbolic name for the identifier of a service configuration.
        string CalSymKeyWrapAsymInitConfiguration: set at pre-compile  # Name of a C symbol which contains the configuration of the underlying cryptographic primitive.
        string CalSymKeyWrapAsymPrimitiveName: set at pre-compile  # Name of the cryptographic primitive to use.
    container CalSymKeyWrapSym [0..1]  # Container for incorporation of SymKeyWrapSym primitives.
      integer CalSymKeyWrapSymMaxCtxBufByteSize: 1..4294967295, set at pre-compile  # The maximum, in bytes, of all context buffers used in all CPL primitives which implement a symmetrical wrapping of a symmetric key.
      integer CalSymKeyWrapSymMaxSymKeySize: 1..4294967295, set at pre-compile  # The maximum, in bytes, of all key lengths used in all CPL primitives which implement a symmetrical key wrapping.
      container CalSymKeyWrapSymConfig [0..32]  # Container for configuration of service SymKeyWrapSym. | The container name serves as a symbolic name for the identifier of a service configuration.
        string CalSymKeyWrapSymInitConfiguration: set at pre-compile  # Name of a C symbol which contains the configuration of the underlying cryptographic primitive.
        string CalSymKeyWrapSymPrimitiveName: set at pre-compile  # Name of the cryptographic primitive to use.
  module definition Can [0..*]: post-build-variant-support=true, variants post-build/pre-compile  # This container holds the configuration of a single CAN Driver.
    container CanConfigSet  # This container contains the configuration parameters and sub containers of the AUTOSAR Can module.
      container CanController [1..*]  # This container contains the configuration parameters of the CAN controller(s).
        enumeration CanBusoffProcessing: {INTERRUPT, POLLING}, set at pre-compile  # Enables / disables API Can_MainFunction_BusOff() for handling busoff events in polling mode.
        boolean CanControllerActivation: set at pre-compile  # Defines if a CAN controller is used in the configuration.
        integer CanControllerBaseAddress: 0..4294967295, set at pre-compile  # Specifies the CAN controller base address.
        integer CanControllerId: 0..255, scope=ECU, set at pre-compile, symbolic-name-value=true  # This parameter provides the controller ID which is unique in a given CAN Driver. The value for this parameter starts with 0 and continue without any gaps.
        enumeration CanRxProcessing: {INTERRUPT, POLLING}, set at pre-compile  # Enables / disables API Can_MainFunction_Read() for handling PDU reception events in polling mode.
        enumeration CanTxProcessing: {INTERRUPT, POLLING}, set at pre-compile  # Enables / disables API Can_MainFunction_Write() for handling PDU transmission events in polling mode.
        boolean CanWakeupFunctionalityAPI: set at pre-compile, default-value=false  # Adds / removes the service Can_CheckWakeup() from the code. | True: Can_CheckWakeup can be used. False: Can_CheckWakeup cannot be used.
        enumeration CanWakeupProcessing: {INTERRUPT, POLLING}, set at pre-compile  # Enables / disables API Can_MainFunction_Wakeup() for handling wakeup events in polling mode.
        boolean CanWakeupSupport: set at pre-compile  # CAN driver support for wakeup over CAN Bus.
        reference CanControllerDefaultBaudrate: post-build-variant-value=true, set at post-build in variant post-build / pre-compile in variant pre-compile, destination=CanControllerBaudrateConfig  # Reference to baudrate configuration container configured for the Can Controller.
        reference CanCpuClockRef: set at pre-compile, destination=McuClockReferencePoint  # Reference to the CPU clock configuration, which is set in the MCU driver configuration
        symbolic name reference CanWakeupSourceRef [0..1]: multiplicity set at pre-compile, set at pre-compile, destination=EcuMWakeupSource  # This parameter contains a reference to the Wakeup Source for this controller as defined in the ECU State Manager. | Implementation Type: reference to EcuM_WakeupSourceType
        container CanControllerBaudrateConfig [1..*]  # This container contains bit timing related configuration parameters of the CAN controller(s).
          integer CanControllerBaudRate: 0..2000, post-build-variant-value=true, set at post-build in variant post-build / pre-compile in variant pre-compile  # Specifies the baudrate of the controller in kbps.
          integer CanControllerBaudRateConfigID: 0..65535, scope=ECU, post-build-variant-value=true, set at post-build in variant post-build / pre-compile in variant pre-compile, default-value=0  # Uniquely identifies a specific baud rate configuration. This ID is used by SetBaudrate API.
          integer CanControllerPropSeg: 0..255, post-build-variant-value=true, set at post-build in variant post-build / pre-compile in variant pre-compile  # Specifies propagation delay in time quantas.
          integer CanControllerSeg1: 0..255, post-build-variant-value=true, set at post-build in variant post-build / pre-compile in variant pre-compile  # Specifies phase segment 1 in time quantas.
          integer CanControllerSeg2: 0..255, post-build-variant-value=true, set at post-build in variant post-build / pre-compile in variant pre-compile  # Specifies phase segment 2 in time quantas.
          integer CanControllerSyncJumpWidth: 0..255, post-build-variant-value=true, set at post-build in variant post-build / pre-compile in variant pre-compile  # Specifies the synchronization jump width for the controller in time quantas.
          container CanControllerFdBaudrateConfig [0..1]  # This optional container contains bit timing related configuration parameters of the CAN controller(s) for payload and CRC of a CAN FD frame. If this container exists the controller supports CAN FD frames.
            integer CanControllerFdBaudRate: 0..16000, post-build-variant-value=true, set at post-build in variant post-build / pre-compile in variant pre-compile  # Specifies the data segment baud rate of the controller in kbps.
            integer CanControllerPropSeg: 0..255, post-build-variant-value=true, set at post-build in variant post-build / pre-compile in variant pre-compile  # Specifies propagation delay in time quantas.
            integer CanControllerSeg1: 0..255, post-build-variant-value=true, set at post-build in variant post-build / pre-compile in variant pre-compile  # Specifies phase segment 1 in time quantas.
            integer CanControllerSeg2: 0..255, post-build-variant-value=true, set at post-build in variant post-build / pre-compile in variant pre-compile  # Specifies phase segment 2 in time quantas.
            integer CanControllerSyncJumpWidth: 0..255, post-build-variant-value=true, set at post-build in variant post-build / pre-compile in variant pre-compile  # Specifies the synchronization jump width for the controller in time quantas.
            integer CanControllerTrcvDelayCompensationOffset [0..1]: 0..400, multiplicity set at post-build in variant post-build / pre-compile in variant pre-compile, post-build-variant-multiplicity=true, post-build-variant-value=true, set at post-build in variant post-build / pre-compile in variant pre-compile  # Specifies the Transceiver Delay Compensation Offset in ns. If not specified Transceiver Delay Compensation is disabled.
            boolean CanControllerTxBitRateSwitch: post-build-variant-value=true, set at post-build in variant post-build / pre-compile in variant pre-compile, default-value=true  # Specifies if the bit rate switching shall be used for transmissions. | If FALSE: CAN FD frames shall be sent without bit rate switching.
        container CanTTController [0..1]  # CanTTController is specified in the SWS TTCAN and contains the configuration parameters of the TTCAN controller(s) (which are needed in addition to the configuration parameters of the CAN controller(s)). | This container is only included and valid if TTCAN is supported by the controller, enabled (see CanSupportTTCANRef, ECUC_Can_00430), and used.
          integer CanTTControllerApplWatchdogLimit: 0..255, scope=ECU, post-build-variant-value=true, set at post-build in variant post-build / pre-compile in variant pre-compile  # Defines the maximum time period (unit is 256 times NTU) after which the application has to serve the watchdog.
          integer CanTTControllerCycleCountMax: 0..63, scope=ECU, post-build-variant-value=true, set at post-build in variant post-build / pre-compile in variant pre-compile  # Defines the value for cycle_count_max. | Allowed values: 0x00: 1 basic cycle 0x01: 2 basic cycles 0x03: 4 basic cycles 0x07: 8 basic cycles 0x0F: 16 basic cycles 0x1F: 32 basic cycles 0x3F: 64 basic cycles
          integer CanTTControllerExpectedTxTrigger: 0..255, post-build-variant-value=true, set at post-build in variant post-build / pre-compile in variant pre-compile  # Number of expected_tx_trigger.
          boolean CanTTControllerExternalClockSynchronisation: scope=ECU, post-build-variant-value=true, set at post-build in variant post-build / pre-compile in variant pre-compile  # Enables/disables the external clock synchronization. | TRUE: External clock synchronization enabled. FALSE: External clock synchronization disabled. This parameter shall only be configurable if parameter CanTTControllerLevel2 equals TRUE.
          boolean CanTTControllerGlobalTimeFiltering: post-build-variant-value=true, set at post-build in variant post-build / pre-compile in variant pre-compile  # Enables/disables the global time filtering. | TRUE: Global time filtering enabled. FALSE: Global time filtering disabled. This parameter shall only be configurable if parameter CanTTControllerLevel2 equals TRUE.
          integer CanTTControllerInitialRefOffset: 0..127, scope=ECU, post-build-variant-value=true, set at post-build in variant post-build / pre-compile in variant pre-compile  # Defines the initial value for ref trigger offset.
          integer CanTTControllerInterruptEnable: 0..1023, post-build-variant-value=true, set at post-build in variant post-build / pre-compile in variant pre-compile  # Enables/disables the respective interrupts. | Bit Position set to 1: Enable respective interrupt. Bit Position set to 0: Disable respective interrupt. Bit Position / Interrupt Source: 10: Application Watchdog. 9: Watch Trigger reached. 8: Initialization Watch Trigger reached. 7: Change of Error Level. 6: Tx Overflow. 5: Tx Underflow. 4: Global Time Error. 3: Gap. 2: Start of Cycle. 1: Time Discontinuity. 0: Master State Change. Bit position "1: Time Discontinuity" and "4: Global Time Error" shall only be configurable if parameter CanTTControllerLevel2 equals TRUE.
          boolean CanTTControllerLevel2: post-build-variant-value=true, set at post-build in variant post-build / pre-compile in variant pre-compile  # Defines whether Level 2 or Level 1 is used. | TRUE: Level 2. FALSE: Level 1. If this parameter is set to FALSE then all parameters with dependency to CanTTControllerLevel2 need not be configured.
          float CanTTControllerNTUConfig: 0..100, scope=ECU, post-build-variant-value=true, set at post-build in variant post-build / pre-compile in variant pre-compile  # Defines the config value for NTU (network time unit). | Value given in microseconds. The value configured shall be greater than 0. Together with the local oscillator period, the TUR (time unit ratio) can be derived from the NTU. This parameter shall only be configurable if parameter CanTTControllerLevel2 equals TRUE.
          enumeration CanTTControllerOperationMode: {CAN_TT_EVENT_SYNC_TIME_TRIGGERED, CAN_TT_EVENT_TRIGGERED, CAN_TT_TIME_TRIGGERED}, scope=ECU, post-build-variant-value=true, set at post-build in variant post-build / pre-compile in variant pre-compile  # Defines the operation mode.
          float CanTTControllerSyncDeviation: 0..100, post-build-variant-value=true, set at post-build in variant post-build / pre-compile in variant pre-compile  # Defines the maximum synchronization deviation: | Given as a percentage value of the NTU (network time unit). The value configured shall be greater than 0. This parameter shall only be configurable if parameter CanTTControllerLevel2 equals TRUE.
          boolean CanTTControllerTURRestore: post-build-variant-value=true, set at post-build in variant post-build / pre-compile in variant pre-compile  # Enables/disables the TUR restore. | Note that the value configured for TUR can be derived from the value configured for NTU and the local oscillator preriod. TRUE: TUR restore enabled. FALSE: TUR restore disabled. This parameter shall only be configurable if parameter CanTTControllerLevel2 equals TRUE.
          boolean CanTTControllerTimeMaster: scope=ECU, post-build-variant-value=true, set at post-build in variant post-build / pre-compile in variant pre-compile  # Defines whether the controller acts as a potential time master. | TRUE: Potential time master. FALSE: Time slave.
          integer CanTTControllerTimeMasterPriority: 0..7, scope=ECU, post-build-variant-value=true, set at post-build in variant post-build / pre-compile in variant pre-compile  # Defines the time master priority.
          integer CanTTControllerTxEnableWindowLength: 1..16, scope=ECU, post-build-variant-value=true, set at post-build in variant post-build / pre-compile in variant pre-compile  # Length of the tx enable window given in CAN bit times. | Definition parameter "CanTTControllerTxEnableWindowlength" is used such that: Length of enable window = CanTTControllerTxEnableWindowLength + 1
          integer CanTTControllerWatchTriggerGapTimeMark: 0..65535, post-build-variant-value=true, set at post-build in variant post-build / pre-compile in variant pre-compile  # watch trigger time mark after a gap
          integer CanTTControllerWatchTriggerTimeMark: 0..65535, post-build-variant-value=true, set at post-build in variant post-build / pre-compile in variant pre-compile  # watch trigger time mark
          enumeration CanTTIRQProcessing: {INTERRUPT, POLLING}, scope=ECU, post-build-variant-value=true, set at post-build in variant post-build / pre-compile in variant pre-compile  # Enables / disables API Can_MainFunction_BusOff() for handling busoff events in polling mode.
      container CanHardwareObject [1..*]  # This container contains the configuration (parameters) of CAN Hardware Objects.
        integer CanFdPaddingValue [0..1]: 0..255, scope=ECU, multiplicity set at post-build in variant post-build / pre-compile in variant pre-compile, post-build-variant-multiplicity=true, post-build-variant-value=true, set at post-build in variant post-build / pre-compile in variant pre-compile, default-value=0  # Specifies the value which is used to pad unspecified data in CAN FD frames > 8 bytes for transmission. This is necessary due to the discrete possible values of the DLC if > 8 bytes. | If the length of a PDU which was requested to be sent does not match the allowed DLC values, the remaining bytes up to the next possible value shall be padded with this value.
        enumeration CanHandleType: {BASIC, FULL}, scope=ECU, post-build-variant-value=true, set at post-build in variant post-build / pre-compile in variant pre-compile  # Specifies the type (Full-CAN or Basic-CAN) of a hardware object.
        integer CanHwObjectCount [0..1]: 0..65535, scope=ECU, multiplicity set at post-build in variant post-build / pre-compile in variant pre-compile, post-build-variant-multiplicity=true, post-build-variant-value=true, set at post-build in variant post-build / pre-compile in variant pre-compile, default-value=1  # Number of hardware objects used to implement one HOH. In case of a HRH this parameter defines the number of elements in the hardware FIFO or the number of shadow buffers, in case of a HTH it defines the number of hardware objects used for multiplexed transmission or for a hardware FIFO used by a FullCAN HTH.
        enumeration CanIdType: {EXTENDED, MIXED, STANDARD}, scope=ECU, post-build-variant-value=true, set at post-build in variant post-build / pre-compile in variant pre-compile  # Specifies whether the IdValue is of type | - standard identifier - extended identifier - mixed mode ImplementationType: Can_IdType
        integer CanObjectId: 0..65535, scope=ECU, set at pre-compile, symbolic-name-value=true  # Holds the handle ID of HRH or HTH. The value of this parameter is unique in a given CAN Driver, and it should start with 0 and continue without any gaps. | The HRH and HTH Ids share a common ID range. Example: HRH0-0, HRH1-1, HTH0-2, HTH1-3
        enumeration CanObjectType: {RECEIVE, TRANSMIT}, scope=ECU, post-build-variant-value=true, set at post-build in variant post-build / pre-compile in variant pre-compile  # Specifies if the HardwareObject is used as Transmit or as Receive object
        boolean CanTriggerTransmitEnable [0..1]: scope=ECU, set at pre-compile, default-value=false  # This parameter defines if or if not Can supports the trigger-transmit API for this handle.
        reference CanControllerRef: post-build-variant-value=true, set at post-build in variant post-build / pre-compile in variant pre-compile, destination=CanController  # Reference to CAN Controller to which the HOH is associated to.
        reference CanMainFunctionRWPeriodRef [0..1]: multiplicity set at post-build in variant post-build / pre-compile in variant pre-compile, post-build-variant-multiplicity=true, post-build-variant-value=true, set at post-build in variant post-build / pre-compile in variant pre-compile, destination=CanMainFunctionRWPeriods  # Reference to CanMainFunctionPeriod
        container CanHwFilter [0..*]  # This container is only valid for HRHs and contains the configuration (parameters) of one hardware filter.
          integer CanHwFilterCode: 0..4294967295, post-build-variant-value=true, set at post-build in variant post-build / pre-compile in variant pre-compile  # Specifies (together with the filter mask) the identifiers range that passes the hardware filter.
          integer CanHwFilterMask: 0..4294967295, post-build-variant-value=true, set at post-build in variant post-build / pre-compile in variant pre-compile  # Describes a mask for hardware-based filtering of CAN identifiers. The CAN identifiers of incoming messages are masked with the appropriate CanFilterMaskValue. Bits holding a 0 mean don't care, i.e. do not compare the message's identifier in the respective bit position. | The mask shall be build by filling with leading 0. In case of CanIdType EXTENDED or MIXED a 29 bit mask shall be build. In case of CanIdType STANDARD a 11 bit mask shall be build
        container CanTTHardwareObjectTrigger [0..*]  # CanTTHardwareObjectTrigger is specified in the SWS TTCAN and contains the configuration (parameters) of TTCAN triggers for Hardware Objects, which are additional to the configuration (parameters) of CAN Hardware Objects. | This container is only included and valid if TTCAN is supported by the controller and, enabled (see CanSupportTTCANRef, ECUC_Can_00430), and used.
          integer CanTTHardwareObjectBaseCycle: 0..63, scope=ECU, post-build-variant-value=true, set at post-build in variant post-build / pre-compile in variant pre-compile  # Defines the cycle_offset. | CanTTHardwareObjectBaseCycle must be not greater than cycle_count_max.
          integer CanTTHardwareObjectCycleRepetition: 1..64, scope=ECU, post-build-variant-value=true, set at post-build in variant post-build / pre-compile in variant pre-compile  # Defines the repeat_factor. | CanTTHardwareObjectCycleRepetition shall be a power of two (2), greater than cycle_offset but not greater than cycle_count_max + 1.
          integer CanTTHardwareObjectTimeMark: 0..65535, post-build-variant-value=true, set at post-build in variant post-build / pre-compile in variant pre-compile  # Defines the point in time, when the trigger will be activated. | Value is given in cycle time.
          integer CanTTHardwareObjectTriggerId: 0..63, set at pre-compile, symbolic-name-value=true  # Sequential number which allows separation of different TTCAN triggers configured for one and the same hardware object.
          enumeration CanTTHardwareObjectTriggerType: {CAN_TT_RX_TRIGGER, CAN_TT_TX_REF_TRIGGER, CAN_TT_TX_REF_TRIGGER_GAP, CAN_TT_TX_TRIGGER_EXCLUSIVE, CAN_TT_TX_TRIGGER_MERGED, CAN_TT_TX_TRIGGER_SINGLE}, post-build-variant-value=true, set at post-build in variant post-build / pre-compile in variant pre-compile  # Defines the type of the trigger associated with the hardware object. This parameter depends on plain CAN parameter CAN_OBJECT_TYPE. | If CAN_OBJECT_TYPE equals RECEIVE than this parameter is fixed to CAN_TT_RX_TRIGGER. If CAN_OBJECT_TYPE equals TRANSMIT than one of the following literals is configurable: CAN_TT_TX_REF_TRIGGER, CAN_TT_TX_REF_TRIGGER_GAP, CAN_TT_TX_TRIGGER_MERGED, CAN_TT_TX_TRIGGER_SINGLE, CAN_TT_TX_TRIGGER_EXCLUSIVE.
      container CanIcom [0..1]  # This container contains the parameters for configuring pretended networking
        container CanIcomConfig [1..*]  # This container contains the configuration parameters of the ICOM Configuration.
          integer CanIcomConfigId: 1..255, scope=ECU, set at pre-compile  # This parameter identifies the ID of the ICOM configuration.
          boolean CanIcomWakeOnBusOff: scope=ECU, set at pre-compile, default-value=true  # This parameter defines that the MCU shall wake if the bus off is detected or not.
          container CanIcomWakeupCauses  # This container contains the configuration parameters of the wakeup causes to leave the power saving mode.
            container CanIcomRxMessage [1..*]  # This container contains the configuration parameters for the wakeup causes for matching received messages. It has to be configured as often as received messages are defined as wakeup cause. | constraint: For all CanIcomRxMessage instances the Message IDs which are defined in CanIcomMessageId and in CanIcomRxMessageIdMask shall not overlap.
              integer CanIcomCounterValue [0..1]: 1..65536, scope=ECU, multiplicity set at pre-compile, set at pre-compile  # This parameter defines that the MCU shall wake if the message with the ID is received n times on the communication channel.
              integer CanIcomMessageId: 0..536870912, scope=ECU, multiplicity set at pre-compile, set at pre-compile  # This parameter defines the message ID the wakeup causes of this CanIcomRxMessage are configured for. In addition a mask (CanIcomMessageIdMask) can be defined, in that case it is possible to define a range of rx messages, which can create a wakeup condition.
              integer CanIcomMessageIdMask [0..1]: 0..536870912, scope=ECU, multiplicity set at pre-compile, set at pre-compile  # Describes a mask for filtering of CAN identifiers. The CAN identifiers of incoming messages are masked with this CanIcomMessageIdMask. If the masked identifier matches the masked value of CanIcomMessageId, it can create a wakeup condition for this CanIcomRxMessage. Bits holding a 0 mean don't care, i.e. do not compare the message's identifier in the respective bit position. The mask shall be build by filling with leading 0.
              float CanIcomMissingMessageTimerValue [0..1]: scope=ECU, multiplicity set at pre-compile, set at pre-compile  # This parameter defines that the MCU shall wake if the message with the ID is not received for a specific time in s on the | communication channel.
              boolean CanIcomPayloadLengthError: scope=ECU, set at pre-compile, default-value=false  # This parameter defines that the MCU shall wake if a payload error occurs
              container CanIcomRxMessageSignalConfig [0..*]  # This container contains the configuration parameters for the wakeup causes for matching signals. | It has to be configured as often as a signal is defined as wakeup cause. If at least one Signal conditions defined in a CanIcomRxMessageSignalConfig evaluates to true or if no CanIcomRxMessageSignalConfig are defined, the whole wakeup condition is considered to be true. All instances of this container refer to the same frame/pdu (see CanIcomMessageId).
                integer CanIcomSignalMask: 0..18446744073709551615, set at pre-compile  # This parameter shall be used to mask a signal in the payload of a CAN message. | The mask is binary AND with the signal payload. The result will be used in combination of the operations defined in CanIcomSignalOperation with the CanIcomSignalValue.
                enumeration CanIcomSignalOperation: {AND, EQUAL, GREATER, SMALLER, XOR}, scope=ECU, set at pre-compile  # This parameter defines the operation, which shall be used to verify the signal value creates a wakeup condition.
                integer CanIcomSignalValue: 0..18446744073709551615, set at pre-compile  # This parameter shall be used to define a signal value which shall be compared (CanIcomSignalOperation) with the masked CanIcomSignalMask value of the received signal (CanIcomSignalRef).
                reference CanIcomSignalRef [0..1]: scope=ECU, multiplicity set at pre-compile, set at pre-compile, destination=ComSignal  # This parameter defines a reference to the signal which shall be checked additional to the message id (CanIcomMessageId). | This reference is used for documentation to define which ComSignal originates this filter setting. All signals being referred by this reference shall point to the same PDU.
    container CanGeneral  # This container contains the parameters related each CAN Driver Unit.
      boolean CanDevErrorDetection: set at pre-compile  # Switches the Development Error Detection and Notification ON or OFF.
      integer CanIndex: 0..255, set at pre-compile  # Specifies the InstanceId of this module instance. If only one instance is present it shall have the Id 0.
      function name CanLPduReceiveCalloutFunction [0..1]: multiplicity set at pre-compile, set at pre-compile  # This parameter defines the existence and the name of a callout function that is called after a successful | reception of a received CAN Rx L-PDU. If this parameter is omitted no callout shall take place.
      float CanMainFunctionBusoffPeriod [0..1]: 0.001..65.535, multiplicity set at pre-compile, set at pre-compile  # This parameter describes the period for cyclic call to Can_MainFunction_Busoff. Unit is seconds.
      float CanMainFunctionModePeriod: 0.001..65.535, set at pre-compile  # This parameter describes the period for cyclic call to Can_MainFunction_Mode. Unit is seconds.
      float CanMainFunctionWakeupPeriod [0..1]: 0.001..65.535, multiplicity set at pre-compile, set at pre-compile  # This parameter describes the period for cyclic call to Can_MainFunction_Wakeup. Unit is seconds.
      boolean CanMultiplexedTransmission: scope=ECU, set at pre-compile  # Specifies if multiplexed transmission shall be supported.ON or OFF
      boolean CanPublicIcomSupport: scope=ECU, set at pre-compile, default-value=false  # Selects support of Pretended Network features in Can driver. | True: Enabled False: Disabled
      boolean CanSetBaudrateApi [0..1]: scope=ECU, multiplicity set at pre-compile, set at pre-compile, default-value=false  # The support of the Can_SetBaudrate API is optional. | If this parameter is set to true the Can_SetBaudrate API shall be supported. Otherwise the API is not supported.
      float CanTimeoutDuration: 1E-6..65.535, set at pre-compile  # Specifies the maximum time for blocking function until a timeout is detected. Unit is seconds.
      boolean CanVersionInfoApi: set at pre-compile  # Switches the Can_GetVersionInfo() API ON or OFF.
      reference CanOsCounterRef [0..1]: multiplicity set at pre-compile, set at pre-compile, destination=OsCounter  # This parameter contains a reference to the OsCounter, which is used by the CAN driver.
      reference CanSupportTTCANRef: scope=ECU, set at pre-compile, destination=CanIfPrivateCfg  # The parameter refers to CanIfSupportTTCAN parameter in the CAN Interface Module configuration. | The CanIfSupportTTCAN parameter defines whether TTCAN is supported.
      container CanIcomGeneral [0..1]  # This container contains the general configuration parameters of the ICOM Configuration.
        enumeration CanIcomLevel [0..1]: {CAN_ICOM_LEVEL_ONE, CAN_ICOM_LEVEL_TWO}, scope=ECU, multiplicity set at pre-compile, set at pre-compile, default-value=CAN_ICOM_LEVEL_ONE  # Defines the level of Pretended Networking. | This parameter is reserved for future implementations (Pretended Networking level 2).
        enumeration CanIcomVariant: {CAN_ICOM_VARIANT_HW, CAN_ICOM_VARIANT_NONE, CAN_ICOM_VARIANT_SW}, scope=ECU, set at pre-compile, default-value=CAN_ICOM_VARIANT_NONE  # Defines the variant, which is supported by this CanController
      container CanMainFunctionRWPeriods [0..*]  # This container contains the parameter for configuring the period for cyclic call to Can_MainFunction_Read or Can_MainFunction_Write depending on the referring item.
        float CanMainFunctionPeriod: 0.001..65.535, set at pre-compile  # This parameter describes the period for cyclic call to Can_MainFunction_Read or Can_MainFunction_Write depending on the referring item. Unit is seconds. Different poll-cycles will be configurable if more than one CanMainFunctionPeriod is configured. In this case multiple Can_MainFunction_Read() or Can_MainFunction_Write() will be provided by the CAN Driver module.
  module definition CanIf [0..1]: post-build-variant-support=true, variants link-time/post-build/pre-compile  # This container includes all necessary configuration sub-containers according the CAN Interface configuration structure.
    container CanIfCtrlDrvCfg [1..*]: multiplicity set at pre-compile  # Configuration parameters for all the underlying CAN Driver modules are aggregated under this container. For each CAN Driver module a seperate instance of this container has to be provided.
      reference CanIfCtrlDrvInitHohConfigRef: set at link in variant link-time+post-build / pre-compile in variant pre-compile, destination=CanIfInitHohCfg  # Reference to the Init Hoh Configuration
      reference CanIfCtrlDrvNameRef: set at pre-compile, destination=CanGeneral  # CAN Interface Driver Reference. | This reference can be used to get any information (Ex. Driver Name, Vendor ID) from the CAN driver. The CAN Driver name can be derived from the ShortName of the CAN driver module.
      container CanIfCtrlCfg [1..*]: multiplicity set at pre-compile  # This container contains the configuration (parameters) of an adressed CAN controller by an underlying CAN Driver module. This container is configurable per CAN controller.
        integer CanIfCtrlId: 0..255, scope=ECU, set at link in variant link-time+post-build / pre-compile in variant pre-compile, symbolic-name-value=true  # This parameter abstracts from the CAN Driver specific parameter Controller. Each controller of all connected CAN Driver modules shall be assigned to one specific ControllerId of the CanIf. | Range: 0..number of configured controllers of all CAN Driver modules
        boolean CanIfCtrlWakeupSupport: scope=ECU, set at link in variant link-time+post-build / pre-compile in variant pre-compile, default-value=false  # This parameter defines if a respective controller of the referenced CAN Driver modules is queriable for wake up events. | True: Enabled False: Disabled
        symbolic name reference CanIfCtrlCanCtrlRef: scope=ECU, set at link in variant link-time+post-build / pre-compile in variant pre-compile, destination=CanController  # This parameter references to the logical handle of the underlying CAN controller from the CAN Driver module to be served by the CAN Interface module. The following parameters of CanController config container shall be referenced by this link: CanControllerId, CanWakeupSourceRef | Range: 0..max. number of underlying supported CAN controllers
    container CanIfDispatchCfg  # Callback functions provided by upper layer modules of the CanIf. The callback functions defined in this container are common to all configured CAN Driver / CAN Transceiver Driver modules.
      function name CanIfDispatchUserCheckTrcvWakeFlagIndicationName [0..1]: scope=ECU, multiplicity set at link in variant link-time+post-build / pre-compile in variant pre-compile, set at link in variant link-time+post-build / pre-compile in variant pre-compile  # This parameter defines the name of <User_ClearTrcvWufFlagIndication>. | If CANIF_DISPATCH_USERCHECKTRCVWAKEFLAGINDICATION_UL equals CAN_SM the name of <User_CheckTrcvWakeFlagIndication> is fixed. If it equals CDD, the name is selectable. If CANIF_PUBLIC_PN_SUPPORT equals False, this parameter shall not be configurable.
      enumeration CanIfDispatchUserCheckTrcvWakeFlagIndicationUL [0..1]: {CAN_SM, CDD}, scope=ECU, multiplicity set at link in variant link-time+post-build / pre-compile in variant pre-compile, set at link in variant link-time+post-build / pre-compile in variant pre-compile  # This parameter defines the upper layer module to which the CheckTrcvWakeFlagIndication from the Driver modules have to be routed. | If CANIF_PUBLIC_PN_SUPPORT equals False, this parameter shall not be configurable.
      function name CanIfDispatchUserClearTrcvWufFlagIndicationName [0..1]: scope=ECU, multiplicity set at link in variant link-time+post-build / pre-compile in variant pre-compile, set at link in variant link-time+post-build / pre-compile in variant pre-compile  # This parameter defines the name of <User_ClearTrcvWufFlagIndication>. | If CANIF_DISPATCH_USERCLEARTRCVWUFFLAGINDICATION_UL equals CAN_SM the name of <User_ClearTrcvWufFlagIndication> is fixed. If it equals CDD, the name is selectable. If CANIF_PUBLIC_PN_SUPPORT equals False, this parameter shall not be configurable.
      enumeration CanIfDispatchUserClearTrcvWufFlagIndicationUL [0..1]: {CAN_SM, CDD}, scope=ECU, multiplicity set at link in variant link-time+post-build / pre-compile in variant pre-compile, set at link in variant link-time+post-build / pre-compile in variant pre-compile  # This parameter defines the upper layer module to which the ClearTrcvWufFlagIndication from the Driver modules have to be routed. | If CANIF_PUBLIC_PN_SUPPORT equals False, this parameter shall not be configurable.
      function name CanIfDispatchUserConfirmPnAvailabilityName [0..1]: scope=ECU, multiplicity set at link in variant link-time+post-build / pre-compile in variant pre-compile, set at link in variant link-time+post-build / pre-compile in variant pre-compile  # This parameter defines the name of <User_ConfirmPnAvailability>. If CANIF_DISPATCH_USERCONFIRMPNAVAILABILITY_UL equals CAN_SM the name of <User_ConfirmPnAvailability> is fixed. If it equals CDD, the name is selectable. If CANIF_PUBLIC_PN_SUPPORT equals False, this parameter shall not be configurable.
      enumeration CanIfDispatchUserConfirmPnAvailabilityUL [0..1]: {CAN_SM, CDD}, scope=ECU, multiplicity set at link in variant link-time+post-build / pre-compile in variant pre-compile, set at link in variant link-time+post-build / pre-compile in variant pre-compile  # This parameter defines the upper layer module to which the ConfirmPnAvailability notification from the Driver modules have to be routed. If CANIF_PUBLIC_PN_SUPPORT equals False, this parameter shall not be configurable.
      function name CanIfDispatchUserCtrlBusOffName [0..1]: scope=ECU, multiplicity set at link in variant link-time+post-build / pre-compile in variant pre-compile, set at link in variant link-time+post-build / pre-compile in variant pre-compile, max-length=32, min-length=1  # This parameter defines the name of <User_ControllerBusOff>. | This parameter depends on the parameter CANIF_USERCTRLBUSOFF_UL. If CANIF_USERCTRLBUSOFF_UL equals CAN_SM the name of <User_ControllerBusOff> is fixed. If CANIF_USERCTRLBUSOFF_UL equals CDD, the name of <User_ControllerBusOff> is selectable.
      enumeration CanIfDispatchUserCtrlBusOffUL: {CAN_SM, CDD}, scope=ECU, set at link in variant link-time+post-build / pre-compile in variant pre-compile  # This parameter defines the upper layer (UL) module to which the notifications of all ControllerBusOff events from the CAN Driver modules have to be routed via <User_ControllerBusOff>. | There is no possibility to configure no upper layer (UL) module as the provider of <User_ControllerBusOff>.
      function name CanIfDispatchUserCtrlModeIndicationName [0..1]: scope=ECU, multiplicity set at link in variant link-time+post-build / pre-compile in variant pre-compile, set at link in variant link-time+post-build / pre-compile in variant pre-compile, max-length=32, min-length=1  # This parameter defines the name of <User_ControllerModeIndication>. | This parameter depends on the parameter CANIF_USERCTRLMODEINDICATION_UL. If CANIF_USERCTRLMODEINDICATION_UL equals CAN_SM the name of <User_ControllerModeIndication> is fixed. If CANIF_USERCTRLMODEINDICATION_UL equals CDD, the name of <User_ControllerModeIndication> is selectable.
      enumeration CanIfDispatchUserCtrlModeIndicationUL: {CAN_SM, CDD}, scope=ECU, set at link in variant link-time+post-build / pre-compile in variant pre-compile  # This parameter defines the upper layer (UL) module to which the notifications of all ControllerTransition events from the CAN Driver modules have to be routed | via <User_ControllerModeIndication>.
      function name CanIfDispatchUserTrcvModeIndicationName [0..1]: scope=ECU, multiplicity set at link in variant link-time+post-build / pre-compile in variant pre-compile, set at link in variant link-time+post-build / pre-compile in variant pre-compile, max-length=32, min-length=1  # This parameter defines the name of <User_TrcvModeIndication>. | This parameter depends on the parameter CANIF_USERTRCVMODEINDICATION_UL. If CANIF_USERTRCVMODEINDICATION_UL equals CAN_SM the name of <User_TrcvModeIndication> is fixed. If CANIF_USERTRCVMODEINDICATION_UL equals CDD, the name of <User_TrcvModeIndication> is selectable.
      enumeration CanIfDispatchUserTrcvModeIndicationUL [0..1]: {CAN_SM, CDD}, scope=ECU, multiplicity set at link in variant link-time+post-build / pre-compile in variant pre-compile, set at link in variant link-time+post-build / pre-compile in variant pre-compile  # This parameter defines the upper layer (UL) module to which the notifications of all TransceiverTransition events from the CAN Transceiver Driver modules have to be routed via <User_TrcvModeIndication>. If no UL module is configured, no upper layer callback function will be called.
      function name CanIfDispatchUserValidateWakeupEventName [0..1]: scope=ECU, multiplicity set at link in variant link-time+post-build / pre-compile in variant pre-compile, set at link in variant link-time+post-build / pre-compile in variant pre-compile, max-length=32, min-length=1  # This parameter defines the name of <User_ValidateWakeupEvent>. This | parameter depends on the parameter CANIF_USERVALIDATEWAKEUPEVENT_UL. CANIF_USERVALIDATEWAKEUPEVENT_UL equals ECUM the name of <User_ValidateWakeupEvent> is fixed. CANIF_USERVALIDATEWAKEUPEVENT_UL equals CDD, the name of <User_ValidateWakeupEvent> is selectable. If parameter CANIF_WAKEUP_CHECK_VALIDATION_API is disabled, no <User_ValidateWakeupEvent> API can be configured.
      enumeration CanIfDispatchUserValidateWakeupEventUL [0..1]: {CDD, ECUM}, scope=ECU, multiplicity set at link in variant link-time+post-build / pre-compile in variant pre-compile, set at link in variant link-time+post-build / pre-compile in variant pre-compile  # This parameter defines the upper layer (UL) module to which the notifications about positive former requested wake up sources have to be routed via <User_ValidateWakeupEvent>. If parameter CANIF_WAKEUP_CHECK_VALIDATION_API is disabled, this parameter cannot be configured.
    container CanIfInitCfg  # This container contains the init parameters of the CAN Interface.
      string CanIfInitCfgSet: post-build-variant-value=true, set at link in variant link-time / post-build in variant post-build / pre-compile in variant pre-compile, max-length=32, min-length=1  # Selects the CAN Interface specific configuration setup. This type of the external data structure shall contain the post build initialization data for the CAN Interface for all underlying CAN Dirvers. | constant to CanIf_ConfigType
      integer CanIfMaxBufferSize [0..1]: 0..18446744073709551615, multiplicity set at link in variant link-time+post-build / pre-compile in variant pre-compile, set at link in variant link-time+post-build / pre-compile in variant pre-compile  # Maximum total size of all Tx buffers. This parameter is needed only in case of post-build loadable implementation using static memory | allocation.
      integer CanIfMaxRxPduCfg [0..1]: 0..18446744073709551615, multiplicity set at link in variant link-time+post-build / pre-compile in variant pre-compile, set at link in variant link-time+post-build / pre-compile in variant pre-compile  # Maximum number of Pdus. This parameter is needed only in case of post-build loadable implementation using static memory allocation.
      integer CanIfMaxTxPduCfg [0..1]: 0..18446744073709551615, multiplicity set at link in variant link-time+post-build / pre-compile in variant pre-compile, set at link in variant link-time+post-build / pre-compile in variant pre-compile  # Maximum number of Pdus. This parameter is needed only in case of post-build loadable implementation using static memory allocation.
      container CanIfBufferCfg [0..*]: multiplicity set at link in variant link-time / post-build in variant post-build / pre-compile in variant pre-compile  # This container contains the Txbuffer configuration. Multiple buffers with different sizes could be configured. If CanIfBufferSize (ECUC_CanIf_00834) equals 0, the CanIf Tx L-PDU only refers via this CanIfBufferCfg the corresponding CanIfHthCfg.
        integer CanIfBufferSize: 0..255, post-build-variant-value=true, set at link in variant link-time / post-build in variant post-build / pre-compile in variant pre-compile, default-value=0  # This parameter defines the number of CanIf Tx L-PDUs which can be buffered in one Txbuffer. If this value equals 0, the CanIf does not perform Txbuffering for the CanIf Tx L-PDUs which are assigned to this Txbuffer. If CanIfPublicTxBuffering equals False, this parameter equals 0 for all TxBuffer. If the CanHandleType of the referred HTH equals FULL, this parameter equals 0 for this TxBuffer.
        reference CanIfBufferHthRef: post-build-variant-value=true, set at link in variant link-time / post-build in variant post-build / pre-compile in variant pre-compile, destination=CanIfHthCfg  # Reference to HTH, that defines the hardware object or the pool of hardware objects configured for transmission. All the CanIf Tx L-PDUs refer via the CanIfBufferCfg and this parameter to the HTHs if TxBuffering is enabled, or not. | Each HTH shall not be assigned to more than one buffer.
      container CanIfInitHohCfg [0..*]: multiplicity set at pre-compile  # This container contains the references to the configuration setup of each underlying CAN Driver.
        container CanIfHrhCfg [0..*]: multiplicity set at link in variant link-time / post-build in variant post-build / pre-compile in variant pre-compile  # This container contains configuration parameters for each hardware receive object (HRH).
          boolean CanIfHrhSoftwareFilter: set at link in variant link-time+post-build / pre-compile in variant pre-compile, default-value=true  # Selects the hardware receive objects by using the HRH range/list from CAN Driver configuration to define, for which HRH a software filtering has to be performed at during receive processing. | True: Software filtering is enabled False: Software filtering is enabled
          reference CanIfHrhCanCtrlIdRef: scope=ECU, set at link in variant link-time+post-build / pre-compile in variant pre-compile, destination=CanIfCtrlCfg  # Reference to controller Id to which the HRH belongs to. A controller can contain one or more HRHs.
          symbolic name reference CanIfHrhIdSymRef: scope=ECU, post-build-variant-value=true, set at link in variant link-time / post-build in variant post-build / pre-compile in variant pre-compile, destination=CanHardwareObject  # The parameter refers to a particular HRH object in the CanDrv configuration (see CanHardwareObject ECUC_Can_00324). | CanIf receives the following information of the CanDrv module by this reference: - CanHandleType (see ECUC_Can_00323) - CanObjectId (see ECUC_Can_00326)
          container CanIfHrhRangeCfg [0..*]: multiplicity set at link in variant link-time / post-build in variant post-build / pre-compile in variant pre-compile  # Defines the parameters required for configurating multiple CANID ranges for a given same HRH.
            integer CanIfHrhRangeBaseId [0..1]: 0..536870911, multiplicity set at link in variant link-time / post-build in variant post-build / pre-compile in variant pre-compile, post-build-variant-multiplicity=true, post-build-variant-value=true, set at link in variant link-time / post-build in variant post-build / pre-compile in variant pre-compile  # CAN Identifier used as base value in combination with CanIfHrhRangeMask for a masked ID range in which all CAN Ids shall pass the software filtering. The size of this parameter is limited by CanIfHrhRangeRxPduRangeCanIdType.
            integer CanIfHrhRangeMask [0..1]: 0..536870911, multiplicity set at link in variant link-time / post-build in variant post-build / pre-compile in variant pre-compile, post-build-variant-multiplicity=true, post-build-variant-value=true, set at link in variant link-time / post-build in variant post-build / pre-compile in variant pre-compile  # Used as mask value in combination with CanIfHrhRangeBaseId for a masked ID range in which all CAN Ids shall pass the software filtering. The size of this parameter is limited by CanIfHrhRangeRxPduRangeCanIdType.
            integer CanIfHrhRangeRxPduLowerCanId [0..1]: 0..536870911, multiplicity set at link in variant link-time / post-build in variant post-build / pre-compile in variant pre-compile, post-build-variant-multiplicity=true, post-build-variant-value=true, set at link in variant link-time / post-build in variant post-build / pre-compile in variant pre-compile  # Lower CAN Identifier of a receive CAN L-PDU for identifier range definition, in which all CAN Ids shall pass the software filtering.
            enumeration CanIfHrhRangeRxPduRangeCanIdType: {EXTENDED, STANDARD}, post-build-variant-value=true, set at link in variant link-time / post-build in variant post-build / pre-compile in variant pre-compile  # Specifies whether a configured Range of CAN Ids shall only consider standard CAN Ids or extended CAN Ids.
            integer CanIfHrhRangeRxPduUpperCanId [0..1]: 0..536870911, multiplicity set at link in variant link-time / post-build in variant post-build / pre-compile in variant pre-compile, post-build-variant-multiplicity=true, post-build-variant-value=true, set at link in variant link-time / post-build in variant post-build / pre-compile in variant pre-compile  # Upper CAN Identifier of a receive CAN L-PDU for identifier range definition, in which all CAN Ids shall pass the software filtering.
        container CanIfHthCfg [0..*]: multiplicity set at link in variant link-time / post-build in variant post-build / pre-compile in variant pre-compile  # This container contains parameters related to each HTH.
          reference CanIfHthCanCtrlIdRef: scope=ECU, set at link in variant link-time+post-build / pre-compile in variant pre-compile, destination=CanIfCtrlCfg  # Reference to controller Id to which the HTH belongs to. A controller can contain one or more HTHs.
          symbolic name reference CanIfHthIdSymRef: scope=ECU, set at link in variant link-time+post-build / pre-compile in variant pre-compile, destination=CanHardwareObject  # The parameter refers to a particular HTH object in the CanDrv configuration (see CanHardwareObject ECUC_Can_00324). | CanIf receives the following information of the CanDrv module by this reference: - CanHandleType (see ECUC_Can_00323) - CanObjectId (see ECUC_Can_00326)
      container CanIfRxPduCfg [0..*]: multiplicity set at link in variant link-time / post-build in variant post-build / pre-compile in variant pre-compile  # This container contains the configuration (parameters) of each receive CAN L-PDU. | The SHORT-NAME of "CanIfRxPduConfig" container itself represents the symolic name of Receive L-PDU.
        integer CanIfRxPduCanId [0..1]: 0..536870911, scope=ECU, multiplicity set at link in variant link-time / post-build in variant post-build / pre-compile in variant pre-compile, post-build-variant-multiplicity=true, post-build-variant-value=true, set at link in variant link-time / post-build in variant post-build / pre-compile in variant pre-compile  # CAN Identifier of Receive CAN L-PDUs used by the CAN Interface. Exa: Software Filtering. This parameter is used if exactly one Can Identifier is assigned to the Pdu. If a range is assigned then the CanIfRxPduCanIdRange parameter shall be used. | Range: 11 Bit For Standard CAN Identifier ... 29 Bit For Extended CAN identifier
        integer CanIfRxPduCanIdMask [0..1]: 0..536870911, scope=ECU, multiplicity set at link in variant link-time / post-build in variant post-build / pre-compile in variant pre-compile, post-build-variant-multiplicity=true, post-build-variant-value=true, set at link in variant link-time / post-build in variant post-build / pre-compile in variant pre-compile, default-value=536870911  # Identifier mask which denotes relevant bits in the CAN Identifier. This parameter defines a CAN Identifier range in an alternative way to CanIfRxPduCanIdRange. It identifies the bits of the configured CAN Identifier that must match the received CAN Identifier. Range: 11 bits for Standard CAN Identifier, 29 bits for Extended CAN Identifier.
        enumeration CanIfRxPduCanIdType: {EXTENDED_CAN, EXTENDED_FD_CAN, EXTENDED_NO_FD_CAN, STANDARD_CAN, STANDARD_FD_CAN, STANDARD_NO_FD_CAN}, post-build-variant-value=true, set at link in variant link-time / post-build in variant post-build / pre-compile in variant pre-compile  # CAN Identifier of receive CAN L-PDUs used by the CAN Driver for CAN L-PDU reception.
        integer CanIfRxPduDlc: 0..64, scope=ECU, post-build-variant-value=true, set at link in variant link-time / post-build in variant post-build / pre-compile in variant pre-compile  # Data length of the received CAN L-PDUs used by the CAN Interface. | This information is used for DLC checking. Additionally it might specify the valid bits in case of the discrete DLC for CAN FD L-PDUs > 8 bytes. The data area size of a CAN L-PDU can have a range from 0 to 64 bytes.
        integer CanIfRxPduId: 0..4294967295, scope=ECU, set at link in variant link-time+post-build / pre-compile in variant pre-compile, symbolic-name-value=true  # ECU wide unique, symbolic handle for receive CAN L-SDU. It shall fulfill ANSI/AUTOSAR definitions for constant defines. | Range: 0..max. number of defined CanRxPduIds
        boolean CanIfRxPduReadData: scope=ECU, post-build-variant-value=true, set at link in variant link-time / post-build in variant post-build / pre-compile in variant pre-compile, default-value=false  # Enables and disables the Rx buffering for reading of received L-SDU data. | True: Enabled False: Disabled
        boolean CanIfRxPduReadNotifyStatus: post-build-variant-value=true, set at link in variant link-time / post-build in variant post-build / pre-compile in variant pre-compile, default-value=false  # Enables and disables receive indication for each receive CAN L-SDU for reading its notification status. | True: Enabled False: Disabled
        function name CanIfRxPduUserRxIndicationName [0..1]: scope=ECU, multiplicity set at link in variant link-time+post-build / pre-compile in variant pre-compile, set at link in variant link-time+post-build / pre-compile in variant pre-compile, max-length=32, min-length=1  # This parameter defines the name of the <User_RxIndication>. | This parameter depends on the parameter CANIF_RXPDU_USERRXINDICATION_UL. If CANIF_RXPDU_USERRXINDICATION_UL equals CAN_TP, CAN_NM, PDUR, XCP, CAN_TSYN, J1939NM or J1939TP, the name of the <User_RxIndication> is fixed. If CANIF_RXPDU_USERRXINDICATION_UL equals CDD, the name of the <User_RxIndication> is selectable.
        enumeration CanIfRxPduUserRxIndicationUL [0..1]: {CAN_NM, CAN_TP, CAN_TSYN, CDD, J1939NM, J1939TP, PDUR, XCP}, scope=ECU, multiplicity set at link in variant link-time+post-build / pre-compile in variant pre-compile, set at link in variant link-time+post-build / pre-compile in variant pre-compile  # This parameter defines the upper layer (UL) module to which the indication | of the successfully received CANRXPDUID has to be routed via <User_RxIndication>. This <User_RxIndication> has to be invoked when the indication of the configured CANRXPDUID will be received by an Rx indication event from the CAN Driver module. If no upper layer (UL) module is configured, no <User_RxIndication> has to be called in case of an Rx indication event of the CANRXPDUID from the CAN Driver module.
        reference CanIfRxPduHrhIdRef: post-build-variant-value=true, set at link in variant link-time / post-build in variant post-build / pre-compile in variant pre-compile, destination=CanIfHrhCfg  # The HRH to which Rx L-PDU belongs to, is referred through this parameter.
        reference CanIfRxPduRef: scope=ECU, post-build-variant-value=true, set at link in variant link-time / post-build in variant post-build / pre-compile in variant pre-compile, destination=Pdu  # Reference to the "global" Pdu structure to allow harmonization of handle IDs in the COM-Stack.
        container CanIfRxPduCanIdRange [0..1]  # Optional container that allows to map a range of CAN Ids to one PduId.
          integer CanIfRxPduCanIdRangeLowerCanId: 0..536870911, post-build-variant-value=true, set at link in variant link-time / post-build in variant post-build / pre-compile in variant pre-compile  # Lower CAN Identifier of a receive CAN L-PDU for identifier range definition, in which all CAN Ids are mapped to one PduId.
          integer CanIfRxPduCanIdRangeUpperCanId: 0..536870911, post-build-variant-value=true, set at link in variant link-time / post-build in variant post-build / pre-compile in variant pre-compile  # Upper CAN Identifier of a receive CAN L-PDU for identifier range definition, in which all CAN Ids are mapped to one PduId.
        container CanIfTTRxFrameTriggering [0..1]  # CanIfTTRxFrameTriggering is specified in the SWS TTCAN Interface and defines Frame trigger for TTCAN reception. | This container is only included and valid if TTCAN is supported by the controller, enabled (see CanIfSupportTTCAN, ECUC_CanIf_00675), and a joblist is used for reception.
          integer CanTTRxJoblistTimeMark [0..1]: 0..65535, multiplicity set at link in variant link-time / post-build in variant post-build / pre-compile in variant pre-compile, post-build-variant-multiplicity=true, post-build-variant-value=true, set at link in variant link-time / post-build in variant post-build / pre-compile in variant pre-compile  # Defines the point in time, when the joblist execution funciton (JLEF) shall be called for the referenced rx trigger. Value is given in cycle time. This parameter is only configurable if a joblist is enabled by parameter CanIfTTJobList.
          reference CanIfTTRxHwObjectTriggerIdRef: post-build-variant-value=true, set at link in variant link-time / post-build in variant post-build / pre-compile in variant pre-compile, destination=CanTTHardwareObjectTrigger  # This parameter refers to a particular TTCAN hardware receive object Trigger of a hardware object in the TTCAN Driver Module, which is referred via plain CAN parameter CANIF_HRH_HANDLETYPE_REF. This parameter is only configurable if a joblist is enabled by parameter CanIfTTJobList.
      container CanIfTxPduCfg [0..*]: multiplicity set at link in variant link-time / post-build in variant post-build / pre-compile in variant pre-compile  # This container contains the configuration (parameters) of a transmit CAN L-PDU. It has to be configured as often as a transmit CAN L-PDU is needed. | The SHORT-NAME of "CanIfTxPduConfig" container represents the symolic name of Transmit L-PDU.
        integer CanIfTxPduCanId [0..1]: 0..536870911, scope=ECU, multiplicity set at link in variant link-time / post-build in variant post-build / pre-compile in variant pre-compile, post-build-variant-multiplicity=true, post-build-variant-value=true, set at link in variant link-time / post-build in variant post-build / pre-compile in variant pre-compile  # CAN Identifier of transmit CAN L-PDUs used by the CAN Driver for CAN L-PDU transmission. | Range: 11 Bit For Standard CAN Identifier ... 29 Bit For Extended CAN identifier The CAN Identifier may be omitted for dynamic transmit L-PDUs.
        integer CanIfTxPduCanIdMask [0..1]: 0..536870911, scope=ECU, multiplicity set at link in variant link-time / post-build in variant post-build / pre-compile in variant pre-compile, post-build-variant-multiplicity=true, post-build-variant-value=true, set at link in variant link-time / post-build in variant post-build / pre-compile in variant pre-compile, default-value=536870911  # Identifier mask which denotes relevant bits in the CAN Identifier. This parameter may be used to keep parts of the CAN Identifier of dynamic transmit L-PDUs static. Range: 11 bits for Standard CAN Identifier, 29 bits for Extended CAN Identifier.
        enumeration CanIfTxPduCanIdType: {EXTENDED_CAN, EXTENDED_FD_CAN, STANDARD_CAN, STANDARD_FD_CAN}, scope=ECU, post-build-variant-value=true, set at link in variant link-time / post-build in variant post-build / pre-compile in variant pre-compile  # Type of CAN Identifier of the transmit CAN L-PDU used by the CAN Driver module for CAN L-PDU transmission.
        integer CanIfTxPduId: 0..4294967295, scope=ECU, set at link in variant link-time+post-build / pre-compile in variant pre-compile, symbolic-name-value=true  # ECU wide unique, symbolic handle for transmit CAN L-SDU. | Range: 0..max. number of CantTxPduIds
        boolean CanIfTxPduPnFilterPdu [0..1]: multiplicity set at link in variant link-time / post-build in variant post-build / pre-compile in variant pre-compile, post-build-variant-multiplicity=true, post-build-variant-value=true, set at link in variant link-time / post-build in variant post-build / pre-compile in variant pre-compile, default-value=false  # If CanIfPublicPnFilterSupport is enabled, by this parameter PDUs could be configured which will pass the CanIfPnFilter. | If there is no CanIfTxPduPnFilterPdu configured per controller, the corresponding controller applies no CanIfPnFilter.
        boolean CanIfTxPduReadNotifyStatus: post-build-variant-value=true, set at link in variant link-time / post-build in variant post-build / pre-compile in variant pre-compile, default-value=false  # Enables and disables transmit confirmation for each transmit CAN L-SDU for reading its notification status. | True: Enabled False: Disabled
        boolean CanIfTxPduTriggerTransmit [0..1]: scope=ECU, post-build-variant-value=true, set at link in variant link-time / post-build in variant post-build / pre-compile in variant pre-compile, default-value=false  # Determines if or if not CanIf shall use the trigger transmit API for this PDU.
        enumeration CanIfTxPduType: {DYNAMIC, STATIC}, scope=ECU, post-build-variant-value=true, set at link in variant link-time / post-build in variant post-build / pre-compile in variant pre-compile  # Defines the type of each transmit CAN L-PDU.
        function name CanIfTxPduUserTriggerTransmitName [0..1]: scope=ECU, multiplicity set at link in variant link-time+post-build / pre-compile in variant pre-compile, set at link in variant link-time+post-build / pre-compile in variant pre-compile, max-length=32, min-length=1  # This parameter defines the name of the <User_TriggerTransmit>. This parameter depends on the parameter CanIfTxPduUserTxConfirmationUL. If CanIfTxPduUserTxConfirmationUL equals CAN_TP, CAN_NM, PDUR, XCP, CAN_TSYN, J1939NM or J1939TP, the name of the <User_TriggerTransmit> is fixed. If CanIfTxPduUserTxConfirmationUL equals CDD, the name of the <User_TxConfirmation> is selectable. | Please be aware that this parameter depends on the same parameter as CanIfTxPduUserTxConfirmationName. It shall be clear which upper layer is responsible for that PDU.
        function name CanIfTxPduUserTxConfirmationName [0..1]: scope=ECU, multiplicity set at link in variant link-time+post-build / pre-compile in variant pre-compile, set at link in variant link-time+post-build / pre-compile in variant pre-compile, max-length=32, min-length=1  # This parameter defines the name of the <User_TxConfirmation>. | This parameter depends on the parameter CANIF_TXPDU_USERTXCONFIRMATION_UL. If CANIF_TXPDU_USERTXCONFIRMATION_UL equals CAN_TP, CAN_NM, PDUR, XCP, CAN_TSYN, J1939NM or J1939TP, the name of the <User_TxConfirmation> is fixed. If CANIF_TXPDU_USERTXCONFIRMATION_UL equals CDD, the name of the <User_TxConfirmation> is selectable.
        enumeration CanIfTxPduUserTxConfirmationUL [0..1]: {CAN_NM, CAN_TP, CAN_TSYN, CDD, J1939NM, J1939TP, PDUR, XCP}, scope=ECU, multiplicity set at link in variant link-time+post-build / pre-compile in variant pre-compile, set at link in variant link-time+post-build / pre-compile in variant pre-compile  # This parameter defines the upper layer (UL) module to which the confirmation of the successfully transmitted CANTXPDUID has to be routed via the <User_TxConfirmation>. | This <User_TxConfirmation> has to be invoked when the confirmation of the configured CANTXPDUID will be received by a Tx confirmation event from the CAN Driver module. If no upper layer (UL) module is configured, no <User_TxConfirmation> has to be called in case of a Tx confirmation event of the CANTXPDUID from the CAN Driver module.
        reference CanIfTxPduBufferRef: scope=ECU, post-build-variant-value=true, set at link in variant link-time / post-build in variant post-build / pre-compile in variant pre-compile, destination=CanIfBufferCfg  # Configurable reference to a CanIf buffer configuration.
        reference CanIfTxPduRef: scope=ECU, post-build-variant-value=true, set at link in variant link-time / post-build in variant post-build / pre-compile in variant pre-compile, destination=Pdu  # Reference to the "global" Pdu structure to allow harmonization of handle IDs in the COM-Stack.
        container CanIfTTTxFrameTriggering [0..1]  # CanIfTTTxFrameTriggering is specified in the SWS TTCAN Interface and defines Frame trigger for TTCAN transmission. | This container is only included and valid if TTCAN is supported by the controller, enabled (see CanIfSupportTTCAN, ECUC_CanIf_00675), and a joblist is used.
          integer CanIfTTTxJoblistTimeMark [0..1]: 0..65535, multiplicity set at link in variant link-time / post-build in variant post-build / pre-compile in variant pre-compile, post-build-variant-multiplicity=true, post-build-variant-value=true, set at link in variant link-time / post-build in variant post-build / pre-compile in variant pre-compile  # Defines the point in time, when the joblist execution funciton (JLEF) shall be called for the referenced tx frame trigger. | Value is given in cycle time. This parameter is only configurable if a joblist is enabled by parameter CanIfTTJobList.
          reference CanIfTTTxHwObjectTriggerIdRef: post-build-variant-value=true, set at link in variant link-time / post-build in variant post-build / pre-compile in variant pre-compile, destination=CanTTHardwareObjectTrigger  # This parameter refers to a particular TTCAN hardware transmit object Trigger of a hardware object in the TTCAN Driver Module, | which is referred via plain CAN parameter CANIF_HTH_HANDLETYPE_REF. This parameter is only configurable if a joblist is enabled by parameter CanIfTTJobList.
    container CanIfPrivateCfg  # This container contains the private configuration (parameters) of the CAN Interface.
      boolean CanIfFixedBuffer [0..1]: multiplicity set at pre-compile, set at pre-compile, default-value=false  # This parameter defines if the buffer element length shall be fixed to 8 Bytes. | TRUE: Buffer element length is fixed to 8 Bytes. FALSE: Buffer element length depends on the size of the referencing PDUs.
      boolean CanIfPrivateDlcCheck: set at pre-compile, default-value=true  # Selects whether the DLC check is supported. | True: Enabled False: Disabled
      enumeration CanIfPrivateSoftwareFilterType: {BINARY, INDEX, LINEAR, TABLE}, set at pre-compile  # Selects the desired software filter mechanism for reception only. | Each implemented software filtering method is identified by this enumeration number. Range: Types implemented software filtering methods
      boolean CanIfSupportTTCAN: scope=ECU, set at pre-compile, default-value=false  # Defines whether TTCAN is supported. | TRUE: TTCAN is supported. FALSE: TTCAN is not supported, only normal CAN communication is possible.
      container CanIfTTGeneral [0..1]  # CanIfTTGeneral is specified in the SWS TTCAN Interface and defines if and in which way TTCAN is supported. | This container is only included and valid if TTCAN is supported by the controller, enabled (see CanIfSupportTTCAN, ECUC_CanIf_00675), and used.
        boolean CanIfTTJoblist: set at pre-compile, default-value=false  # Defines whether TTCAN is processed via a joblist. | TRUE: Joblist is used. FALSE: No joblist is used. This parameter is only configurable if TTCAN is enabled by parameter CanIfSupportTTCAN.
        integer CanIfTTMaxIsrDelay: 0..65535, post-build-variant-value=true, set at link in variant link-time / post-build in variant post-build / pre-compile in variant pre-compile  # Defines the maximum delay for the execution of the joblist execution function JLEF. This parameter is only configurable if a joblist is enabled by parameter CanIfTTJobList.
        container CanIfTTDemEventParameterRefs [0..1]  # Container for the references to DemEventParameter elements which shall be invoked using the API Dem_ReportErrorStatus API in case the corresponding error occurs. The EventId is taken from the referenced DemEventParameter's DemEventId value. The standardized errors are provided in the container and can be extended by vendor specific error references.
          symbolic name reference CANIF_TT_E_JLE_SYNC [0..1]: multiplicity set at link in variant link-time / post-build in variant post-build / pre-compile in variant pre-compile, post-build-variant-multiplicity=true, post-build-variant-value=true, set at link in variant link-time / post-build in variant post-build / pre-compile in variant pre-compile, destination=DemEventParameter  # Reference to configured DEM event to report that the JLEF lost synchronization to the local time of the TTCAN controller.
    container CanIfPublicCfg  # This container contains the public configuration (parameters) of the CAN Interface.
      boolean CanIfMetaDataSupport [0..1]: scope=ECU, multiplicity set at pre-compile, set at pre-compile, default-value=false  # Enable support for dynamic ID handling using L-SDU MetaData.
      boolean CanIfPublicCancelTransmitSupport: scope=ECU, set at pre-compile  # Configuration parameter to enable/disable dummy API for upper layer modules which allows to request the cancellation of an I-PDU.
      string CanIfPublicCddHeaderFile [0..*]: scope=ECU, multiplicity set at pre-compile, set at pre-compile, max-length=32, min-length=1  # Defines header files for callback functions which shall be included in case of CDDs. Range of characters is 1.. 32.
      boolean CanIfPublicDevErrorDetect: set at pre-compile, default-value=true  # Enables and disables the development error detection and notification mechanism. | True: Enabled False: Disabled
      enumeration CanIfPublicHandleTypeEnum: {UINT16, UINT8}, scope=ECU, set at pre-compile  # This parameter is used to configure the Can_HwHandleType. The Can_HwHandleType represents the hardware object handles of a CAN hardware unit. For CAN hardware units with more than 255 HW objects the extended range shall be used (UINT16).
      boolean CanIfPublicIcomSupport: scope=ECU, set at pre-compile, default-value=false  # Selects support of Pretended Network features in CanIf. | True: Enabled False: Disabled
      boolean CanIfPublicMultipleDrvSupport: scope=ECU, set at pre-compile, default-value=true  # Selects support for multiple CAN Drivers. | True: Enabled False: Disabled
      boolean CanIfPublicPnSupport: scope=ECU, set at pre-compile, default-value=false  # Selects support of Partial Network features in CanIf. | True: Enabled False: Disabled
      boolean CanIfPublicReadRxPduDataApi: scope=ECU, set at pre-compile, default-value=false  # Enables / Disables the API CanIf_ReadRxPduData() for reading received L-SDU data. | True: Enabled False: Disabled
      boolean CanIfPublicReadRxPduNotifyStatusApi: scope=ECU, set at pre-compile, default-value=false  # Enables and disables the API for reading the notification status of receive L-PDUs. | True: Enabled False: Disabled
      boolean CanIfPublicReadTxPduNotifyStatusApi: scope=ECU, set at pre-compile, default-value=false  # Enables and disables the API for reading the notification status of transmit L-PDUs. | True: Enabled False: Disabled
      boolean CanIfPublicSetDynamicTxIdApi: scope=ECU, set at pre-compile, default-value=false  # Enables and disables the API for reconfiguration of the CAN Identifier for each Transmit L-PDU. | True: Enabled False: Disabled
      boolean CanIfPublicTxBuffering: scope=ECU, set at pre-compile, default-value=false  # Enables and disables the buffering of transmit L-PDUs (rejected by the CanDrv) within the CAN Interface module. | True: Enabled False: Disabled
      boolean CanIfPublicTxConfirmPollingSupport: set at pre-compile  # Configuration parameter to enable/disable the API to poll for Tx Confirmation state.
      boolean CanIfPublicVersionInfoApi: set at pre-compile, default-value=true  # Enables and disables the API for reading the version information about the CAN Interface. | True: Enabled False: Disabled
      boolean CanIfPublicWakeupCheckValidByNM [0..1]: scope=ECU, multiplicity set at pre-compile, set at pre-compile, default-value=false  # If enabled, only NM messages shall validate a detected wake-up event | (see CANIF722) at the corresponding wake-up source in the CanIf. If disabled, all messages shall validate such a wake-up event. This parameter depends on CANIF_PUBLIC_WAKEUP_CHECK_VALID_API and shall only be configurable, if it is enabled. True: Enabled False: Disabled
      boolean CanIfPublicWakeupCheckValidSupport: scope=ECU, set at pre-compile, default-value=false  # Selects support for wake up validation | True: Enabled False: Disabled
      boolean CanIfSetBaudrateApi [0..1]: scope=ECU, multiplicity set at pre-compile, set at pre-compile, default-value=false  # Configuration parameter to enable/disable the CanIf_SetBaudrate API to change the baud rate of a CAN Controller. If this parameter is set to true the CanIf_SetBaudrate API shall be supported. Otherwise the API is not supported.
      boolean CanIfTxOfflineActiveSupport: scope=ECU, set at pre-compile, default-value=false  # Determines wether TxOffLineActive feature (see SWS_CANIF_00072) is supported by CanIf. | True: Enabled False: Disabled
    container CanIfTrcvDrvCfg [0..*]: multiplicity set at pre-compile  # This container contains the configuration (parameters) of all addressed CAN transceivers by each underlying CAN Transceiver Driver module. For each CAN transceiver Driver a seperate instance of this container shall be provided.
      container CanIfTrcvCfg [1..*]: multiplicity set at pre-compile  # This container contains the configuration (parameters) of one addressed CAN transceiver by the underlying CAN Transceiver Driver module. For each CAN transceiver a seperate instance of this container has to be provided.
        integer CanIfTrcvId: 0..255, scope=ECU, set at link in variant link-time+post-build / pre-compile in variant pre-compile, symbolic-name-value=true  # This parameter abstracts from the CAN Transceiver Driver specific parameter Transceiver. Each transceiver of all connected CAN Transceiver Driver modules shall be assigned to one specific TransceiverId of the CanIf. | Range: 0..number of configured transceivers of all CAN Transceiver Driver modules
        boolean CanIfTrcvWakeupSupport: scope=ECU, set at link in variant link-time+post-build / pre-compile in variant pre-compile, default-value=false  # This parameter defines if a respective transceiver of the referenced CAN Transceiver Driver modules is queriable for wake up events. | True: Enabled False: Disabled
        symbolic name reference CanIfTrcvCanTrcvRef: scope=ECU, set at link in variant link-time+post-build / pre-compile in variant pre-compile, destination=CanTrcvChannel  # This parameter references to the logical handle of the underlying CAN | transceiver from the CAN transceiver driver module to be served by the CAN Interface module. Range: 0..max. number of underlying supported CAN transceivers
  module definition CanNm [0..1]: post-build-variant-support=true, variants link-time/post-build/pre-compile  # Configuration Parameters for the Can Nm module.
    container CanNmGlobalConfig  # This container contains the global configuration parameter of the CanNm. The parameters and the parameters of the sub containers shall be mapped to the C data type CanNm_ConfigType (for parameters where it is possible) which is passed to the CanNm_Init function.
      boolean CanNmBusLoadReductionEnabled: set at pre-compile  # Pre-processor switch for enabling busload reduction support.
      boolean CanNmBusSynchronizationEnabled: scope=ECU, set at pre-compile  # Pre-processor switch for enabling bus synchronization support. This feature is required for gateway nodes only.
      boolean CanNmComControlEnabled: scope=ECU, set at pre-compile  # Pre-processor switch for enabling the Communication Control support.
      boolean CanNmComUserDataSupport: scope=ECU, set at pre-compile  # Preprocessor switch for enabling Com User Data.
      boolean CanNmCoordinatorSyncSupport: scope=ECU, set at pre-compile  # Enables/disables the coordinator synchronisation support.
      boolean CanNmDevErrorDetect: set at pre-compile  # Pre-processor switch for enabling development error detection support.
      boolean CanNmImmediateRestartEnabled: set at pre-compile  # Pre-processor switch for enabling the asynchronous transmission of a NM PDU upon bus-communication request in Prepare-Bus-Sleep mode.
      boolean CanNmImmediateTxconfEnabled: scope=ECU, set at pre-compile  # Enable/disable the immediate tx confirmation.
      float CanNmMainFunctionPeriod: 0.001..0.255, set at link in variant link-time+post-build / pre-compile in variant pre-compile  # Call cycle in seconds of CanNm_MainFunction.
      boolean CanNmNodeDetectionEnabled: scope=ECU, set at pre-compile  # Precompile time switch to enable the node detection feature.
      boolean CanNmNodeIdEnabled: scope=ECU, set at pre-compile  # Pre-processor switch for enabling the source node identifier.
      boolean CanNmPassiveModeEnabled: scope=ECU, set at pre-compile  # Pre-processor switch for enabling support of the Passive Mode.
      boolean CanNmPduRxIndicationEnabled: scope=ECU, set at pre-compile  # Pre-processor switch for enabling the PDU Rx Indication.
      boolean CanNmPnEiraCalcEnabled [0..1]: multiplicity set at pre-compile, set at pre-compile, default-value=false  # Specifies if CanNm calculates the PN request information for internal an external requests. (EIRA) | true: PN request are calculated false: PN request are not calculated
      float CanNmPnResetTime [0..1]: 0.001..65.535, multiplicity set at link in variant link-time+post-build / pre-compile in variant pre-compile, set at link in variant link-time+post-build / pre-compile in variant pre-compile  # Specifies the runtime of the reset timer in seconds. This reset time is valid for the reset of PN requests in the EIRA and in the ERA. The value shall be the same for every channel. Thus it is a global config parameter.
      boolean CanNmRemoteSleepIndEnabled: set at pre-compile  # Pre-processor switch for enabling remote sleep indication support. This feature is required for gateway nodes only.
      boolean CanNmRepeatMsgIndEnabled: scope=ECU, set at pre-compile  # Enable/disable the notification that a RepeatMessageRequest bit has been received.
      boolean CanNmStateChangeIndEnabled: scope=ECU, set at pre-compile  # Pre-processor switch for enabling the CAN NM state change notification.
      boolean CanNmUserDataEnabled: scope=ECU, set at pre-compile  # Pre-processor switch for enabling user data support.
      boolean CanNmVersionInfoApi: scope=ECU, set at pre-compile  # Pre-processor switch for enabling version info API support.
      reference CanNmPnEiraRxNSduRef [0..1]: multiplicity set at link in variant link-time+post-build / pre-compile in variant pre-compile, set at link in variant link-time+post-build / pre-compile in variant pre-compile, destination=Pdu  # Reference to a Pdu in the COM-Stack. | Only one SduRef is required for CanNm because the EIRA is the aggregation over all Can Channels.
      container CanNmChannelConfig [1..*]: multiplicity set at pre-compile  # This container contains the channel specific configuration parameter of the CanNm.
        boolean CanNmActiveWakeupBitEnabled [0..1]: multiplicity set at link in variant link-time+post-build / pre-compile in variant pre-compile, set at link in variant link-time+post-build / pre-compile in variant pre-compile, default-value=false  # Enables/Disables the handling of the Active Wakeup Bit in the CanNm module.
        boolean CanNmAllNmMessagesKeepAwake [0..1]: multiplicity set at link in variant link-time+post-build / pre-compile in variant pre-compile, set at link in variant link-time+post-build / pre-compile in variant pre-compile, default-value=false  # Specifies if CanNm drops irrelevant NM PDUs. | false: Only NM PDUs with a PNI bit = true and containing a PN request for this ECU triggers the standard RX indication handling true: Every NM PDU triggers the standard RX indication handling
        boolean CanNmBusLoadReductionActive: set at link in variant link-time+post-build / pre-compile in variant pre-compile  # This parameter defines if bus load reduction for the respective NM channel is active or not.
        integer CanNmCarWakeUpBitPosition [0..1]: 0..7, multiplicity set at link in variant link-time+post-build / pre-compile in variant pre-compile, set at link in variant link-time+post-build / pre-compile in variant pre-compile  # Specifies the Bit position of the CWU within the NM PDU.
        integer CanNmCarWakeUpBytePosition [0..1]: 0..7, multiplicity set at link in variant link-time+post-build / pre-compile in variant pre-compile, set at link in variant link-time+post-build / pre-compile in variant pre-compile  # Specifies the Byte position of the CWU within the NM PDU.
        boolean CanNmCarWakeUpFilterEnabled [0..1]: multiplicity set at link in variant link-time+post-build / pre-compile in variant pre-compile, set at link in variant link-time+post-build / pre-compile in variant pre-compile, default-value=false  # If CWU filtering is supported, only the CWU bit within the NM PDU with source node identifier CanNmCarWakeUpFilterNodeId is considered as CWU request. | FALSE - CWU filtering is not supported TRUE - CWU filtering is supported
        integer CanNmCarWakeUpFilterNodeId [0..1]: 0..255, multiplicity set at link in variant link-time+post-build / pre-compile in variant pre-compile, set at link in variant link-time+post-build / pre-compile in variant pre-compile  # Source node identifier for CWU filtering. If CWU filtering is supported, only the CWU bit within the NM PDU with source node identifier CanNmCarWakeUpFilterNodeId is considered as CWU request.
        boolean CanNmCarWakeUpRxEnabled: scope=ECU, set at link in variant link-time+post-build / pre-compile in variant pre-compile, default-value=false  # Enables or disables support of CarWakeUp bit evaluation in received NM PDUs. | FALSE - CarWakeUp not supported TRUE - CarWakeUp supported
        float CanNmImmediateNmCycleTime [0..1]: 0.001..65.535, multiplicity set at link in variant link-time+post-build / pre-compile in variant pre-compile, set at link in variant link-time+post-build / pre-compile in variant pre-compile  # Defines the immediate NM PDU cycle time in seconds which is used for CanNmImmediateNmTransmissions NM PDU transmissions.
        integer CanNmImmediateNmTransmissions: 0..255, set at link in variant link-time+post-build / pre-compile in variant pre-compile  # Defines the number of immediate NM PDUs which shall be transmitted. If the value is zero no immediate NM PDUs are transmitted. The cycle time of immeditate NM PDUs is defined by CanNmImmediateNmCycleTime.
        float CanNmMsgCycleOffset: 0..65.535, set at link in variant link-time+post-build / pre-compile in variant pre-compile  # Time offset in the periodic transmission node. It determines the start delay of the transmission. Specified in seconds.
        float CanNmMsgCycleTime: 0.001..65.535, scope=ECU, set at link in variant link-time+post-build / pre-compile in variant pre-compile  # Period of a NM PDU in seconds. It determines the periodic rate in the "periodic transmission mode with bus load reduction" and is the basis for transmit scheduling in the "periodic transmission mode without bus load reduction".
        float CanNmMsgReducedTime: 0.001..65.535, set at link in variant link-time+post-build / pre-compile in variant pre-compile  # Node specific bus cycle time in the periodic transmission mode with bus load reduction. Specified in seconds.
        float CanNmMsgTimeoutTime: 0.001..65.535, set at link in variant link-time+post-build / pre-compile in variant pre-compile  # Transmission Timeout of NM PDU. If there is no transmission confirmation by the CAN Interface within this timeout, the CANNM module shall give an error notification.
        integer CanNmNodeId: 0..255, post-build-variant-value=true, set at link in variant link-time / post-build in variant post-build / pre-compile in variant pre-compile  # Node identifier of local node.
        enumeration CanNmPduCbvPosition: {CANNM_PDU_BYTE_0, CANNM_PDU_BYTE_1, CANNM_PDU_OFF}, scope=ECU, set at link in variant link-time+post-build / pre-compile in variant pre-compile  # Defines the position of the control bit vector within the NM PDU. | The value of the parameter represents the location of the Control Bit Vector in the NM PDU (CanNmPduByte0 means byte 0, CanNmPduByte1 means byte 1, CanNmPduOff means source node identifier is not part of the NM PDU) ImplementationType: CanNm_PduPositionType
        enumeration CanNmPduNidPosition: {CANNM_PDU_BYTE_0, CANNM_PDU_BYTE_1, CANNM_PDU_OFF}, scope=ECU, set at link in variant link-time+post-build / pre-compile in variant pre-compile  # Defines the position of the source node identifier within the NM PDU. | The value of the parameter represents the location of the source node identifier in the NM PDU (CanNMPduByte0 means byte 0, CanNmPduByte1 means byte 1, CanNmPduOff means source node identifier is not part of the NM PDU) ImplementationType: CanNm_PduPositionType
        boolean CanNmPnEnabled [0..1]: scope=ECU, multiplicity set at link in variant link-time / post-build in variant post-build / pre-compile in variant pre-compile, post-build-variant-multiplicity=true, post-build-variant-value=true, set at link in variant link-time / post-build in variant post-build / pre-compile in variant pre-compile, default-value=false  # Enables or disables support of partial networking. | false: Partial networking Range not supported true: Partial networking supported
        boolean CanNmPnEraCalcEnabled [0..1]: multiplicity set at link in variant link-time+post-build / pre-compile in variant pre-compile, set at link in variant link-time+post-build / pre-compile in variant pre-compile, default-value=false  # Specifies if CanNm calculates the PN request information for external requests. (ERA) | false: PN request are not calculated true: PN request are calculated
        boolean CanNmPnHandleMultipleNetworkRequests [0..1]: multiplicity set at link in variant link-time+post-build / pre-compile in variant pre-compile, set at link in variant link-time+post-build / pre-compile in variant pre-compile, default-value=false  # Specifies if CanNm performs an additional transition from Network Mode to Repeat Message State (true) or not (false).
        float CanNmRemoteSleepIndTime: 0..65.535, set at link in variant link-time+post-build / pre-compile in variant pre-compile  # Timeout for Remote Sleep Indication. | It defines the time in seconds how long it shall take to recognize that all other nodes are ready to sleep.
        float CanNmRepeatMessageTime: 0..65.535, set at link in variant link-time+post-build / pre-compile in variant pre-compile  # Timeout for Repeat Message State. | It defines the time in seconds how long the NM shall stay in the Repeat Message State.
        boolean CanNmRetryFirstMessageRequest [0..1]: set at link in variant link-time+post-build / pre-compile in variant pre-compile  # Specifies if first message request in CanNm is repeated until accepted by CanIf.
        float CanNmTimeoutTime: 0.002..65.535, set at link in variant link-time+post-build / pre-compile in variant pre-compile  # Network Timeout for NM PDUs. | It denotes the time in seconds how long the NM shall stay in the Ready Sleep State before transition into the Prepare Bus-Sleep Mode is initiated.
        float CanNmWaitBusSleepTime: 0.001..65.535, set at link in variant link-time+post-build / pre-compile in variant pre-compile  # Timeout for bus calm down phase. | It denotes the time in seconds how long the NM shall stay in the Prepare Bus-Sleep Mode before transition into Bus-Sleep Mode shall take place.
        reference CanNmPnEraRxNSduRef [0..1]: multiplicity set at link in variant link-time+post-build / pre-compile in variant pre-compile, set at link in variant link-time+post-build / pre-compile in variant pre-compile, destination=Pdu  # Reference to a Pdu in the COM-Stack. The SduRef is required for every CanNm Channel, because ERA is reported per channel.
        symbolic name reference CanNmComMNetworkHandleRef: set at link in variant link-time+post-build / pre-compile in variant pre-compile, destination=ComMChannel  # This reference points to the unique channel defined by the ComMChannel and provides access to the unique channel index value in ComMChannelId.
        container CanNmRxPdu [1..*]  # This container is used to configure the Rx PDU properties that are used for the CanNm Channel.
          integer CanNmRxPduId: 0..65535, scope=ECU, set at link in variant link-time+post-build / pre-compile in variant pre-compile, symbolic-name-value=true  # This parameter defines the Rx PDU ID of the CanIf L-PDU range that is associated with this CanNm channel.
          reference CanNmRxPduRef: post-build-variant-value=true, set at link in variant link-time / post-build in variant post-build / pre-compile in variant pre-compile, destination=Pdu  # Reference to the global PDU that is used by this CanNm channel.
        container CanNmTxPdu [0..1]  # This container contains the CanNmTxConfirmationPduId and the CanNmTxPduRef.
          integer CanNmTxConfirmationPduId: 0..65535, scope=ECU, set at link in variant link-time+post-build / pre-compile in variant pre-compile, symbolic-name-value=true  # Handle Id to be used by the Lower Layer to confirm the transmission of the CanNmTxPdu to the LowerLayer.
          reference CanNmTxPduRef: post-build-variant-value=true, set at link in variant link-time / post-build in variant post-build / pre-compile in variant pre-compile, destination=Pdu  # The reference to the common PDU structure.
        container CanNmUserDataTxPdu [0..1]  # This optional container is used to configure the UserNm PDU. This container is only available if CanNmComUserDataSupport is enabled.
          integer CanNmTxUserDataPduId: 0..65535, scope=ECU, set at link in variant link-time+post-build / pre-compile in variant pre-compile, symbolic-name-value=true  # This parameter defines the Handle ID of the NM User Data I-PDU.
          reference CanNmTxUserDataPduRef: post-build-variant-value=true, set at link in variant link-time / post-build in variant post-build / pre-compile in variant pre-compile, destination=Pdu  # Reference to the NM User Data I-PDU in the global PDU collection.
      container CanNmPnInfo [0..1]  # PN information configuration
        integer CanNmPnInfoLength: 1..7, set at link in variant link-time+post-build / pre-compile in variant pre-compile, default-value=1  # Specifies the length of the PN request information in the NM PDU.
        integer CanNmPnInfoOffset: 1..7, set at link in variant link-time+post-build / pre-compile in variant pre-compile, default-value=1  # Specifies the offset of the PN request information in the NM PDU.
        container CanNmPnFilterMaskByte [0..7]  # PN information configuration
          integer CanNmPnFilterMaskByteIndex: 0..6, set at link in variant link-time+post-build / pre-compile in variant pre-compile  # Index of the filter mask byte. Specifies the position within the filter mask byte array.
          integer CanNmPnFilterMaskByteValue: 0..255, post-build-variant-value=true, set at link in variant link-time / post-build in variant post-build / pre-compile in variant pre-compile, default-value=0  # Parameter to configure the filter mask byte.
