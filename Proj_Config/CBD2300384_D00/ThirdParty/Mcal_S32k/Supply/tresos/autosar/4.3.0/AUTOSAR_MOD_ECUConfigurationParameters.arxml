[part 4 of 8: package /AUTOSAR/EcucDefs]
AUTOSAR XML (schema 4-3-0)
# The material contained in this specification is protected by copyright and
# other types of Intellectual Property Rights. The commercial exploitation of the
# material contained in this specification requires a license to such
# Intellectual Property Rights.
# This specification may be utilized or reproduced without any modification, in
# any form or by any means, for informational purposes only. For any other
# purpose, no part of the specification may be utilized or reproduced, in any
# form or by any means, without permission in writing from the publisher.
# licensed under the same rules as applicable to the AUTOSAR Standard.
package /AUTOSAR/EcucDefs  (continued)
  module definition Dem [0..1]: post-build-variant-support=true, variants post-build/pre-compile  # Configuration of the Dem (Diagnostic Event Manager) module.
    container DemConfigSet  # This container contains the configuration parameters and sub containers of the Dem module supporting multiple configuration sets.
      container DemComponent [0..*]  # This container configures the monitored components and system dependencies.
        function name DemComponentFailedCallbackFnc [0..1]: multiplicity set at pre-compile, set at pre-compile  # Specifies the function to be called on component failed status changes.
        integer DemComponentId: 1..65535, scope=ECU, set at pre-compile, symbolic-name-value=true  # Unique identifier of a DemComponent. | Component Id should be configured in sequential order beginning with 1 and no gaps in between. This parameter should not be changeable by user, because the Id should be generated by Dem itself to prevent gaps and multiple use of an Id
        boolean DemComponentIgnoresPriority [0..1]: multiplicity set at pre-compile, set at pre-compile, default-value=false  # This configuration switch defines, whether the priority of events at this component shall be ignored.
        reference DemImmediateChildComponentRef [0..*]: multiplicity set at pre-compile, set at pre-compile, destination=DemComponent  # Reference to all immediate children of the current component.
      container DemDTC [0..65535]  # This container contains the configuration (parameters) for DemUdsDTC.
        integer DemDTCFunctionalUnit [0..1]: 0..255, scope=ECU, multiplicity set at pre-compile, set at pre-compile  # DTCFuncitonalUnit is a 1-byte value which identifies the corresponding basic vehicle / system function which reports the DTC. This parameter is necessary for the report of severity information. | If this parameter is configured for no DTC, the Dem provides no DTC functional unit information.
        enumeration DemDTCSeverity [0..1]: {DEM_SEVERITY_CHECK_AT_NEXT_HALT, DEM_SEVERITY_CHECK_IMMEDIATELY, DEM_SEVERITY_MAINTENANCE_ONLY, DEM_SEVERITY_NO_SEVERITY}, scope=ECU, multiplicity set at pre-compile, set at pre-compile, default-value=DEM_SEVERITY_NO_SEVERITY  # DTC severity according to ISO 14229-1. This parameter depends on the automotive manufacturer. | If it is not configured, the value is counted as 'no severity'. If this parameter is configured for no DTC, the Dem provides no DTC severity information.
        integer DemDtcValue [0..1]: 1..16777214, scope=ECU, multiplicity set at post-build in variant post-build / pre-compile in variant pre-compile, post-build-variant-multiplicity=true, post-build-variant-value=true, set at post-build in variant post-build / pre-compile in variant pre-compile  # Unique Diagnostic Trouble Code value for UDS | (Range: 0x000000 and 0xFFFFFF are reserved for DTC groups by ISO 14229-1)
        enumeration DemNvStorageStrategy [0..1]: {DURING_SHUTDOWN, IMMEDIATE_AT_FIRST_OCCURRENCE}, scope=ECU, multiplicity set at pre-compile, origin=AUTOSAR, set at pre-compile, default-value=DURING_SHUTDOWN  # This parameter defines when a specific event memory entry is allowed to be stored in the NVRAM.
        enumeration DemWWHOBDDTCClass [0..1]: {DEM_DTC_WWHOBD_CLASS_A, DEM_DTC_WWHOBD_CLASS_B1, DEM_DTC_WWHOBD_CLASS_B2, DEM_DTC_WWHOBD_CLASS_C, DEM_DTC_WWHOBD_CLASS_NOCLASS}, scope=ECU, multiplicity set at pre-compile, set at pre-compile  # DTC Class according to ISO 14229-1 [2013 version]. This parameter depends on the automotive manufacturer. | If it is not configured, the value is marked as 'unclassified'. If this parameter is configured for no DTC, the Dem provides no DTC WWHOBD class information.
        reference DemDTCAttributesRef: set at pre-compile, destination=DemDTCAttributes  # This parameter defines the DTC Attributes associated with the DemDTC.
        reference DemObdDTCRef [0..1]: multiplicity set at pre-compile, set at pre-compile, destination=DemObdDTC  # This parameter defines the OBD DTC configuration associated with the DemDTC. | It is allowed to have events without a OBD DTC.
      container DemDTCAttributes [0..65535]  # This container contains the configuration (parameters) for DemDTCAttributes.
        boolean DemAgingAllowed: scope=ECU, set at pre-compile  # Switch to allow aging/unlearning of the event or not. | true: aging allowed false: aging not allowed
        integer DemAgingCycleCounterThreshold [0..1]: 1..255, scope=ECU, multiplicity set at pre-compile, set at pre-compile  # Number of aging cycles needed to unlearn/delete the event.
        integer DemAgingCycleCounterThresholdForTFSLC [0..1]: 1..255, scope=ECU, multiplicity set at pre-compile, set at pre-compile  # Number of aging cycles needed to reset the testFailedSinceLastClear Bit.
        integer DemDTCPriority: 0..255, scope=ECU, set at pre-compile  # Priority of the event/dtc, in view of full event memory. A lower value means higher priority.
        enumeration DemDTCSignificance [0..1]: {DEM_EVENT_SIGNIFICANCE_FAULT, DEM_EVENT_SIGNIFICANCE_OCCURRENCE}, scope=ECU, multiplicity set at pre-compile, set at pre-compile  # Significance of the event, which indicates additional information concerning fault classification and resolution. | It can be mapped as Dem-internal data element. It shall be configured, if it is a part of event related data.
        integer DemMaxNumberFreezeFrameRecords [0..1]: 0..255, scope=ECU, multiplicity set at pre-compile, set at pre-compile  # This parameter defines the number of according freeze frame records, which can maximal be stored for this event. Therefore all these freeze frame records have the same freeze frame class. | This parameter is only required for calculated record numeration (refer to DemTypeOfFreezeFrameRecordNumeration).
        reference DemAgingCycleRef [0..1]: scope=ECU, multiplicity set at pre-compile, origin=AUTOSAR_ECUC V1.0.0, set at pre-compile, destination=DemOperationCycle  # Reference to the cycle which is triggering the aging of the event.
        reference DemExtendedDataClassRef [0..1]: multiplicity set at pre-compile, set at pre-compile, destination=DemExtendedDataClass  # This reference defines the link to an extended data class sampler.
        reference DemFreezeFrameClassRef [0..1]: multiplicity set at pre-compile, set at pre-compile, destination=DemFreezeFrameClass  # These references define the links to a freeze frame class sampler.
        reference DemFreezeFrameRecNumClassRef [0..1]: scope=ECU, multiplicity set at pre-compile, set at pre-compile, destination=DemFreezeFrameRecNumClass  # This parameter defines the list of dedicated freeze frame record numbers associated with the diagnostic event. These record numbers are assigned to the freeze frame records (instead of calculated record numbers). | This parameter is only required for configured record numeration (refer to DemTypeOfFreezeFrameRecordNumeration).
        reference DemJ1939ExpandedFreezeFrameClassRef [0..1]: multiplicity set at pre-compile, set at pre-compile, destination=DemJ1939FreezeFrameClass  # These references define the links to a J1939 freeze frame class sampler.
        reference DemJ1939FreezeFrameClassRef [0..1]: multiplicity set at pre-compile, set at pre-compile, destination=DemJ1939FreezeFrameClass  # These references define the links to a J1939 freeze frame class sampler.
        choice reference DemMemoryDestinationRef [0..2]: scope=ECU, multiplicity set at pre-compile, set at pre-compile, destination=[DemMirrorMemory, DemPrimaryMemory, DemUserDefinedMemory]  # The event destination assigns events to none, one or two origins. If no event destination is assigned to a specific event, the event is handled internally and is not visible externally to the Dcm. If more than one event destination is assigned to a specific event, the event can be present in the corresponding origins.
        reference DemWWHOBDFreezeFrameClassRef [0..1]: multiplicity set at pre-compile, set at pre-compile, destination=DemFreezeFrameClass  # This reference defines the link to a WWH-OBD freeze frame class sampler.
      container DemDebounceCounterBasedClass [0..65535]  # This container contains the configuration of Debounce Counter Based Class
        integer DemCounterBasedFdcThresholdStorageValue [0..1]: 1..32767, multiplicity set at pre-compile, set at pre-compile  # Threshold to allocate an event memory entry and to capture the Freeze Frame.
        enumeration DemDebounceBehavior: {DEM_DEBOUNCE_FREEZE, DEM_DEBOUNCE_RESET}, set at pre-compile  # This parameter defines how the event debounce algorithm will behave, if a related enable condition is not fulfilled or ControlDTCSetting of the related event is disabled.
        integer DemDebounceCounterDecrementStepSize: 1..32768, scope=ECU, set at pre-compile  # Defines the step size for decrementation of the internal debounce counter (PREPASSED).
        integer DemDebounceCounterFailedThreshold: 1..32767, scope=ECU, set at pre-compile  # Defines the value of the internal debounce counter, which indicates the failed status.
        integer DemDebounceCounterIncrementStepSize: 1..32767, scope=ECU, set at pre-compile  # Defines the step size for incrementation of the internal debounce counter (PREFAILED).
        boolean DemDebounceCounterJumpDown: scope=ECU, set at pre-compile  # Switch for the activation of Jump-Down. | true: Jump-Down activated false: Jump-Down deactivated
        integer DemDebounceCounterJumpDownValue: -32768..32767, scope=ECU, set at pre-compile, default-value=0  # Jump-Down value of the internal debounce counter which is taken as initialization value for the counter when the respective step-down occurs.
        boolean DemDebounceCounterJumpUp: scope=ECU, set at pre-compile  # Switch for the activation of Jump-Up. | true: Jump-Up activated false: Jump-Up deactivated
        integer DemDebounceCounterJumpUpValue: -32768..32767, scope=ECU, set at pre-compile, default-value=0  # Jump-Up value of the internal debounce counter which is taken as initialization value for the counter when the respective step-up occurs.
        integer DemDebounceCounterPassedThreshold: -32768..-1, scope=ECU, set at pre-compile  # Defines the value of the internal debounce counter, which indicates the passed status.
        boolean DemDebounceCounterStorage: set at pre-compile, default-value=false  # Switch to store the debounce counter value non-volatile or not. | true: debounce counter value shall be stored non-volatile false: debounce counter value is volatile
      container DemDebounceTimeBaseClass [0..65535]  # This container contains the configuration of Debounce Time Based Class.
        enumeration DemDebounceBehavior: {DEM_DEBOUNCE_FREEZE, DEM_DEBOUNCE_RESET}, set at pre-compile  # This parameter defines how the event debounce algorithm will | behave, if a related enable condition is not fulfilled or ControlDTCSetting of the related event is disabled.
        float DemDebounceTimeFailedThreshold: 0.001..3600, scope=ECU, set at pre-compile  # Defines the time out duration for "Event Failed" qualification. | The AUTOSAR configuration standard is to use SI units, so this parameter is defined as float value in seconds. Dem configuration tools must convert this float value to the appropriate value format for the use in the software implementation of Dem.
        float DemDebounceTimePassedThreshold: 0.001..3600, scope=ECU, set at pre-compile  # Defines the time out duration for "Event Passed" qualification. | The AUTOSAR configuration standard is to use SI units, so this parameter is defined as float value in seconds. Dem configuration tools must convert this float value to the appropriate value format for the use in the software implementation of Dem.
        float DemTimeBasedFdcThresholdStorageValue [0..1]: 0.001..3600, multiplicity set at pre-compile, set at pre-compile  # Threshold to allocate an event memory entry and to capture the Freeze Frame.
      container DemDtrs [0..1]  # This container holds the configuration of DTRs collection.
        container DemDtr [0..65535]  # This container holds the configuration of one individual DTR.
          float DemDtrCompuDenominator0: scope=ECU, set at pre-compile  # Part of the conversion between the binary representation and the physical meaning analogous to the SW-C Template conversion CompuRationalCoeffs with 2 numerator coefficients and 1 denominator coefficient in the direction compuInternalToPhys. | This is the only one supported denominator value, a constant divisor. The value 0 is not allowed.
          float DemDtrCompuNumerator0: scope=ECU, set at pre-compile  # Part of the conversion between the binary representation and the physical meaning analogous to the SW-C Template conversion CompuRationalCoeffs with 2 numerator coefficients and 1 denominator coefficient in the direction compuInternalToPhys. | This is the first numerator value, which is multiplied with x^0, i.e., the offset.
          float DemDtrCompuNumerator1: scope=ECU, set at pre-compile  # Part of the conversion between the binary representation and the physical meaning analogous to the SW-C Template conversion CompuRationalCoeffs with 2 numerator coefficients and 1 denominator coefficient in the direction compuInternalToPhys. | This is the second numerator value, which is multiplied with x^1, i.e., the factor.
          integer DemDtrId: 0..65535, scope=ECU, set at pre-compile, symbolic-name-value=true  # The index identifier value assigned to this DTR. The value is generated during the Dem configuration process.
          integer DemDtrMid: 0..255, scope=ECU, multiplicity set at post-build in variant post-build / pre-compile in variant pre-compile, post-build-variant-multiplicity=true, post-build-variant-value=true, set at post-build in variant post-build / pre-compile in variant pre-compile  # The OBDMID of the DTR. | The values 0x00, 0x20, 0x40, 0x60, 0x80, 0xA0, 0xC0, 0xE0 are reserved.
          integer DemDtrTid: 0..255, scope=ECU, multiplicity set at post-build in variant post-build / pre-compile in variant pre-compile, post-build-variant-multiplicity=true, post-build-variant-value=true, set at post-build in variant post-build / pre-compile in variant pre-compile  # The OBDTID of the DTR.
          integer DemDtrUasid: 0..255, scope=ECU, multiplicity set at post-build in variant post-build / pre-compile in variant pre-compile, post-build-variant-multiplicity=true, post-build-variant-value=true, set at post-build in variant post-build / pre-compile in variant pre-compile  # The UaSId the DTR data shall be scaled to, and reported together with the rescaled DTR data.
          enumeration DemDtrUpdateKind [0..1]: {DEM_DTR_UPDATE_ALWAYS, DEM_DTR_UPDATE_STEADY}, multiplicity set at pre-compile, set at pre-compile  # Update conditions applied by the Dem to reports of DTR values. Only supported if a related Event is configured. If no related Event is configured, the Dem behaves as if DemDtrUpdateKind is configured to "DEM_DTR_UPDATE_ALWAYS".
          reference DemDtrEventRef [0..1]: scope=ECU, multiplicity set at pre-compile, set at pre-compile, destination=DemEventParameter  # Reference to the DemEventParameter this DTR is related to. If the related event is not configured, the Dem cannot ensure consistency between the DTR and the event.
      container DemEventParameter [1..65535]  # This container contains the configuration (parameters) for events.
        float DemCausalityDelayTime [0..1]: 0..2.5, multiplicity set at pre-compile, set at pre-compile, default-value=0  # Time to wait until the event is considered as causal. | The parameter is specified in seconds.
        integer DemComponentPriority [0..1]: 0..255, multiplicity set at pre-compile, set at pre-compile  # Specifies the priority within the component. A lower value means higher priority.
        boolean DemEventAvailable: scope=ECU, post-build-variant-value=true, set at post-build in variant post-build / pre-compile in variant pre-compile  # This parameter configures an Event as unavailable. | It is treated by Dem as if it does not exist. true = Event is available false = Event is not available
        integer DemEventConfirmationThreshold: 1..255, scope=ECU, post-build-variant-value=true, set at post-build in variant post-build / pre-compile in variant pre-compile, default-value=1  # Defines the operation cycle threshold of the DTC confirmation status according "Confirmation Threshold" of ISO 14229-1.
        boolean DemEventFailureCycleCounterThresholdAdaptable [0..1]: scope=ECU, set at pre-compile, default-value=false  # Indicates whether the events confirmation Cycle threshold can be adapted by Dem_SetEventFailureCycleCounterThreshold.
        integer DemEventId: 1..65535, scope=ECU, set at pre-compile, symbolic-name-value=true  # Unique identifier of a diagnostic event. | This parameter should not be changeable by user, because the Id should be generated by Dem itself to prevent gaps and multiple use of an Id. The events should be sequentially ordered beginning with 1 and no gaps in between.
        enumeration DemEventKind: {DEM_EVENT_KIND_BSW, DEM_EVENT_KIND_SWC}, set at pre-compile  # This parameter is used to distinguish between SW-C and BSW events.
        boolean DemEventRecoverableInSameOperationCycle [0..1]: scope=ECU, post-build-variant-value=true, set at pre-compile, default-value=true  # If parameter is configured to FALSE, reporting of PASSED will be ignored if the event is already "testfailed this operation cycle".
        boolean DemFFPrestorageSupported: scope=ECU, set at pre-compile  # If this parameter is set to true, then the Prestorage of FreezeFrames is supported by the assigned event. This parameter is useful to calculate the buffer size.
        enumeration DemReportBehavior [0..1]: {REPORT_AFTER_INIT, REPORT_BEFORE_INIT}, multiplicity set at pre-compile, set at pre-compile, default-value=REPORT_BEFORE_INIT  # Indicates the reporting behavior of the BSW Module (DemEventKind == DEM_EVENT_KIND_BSW) in order to determine the size of the reporting queue. | If the parameter is not defined it means REPORT_BEFORE_INIT.
        reference DemComponentClassRef [0..1]: multiplicity set at pre-compile, set at pre-compile, destination=DemComponent  # Reference to the monitored component.
        reference DemDTCRef [0..1]: multiplicity set at pre-compile, set at pre-compile, destination=DemDTC  # This parameter defines the DTC configuration (typically Uds) associated with the diagnostic event. | It is allowed to have events without a DTC (e.g. for ECU-internal events triggering safety reactions without being reported via diagnostic communication). The same DemDTCAttributes can be used from several events, to combine these (refer to chapter "Combination of diagnostic event").
        reference DemEnableConditionGroupRef [0..1]: scope=ECU, multiplicity set at pre-compile, origin=AUTOSAR_ECUC V1.0.0, set at pre-compile, destination=DemEnableConditionGroup  # References an enable condition group.
        reference DemOBDGroupingAssociativeEventsRef [0..1]: scope=ECU, multiplicity set at pre-compile, set at pre-compile, destination=DemEventParameter  # This parameter defines a reference which points to a representative event of one group of associate events. | The "reverence event" must refer to it self. Note: One event is only allowed to be reverenced to only one group of associate events.
        reference DemOperationCycleRef: scope=ECU, origin=AUTOSAR_ECUC V1.0.0, set at pre-compile, destination=DemOperationCycle  # Kind of operation cycle for the event (e.g. power cycle, driving cycle, ...)
        reference DemStorageConditionGroupRef [0..1]: scope=ECU, multiplicity set at pre-compile, origin=AUTOSAR_ECUC V1.0.0, set at pre-compile, destination=DemStorageConditionGroup  # References a storage condition group.
        container DemCallbackClearEventAllowed [0..1]  # The presence of this container indicates that the Dem has access to a "ClearEventAllowed" callback. | In case there is a DemCallbackClearEventAllowedFnc, this parameter defines the name of the function that the Dem will call. In case there is no DemCallbackClearEventAllowedFnc, the Dem will have an R-Port requiring the interface CallbackClearEventAllowed whose name is generated by using the unique callback-prefix followed by the event name.
          function name DemCallbackClearEventAllowedFnc [0..1]: scope=ECU, multiplicity set at pre-compile, set at pre-compile  # Function name of prototype "ClearEventAllowed".
          enumeration DemClearEventAllowedBehavior: {DEM_NO_STATUS_BYTE_CHANGE, DEM_ONLY_THIS_CYCLE_AND_READINESS}, set at pre-compile, default-value=DEM_NO_STATUS_BYTE_CHANGE  # Defines the resulting UDS status byte for the related event, which must not be cleared according to the ClearEventAllowed callback.
        container DemCallbackEventDataChanged [0..1]  # The presence of this container indicates that the Dem has access to an "EventDataChanged" callback. | In case there is a DemCallbackEventDataChangedFnc, this parameter defines the name of the function that the Dem will call. In case there is no DemCallbackEventDataChangedFnc, the Dem will have an R-Port requiring the interface CallbackEventDataChanged whose name is generated by using the unique callback-prefix followed by the event name.
          function name DemCallbackEventDataChangedFnc [0..1]: scope=ECU, multiplicity set at pre-compile, set at pre-compile  # Function name of prototype "EventDataChanged"
        container DemCallbackEventUdsStatusChanged [0..*]  # The presence of this container indicates, that the Dem has access to an "EventUdsStatusChanged" callback, which the Dem will call to notify other components about the change in the status of an event. | In case there is a DemCallbackEventUdsStatusChangedFnc, this parameter defines the name of the function that the Dem will call. In case there is no DemCallbackEventUdsStatusChangedFnc, the Dem will have an R-Port requiring the interface CallbackEventUdsStatusChanged, whose name is generated by using the unique callback-prefix followed by the event name.
          function name DemCallbackEventUdsStatusChangedFnc [0..1]: scope=ECU, multiplicity set at pre-compile, set at pre-compile  # Function name of prototype "Dem_CBEventUdsStatusChanged"
        container DemCallbackInitMForE [0..1]  # The presence of this container indicates, that the Dem has access to an "InitMonitorForEvent" callback, which the Dem will call to initialize a monitor. | In case the container has a DemCallbackInitMForEFnc, this parameter defines the name of the function that the Dem will call. In case there is no DemCallbackInitMForEFnc, the Dem will have an R-Port requiring the interface CallbackInitMonitorForEvent, whose name is generated by using the unique callback-prefix followed by the event name.
          function name DemCallbackInitMForEFnc [0..1]: multiplicity set at pre-compile, set at pre-compile  # Function name of prototype "InitMonitorForEvent".
        container DemCallbackMonitorStatusChanged [0..*]  # The presence of this container indicates, that the Dem has access to an "MonitorStatusChanged" callback, which the Dem will call to notify other components about the change in the status of an event. | In case there is a DemCallbackMonitorStatusChangedFnc, this parameter defines the name of the function that the Dem will call. In case there is no DemCallbackMonitorStatusChangedFnc, the Dem will have an R-Port requiring the interface CallbackMonitorStatusChanged, whose name is generated by using the unique callback-prefix followed by the event name.
          function name DemCallbackMonitorStatusChangedFnc [0..1]: scope=ECU, multiplicity set at pre-compile, set at pre-compile  # Function name of prototype "<Module>_DemTriggerOnMonitorStatus"
        choice container DemDebounceAlgorithmClass  # Debounce algorithm class: counter based, time based, or monitor internal.
          container DemDebounceCounterBased [0..1]  # This container contains the configuration (parameters) for counter based debouncing.
            reference DemDebounceCounterBasedClassRef: set at pre-compile, destination=DemDebounceCounterBasedClass  # This reference selects the DemDebounceCounterBasedClass applied for the debouncing of the DemEventParameter.
          container DemDebounceMonitorInternal [0..1]  # This container contains the configuration (parameters) for monitor internal debouncing.
            container DemCallbackGetFDC [0..1]  # DemCallbackGetFDC specifies the callback (parameter DemCallbackGetFDCFnc is present) or R-Port (no parameter DemCallbackGetFDCFnc is present) to retrieve the fault detection counter value. | In case no container is configured, no fault detection counter will be available.
              function name DemCallbackGetFDCFnc [0..1]: scope=ECU, multiplicity set at pre-compile, set at pre-compile  # This parameter defines the name of the function that the Dem will call to retrieve the fault-detection counter value from a complex driver.
          container DemDebounceTimeBase [0..1]  # This container contains the configuration (parameters) for time based debouncing.
            reference DemDebounceTimeBaseRef: set at pre-compile, destination=DemDebounceTimeBaseClass  # This reference selects the DemDebounceTimeBaseClass applied for the debouncing of the DemEventParameter.
        container DemIndicatorAttribute [0..255]  # This container contains the event specific configuration of Indicators.
          enumeration DemIndicatorBehaviour: {DEM_INDICATOR_BLINKING, DEM_INDICATOR_BLINK_CONT, DEM_INDICATOR_CONTINUOUS, DEM_INDICATOR_FAST_FLASH, DEM_INDICATOR_SLOW_FLASH}, scope=ECU, post-build-variant-value=true, set at post-build in variant post-build / pre-compile in variant pre-compile  # Behaviour of the linked indicator
          integer DemIndicatorFailureCycleCounterThreshold [0..1]: 1..255, scope=ECU, multiplicity set at pre-compile, set at pre-compile  # Defines the number of failure cycles for the WarningIndicatorOnCriteria.
          integer DemIndicatorHealingCycleCounterThreshold: 0..255, scope=ECU, set at pre-compile  # Defines the number of healing cycles for the WarningIndicatorOffCriteria.
          reference DemIndicatorRef: scope=ECU, set at pre-compile, destination=DemIndicator  # Reference to the used indicator.
      container DemMultiEventTriggering [0..65535]  # Configures an event that will trigger other events whenever the event is reported.
        reference DemMultiEventTriggeringMasterEventRef: scope=ECU, set at pre-compile, destination=DemEventParameter  # Reference to the event that will trigger other events upon reception of this event.
        reference DemMultiEventTriggeringSlaveEventRef [1..255]: scope=ECU, set at pre-compile, destination=DemEventParameter  # Reference to the event that is triggered upon triggering the master event.
      container DemObdDTC [0..65535]  # This container contains the configuration (parameters) for DemObdDTC.
        boolean DemConsiderPtoStatus: scope=ECU, set at pre-compile  # This parameter is TRUE, when the event is affected by the Dem PTO handling.
        integer DemDtcValue [0..1]: 1..65535, scope=ECU, multiplicity set at post-build in variant post-build / pre-compile in variant pre-compile, post-build-variant-multiplicity=true, post-build-variant-value=true, set at post-build in variant post-build / pre-compile in variant pre-compile  # Unique Diagnostic Trouble Code value for OBD
        enumeration DemEventOBDReadinessGroup [0..1]: {DEM_OBD_RDY_AC, DEM_OBD_RDY_BOOSTPR, DEM_OBD_RDY_CAT, DEM_OBD_RDY_CMPRCMPT, DEM_OBD_RDY_EGR, DEM_OBD_RDY_EGSENS, DEM_OBD_RDY_EVAP, DEM_OBD_RDY_FLSYS, DEM_OBD_RDY_FLSYS_NONCONT, DEM_OBD_RDY_HCCAT, DEM_OBD_RDY_HTCAT, DEM_OBD_RDY_MISF, DEM_OBD_RDY_NONE, DEM_OBD_RDY_NOXCAT, DEM_OBD_RDY_O2SENS, DEM_OBD_RDY_O2SENSHT, DEM_OBD_RDY_PMFLT, DEM_OBD_RDY_SECAIR}, scope=ECU, multiplicity set at pre-compile, set at pre-compile  # This parameter specifies the Event OBD Readiness group for PID $01 and PID $41 computation. | This parameter is only applicable for emission-related ECUs.
        integer DemJ1939DTCValue [0..1]: 1..16777214, scope=ECU, multiplicity set at post-build in variant post-build / pre-compile in variant pre-compile, post-build-variant-multiplicity=true, post-build-variant-value=true, set at post-build in variant post-build / pre-compile in variant pre-compile  # Unique Diagnostic Trouble Code value for J1939 (consisting of SPN and FMI)
      container DemPidClass [0..255]  # This container contains the different PIDs for the single global OBD relevant freeze frame class. It is assembled out of one or several data elements.
        integer DemPidIdentifier: 0..255, scope=ECU, post-build-variant-value=true, set at post-build in variant post-build / pre-compile in variant pre-compile  # identifier of the PID
        container DemPidDataElement [1..255]: multiplicity set at pre-compile  # This container contains the different data elements contained in the specific PID.
          reference DemPidDataElementClassRef: scope=ECU, post-build-variant-value=true, set at post-build in variant post-build / pre-compile in variant pre-compile, destination=DemDataElementClass  # This reference contains the link to a data element class.
    container DemGeneral  # This container contains the configuration (parameters) of the BSW Dem
      boolean DemAgingRequiresNotFailedCycle: set at pre-compile, default-value=false  # Defines if the aging cycle counter is processed in operation cycles with test failed report or not. | True: Aging cycle counter is processed only in operation cycles without test failed. False (Default): No effect on aging cycle counter processing.
      boolean DemAgingRequiresTestedCycle: scope=ECU, set at pre-compile  # Defines if the aging cycle counter is processed every aging cycles or if only tested aging cycle are considered. | true: only tested aging cycle are considered for aging cycle counter false: aging cycle counter is processed every aging cycle
      enumeration DemAvailabilitySupport: {DEM_EVENT_AVAILABILITY, DEM_NO_AVAILABILITY}, set at pre-compile  # This configuration switch defines, whether support for availability is enabled or not.
      integer DemBswErrorBufferSize [0..1]: 0..255, scope=ECU, multiplicity set at pre-compile, set at pre-compile  # Maximum number of elements in buffer for handling of BSW errors (ref. to SWS_Dem_00207).
      enumeration DemClearDTCBehavior: {DEM_CLRRESP_NONVOLATILE_FINISH, DEM_CLRRESP_NONVOLATILE_TRIGGER, DEM_CLRRESP_VOLATILE}, scope=ECU, set at pre-compile  # Defines the clearing process of diagnostic information for volatile and non-volatile memory and the positive response handling for the Dcm module.
      enumeration DemClearDTCLimitation: {DEM_ALL_SUPPORTED_DTCS, DEM_ONLY_CLEAR_ALL_DTCS}, scope=ECU, set at pre-compile, default-value=DEM_ALL_SUPPORTED_DTCS  # Defines the supported Dem_<...>ClearDTC API scope.
      enumeration DemDataElementDefaultEndianness: {BIG_ENDIAN, LITTLE_ENDIAN, OPAQUE}, set at pre-compile  # Defines the default endianness of the data belonging to a data element which is applicable if the DemExternalSRDataElementClass does not define a endianness.
      boolean DemDebounceCounterBasedSupport: scope=ECU, set at pre-compile  # This configuration switch defines, whether support for counter based debouncing is enabled or not. | true: counter based debouncing support is enabled false: counter based debouncing support is disabled
      boolean DemDebounceTimeBasedSupport: scope=ECU, set at pre-compile  # This configuration switch defines, whether support for time based debouncing is enabled or not. | true: time based debouncing support is enabled false: time based debouncing support is disabled
      boolean DemDevErrorDetect: set at pre-compile, default-value=false  # Switches the development error detection and notification on or off. | * true: detection and notification is enabled. * false: detection and notification is disabled.
      enumeration DemEnvironmentDataCapture [0..1]: {DEM_CAPTURE_ASYNCHRONOUS_TO_REPORTING, DEM_CAPTURE_SYNCHRONOUS_TO_REPORTING}, multiplicity set at pre-compile, set at pre-compile  # DemEnvironmentDataCapture defines the point in time, when the data actually is captured.
      enumeration DemEventCombinationSupport: {DEM_EVCOMB_DISABLED, DEM_EVCOMB_ONRETRIEVAL, DEM_EVCOMB_ONSTORAGE}, scope=ECU, set at pre-compile  # This parameter defines the type of event combination supported by the Dem.
      enumeration DemEventDisplacementStrategy: {DEM_DISPLACEMENT_FULL, DEM_DISPLACEMENT_NONE, DEM_DISPLACEMENT_PRIO_OCC}, scope=ECU, set at pre-compile  # This configuration switch defines, whether support for event displacement is enabled or not, and which displacement strategy is followed.
      enumeration DemEventMemoryEntryStorageTrigger: {DEM_TRIGGER_ON_CONFIRMED, DEM_TRIGGER_ON_FDC_THRESHOLD, DEM_TRIGGER_ON_TEST_FAILED}, set at pre-compile, default-value=DEM_TRIGGER_ON_TEST_FAILED  # Configures the primary trigger to allocate an event memory entry.
      function name DemGeneralCallbackMonitorStatusChangedFnc [0..1]: scope=ECU, multiplicity set at pre-compile, set at pre-compile  # Function name of prototype "<Module>_DemTriggerOnMonitorStatus". | Function for the General Monitor Status Changed notification.
      boolean DemGeneralInterfaceSupport: scope=ECU, set at pre-compile  # The interfaces GeneralEvtInfo, GeneralCallbackEventDataChanged, GeneralCallbackMonitorStatusChanged and GeneralCallbackEventUdsStatusChange are provided if DemGeneralInterfaceSupport is equal to true.
      string DemHeaderFileInclusion [0..*]: scope=ECU, multiplicity set at pre-compile, set at pre-compile, regular-expression=[a-zA-Z0-9_]([a-zA-Z0-9\._])*  # Name of the header file(s) to be included by the Dem module containing the used C-callback declarations.
      integer DemMaxNumberEventEntryEventBuffer [0..1]: 1..250, scope=ECU, multiplicity set at pre-compile, set at pre-compile  # Specifies the size of the buffer for storing environmental data (freezeframes and extended data) until they are processed and stored to the event memory.
      integer DemMaxNumberPrestoredFF: 0..255, scope=ECU, set at pre-compile  # Defines the maximum number for prestored freeze frames. | If set to 0, then freeze frame prestorage is not supported by the ECU.
      enumeration DemOBDSupport: {DEM_OBD_DEP_SEC_ECU, DEM_OBD_MASTER_ECU, DEM_OBD_NO_OBD_SUPPORT, DEM_OBD_PRIMARY_ECU}, scope=ECU, set at pre-compile  # This configuration switch defines OBD support and kind of OBD ECU.
      enumeration DemOccurrenceCounterProcessing: {DEM_PROCESS_OCCCTR_CDTC, DEM_PROCESS_OCCCTR_TF}, scope=ECU, set at pre-compile  # This configuration switch defines the consideration of the fault confirmation process for the occurrence counter. For OBD and mixed systems (OBD/non OBD, refer to DemOBDSupport) configuration switch shall always set to DEM_PROCESS_OCCCTR_TF.
      boolean DemOperationCycleStatusStorage: scope=ECU, set at pre-compile  # Defines if the operation cycle state is available over the power cycle (stored non-volatile) or not. | true: the operation cycle state is stored non-volatile false: the operation cycle state is only stored volatile
      boolean DemPTOSupport: scope=ECU, set at pre-compile  # This configuration switch defines, whether PTO support (and therefore PID $1E support) is enabled or not.
      boolean DemResetConfirmedBitOnOverflow: set at pre-compile, default-value=true  # This configuration switch defines, whether the confirmed bit is reset or not while an event memory entry will be displaced.
      enumeration DemStatusBitHandlingTestFailedSinceLastClear: {DEM_STATUS_BIT_AGING_AND_DISPLACEMENT, DEM_STATUS_BIT_NORMAL}, scope=ECU, set at pre-compile, default-value=DEM_STATUS_BIT_NORMAL  # This configuration switch defines, whether the aging and displacement mechanism shall be applied to the "TestFailedSinceLastClear" status bits.
      boolean DemStatusBitStorageTestFailed: scope=ECU, set at pre-compile  # Activate/Deactivate the permanent storage of the "TestFailed" status bits. | true: storage activated false: storage deactivated
      enumeration DemSuppressionSupport: {DEM_DTC_SUPPRESSION, DEM_NO_SUPPRESSION}, scope=ECU, set at pre-compile  # This configuration switch defines, whether support for suppression is enabled or not.
      float DemTaskTime: 0..Inf, scope=ECU, origin=AUTOSAR_ECUC V1.0.0, set at pre-compile  # Allow to configure the time for the periodic cyclic task. Please note: This configuration value shall be equal to the value in the Basic Software Scheduler configuration of the RTE module. | The AUTOSAR configuration standard is to use SI units, so this parameter is defined as float value in seconds. Dem configuration tools must convert this float value to the appropriate value format for the use in the software implementation of Dem. min: A negative value is not allowed. max: After event status was reported, processing shall be completed within 100ms in order to have the fault entry status information updated as soon as possible (e.g. for PID $01). upperMultiplicity: Exactly one TaskTime must be specified per configuration. lowerMultiplicity: Exactly one TaskTime must be specified per configuration.
      boolean DemTriggerDcmReports: scope=ECU, set at pre-compile  # Activate/Deactivate the notification to the Diagnostic Communication Manager for ROE processing. | true: Dcm ROE notification activated false: Dcm ROE notification deactivated
      boolean DemTriggerDltReports: scope=ECU, set at pre-compile  # Activate/Deactivate the notification to the Diagnostic Log and Trace. | true: Dlt notification activated false: Dlt notification deactivated
      boolean DemTriggerFiMReports: scope=ECU, set at pre-compile  # Activate/Deactivate the notification to the Function Inhibition Manager. | true: FiM notification activated false: FiM notification deactivated
      boolean DemTriggerMonitorInitBeforeClearOk: scope=ECU, set at pre-compile  # Defines if the monitor re-initialization has to be triggered before or after the Dem module returns DEM_CLEAR_OK. | true: trigger re-initialization before DEM_CLEAR_OK false: trigger re-initialization after DEM_CLEAR_OK
      enumeration DemTypeOfFreezeFrameRecordNumeration: {DEM_FF_RECNUM_CALCULATED, DEM_FF_RECNUM_CONFIGURED}, scope=ECU, set at pre-compile  # This parameter defines the type of assigning freeze frame record numbers for event-specific freeze frame records.
      boolean DemVersionInfoApi: set at pre-compile, default-value=false  # Activate/Deactivate the version information API. | true: version information activated false: version information deactivated
      reference DemClearEventsWithoutDTCEventMemoryRef [0..1]: multiplicity set at pre-compile, set at pre-compile, destination=DemPrimaryMemory  # Indicating the event memory used as trigger to clear events without assigned DTCs.
      reference DemOBDEventMemorySetRef [0..1]: multiplicity set at pre-compile, set at pre-compile, destination=DemEventMemorySet  # References the DemEventMemorySet used for OBD ECU.
      container DemClient [1..255]: multiplicity set at pre-compile  # This container contains possible clients that are using the Dem APIs.
        enumeration DemClientFunctionality: {DEM_CLIENT_ONLY_USES_EVENTOVERFLOW_INTERFACE, DEM_CLIENT_USES_FULL_FUNCTIONALITY}, post-build-variant-value=true, set at pre-compile, default-value=DEM_CLIENT_USES_FULL_FUNCTIONALITY  # Functionality provided by Dem for the DemClient.
        integer DemClientId: 0..255, scope=ECU, multiplicity set at pre-compile, set at pre-compile, symbolic-name-value=true  # Defines a unique identifier for a Dem client. This number is used by this client in the ClientID parameter in all API with this parameter.
        boolean DemClientUsesRte: multiplicity set at pre-compile, set at pre-compile, default-value=false  # If set to true, this client shall only use the DEM via RTE (Dem will provide the C/S interfaces: CddIf, EvMemOverflowIndication). The client must not do any C_API calls to the DEM.
        reference DemEventMemorySetRef: multiplicity set at pre-compile, set at pre-compile, destination=DemEventMemorySet  # References to the client assigned event memory container that contains client specific settings and event memories.
        container DemCallbackDTCStatusChanged [0..*]  # The presence of this container indicates, that the Dem has access to a "DTCStatusChanged" callback, which the Dem will call to notify other components about the change in the status of a DTC. | In case there is a DemCallbackDTCStatusChangedFnc, this parameter defines the name of the function that the Dem will call. In case there is no DemCallbackDTCStatusChangedFnc, the Dem will have an R-Port requiring the interface CallbackDTCStatusChanged whose name is generated by using the unique callback-prefix followed by the event name. Status change notifications are supported for DTCs in primary memory only.
          function name DemCallbackDTCStatusChangedFnc [0..1]: scope=ECU, multiplicity set at pre-compile, set at pre-compile  # Function name of prototype "DTCStatusChanged". | Note: If the parameter DemTriggerDcmReports is enabled, this parameter shall not be "Dcm_DemTriggerOnDTCStatus".
      choice container DemDataElementClass [0..65535]  # This container contains the configuration (parameters) for an internal/external data element class.
        container DemExternalCSDataElementClass [0..1]  # This container contains the configuration (parameters) for an external client/server based data element class. | It defines, how the Dem can obtain the value of the data element from either a SW-C or another BSW module. Whether a client/server port or a C function-call is used, is defined by DemDataElementUsePort.
          integer DemDataElementDataSize: 1..255, scope=ECU, set at pre-compile  # Defines the size of the data element in bytes.
          function name DemDataElementReadFnc [0..1]: scope=ECU, multiplicity set at pre-compile, set at pre-compile  # In case of DemDataElementUsePort is false, this parameter defines the prototype of the C function "ReadDataElement" used to get the according value.
          boolean DemDataElementUsePort: scope=ECU, set at pre-compile  # If the parameter is set to True, a R-Port is generated, to obtain the data element (interface DataServices_{Data}). | If the parameter is set to False, the information is obtained by C function-call on another BSW module specified by the parameter DemDataElementReadFnc.
        container DemExternalSRDataElementClass [0..1]  # This container contains the configuration (parameters) for an external sender/receiver based data element class. It defines, how the Dem can obtain the value of the data element from a SW-C, by using a sender/receiver port.
          integer DemDataElementDataSize: 1..255, scope=ECU, set at pre-compile  # Defines the size of the data element in bytes.
          enumeration DemDataElementDataType: {BOOLEAN, SINT16, SINT32, SINT8, UINT16, UINT32, UINT8}, scope=ECU, multiplicity set at pre-compile, set at pre-compile  # Provide the implementation data type of data belonging to a external data.
          enumeration DemDataElementEndianness [0..1]: {BIG_ENDIAN, LITTLE_ENDIAN, OPAQUE}, multiplicity set at pre-compile, set at pre-compile  # Defines the endianness of the data belonging to an external data. | If no DemDataElementEndianness is defined the value of DemDataElementDefaultEndianness is applicable.
          choice container DemDiagnosisScaling [0..1]  # This container contains the configuration (parameters) of an alternative Diagnosis Representation. Out if this the scaling between Diagnosis and ECU internal representation and vice versa can be calculated.
            container DemAlternativeDataInterface [0..1]  # This container contains the configuration (parameters) of an alternative Diagnosis Representation by the means of a VariableDataPrototoype in a DataInterface. | Additionally a reference to PortInterfaceMapping can be defined which provide already the mapping rules between the VariableDataPrototoype in a DataInterface used by the software component (DemSRDataElementClass) and the intended Diagnosis Representation defined by DemExternalSRDataElementClass.
              foreign reference DemDataElement: set at pre-compile, destination-type=VARIABLE-DATA-PROTOTYPE  # Alternative Diagnosis Representation for the data defined by the means of a VariableDataPrototoype in a DataInterface. | The CompuMethod of the data type of the referenced VariableDataPrototype will be applied to the data type of the VariableDataPrototype in the interface used by the Dem.
              foreign reference DemPortInterfaceMapping [0..1]: multiplicity set at pre-compile, set at pre-compile, destination-type=PORT-INTERFACE-MAPPING  # Optional reference to PortInterfaceMapping which defines the mapping rules. | The PortInterfaceMapping is used to get the DataPrototypeMapping that describes a conversion between the data prototype referenced by DemDataElement and the data prototype referenced from DcmDspExternalSRDataElementClass.
            container DemAlternativeDataType [0..1]  # This container contains the configuration (parameters) of an alternative Diagnosis Representation by the means of an ApplicationDataType. | Additionally the definition of a text table mapping can be a defined for ApplicationDataTypes of category TEXTTABLE and SCALE_LINEAR_AND_TEXTTABLE.
              foreign reference DemApplicationDataType: set at pre-compile, destination-type=APPLICATION-DATA-TYPE  # Alternative Diagnosis Representation for the data defined by the means of a ApplicationDataType of category VALUE, BOOLEAN or ARRAY. | The CompuMethod that applies to the referenced ApplicationDataType in case of category VALUE or BOOLEAN will be applied to the data type of the VariableDataPrototype in the interface used by the Dem.
              container DemTextTableMapping [0..*]  # The purpose of the DemDspTextTableMapping is to associate a texttable value defined in the context of the Dem to a texttable value defined in the context of a CompuMethod referenced by a DataType that shall be taken to create a dataElement in a SenderReceiverInterface. By this means it is possible to create a primitive version of a TexttableMapping (which can only be applied if a dataElement already exists). | In other words, the DemDspTextTableMapping provides a similar mechanism to the TexttableMapping in a situation where the TexttableMapping cannot be applied since the SenderReceiverInterface for the PortPrototype on the Dem ServiceComponent does not yet exist.
                integer DemDiagnosisRepresentationDataValue: 0..18446744073709551615, scope=ECU, set at pre-compile  # The data value in the diagnosis representation.
                integer DemInternalDataValue: 0..18446744073709551615, scope=ECU, set at pre-compile  # The ECU internal data value.
            container DemAlternativeDiagnosticDataElement [0..1]  # This container contains the configuration (parameters) of an alternative Diagnosis Representation by the means of Diagnostic Extract.
              foreign reference DemDiagnosticDataElementRef: set at pre-compile, destination-type=DIAGNOSTIC-DATA-ELEMENT  # Alternative Diagnosis Representation for the data defined by the means of a DiagnosticDataElement in the Diagnostic Extract. | This EcucForeignReference enables the access to all SwDataDefProps, in particular BaseType, CompuMethod and DataConstr The CompuMethod and DataConstr that applies to the referenced DiagnosticDataElement will be applied to the data type of the VariableDataPrototype in the interface used by the Dem. The mapped ImplementationDataType needs to match the given BaseType.
          choice container DemSRDataElementClass [0..1]  # This container defines the source of data in a provided port which shall be read for a external data element | This container shall contain either one DemSubElementInDataElementInstance OR DemDataElementInstance OR DemSubElementInImplDataElementInstance reference.
            container DemDataElementInstance [0..1]  # Instance Reference to the primitive data in a port where the data element is typed with an ApplicationPrimitveDataType or an ImplementationDataType.
              instance reference DemDataElementInstanceRef: set at pre-compile, destination-context=ROOT-SW-COMPOSITION-PROTOTYPE SW-COMPONENT-PROTOTYPE PORT-PROTOTYPE, destination-type=AUTOSAR-DATA-PROTOTYPE  # Instance Reference to the primitive data which shall be read or written. | Supported are VariableDataPrototypes in SenderReceiverInterfaces and NvDataInterfaces and ParameterDataPrototypes in ParameterInterfaces (read only). This reference is applicable if the AutosarDataPrototype is typed with a ApplicationPrimitiveDataType of category VALUE or BOOLEAN or if the AutosarDataPrototype is typed with a ImplementationDataType of category VALUE or TYPE_REFERENCE that in turn boils down to VALUE
            container DemSubElementInDataElementInstance [0..1]  # Instance Reference to the primitve sub-element (at any level) of composite data in a port where the data element is typed with an ApplicationCompositeDataType.
              instance reference DemSubElementInDataElementInstanceRef: set at pre-compile, destination-context=ROOT-SW-COMPOSITION-PROTOTYPE SW-COMPONENT-PROTOTYPE PORT-PROTOTYPE AUTOSAR-DATA-PROTOTYPE APPLICATION-COMPOSITE-ELEMENT-DATA-PROTOTYPE*, destination-type=APPLICATION-COMPOSITE-ELEMENT-DATA-PROTOTYPE  # Instance Reference to the primitve sub-element (at any level) of composite data in a port which shall be read or written. | Supported are VariableDataPrototypes in SenderReceiverInterfaces and NvDataInterfaces and ParameterDataPrototypes in ParameterInterfaces (read only). This reference is applicable if the AutosarDataPrototype is typed with a ApplicationCompositeDataType.
            container DemSubElementInImplDataElementInstance [0..1]  # Instance Reference to the primitve sub-element (at any level) of composite data in a port where the data element is typed with an ImplementationDataType of category STRUCTURE or ARRAY.
              instance reference DemSubElementInImplDataElementInstanceRef: set at pre-compile, destination-context=ROOT-SW-COMPOSITION-PROTOTYPE SW-COMPONENT-PROTOTYPE PORT-PROTOTYPE AUTOSAR-DATA-PROTOTYPE IMPLEMENTATION-DATA-TYPE-ELEMENT*, destination-type=IMPLEMENTATION-DATA-TYPE-ELEMENT  # Instance Reference to the primitve sub-element (at any level) of composite data in a port which shall be read or written. | Supported are VariableDataPrototypes in SenderReceiverInterfaces and NvDataInterfaces and ParameterDataPrototypes in ParameterInterfaces (read only). This reference is applicable if the AutosarDataPrototype is typed with a ImplementationDataType of category STRUCTURE or ARRAY. Please note that in case of ARRAY the index attribute in the target reference has to be set to select a single array element.
        container DemInternalDataElementClass [0..1]  # This container contains the configuration (parameters) for an internal data element class.
          integer DemDataElementDataSize: 1..255, scope=ECU, set at pre-compile  # Defines the size of the data element in bytes.
          enumeration DemInternalDataElement: {DEM_AGINGCTR_DOWNCNT, DEM_AGINGCTR_UPCNT, DEM_AGINGCTR_UPCNT_FIRST_ACTIVE, DEM_CLR_DIST, DEM_CLR_TIME, DEM_CURRENT_FDC, DEM_CYCLES_SINCE_FIRST_FAILED, DEM_CYCLES_SINCE_LAST_FAILED, DEM_FAILED_CYCLES, DEM_MAX_FDC_DURING_CURRENT_CYCLE, DEM_MAX_FDC_SINCE_LAST_CLEAR, DEM_MIL_DIST, DEM_MIL_TIME, DEM_OCCCTR, DEM_OVFLIND, DEM_SIGNIFICANCE, DEM_WARM_UPS}, scope=ECU, set at pre-compile  # This parameter defines the Dem-internal data value, which is mapped to the data element.
      container DemDidClass [0..65535]  # This container contains the configuration (parameters) for a data Id class. It is assembled out of one or several data elements.
        integer DemDidIdentifier: 0..65535, set at pre-compile  # Identifier of the Data ID.
        reference DemDidDataElementClassRef [1..255]: scope=ECU, multiplicity set at pre-compile, requires-index=true, set at pre-compile, destination=DemDataElementClass  # This reference contains the link to a data element class.
      container DemEnableCondition [0..255]  # This container contains the configuration (parameters) for enable conditions.
        integer DemEnableConditionId: 0..255, scope=ECU, set at pre-compile, symbolic-name-value=true  # Defines a unique enable condition Id. | This parameter should not be changeable by user, because the Id should be generated by Dem itself to prevent gaps and multiple use of an Id. The enable conditions should be sequentially ordered beginning with 0 and no gaps in between.
        boolean DemEnableConditionStatus: scope=ECU, set at pre-compile  # Defines the initial status for enable or disable of acceptance of event reports of a diagnostic event. | The value is the initialization after power up (before this condition is reported the first time). true: acceptance of a diagnostic event enabled false: acceptance of a diagnostic event disabled
      container DemEnableConditionGroup [0..255]  # This container contains the configuration (parameters) for enable condition groups.
        reference DemEnableConditionRef [1..255]: scope=ECU, multiplicity set at pre-compile, origin=AUTOSAR_ECUC V1.0.0, set at pre-compile, destination=DemEnableCondition  # References an enable condition.
      container DemEventMemorySet [1..255]  # This container is a collection of referenced event memories and related information for a Dem client.
        integer DemDtcStatusAvailabilityMask: 0..255, scope=ECU, set at pre-compile  # Mask for the supported DTC status bits by the Dem. This mask is used by UDS service 0x19.
        integer DemMaxNumberEventEntryPermanent: 0..255, scope=ECU, set at pre-compile  # Maximum number of events which can be stored in the permanent memory. | The assignment of an event to this memory type is dynamic and used for emission-related events only.
        enumeration DemTypeOfDTCSupported: {DEM_DTC_TRANSLATION_ISO11992_4, DEM_DTC_TRANSLATION_ISO14229_1, DEM_DTC_TRANSLATION_ISO15031_6, DEM_DTC_TRANSLATION_SAEJ1939_73, DEM_DTC_TRANSLATION_SAE_J2012_DA_DTCFORMAT_04}, scope=ECU, set at pre-compile  # This parameter defines the format returned by Dem_GetTranslationType and does not relate to/influence the supported Dem functionality.
        reference DemAmberWarningLampIndicatorRef [0..1]: multiplicity set at pre-compile, set at pre-compile, destination=DemIndicator  # This parameter defines the indicator representing the AmberWarningLamp . This parameter may be used for ECUs supporting J1939.
        reference DemMILIndicatorRef [0..1]: scope=ECU, multiplicity set at pre-compile, set at pre-compile, destination=DemIndicator  # This parameter defines the indicator representing the MIL. | This parameter is mandatory for ECUs supporting OBD (refer to DemOBDSupport).
        reference DemProtectLampIndicatorRef [0..1]: multiplicity set at pre-compile, set at pre-compile, destination=DemIndicator  # This parameter defines the indicator representing the ProtectLamp. This parameter may be used for ECUs supporting J1939.
        reference DemRedStopLampIndicatorRef [0..1]: multiplicity set at pre-compile, set at pre-compile, destination=DemIndicator  # This parameter defines the indicator representing the RedStopLamp. This parameter may be used for ECUs supporting J1939.
        container DemClearDTCNotification [0..255]  # Contains callback function definition which are called during clear DTC operations.
          function name DemClearDtcNotificationFnc [0..1]: multiplicity set at pre-compile, set at pre-compile  # Notification callback function name which is called on a clear DTC operation (refer to <Module>_ClearDtcNotification).
          enumeration DemClearDtcNotificationTime: {FINISH, START}, set at pre-compile  # Configure, whether the callback shall be called on start of a clear or after finishing a clear DTC operation (refer to <Module>_ClearDtcNotification)
        container DemIndicator [0..255]  # This container contains the configuration (parameters) for Indicators.
          integer DemIndicatorID: 0..255, scope=ECU, set at pre-compile, symbolic-name-value=true  # Unique identifier of an indicator.
        container DemMirrorMemory [0..1]  # This container contains the mirror event memory specific parameters of the Dem module.
          integer DemMaxNumberEventEntryMirror: 1..255, scope=ECU, set at pre-compile  # Maximum number of events which can be stored in the mirror memory
        container DemPrimaryMemory  # This container contains the primary event memory specific parameters of the Dem module.
          integer DemMaxNumberEventEntryPrimary: 1..255, scope=ECU, set at pre-compile  # Maximum number of events which can be stored in the primary memory
        container DemUserDefinedMemory [0..30]  # This container contains the user defined event memory specific parameters of the Dem module.
          integer DemMaxNumberEventEntryUserDefined: 1..255, scope=ECU, set at pre-compile  # Maximum number of events which can be stored in the user defined memory.
          integer DemUserDefinedMemoryIdentifier: 0..255, scope=ECU, set at pre-compile, symbolic-name-value=true  # Identifier used by external tester to identify the User defined event memory.
      container DemExtendedDataClass [0..*]  # This class contains the combinations of extended data records for an extended data class.
        reference DemExtendedDataRecordClassRef [1..253]: multiplicity set at pre-compile, requires-index=true, set at pre-compile, destination=DemExtendedDataRecordClass  # This reference contains the link to an extended data class record.
      container DemExtendedDataRecordClass [0..253]  # This container contains the configuration (parameters) for an extended data record class. | It is assembled out of one or several data elements.
        integer DemExtendedDataRecordNumber: 1..239, scope=ECU, set at pre-compile  # This configuration parameter specifies an unique identifier for an extended data record. | One or more extended data records can be assigned to one diagnostic event/DTC. 0x00 is reserved by ISO (therefore the minimal value equals 1) 0xF0 to 0xFF are reserved by ISO (therefore the maximal value equals 239)
        enumeration DemExtendedDataRecordTrigger: {DEM_TRIGGER_ON_CONFIRMED, DEM_TRIGGER_ON_FDC_THRESHOLD, DEM_TRIGGER_ON_MIRROR, DEM_TRIGGER_ON_PASSED, DEM_TRIGGER_ON_PENDING, DEM_TRIGGER_ON_TEST_FAILED}, set at pre-compile  # Defines the trigger to store the ExtendedDataRecord.
        enumeration DemExtendedDataRecordUpdate: {DEM_UPDATE_RECORD_NO, DEM_UPDATE_RECORD_YES}, scope=ECU, set at pre-compile  # This extended data record is captured if the configured trigger condition in "DemExtendedDataRecordTrigger" is fulfilled.
        reference DemDataElementClassRef [1..255]: multiplicity set at pre-compile, requires-index=true, set at pre-compile, destination=DemDataElementClass  # This reference contains the link to a data element class.
      container DemFreezeFrameClass [0..65535]  # This container contains the combinations of DIDs for a non OBD2 and WWH-OBD relevant freeze frame class.
        reference DemDidClassRef [1..255]: scope=ECU, multiplicity set at pre-compile, requires-index=true, set at pre-compile, destination=DemDidClass  # Reference to the DID elements which shall be contained in the freeze frame.
      container DemFreezeFrameRecNumClass [0..255]  # This container contains a list of dedicated, different freeze frame record numbers assigned to an event. The order of record numbers in this list is assigned to the chronological order of the according freeze frame records. | dependency: DemTypeOfFreezeFrameRecordNumeration = DEM_FF_RECNUM_CONFIGURED
        reference DemFreezeFrameRecordClassRef [1..254]: scope=ECU, multiplicity set at pre-compile, requires-index=true, set at pre-compile, destination=DemFreezeFrameRecordClass  # This parameter references record number(s) for a freeze frame record.
      container DemFreezeFrameRecordClass [0..255]  # This container contains a list of dedicated, different freeze frame record numbers.
        integer DemFreezeFrameRecordNumber: 0..254, scope=ECU, set at pre-compile  # This parameter defines a record number for a freeze frame record. This record number is unique per freeze frame record number class.
        enumeration DemFreezeFrameRecordTrigger: {DEM_TRIGGER_ON_CONFIRMED, DEM_TRIGGER_ON_FDC_THRESHOLD, DEM_TRIGGER_ON_PENDING, DEM_TRIGGER_ON_TEST_FAILED}, set at pre-compile  # Defines the trigger to store the FreezeFrameRecord.
        enumeration DemFreezeFrameRecordUpdate: {DEM_UPDATE_RECORD_NO, DEM_UPDATE_RECORD_YES}, scope=ECU, set at pre-compile  # This parameter defines the case, when the freeze frame record is stored/updated.
      container DemGeneralJ1939 [0..1]  # This container contains the general J1939-specific configuration (parameters) of the Dem module. | If the container exists the J1939 support is enabled.
        boolean DemJ1939ClearDtcSupport: set at pre-compile  # This configuration switch defines whether clearing J1939 DTCs (DM03 und DM11) is supported or not. | This switches on and off the API Dem_J1939DcmClearDTC.
        boolean DemJ1939Dm31Support: set at pre-compile  # This configuration switch defines whether J1939 DM31 is supported or not. | This switches on and off the APIs Dem_J1939DcmFirstDTCwithLampStatus and Dem_J1939DcmGetNextDTCwithLampStatus. .
        boolean DemJ1939ExpandedFreezeFrameSupport: set at pre-compile  # This configuration switch defines whether J1939 expanded freeze frames are supported or not. | This switches on and off the APIs Dem_J1939DcmSetFreezeFrameFilter, Dem_J1939DcmGetNextFreezeFrame and Dem_J1939DcmGetNextSPNInFreezeFrame.
        boolean DemJ1939FreezeFrameSupport: set at pre-compile  # This configuration switch defines whether J1939 freeze frames are supported or not. | This switches on and off the APIs Dem_J1939DcmSetFreezeFrameFilter and Dem_J1939DcmGetNextFreezeFrame.
        boolean DemJ1939RatioSupport: set at pre-compile  # This configuration switch defines whether J1939 performance ratios are supported or not. | This switches on and off the APIs Dem_J1939DcmSetRatioFilter and Dem_J1939DcmGetNextFilteredRatio.
        boolean DemJ1939Readiness1Support: set at pre-compile  # This configuration switch defines whether J1939 diagnostic readiness 1 is supported or not. | This switches on and off the API Dem_J1939DcmReadDiagnosticReadiness1.
        boolean DemJ1939Readiness2Support: set at pre-compile  # This configuration switch defines whether J1939 diagnostic readiness 2 is supported or not. | This switches on and off the API Dem_J1939DcmReadDiagnosticReadiness2.
        boolean DemJ1939Readiness3Support: set at pre-compile  # This configuration switch defines whether J1939 diagnostic readiness 3 is supported or not. | This switches on and off the API Dem_J1939DcmReadDiagnosticReadiness3.
        boolean DemJ1939ReadingDtcSupport: set at pre-compile  # This configuration switch defines whether J1939 DTC readout is supported or not. | This switches on and off the APIs Dem_J1939DcmSetDTCFilter, Dem_J1939DcmGetNumberOfFilteredDTC and Dem_J1939DcmGetNextFilteredDTC.
        container DemCallbackJ1939DTCStatusChanged [0..*]  # The presence of this container indicates, that the Dem has access to a "DTCStatusChanged" callback, which the Dem will call to notify other components about the change in the status of a DTC. | In case there is a DemCallbackDTCStatusChangedFnc, this parameter defines the name of the function that the Dem will call. In case there is no DemCallbackDTCStatusChangedFnc, the Dem will have an R-Port requiring the interface CallbackDTCStatusChanged whose name is generated by using the unique callback-prefix followed by the event name. Status change notifications are supported for DTCs in primary memory only.
          function name DemCallbackDTCStatusChangedFnc [0..1]: scope=ECU, multiplicity set at pre-compile, set at pre-compile  # Function name of prototype "DTCStatusChanged". | Note: If the parameter DemTriggerDcmReports is enabled, this parameter shall not be "Dcm_DemTriggerOnDTCStatus".
        container DemJ1939FreezeFrameClass [0..255]  # This container contains the combinations of SPNs s for a J1939 relevant freeze frame.
          reference DemSPNClassRef [1..255]: scope=ECU, multiplicity set at pre-compile, requires-index=true, set at pre-compile, destination=DemSPNClass  # Reference to an SPN. This reference defines requiresIndex = true since it represents a ordered list of references where the order describes the order of single SPNs in the J1939 Freeze Frame.
        container DemSPNClass [0..*]  # This container contains the configuration (parameters) for a SPN.
          integer DemSPNId: 0..524287, set at pre-compile  # Suspect parameter number
          reference DemSPNDataElementClassRef: scope=ECU, set at pre-compile, destination=DemDataElementClass  # This reference contains the link to a data element class.
      container DemGeneralOBD [0..1]  # This container contains the general OBD-specific configuration (parameters) of the Dem module.
        boolean DemOBDCentralizedPID21Handling: scope=ECU, set at pre-compile  # Switch to enable the centralized handling of PID $21. | true: centralized handling of PID $21 enabled false: centralized handling of PID $21 disabled
        boolean DemOBDCentralizedPID31Handling: scope=ECU, set at pre-compile  # Switch to enable the centralized handling of PID $31. | true: centralized handling of PID $31 enabled false: centralized handling of PID $31 disabled
        integer DemOBDCompliancy: 0..255, scope=ECU, multiplicity set at pre-compile, post-build-variant-value=true, set at post-build in variant post-build / pre-compile in variant pre-compile  # Configuration value to define the appropriate value to PID$1C "OBD requirements to which vehicle or engine is certified." according to the respective standards, e.g. OBD, OBDII, JOBD etc. | Notice as well J1979 or the "DiagnosticReadiness 1" DM05 message of J1939-73
        boolean DemOBDDelayedDCYConfirmedAndMIL [0..1]: set at pre-compile, default-value=false  # Controls the delayed calculation of the confirmed status for the OBD driving cycle.
        enumeration DemOBDEngineType [0..1]: {DEM_IGNITION_COMPRESSION, DEM_IGNITION_SPARK}, scope=ECU, multiplicity set at pre-compile, set at pre-compile  # Switch to provide either Gasoline or Diesel parameters.
        boolean DemOBDEventDisplacement: set at pre-compile  # Activate/Deactivate a different displacement behavior for OBD events. | OBD events with special Conditions (e.g. Pending, MIL_On...) shall not be displaced.
        reference DemOBDDrivingCycleRef: origin=AUTOSAR_ECUC V1.0.0, set at pre-compile, destination=DemOperationCycle  # Defines the operationCycle which denotes the OBD driving cycle.
        choice reference DemOBDInputAcceleratorPedalInformation [0..1]: scope=ECU, multiplicity set at pre-compile, set at pre-compile, destination=[DemExternalCSDataElementClass, DemExternalSRDataElementClass]  # Input variable for the accelerator padal information, which is assigned to a specific data element used as interface for the Dem-internal PID calculations.
        choice reference DemOBDInputAmbientPressure [0..1]: scope=ECU, multiplicity set at pre-compile, set at pre-compile, destination=[DemExternalCSDataElementClass, DemExternalSRDataElementClass]  # Input variable for the ambient pressure, which is assigned to a specific data element used as interface for the Dem-internal PID calculations.
        choice reference DemOBDInputAmbientTemperature [0..1]: scope=ECU, multiplicity set at pre-compile, set at pre-compile, destination=[DemExternalCSDataElementClass, DemExternalSRDataElementClass]  # Input variable for the ambient temperature, which is assigned to a specific data element used as interface for the Dem-internal PID calculations.
        choice reference DemOBDInputDistanceInformation [0..1]: scope=ECU, multiplicity set at pre-compile, set at pre-compile, destination=[DemExternalCSDataElementClass, DemExternalSRDataElementClass]  # Input variable for the distance information, which is assigned to a specific data element used as interface for the Dem-internal PID calculations.
        choice reference DemOBDInputEngineSpeed [0..1]: scope=ECU, multiplicity set at pre-compile, set at pre-compile, destination=[DemExternalCSDataElementClass, DemExternalSRDataElementClass]  # Input variable for the engine speed, which is assigned to a specific data element used as interface for the Dem-internal PID calculations.
        choice reference DemOBDInputEngineTemperature [0..1]: scope=ECU, multiplicity set at pre-compile, set at pre-compile, destination=[DemExternalCSDataElementClass, DemExternalSRDataElementClass]  # Input variable for the engine temperature, which is assigned to a specific data element used as interface for the Dem-internal PID calculations.
        choice reference DemOBDInputProgrammingEvent [0..1]: scope=ECU, multiplicity set at pre-compile, set at pre-compile, destination=[DemExternalCSDataElementClass, DemExternalSRDataElementClass]  # Input variable for the programming event, which is assigned to a specific data element used as interface for the Dem-internal PID calculations.
        choice reference DemOBDInputVehicleSpeed [0..1]: scope=ECU, multiplicity set at pre-compile, set at pre-compile, destination=[DemExternalCSDataElementClass, DemExternalSRDataElementClass]  # Input variable for the vehicle speed, which is assigned to a specific data element used as interface for the Dem-internal PID calculations.
        reference DemOBDPFCCycleRef: origin=AUTOSAR_ECUC V1.0.0, set at pre-compile, destination=DemOperationCycle  # Defines the operationCycle, which is relevant for processing the OBDPFCCycle.
        choice reference DemOBDTimeSinceEngineStart [0..1]: multiplicity set at pre-compile, set at pre-compile, destination=[DemExternalCSDataElementClass, DemExternalSRDataElementClass, DemInternalDataElementClass]  # Input variable for the Time Since Engine Start information, which is assigned to a specific data element.
        reference DemOBDWarmUpCycleRef: origin=AUTOSAR_ECUC V1.0.0, set at pre-compile, destination=DemOperationCycle  # Defines the operationCycle which denotes the OBD warm-up cycle.
        container DemCallbackOBDDTCStatusChanged [0..*]  # The presence of this container indicates, that the Dem has access to a "DTCStatusChanged" callback, which the Dem will call to notify other components about the change in the status of a DTC. | In case there is a DemCallbackDTCStatusChangedFnc, this parameter defines the name of the function that the Dem will call. In case there is no DemCallbackDTCStatusChangedFnc, the Dem will have an R-Port requiring the interface CallbackDTCStatusChanged whose name is generated by using the unique callback-prefix followed by the event name. Status change notifications are supported for DTCs in primary memory only.
          function name DemCallbackDTCStatusChangedFnc [0..1]: scope=ECU, multiplicity set at pre-compile, set at pre-compile  # Function name of prototype "DTCStatusChanged". | Note: If the parameter DemTriggerDcmReports is enabled, this parameter shall not be "Dcm_DemTriggerOnDTCStatus".
      container DemGroupOfDTC [0..255]  # This container contains the configuration (parameters) for DTC groups.
        integer DemGroupDTCs: 256..16776959, scope=ECU, set at pre-compile, symbolic-name-value=true  # DTC values of the selected group of DTC | (Range: 3 byte, 0xFFFFFF is reserved for 'all DTCs', according to ISO14229-1 Annex D.1) The DTC group 'all DTCs' is always available and will not be configured. The following ranges are reserved by ISO 14229-1 : 0x000000 to 0x0000ff and 0xffff00 to 0xffffff.
      container DemNvRamBlockId [0..*]  # This container contains the configuration (parameters) for a non-volatile memory block, which is used from the Dem. If no permanent storage of event memory entries is required, no block needs to be configured. | The number of blocks which are necessary depends on the implementation and configuration (e.g. number of used event memories) of the Dem module.
        symbolic name reference DemNvRamBlockIdRef: origin=AUTOSAR_ECUC V1.0.0, set at pre-compile, destination=NvMBlockDescriptor  # This reference contains the link to a non-volatile memory block. For post build time configurations worst case scenario shall be used.
      container DemOperationCycle [1..256]  # This container holds all parameters that are relevant to configure an operation cycle.
        boolean DemOperationCycleAutostart: scope=ECU, set at pre-compile, default-value=false  # The autostart property defines if the operation cycles is automatically (re-)started during Dem_PreInit.
        integer DemOperationCycleId [0..1]: 0..255, multiplicity set at pre-compile, set at pre-compile, symbolic-name-value=true  # This parameter's value is used, together with the aggregating container, to define a symbolic name of the operation cycle.
        symbolic name reference DemLeadingCycleRef [0..1]: origin=AUTOSAR_ECUC V1.0.0, set at pre-compile, destination=DemOperationCycle  # Defines the operation cycle, which is relevant for processing this operation cycle.
      container DemRatio [0..65535]  # This container contains the OBD-specific in-use-monitor performance ratio configuration. | It is related to a specific event, a FID, and an IUMPR group.
        enumeration DemIUMPRDenGroup: {DEM_IUMPR_DEN_500MILL, DEM_IUMPR_DEN_COLDSTART, DEM_IUMPR_DEN_EVAP, DEM_IUMPR_DEN_NONE, DEM_IUMPR_DEN_PHYS_API}, scope=ECU, set at pre-compile  # This parameter specifies the assigned denominator type which is applied in addition to the DEM_IUMPR_GENERAL_INDIVIDUAL_DENOMINATOR conditions.
        enumeration DemIUMPRGroup: {DEM_IUMPR_AFRI1, DEM_IUMPR_AFRI2, DEM_IUMPR_BOOSTPRS, DEM_IUMPR_CAT1, DEM_IUMPR_CAT2, DEM_IUMPR_EGR, DEM_IUMPR_EGSENSOR, DEM_IUMPR_EVAP, DEM_IUMPR_FLSYS, DEM_IUMPR_NMHCCAT, DEM_IUMPR_NOXADSORB, DEM_IUMPR_NOXCAT, DEM_IUMPR_OXS1, DEM_IUMPR_OXS2, DEM_IUMPR_PF1, DEM_IUMPR_PF2, DEM_IUMPR_PMFILTER, DEM_IUMPR_PRIVATE, DEM_IUMPR_SAIR, DEM_IUMPR_SECOXS1, DEM_IUMPR_SECOXS2}, scope=ECU, set at pre-compile  # This parameter specifies the assigned IUMPR group of the ratio Id.
        integer DemRatioId: 0..65535, scope=ECU, set at pre-compile, symbolic-name-value=true  # Defines a unique ratio Id. | This parameter should not be changeable by user, because the Id should be generated by Dem itself to prevent gaps and multiple use of an Id. The ratio Ids should be sequentially ordered beginning with 0 and no gaps in between.
        enumeration DemRatioKind: {DEM_RATIO_API, DEM_RATIO_OBSERVER}, scope=ECU, set at pre-compile  # This parameter defines whether the ratio will be calculated API or observer based.
        reference DemDiagnosticEventRef: scope=ECU, set at pre-compile, destination=DemEventParameter  # This reference contains the link to a diagnostic event.
        symbolic name reference DemFunctionIdRef: scope=ECU, set at pre-compile, destination=FiMFID  # This reference contains the link to a function identifier within the FiM which is used as a primary FID.
        symbolic name reference DemSecondaryFunctionIdRef [0..*]: scope=ECU, multiplicity set at pre-compile, set at pre-compile, destination=FiMFID  # This reference contains the link to a function identifier within the FiM which is used as a secondary FID. | The "primary" and all "secondary" FID inhibitions are combined by "OR".
      container DemStorageCondition [0..255]  # This container contains the configuration (parameters) for storage conditions.
        integer DemStorageConditionId: 0..255, scope=ECU, set at pre-compile, symbolic-name-value=true  # Defines a unique storage condition Id. This parameter should not be changeable by user, because the Id should be generated by Dem itself to prevent gaps and multiple use of an Id. The storage conditions should be sequentially ordered beginning with 0 and no gaps in between.
        boolean DemStorageConditionStatus: set at pre-compile  # Defines the initial status for enable or disable of storage of a diagnostic event. | The value is the initialization after power up (before this condition is reported the first time). true: storage of a diagnostic event enabled false: storage of a diagnostic event disabled
        reference DemStorageConditionReplacementEventRef [0..1]: scope=ECU, multiplicity set at pre-compile, origin=AUTOSAR_ECUC V1.0.0, set at pre-compile, destination=DemEventParameter  # Specifies the reference to an event which is stored to event memory and supports failure analysis.
      container DemStorageConditionGroup [0..255]  # This container contains the configuration (parameters) for storage condition groups.
        reference DemStorageConditionRef [1..255]: scope=ECU, multiplicity set at pre-compile, origin=AUTOSAR_ECUC V1.0.0, set at pre-compile, destination=DemStorageCondition  # References an enable condition.
  module definition Det [0..1]: variants pre-compile  # Det configuration includes the functions to be called at notification. On one | side the application functions are specified and in general it can be decided whether Dlt shall be called at each call of Det.
    container DetConfigSet [0..1]  # Configuration set container for Det.
      container DetModule [0..*]  # This container describes a non BSW module that is using the Det via Service Interface.
        integer DetModuleId: 4096..65535, set at pre-compile, symbolic-name-value=true  # Unique identifier of the error reporting component. When reporting errors to the DET, a symbolic name derived from the moduleID has to be used to identify the reporter.
        container DetModuleInstance [1..*]: multiplicity set at pre-compile, post-build-variant-multiplicity=true  # Describes the Instance used for the according Service Port. | It shall be used to differentiate software component instances when multiple instantiation is used.
          integer DetInstanceId: 0..255, set at pre-compile, default-value=0  # Describes the InstanceId used for the according Service Port. | It shall be used to differentiate software component instances when multiple instantiation is used. Else it shall be set to 0.
    container DetGeneral  # Generic configuration parameters of the Det module.
      boolean DetForwardToDlt [0..1]: multiplicity set at pre-compile, set at pre-compile  # Only if the parameter is present and set to true, the Det requires the Dlt interface and forwards it's call to the function Dlt_DetForwardErrorTrace. In this case the optional interface to Dlt_Det is required.
      function name DetReportRuntimeErrorCallout [0..*]: set at pre-compile  # This parameter defines the existence and the names of callout functions for the corresponding runtime error handler. | The type of these functions shall be identical the type of Det_ReportRuntimeError itself: Std_ReturnType (*f)(uint16, uint8, uint8, uint8)
      function name DetReportTransientFaultCallout [0..*]: set at pre-compile  # This parameter defines the existence and the names of callout functions for the corresponding transient fault handler. | The type of these functions shall be identical the type of Det_ReportTransientFault itself: Std_ReturnType (*f)(uint16, uint8, uint8, uint8)
      boolean DetVersionInfoApi: set at pre-compile, default-value=false  # Pre-processor switch to enable / disable the API to read out the modules version information. | true: Version info API enabled. false: Version info API disabled.
    container DetNotification [0..1]  # Configuration of the notification functions.
      function name DetErrorHook [0..*]: multiplicity set at pre-compile, set at pre-compile  # Optional list of functions to be called by the Default Error Tracer in context of each call of Det_ReportError. | The type of these functions shall be identical the type of Det_ReportError itself: Std_ReturnType (*f)(uint16, uint8, uint8, uint8).
  module definition Dio [0..1]: post-build-variant-support=true, variants link-time/pre-compile  # Configuration of the Dio (Digital IO) module.
    container DioConfig  # This container contains the configuration parameters and sub containers of the AUTOSAR DIO module.
      container DioPort [1..*]  # Configuration of individual DIO ports, consisting of channels and possible channel groups. | Note that this container definition does not explicitly define a symbolic name parameter. Instead, the container's short name will be used in the Ecu Configuration Description to specify the symbolic name of the port.
        integer DioPortId: 0..4294967295, scope=ECU, set at pre-compile, symbolic-name-value=true  # Numeric identifier of the DIO port. Not all MCU ports may be used for DIO, thus there may be "gaps" in the list of all IDs. This value will be | assigned to the DIO port symbolic name (i.e. the SHORT-NAME of the DioPort container).
        container DioChannel [0..*]  # Configuration of an individual DIO channel.
          integer DioChannelId: 0..4294967295, scope=ECU, set at pre-compile, symbolic-name-value=true  # Channel Id of the DIO channel. This value will be assigned to the symbolic names.
        container DioChannelGroup [0..*]  # Definition and configuration of DIO channel groups. A channel group represents several adjoining DIO channels represented by a logical group. | Note hat this container definition does not explicitly define a symbolic name parameter. Instead, the container's short name will be used in the Ecu Configuration Description to specify the symbolic name of the channel group.
          string DioChannelGroupIdentification: scope=ECU, set at pre-compile, symbolic-name-value=true  # The DIO channel group is identified in DIO API by a pointer to a data structure (of type Dio_ChannelGroupType). That data structure contains the channel group information. | This parameter contains the code fragment that has to be inserted in the API call of the calling module to get the address of the variable in memory which holds the channel group information. Example values are "&MyDioGroup1" or "&MyDioGroupArray[0]"
          integer DioPortMask: 0..4294967295, set at link in variant link-time / pre-compile in variant pre-compile  # This shall be the mask which defines the positions of the channel | group. The channels shall consist of adjoining bits in the same port. The data type depends on the port width.
          integer DioPortOffset: 0..31, set at link in variant link-time / pre-compile in variant pre-compile  # The position of the Channel Group on the port, counted | from the LSB. This value can be derived from DioPortMask. calculationFormula = Position of the first bit of DioPortMask which is set to '1' counted from LSB
    container DioGeneral  # General DIO module configuration parameters.
      boolean DioDevErrorDetect: set at pre-compile, default-value=false  # Switches the development error detection and notification on or off. | * true: detection and notification is enabled. * false: detection and notification is disabled.
      boolean DioFlipChannelApi: set at pre-compile  # Adds / removes the service Dio_FlipChannel() from the code.
      boolean DioVersionInfoApi: set at pre-compile, default-value=false  # Adds / removes the service Dio_ GetVersionInfo() from the code.
  module definition Dlt [0..1]: post-build-variant-support=true, variants link-time/post-build/pre-compile
    container DltConfigSet  # This container lists all the global Dlt functionalities that can be enabled or disabled at pre-compile time to optimize resource consumption.
      container DltLogLevelSetting  # Contains settings for thresholds.
        enumeration DltDefaultLogLevel: {DLT_LOG_DEBUG, DLT_LOG_ERROR, DLT_LOG_FATAL, DLT_LOG_INFO, DLT_LOG_OFF, DLT_LOG_VERBOSE, DLT_LOG_WARN}, scope=ECU, post-build-variant-value=true, set at link in variant link-time / post-build in variant post-build / pre-compile in variant pre-compile  # This is the effective log level used in case no filter matches the given AppicationId and ContextId. This can be seen as a fall-through filter definition with wildcard for AppicationId and ContextId, which will be used, when no other filter matches.
      container DltLogOutput  # Contains settings for log/trace message output
        reference DltDefaultLogChannelRef: post-build-variant-value=true, set at link in variant link-time / post-build in variant post-build / pre-compile in variant pre-compile, destination=DltLogChannel  # Reference to the default log channel, which has to be used for a log/trace output, if no other match has been found.
        container DltLogChannel [1..*]  # Contains settings for log/trace message output
          float DltLogChannelBufferOverflowTimer: 0.001..1, scope=ECU, post-build-variant-value=true, set at link in variant link-time / post-build in variant post-build / pre-compile in variant pre-compile  # Specifies the cycle time in seconds for resetting the buffer overflow flag in case a buffer overflow occurred.
          integer DltLogChannelBufferSize: 0..4294967295, scope=ECU, set at pre-compile  # Buffer size in bytes for the LogChannel specific message buffer.
          string DltLogChannelId: scope=ECU, post-build-variant-value=true, set at link in variant link-time / post-build in variant post-build / pre-compile in variant pre-compile  # This is the 4 ASCII character long name of the log channel as used in the Dlt control messages as parameter name Dlt_interface
          integer DltLogChannelMaxMessageLength: 8..65535, scope=ECU, post-build-variant-value=true, set at link in variant link-time / pre-compile in variant post-build+pre-compile  # The maximum length of a Dlt log or trace message.
          integer DltLogChannelMaxNumOfRetries: 0..255, scope=ECU, post-build-variant-value=true, set at link in variant link-time / post-build in variant post-build / pre-compile in variant pre-compile, default-value=0  # The maximum length of a Dlt log or trace message.
          enumeration DltLogChannelThreshold: {DLT_LOG_DEBUG, DLT_LOG_ERROR, DLT_LOG_FATAL, DLT_LOG_INFO, DLT_LOG_OFF, DLT_LOG_VERBOSE, DLT_LOG_WARN}, scope=ECU, post-build-variant-value=true, set at link in variant link-time / post-build in variant post-build / pre-compile in variant pre-compile  # LogLevel Threshold
          integer DltLogChannelTrafficShapingBandwidth [0..1]: 0..18446744073709551615, multiplicity set at link in variant link-time / post-build in variant post-build / pre-compile in variant pre-compile, post-build-variant-multiplicity=true, post-build-variant-value=true, set at link in variant link-time / post-build in variant post-build / pre-compile in variant pre-compile  # Set the maximum possible bandwith in bit/s.
          float DltLogChannelTransmitCycle: 0.001..1, scope=ECU, post-build-variant-value=true, set at link in variant link-time / post-build in variant post-build / pre-compile in variant pre-compile  # Specifies the cycle time in seconds of the transmit functionality of this log channel.
          boolean DltLogTraceStatusFlag: post-build-variant-value=true, set at link in variant link-time / post-build in variant post-build / pre-compile in variant pre-compile  # Parameter to turn on/off on this LogChannel completely.
          container DltTxPdu  # Contains the configuration parameters of the AUTOSAR Dlt module's Tx Pdus.
            integer DltITxPduHandleId [0..1]: 0..65535, scope=ECU, multiplicity set at link in variant link-time / post-build in variant post-build / pre-compile in variant pre-compile, post-build-variant-multiplicity=true, post-build-variant-value=true, set at link in variant link-time / post-build in variant post-build / pre-compile in variant pre-compile, symbolic-name-value=true  # The numerical value used as the ID of this I-PDU. | This handle Id is used for the APIs calls Dlt_TxConfirmation, Dlt_TriggerTransmit, Dlt_TriggerIPDUSend or Dlt_TriggerIPDUSendWithMetaData, Dlt_CopyTxData and Dlt_TpTxConfirmation to transmit respectively confirm transmissions of I-PDUs, as well as the PduId passed to the Tx-I-PDU-callout configured with DltIPduCallout and/or DltIPduTriggerTransmitCallout.
            reference DltTxPduIdRef: post-build-variant-value=true, set at link in variant link-time / post-build in variant post-build / pre-compile in variant pre-compile, destination=Pdu  # Reference to the "global" Pdu structure to allow harmonization of handle IDs in the COM-Stack.
        container DltLogChannelAssignment [0..*]: multiplicity set at link in variant link-time / post-build in variant post-build / pre-compile in variant pre-compile, post-build-variant-multiplicity=true  # This container contains a preconfiguration of ApplicationId / ContextId pairs and their assigned log channel.
          reference DltLogChannelAssignmentSwcContextRef: post-build-variant-value=true, set at link in variant link-time / post-build in variant post-build / pre-compile in variant pre-compile, destination=DltSwcContext  # Reference to an ApplicationId/ContextId pair that is assigned to a DltLogChannel.
          reference DltLogChannelRef: post-build-variant-value=true, set at link in variant link-time / post-build in variant post-build / pre-compile in variant pre-compile, destination=DltLogChannel  # Reference to a DltLogChannel that is assigned to an ApplicationId / ContextId pair.
      container DltProtocol  # Configuration parameters for handling the specific protocol variants.
        boolean DltHeaderUseEcuId: scope=ECU, post-build-variant-value=true, set at link in variant link-time / post-build in variant post-build / pre-compile in variant pre-compile  # Corresponds to field WEID (With ECU ID). If set ECU ID shall be placed in the header, else not. | If the parameter DltGeneralNvRamRef is used this parameter defines the initial value for the corresponding NVRam entry. If the parameter DltGeneralNvRamRef is not set, Link-Time or Post-Build configuration shall be used.
        boolean DltHeaderUseSessionID: scope=ECU, post-build-variant-value=true, set at link in variant link-time / post-build in variant post-build / pre-compile in variant pre-compile  # Corresponds to field WSID (with Session ID). If set the Session ID shall be placed in the header, else not. | If the parameter DltGeneralNvRamRef is used this parameter defines the initial value for the corresponding NVRam entry. If the parameter DltGeneralNvRamRef is not set, Link-Time or Post-Build configuration shall be used.
        boolean DltHeaderUseTimestamp: scope=ECU, post-build-variant-value=true, set at link in variant link-time / post-build in variant post-build / pre-compile in variant pre-compile  # Corresponds to field WTMS (With Timestamp). If set the timestamp shall be placed in the header, else not. | If the parameter DltGeneralNvRamRef is used this parameter defines the initial value for the corresponding NVRam entry. If the parameter DltGeneralNvRamRef is not set, Link-Time or Post-Build configuration shall be used.
        boolean DltUseExtHeaderInNonVerbMode: scope=ECU, post-build-variant-value=true, set at link in variant link-time / post-build in variant post-build / pre-compile in variant pre-compile  # Non Verbose messages (opposed to verbose messages) do not need an extended header. If this flag is set to true the extended header shall also be used for non verbose messages. | If DltGeneralNvRAMSupport is enabled this parameter is the initial value for the corresponding NVRam entry. If DltGeneralNvRAMSupport is not set, Link-Time or Post-Build configuration shall be used.
        choice container DltEcuId  # This is a choice container to choose between a EcuId value or a callout to get the EcuId.
          container DltEcuIdCalloutChoice [0..1]  # EcuId via user defined callout.
            function name DltEcuIdCallout: scope=ECU, set at pre-compile  # If this choice is used the EcuId shall be fetched by calling the here configured callout function.
          container DltEcuIdValueChoice [0..1]  # EcuId value configuration
            string DltEcuIdValue: scope=ECU, set at pre-compile  # If this choice is used the EcuId shall be taken from the configured string. | This is the name of the ECU for use within the Dlt protocol. If you want to use a number representation type this as character.
      container DltRxPdu [0..*]: multiplicity set at link in variant link-time / post-build in variant post-build / pre-compile in variant pre-compile, post-build-variant-multiplicity=true  # Contains the Pdu IDs to be used for Dlt control messages reception.
        integer DltIRxPduHandleId [0..1]: 0..65535, scope=ECU, multiplicity set at link in variant link-time / post-build in variant post-build / pre-compile in variant pre-compile, post-build-variant-multiplicity=true, post-build-variant-value=true, set at link in variant link-time / post-build in variant post-build / pre-compile in variant pre-compile, symbolic-name-value=true  # The numerical value used as the ID of this I-PDU. The DltRxPduHandleId is required by the API calls Dlt_RxIndication, Dlt_TpRxIndication, Dlt_StartOfReception and Dlt_CopyRxData to receive I-PDUs from the PduR (DltIPduDirection: Receive), as well as the PduId passed to an Rx-I-PDU-callout.
        reference DltRxPduIdRef: post-build-variant-value=true, set at link in variant link-time / post-build in variant post-build / pre-compile in variant pre-compile, destination=Pdu  # Reference to the "global" Pdu structure to allow harmonization of handle IDs in the COM-Stack.
      container DltTraceStatusSetting  # Contains settings for trace status
        boolean DltDefaultTraceStatus: scope=ECU, post-build-variant-value=true, set at link in variant link-time / post-build in variant post-build / pre-compile in variant pre-compile  # This is the effective trace status used in case no filter matches the given ApplicationId and ContextId. This can be seen as a fall-through filter definition with wildcard for ApplicationId and ContextId, which will be used, when no other filter matches.
        container DltTraceStatusAssignment [0..*]: multiplicity set at link in variant link-time / post-build in variant post-build / pre-compile in variant pre-compile, post-build-variant-multiplicity=true  # This container contains a preconfiguration of ApplicationId / ContextId pairs and their assigned trace status.
          boolean DltTraceStatus: scope=ECU, post-build-variant-value=true, set at link in variant link-time / post-build in variant post-build / pre-compile in variant pre-compile  # Trace status for the given ApplicationId/ContextId tuple.
          reference DltTraceStatusAssignmentSwcContextRef: post-build-variant-value=true, set at link in variant link-time / post-build in variant post-build / pre-compile in variant pre-compile, destination=DltSwcContext  # Reference to an ApplicationId/ContextId pair to which a DltTraceStatus is assigned.
    container DltGeneral  # This container lists all the global Dlt functionalities that can be enabled or disabled at pre-compile time to optimize resource consumption.
      boolean DltGeneralDevErrorDetect: set at pre-compile  # If the Default Error Tracer (Det) shall be used, this parameter shall be set to TRUE. Otherwise, it shall be set to FALSE.
      boolean DltGeneralInjectionSupport: set at pre-compile, default-value=false  # Enables or disables the Dlt Injection feature.
      boolean DltGeneralRegisterContextNotification: set at pre-compile, default-value=false  # If this parameter is set to TRUE, a Dlt Control Message is sent every time a SWC registeres and/or de-registers at/from the Dlt Module. Else, this notification is not sent.
      boolean DltGeneralRxDataPathSupport: set at pre-compile, default-value=false  # Enables or disables the Rx Data Path to control the Dlt module.
      float DltGeneralStartUpDelayTimer [0..1]: 0.001..10, multiplicity set at pre-compile, set at pre-compile  # Configurable delay in s of starting the transmission of Log and Trace messages after the Dlt module has been initialized.
      boolean DltGeneralTimeStampSupport: set at pre-compile, default-value=false  # If a Time Stamp shall be added to the Dlt messages, this configuration parameter shall be set to TRUE. | Otherwise, it shall be set to FALSE.
      boolean DltGeneralTrafficShapingSupport: set at pre-compile, default-value=true  # Enables or disables the TrafficShaping feature to limit the maximum bandwidth for Dlt messages. If enabled, the maximum bandwidth can be configured per LogChannel.
      boolean DltGeneralVersionInfoApi [0..1]: multiplicity set at pre-compile, set at pre-compile  # Pre-processor switch for enabling Version Info API support. | * True: version information API activated * False: version information API deactivated
      symbolic name reference DltGeneralGptChannelRef [0..1]: multiplicity set at pre-compile, set at pre-compile, destination=GptChannelConfiguration  # If TimeStampSupport is used the Dlt module shall fetch the time from the Gpt module by calling Gpt_GetTimeElapsed with the here referenced GptChannel. The tick duration can be deduced from the GptChannelTickFrequency parameter of the GptChannelConfiguration container. This is necessary to calculate the microsecond resolution timestamp output in the Dlt message. | A GPT timer shall be used which starts with value 0 at ECU start-up according to the PRS Dlt Protocol Specification.
      symbolic name reference DltGeneralNvRamRef [0..1]: multiplicity set at pre-compile, set at pre-compile, destination=NvMBlockDescriptor  # If the Dlt module shall be able to store modified parameters during runtime persistently, this reference shall be set and shall point to the NvmBlock.
    container DltSwc [0..*]: multiplicity set at link in variant link-time / post-build in variant post-build / pre-compile in variant pre-compile, post-build-variant-multiplicity=true  # Contains necessary configuration parameters of the AUTOSAR Dlt module to interact with SWCs.
      integer DltSwcSessionId: 0..18446744073709551615, set at link in variant link-time+post-build / pre-compile in variant pre-compile  # An ECU wide unique ID to identify the port a SWC (instance) uses.
      boolean DltSwcSupportLogLevelChangeNotification: set at link in variant link-time+post-build / pre-compile in variant pre-compile, default-value=false  # Flag indicating, whether Dlt has to provide a R-Port for the notification of the SWC about LogLevel changes.
      integer MaxSwcLogMessageLength: 0..18446744073709551615, set at link in variant link-time+post-build / pre-compile in variant pre-compile  # Defines the maximum allowed length (unit16) for LogMessages.
      integer MaxSwcTraceMessageLength: 0..18446744073709551615, set at link in variant link-time+post-build / pre-compile in variant pre-compile  # Defines the maximum allowed length (unit16) for TraceMessages.
      container DltSwcContext [0..*]: multiplicity set at link in variant link-time / post-build in variant post-build / pre-compile in variant pre-compile, post-build-variant-multiplicity=true  # This container contains the configuration of ApplicationId / ContextId pairs which are supported by this SWC.
        string DltSwcApplicationId: post-build-variant-value=true, set at link in variant link-time / post-build in variant post-build / pre-compile in variant pre-compile  # Abbreviation for the SWC (4 characters)
        string DltSwcContextId: post-build-variant-value=true, set at link in variant link-time / post-build in variant post-build / pre-compile in variant pre-compile  # Abbreviation for the ContextId (4 characters)
  module definition DoIP [0..1]: post-build-variant-support=true, variants link-time/post-build/pre-compile  # Configuration of the DoIP (Diagnostic over IP) module.
    container DoIPConfigSet  # This container contains the configuration parameters and sub containers of the AUTOSAR DoIP module.
      integer DoIPEid [0..1]: 0..281474976710655, multiplicity set at link in variant link-time / post-build in variant post-build / pre-compile in variant pre-compile, post-build-variant-multiplicity=true, post-build-variant-value=true, set at link in variant link-time / post-build in variant post-build / pre-compile in variant pre-compile  # Configured EID (Entity ID of) for vehicle identification/vehicle announcement. Only necessary if DoIPUseMacAddressForIdentification is set to FALSE.
      integer DoIPGid [0..1]: 0..281474976710655, multiplicity set at link in variant link-time / post-build in variant post-build / pre-compile in variant pre-compile, post-build-variant-multiplicity=true, post-build-variant-value=true, set at link in variant link-time / post-build in variant post-build / pre-compile in variant pre-compile  # Configured GID (Group ID of) for vehicle identification/vehicle announcement.
      integer DoIPLogicalAddress: 0..65535, post-build-variant-value=true, set at link in variant link-time / post-build in variant post-build / pre-compile in variant pre-compile  # Describes the logical address of the DoIP entity, i.e. the LA that will route diagnostic requests to the Dcm of the DoIP entity.
      container DoIPChannel [1..65536]  # Configuration of one DoIPChannel.
        reference DoIPChannelSARef: destination=DoIPTester  # Reference to the DoIPTester.
        reference DoIPChannelTARef: destination=DoIPTargetAddress  # Reference to the target address.
        container DoIPPduRRxPdu [0..1]  # This container contains the Rx Pdus to connect with the Rx Pdus of the PduR.
          integer DoIPPduRRxPduId: 0..65535, scope=ECU, set at pre-compile, symbolic-name-value=true  # The DoIPPduRRxPduId is required by the API call DoIP_TpCancelReceive.
          reference DoIPPduRRxPduRef: post-build-variant-value=true, set at link in variant link-time / post-build in variant post-build / pre-compile in variant pre-compile, destination=Pdu  # Reference to the "global" Pdu structure to allow harmonization of handle IDs in the COM-Stack.
        container DoIPPduRTxPdu [0..1]  # This container contains the Tx Pdus to connect with the Tx Pdus of the PduR. If the parameter is not configured the channel is for functional addressing.
          integer DoIPPduRTxPduId: 0..65535, scope=ECU, set at pre-compile, symbolic-name-value=true  # The DoIPPduRTxPduId is required by DoIP_TpTransmit or DoIP_IfTransmit and DoIP_TpCancelTransmit.
          enumeration DoIPPduType [0..1]: {DOIP_IFPDU, DOIP_TPPDU}, multiplicity set at link in variant link-time / post-build in variant post-build / pre-compile in variant pre-compile, post-build-variant-multiplicity=true, post-build-variant-value=true, set at link in variant link-time / post-build in variant post-build / pre-compile in variant pre-compile, default-value=DOIP_TPPDU  # API Type to use for communication with PduR. DOIP_IFPDU for UUDT messages, DOIP_TPPDU for all other diagnostic messages.
          reference DoIPPduRTxPduRef: post-build-variant-value=true, set at link in variant link-time / post-build in variant post-build / pre-compile in variant pre-compile, destination=Pdu  # Reference to the "global" Pdu structure to allow harmonization of handle IDs in the COM-Stack.
      container DoIPConnections  # Container contains all lower layer connection specific information, i.e. the single Pdu References and Handle IDs to the SoAd.
        container DoIPTargetAddress [1..255]  # This container describes a possible TargetAddress that is supported by DoIP.
          integer DoIPTargetAddressValue: 0..65535, post-build-variant-value=true, set at link in variant link-time / post-build in variant post-build / pre-compile in variant pre-compile  # Valid Target Address of a DoIP target address.
        container DoIPTcpConnection [2..255]  # This container describes a tcp connection to the lower layer SoAd module.
          container DoIPSoAdRxPdu  # This container contains the Rx Pdus received by DoIP
            integer DoIPSoAdRxPduId: 0..65535, scope=ECU, set at pre-compile, symbolic-name-value=true  # The DoIPSoAdRxPduId is required by the API call DoIP_SoAdTpRxIndication to receive I-PDUs from the SoAd.
            reference DoIPSoAdRxPduRef: post-build-variant-value=true, set at link in variant link-time / post-build in variant post-build / pre-compile in variant pre-compile, destination=Pdu  # Reference to the "global" Pdu structure to allow harmonization of handle IDs in the COM-Stack.
          container DoIPSoAdTxPdu  # This container describes the TxPdu sent via the SoAd
            integer DoIPSoAdTxPduId: 0..65535, scope=ECU, set at pre-compile, symbolic-name-value=true  # The DoIPSoAdTxPduId is required by the API call DoIP_SoAdTpTxConfirmation that is called by the SoAd to confirm that the IPdu has been transmitted successfully.
            reference DoIPSoAdTxPduRef: post-build-variant-value=true, set at link in variant link-time / post-build in variant post-build / pre-compile in variant pre-compile, destination=Pdu  # Reference to the "global" Pdu structure to allow harmonization of handle IDs in the COM-Stack.
        container DoIPUdpConnection [1..255]  # This Container describes a udp connection to the lower layer SoAd module.
          container DoIPSoAdRxPdu  # This container contains the Rx Pdus received by DoIP
            integer DoIPSoAdRxPduId: 0..65535, scope=ECU, set at pre-compile, symbolic-name-value=true  # The DoIPSoAdRxPduId is required by the API call DoIP_SoAdTpRxIndication to receive I-PDUs from the SoAd.
            reference DoIPSoAdRxPduRef: post-build-variant-value=true, set at link in variant link-time / post-build in variant post-build / pre-compile in variant pre-compile, destination=Pdu  # Reference to the "global" Pdu structure to allow harmonization of handle IDs in the COM-Stack.
          container DoIPSoAdTxPdu  # This container describes the TxPdu sent via the SoAd
            integer DoIPSoAdTxPduId: 0..65535, scope=ECU, set at pre-compile, symbolic-name-value=true  # The DoIPSoAdTxPduId is required by the API call DoIP_SoAdTpTxConfirmation that is called by the SoAd to confirm that the IPdu has been transmitted successfully.
            reference DoIPSoAdTxPduRef: post-build-variant-value=true, set at link in variant link-time / post-build in variant post-build / pre-compile in variant pre-compile, destination=Pdu  # Reference to the "global" Pdu structure to allow harmonization of handle IDs in the COM-Stack.
        container DoIPUdpVehicleAnnouncementConnection [1..255]  # This container describes the UDP multicast connections to the lower layer SoAd module.
          container DoIPSoAdUdpVehicleAnnouncementTxPdu  # This container describes the vehicle announcement TxPdu sent via the SoAd.
            integer DoIPSoAdUdpVehicleAnnouncementTxPduId: 0..4294967295, scope=ECU, set at pre-compile, symbolic-name-value=true  # The DoIPSoAdUdpVehicleAnnouncementTxPduId is required by the API call DoIP_SoAdIfTxConfirmation() that is called by the SoAd to confirm that the IPdu has been transmitted successfully.
            reference DoIPSoAdUdpVehicleAnnouncementTxPduRef: post-build-variant-value=true, set at link in variant link-time / post-build in variant post-build / pre-compile in variant pre-compile, destination=Pdu  # Reference to the "global" PDU structure to allow harmonization of handle IDs in the COM-Stack.
      container DoIPRoutingActivation [0..255]: multiplicity set at link in variant link-time / post-build in variant post-build / pre-compile in variant pre-compile, post-build-variant-multiplicity=true  # This container describes the routing activation possibilities by representing for each container a possible routing activation request message to the DoIP entity and the according references to the activated diagnostic messages.
        integer DoIPRoutingActivationNumber: 0..255, post-build-variant-value=true, set at link in variant link-time / post-build in variant post-build / pre-compile in variant pre-compile  # Identifies the Routing activation Number which is received for a DoIP routing activation request message.
        reference DoIPTargetAddressRef [1..255]: multiplicity set at link in variant link-time / post-build in variant post-build / pre-compile in variant pre-compile, post-build-variant-multiplicity=true, post-build-variant-value=true, set at link in variant link-time / post-build in variant post-build / pre-compile in variant pre-compile, destination=DoIPTargetAddress  # Reference to all DoIPTargetAddress which are activated on this Routing activation.
        container DoIPRoutingActivationAuthenticationCallback [0..1]  # Container describes the Callbackfunction to call on a Routing Activation Request for Authentication. If this container is configured but the DoIPRoutingActivationAuthenticationFunc parameter is not present, the DoIP module will use an RPort of ServiceInterface <RoutingActivation>_RoutingActivation with the name "CB<RoutingActivation>RoutingActivation". <RoutingActivation> is the ShortName of the DoIPRoutingActiviation container.
          function name DoIPRoutingActivationAuthenticationFunc [0..1]: multiplicity set at link in variant link-time+post-build / pre-compile in variant pre-compile, set at link in variant link-time+post-build / pre-compile in variant pre-compile  # Direct C Callback function to trigger the authentication function for routing activation. If the DoIPRoutingActivationAuthenticationFunc parameter is present, the DoIP module will not use an RPort of ServiceInterface <RoutingActivation>_RoutingActivation but call the configured function.
          integer DoIPRoutingActivationAuthenticationReqLength: 0..4, set at link in variant link-time+post-build / pre-compile in variant pre-compile  # Describes the amount of bytes used to handle to the authentication function on routing activation. If 0 is configured as length the parameter AuthenticationReqData will not be handled to the API.
          integer DoIPRoutingActivationAuthenticationResLength: 0..4, set at link in variant link-time+post-build / pre-compile in variant pre-compile  # Describes the amount of bytes used to read by the authentication function on routing activation. If 0 is configured as length the parameter AuthenticationResData will not be fetched via the API.
        container DoIPRoutingActivationConfirmationCallback [0..1]  # Container describes the Callbackfunction to call on a Routing Activation Request for Confirmation. If this container is configured but the DoIPRoutingActivationConfirmationFunc parameter is not present the DoIP module will use an RPort of ServiceInterface <RoutingActivation>_RoutingActivation with the name "CB<RoutingActivation>RoutingActivation". <RoutingActivation> is the ShortName of the DoIPRoutingActiviation container.
          function name DoIPRoutingActivationConfirmationFunc [0..1]: multiplicity set at link in variant link-time+post-build / pre-compile in variant pre-compile, set at link in variant link-time+post-build / pre-compile in variant pre-compile  # Direct C Callback function to trigger the confirmation function for routing activation. If the DoIPRoutingActivationConfirmationFunc parameter is present the DoIP module will not use an RPort of ServiceInterface <RoutingActivation>_RoutingActivation but call the configured function.
          integer DoIPRoutingActivationConfirmationReqLength: 0..4, set at link in variant link-time+post-build / pre-compile in variant pre-compile  # Describes the amount of bytes used to handle to the confirmation function on routing activation. If 0 is configured as length the parameter ConfirmedReqData will not be handled to the API.
          integer DoIPRoutingActivationConfirmationResLength: 0..4, set at link in variant link-time+post-build / pre-compile in variant pre-compile  # Describes the amount of bytes used to read by the confirmation function on routing activation. If 0 is configured as length the parameter ConfirmedResData will not be fetched via the API.
      container DoIPTester [1..255]: multiplicity set at link in variant link-time / post-build in variant post-build / pre-compile in variant pre-compile, post-build-variant-multiplicity=true  # This container describes the properties of the possible connectable Tester for the DoIP entity.
        integer DoIPNumByteDiagAckNack: 0..4294967295, post-build-variant-value=true, set at link in variant link-time / post-build in variant post-build / pre-compile in variant pre-compile  # Specifies the number of original Diagnostic request bytes the DoIP entity responses on a NACK of a diagnostic response message to the Tester.
        integer DoIPTesterSA: 0..65535, post-build-variant-value=true, set at link in variant link-time / post-build in variant post-build / pre-compile in variant pre-compile  # Source Address of the Tester sent via routing activation or diagnostic message.
        reference DoIPRoutingActivationRef [1..255]: multiplicity set at link in variant link-time / post-build in variant post-build / pre-compile in variant pre-compile, post-build-variant-multiplicity=true, post-build-variant-value=true, set at link in variant link-time / post-build in variant post-build / pre-compile in variant pre-compile, destination=DoIPRoutingActivation  # Reference to a DoIPRoutingActivation describing the possible routing activations of the DoIPTester
    container DoIPGeneral  # This container specifies the general configuration parameters of the DoIP module.
      float DoIPAliveCheckResponseTimeout: 0..Inf, set at pre-compile  # Timeout in [s] for waiting for a response to an Alive Check request before the connection is considered to be disconnected. Represents parameter T_TCP_AliveCheck of ISO 13400-2:2012.
      boolean DoIPDevelopmentErrorDetect: set at pre-compile  # Switches the development error detection and notification on or off. | * true: detection and notification is enabled. * false: detection and notification is disabled.
      boolean DoIPDhcpOptionVinUse: set at pre-compile  # If DoIPDhcpOptionVinUse is set to true the DoIP module will add the VIN to the Dhcp host name if no valid Dhcp host name is already set.
      boolean DoIPEntityStatusMaxByteFieldUse: set at pre-compile  # This parameter is used to distinguish the optional support of the Max data size element of a diagnostic entity status response.
      float DoIPGeneralInactivityTime: 0..Inf, set at pre-compile  # Timeout in [s] for maximum inactivity of a TCP socket connection before the DoIP module will close the according socket connection. Represents parameter T_TCP_General_Inactivity of ISO 13400-2:2012
      integer DoIPGIDInvalidityPattern: 0..255, set at pre-compile  # Specifies the Byte pattern that is used for response messages if no valid GID could be retrieved. | Only the value '0' or '255' is allowed".
      string DoIPHeaderFileInclusion [0..*]: multiplicity set at pre-compile, set at pre-compile  # Name of the header file(s) to be included by the DoIP module containing the used C-callback declarations.
      integer DoIPHostNameSizeMax: 5..255, set at pre-compile  # Maximum Size of the DHCP HostName in ASCII. This parameter is necessary to reserve the correct amount of bytes for working with the DHCP HostName option. Minimum range is 5 because Dhcp Host Name should be at least "DoIP-" on any configuration.
      float DoIPInitialInactivityTime: 0..Inf, set at pre-compile  # Timeout in [s] used for initial inactivity of a connected TCP socket connection directly after socket connection. Represents parameter T_TCP_Initial_Inactivity of ISO 13400-2:2012
      float DoIPInitialVehicleAnnouncementTime: 0..Inf, set at pre-compile  # Time to wait in [s] for sending first vehicle anouncement message after IP address assignment. Represents parameter A_DoIP_Announce_Wait of ISO 13400-2:2012
      float DoIPMainFunctionPeriod: 0..Inf, set at pre-compile  # Determines the frequency at which the DoIP_MainFunction() is called in [s].
      integer DoIPMaxRequestBytes: 1..18446744073709551615, set at pre-compile  # Specifies the maximum allowed bytes of a DoIP message request without the DoIP header.
      integer DoIPMaxTesterConnections: 1..255, set at pre-compile  # Maximum ammount of tester connections that shall be maintained at one time before alive check is performed.
      integer DoIPMaxUDPRequestPerMessage: 1..255, set at pre-compile  # This parameter captures the maximum amont of UDP Requests necessary to handle paralel within a single UDP connection.
      enumeration DoIPNodeType: {DOIP_GATEWAY, DOIP_NODE}, set at pre-compile  # Describes the Type of the DoIP node.
      boolean DoIPUseEIDasGID: set at pre-compile  # Specifies if the DoIP entity shall use its EID if it is the Master for vehicle identification gid on the vehicle identification/vehicle announcement.
      boolean DoIPUseMacAddressForIdentification: set at pre-compile  # Provided the information if a configured EID at vehicle identification response/vehicle announment is used or the MAC address. | TRUE: Use MAC Address instead of EID for Vehicle identification/announcement. FALSE: Use configured EID for vehicle identification/announcement. Dependencies: DoIPEID
      boolean DoIPUseVehicleIdentificationSyncStatus: set at pre-compile  # Defines if the optional VIN/GID synchronization status is used additionally in the vehicle identification/announcement.
      float DoIPVehicleAnnouncementInterval: 0..Inf, set at pre-compile  # Time to wait in [s] for sending subsequent vehicle anouncement messages. Represents parameter A_DoIP_Announce_Interval of ISO 13400-2:2012
      integer DoIPVehicleAnnouncementRepetition: 1..255, set at pre-compile  # Amount of repetitions of the vehicle announcement message on IP address assignment. Represents parameter A_DoIP_Annunce_Num of ISO 13400-2:2012
      boolean DoIPVersionInfoApi: set at pre-compile, default-value=false  # Activates the DoIP_GetVersionInfo() API. | TRUE: Enables the DoIP_GetVersionInfo() API. FALSE: DoIP_GetVersionInfo() API is not included.
      boolean DoIPVinGidMaster: set at pre-compile  # Specifies if the DoIP entity is the Vehicle identification Master for the GID (Group ID).
      integer DoIPVinInvalidityPattern: 0..255, set at pre-compile  # Specifies the Byte pattern that is used for response messages if no valid VIN could be retrieved. | Only the value '0' or '255' is allowed".
      container DoIPGetGidCallback [0..1]  # This container describes the usage of a callback function to get the GID. (If this container is not present no callback function shall be used by DoIP module to retrive the GID.)
        function name DoIPGetGidDirect [0..1]: multiplicity set at link in variant link-time+post-build / pre-compile in variant pre-compile, set at link in variant link-time+post-build / pre-compile in variant pre-compile  # If the DoIPGetGidDirect parameter exist the DoIP module shall call the configured callback function (<User>_DoIPGetGID) direct. (It is not needed to specify a service port to the DoIP service component.) | If the DoIPGetGidDirect parameter does NOT exist the DoIP module shall use a RPort with a CallbackGetGID type of client-server port interface to retrive the GID.
      container DoIPPowerModeCallback  # This container describes the usage of a callback function to retrieve the current power mode. This container shall always be present.
        function name DoIPPowerModeDirect [0..1]: multiplicity set at link in variant link-time+post-build / pre-compile in variant pre-compile, set at link in variant link-time+post-build / pre-compile in variant pre-compile  # If the DoIPPowerModeDirect parameter exist the DoIP module shall call the configured callback function (<User>_DoIPGetPowerModeCallback) direct. (It is not needed to specify a service port to the DoIP service component.) | If the DoIPPowerModeDirect parameter does NOT present the DoIP module shall use a RPort with a CallbackGetPowerMode type of client-server port interface to retrive the current power mode.
      container DoIPTriggerGidSyncCallback [0..1]  # This container describes the usage of a callback function to trigger the GID synchronization. (If this container does not exist no callback function shall be used by DoIP module to trigger the GID synchronization.)
        function name DoIPTriggerGidSyncDirect [0..1]: multiplicity set at link in variant link-time+post-build / pre-compile in variant pre-compile, set at link in variant link-time+post-build / pre-compile in variant pre-compile  # If the DoIPTriggerGidSyncDirect parameter exist the DoIP module shall call the configured callback function (<User>_DoIPTriggerGidSyncCallback) direct. (It is not needed to specify a service port to the DoIP service component.) | If the DoIPTriggerGidSyncDirect parameter does NOT present the DoIP module shall use a RPort with a CallbackTriggerGIDSynchnonization type of client-server port interface to trigger the GID synchronization.
  module definition Ea [0..1]: variants pre-compile  # Configuration of the Ea (EEPROM Abstraction) module. | The module shall abstract from the device specific addressing scheme and segmentation and provide the upper layers with a virtual addressing scheme and segmentation as well as a 'virtually' unlimited number of erase cycles.
    container EaBlockConfiguration [1..*]  # Configuration of block specific parameters for the EEPROM abstraction module.
      integer EaBlockNumber: 1..65534, scope=ECU, set at pre-compile, symbolic-name-value=true  # Block identifier (handle). | 0x0000 and 0xFFFF shall not be used for block numbers (see EA006). Range: min = 2^NVM_DATASET_SELECTION_BITS max = 0xFFFF -2^NVM_DATASET_SELECTION_BITS Note: Depending on the number of bits set aside for dataset selection several other block numbers shall also be left out to ease implementation.
      integer EaBlockSize: 1..65535, scope=ECU, set at pre-compile  # Size of a logical block in bytes.
      boolean EaImmediateData: scope=ECU, set at pre-compile  # Marker for high priority data. | true: Block contains immediate data. false: Block does not contain immediate data.
      integer EaNumberOfWriteCycles: 0..4294967295, set at pre-compile  # Number of write cycles required for this block.
      symbolic name reference EaDeviceIndex: set at pre-compile, destination=EepGeneral  # Reference to the device this block is stored in.
    container EaGeneral  # General configuration of the EEPROM abstraction module. This container lists block independent configuration parameters.
      boolean EaDevErrorDetect: set at pre-compile, default-value=false  # Switches the development error detection and notification on or off. | * true: detection and notification is enabled. * false: detection and notification is disabled.
      float EaMainFunctionPeriod: 0..Inf, scope=ECU, set at pre-compile  # The period between successive calls to the main function in seconds.
      function name EaNvmJobEndNotification [0..1]: multiplicity set at pre-compile, set at pre-compile  # Mapped to the job end notification routine provided by the upper layer module (NvM_JobEndNotification).
      function name EaNvmJobErrorNotification [0..1]: multiplicity set at pre-compile, set at pre-compile  # Mapped to the job error notification routine provided by the upper layer module (NvM_JobErrorNotification).
      boolean EaPollingMode: set at pre-compile  # Pre-processor switch to enable and disable the polling mode for this module. | true: Polling mode enabled, callback functions (provided to EEP module) disabled. false: Polling mode disabled, callback functions (provided to EEP module) enabled.
      boolean EaSetModeSupported: set at pre-compile, default-value=true  # Compile switch to enable / disable the function Ea_SetMode.
      boolean EaVersionInfoApi: set at pre-compile, default-value=false  # Pre-processor switch to enable / disable the API to read out the modules version information. | true: Version info API enabled. false: Version info API disabled.
      integer EaVirtualPageSize: 0..65535, set at pre-compile  # The size in bytes to which logical blocks shall be aligned.
    container EaPublishedInformation  # Additional published parameters not covered by CommonPublishedInformation container. | Note that these parameters do not have any configuration class setting, since they are published information.
      integer EaBlockOverhead: 0..65535, set at published-information  # Management overhead per logical block in bytes. | Note: If the management overhead depends on the block size or block location a formula has to be provided that allows the configurator to calculate the management overhead correctly.
      integer EaPageOverhead: 0..65535, set at published-information  # Management overhead per page in bytes. | Note: If the management overhead depends on the block size or block location a formula has to be provided that allows the configurator to calculate the management overhead correctly.
  module definition EcuC [0..1]: post-build-variant-support=true, variants post-build/pre-compile  # Virtual module to collect ECU Configuration specific / global configuration information.
    container EcucConfigSet [0..1]  # This container contains the configuration parameters and sub containers of the global PduCollection.
      container EcucPduCollection [0..1]  # Collection of all Pdu objects flowing through the Com-Stack.
        enumeration PduIdTypeEnum: {UINT16, UINT8}  # The PduIdType is used within the entire AUTOSAR Com Stack except for bus drivers. The size of this global type depends on the maximum number of PDUs used within one software module. If no software module deals with more PDUs that 256, this type can be set to uint8. If at least one software module handles more than 256 PDUs, this type must be set to uint16. See AUTOSAR_SWS_CommunicationStackTypes for more details.
        enumeration PduLengthTypeEnum: {UINT16, UINT32, UINT8}  # The PduLengthType is used within the entire AUTOSAR Com Stack except for bus drivers. The size of this global type depends on the maximum length of PDUs to be sent by an ECU. If no segmentation is used the length depends on the maximum payload size of a frame of the underlying communication system (for FlexRay maximum size is 255 bytes, therefore uint8). If segmentation is used it depends on the maximum length of a segmented N-PDU (in general uint16 is used). See AUTOSAR_SWS_CommunicationStackTypes for more details.
        container MetaDataType [0..*]: multiplicity set at pre-compile  # Meta data serves to transport information through the AUTOSAR layers. It is transported by the PduInfoType structure via a separate pointer to a byte array alongside the length of and a pointer to the payload of the PDU. This container defines the content of the meta data.
          container MetaDataItem [1..*]: multiplicity set at pre-compile, requires-index=true  # The content of meta data in a Pdu consists of an ordered list of meta data items. | This container represents a meta data item that is contained in meta data of a Pdu.
            integer MetaDataItemLength: 1..64, set at pre-compile  # This parameter defines the length of a meta data item in bytes.
            enumeration MetaDataItemType: {ADDRESS_EXTENSION_8, CAN_ID_32, ETHERNET_MAC_64, LIN_NAD_8, PRIORITY_8, SOCKET_CONNECTION_ID_16, SOURCE_ADDRESS_16, TARGET_ADDRESS_16}, set at pre-compile  # This parameter defines the type of a meta data item.
        container Pdu [0..*]: multiplicity set at post-build in variant post-build / pre-compile in variant pre-compile, post-build-variant-multiplicity=true  # One Pdu flowing through the COM-Stack. | This Pdu is used by all Com-Stack modules to agree on referencing the same Pdu.
          boolean J1939Requestable [0..1]: multiplicity set at post-build in variant post-build / pre-compile in variant pre-compile, post-build-variant-multiplicity=true, post-build-variant-value=true, set at post-build in variant post-build / pre-compile in variant pre-compile  # Pdu can be triggered by the J1939 request message.
          integer PduLength: 0..4294967295, post-build-variant-value=true, set at post-build in variant post-build / pre-compile in variant pre-compile  # Length of the Pdu in bytes. It should be noted that in former AUTOSAR releases (Rel 2.1, Rel 3.0, Rel 3.1, Rel 4.0 Rev. 1) this parameter was defined in bits.
          reference MetaDataTypeRef: set at pre-compile, destination=MetaDataType  # Reference to meta data that is transported in the Pdu through the AUTOSAR layers.
          foreign reference SysTPduToFrameTriggeringRef [0..1]: multiplicity set at post-build in variant post-build / pre-compile in variant pre-compile, post-build-variant-multiplicity=true, post-build-variant-value=true, set at post-build in variant post-build / pre-compile in variant pre-compile, destination-type=FRAME-TRIGGERING  # Reference to the FrameTriggering from the SystemTemplate which this Pdu belongs to. | SysTPduToFrameTriggeringRef shall be used for UserDefinedPdus, NmPdus and NPdus which are not going through the Pdu Router. This reference shall not be used if SysTPduToPduTriggeringRef exists.
          foreign reference SysTPduToPduTriggeringRef [0..1]: multiplicity set at post-build in variant post-build / pre-compile in variant pre-compile, post-build-variant-multiplicity=true, post-build-variant-value=true, set at post-build in variant post-build / pre-compile in variant pre-compile, destination-type=PDU-TRIGGERING  # Reference to the PduTriggering from the SystemTemplate which this Pdu represents. | SysTPduToPduTriggeringRef shall be used for all Pdus except UserDefinedPdus, NmPdus and NPdus which are not going through the Pdu Router. For these Pdus, SysTPduToFrameTriggeringRef shall be used.
    container EcucHardware [0..1]  # Hardware definition of this Ecu.
      container EcucCoreDefinition [0..*]  # Definition of one Core on this Ecu.
        integer EcucCoreId: 0..65535, set at pre-compile  # ID of the core.
        foreign reference EcucCoreHwRef [0..1]: multiplicity set at pre-compile, set at pre-compile, destination-type=HW-ELEMENT  # Optional reference to the HwElement of HwCategory ProcessingUnit that represents this Core in the ECU Resource Template.
    container EcucPartitionCollection [0..1]  # Collection of Partitions defined for this ECU.
      container EcucPartition [0..*]: multiplicity set at pre-compile  # Definition of one Partition on this ECU. | One Partition will be implemented using one Os-Application.
        boolean EcucPartitionBswModuleExecution: set at pre-compile  # Denotes that this partition will execute BSW Modules. BSW Modules can only be executed in such partitions.
        boolean EcucPartitionQmBswModuleExecution: scope=ECU, set at pre-compile, default-value=true  # Denotes that this partition will execute QM BSW.
        boolean PartitionCanBeRestarted: set at pre-compile  # Specifies the requirement whether the Partition can be restarted. If set to true all software executing in this partition shall be capable of handling a restart.
        foreign reference EcucPartitionBswModuleDistinguishedPartition [0..*]: multiplicity set at pre-compile, set at pre-compile, destination-type=BSW-DISTINGUISHED-PARTITION  # This maps the abstract partition of the Bsw Module to a concrete Partition existing in the ECU.
        instance reference EcucPartitionSoftwareComponentInstanceRef [0..*]: multiplicity set at pre-compile, set at pre-compile, destination-context=ROOT-SW-COMPOSITION-PROTOTYPE, destination-type=SW-COMPONENT-PROTOTYPE  # References the SW Component instances from the Ecu Extract that shall be executed in this partition.
    container EcucPostBuildVariants [0..1]  # Collection of toplevel PostBuildSelectable variants. The PredefinedVariants linked inside this container will determine how many PostBuildSelectableVariants exist. If this container exist the name pattern for initialization of BSW modules will be <Mip>_Config_<PredefinedVariant.shortName>. If this container does not exist the name pattern for initialization of BSW modlues will be <Mip>_Config.
      foreign reference EcucPostBuildVariantRef [1..*]: multiplicity set at pre-compile, set at pre-compile, destination-type=PREDEFINED-VARIANT  # Reference to a PredefinedVariant that defines one toplevel postBuild configuration set (covering all post-build capable BSW modules). PredefinedVariants that are referenced here shall contain only PostBuildVariantCriterionValueSets.
    container EcucUnitGroupAssignment [0..1]  # Collection of UnitGroup references to support the generation of ASAM MCD file.
      foreign reference EcucUnitGroupRef [1..*]: multiplicity set at pre-compile, set at pre-compile, destination-type=UNIT-GROUP  # Optional reference to the UnitGroup to support the generation of ASAM MCD file. These UnitGroups are selecting a set of units for a specific country.
    container EcucVariationResolver [0..1]  # Collection of PredefinedVariant elements containing definition of values for SwSystemconst which shall be applied when resolving the variability during ECU Configuration.
      foreign reference PredefinedVariantRef [1..*]: multiplicity set at pre-compile, set at pre-compile, destination-type=PREDEFINED-VARIANT
  module definition EcuM [0..1]: post-build-variant-support=true, variants post-build  # Configuration of the EcuM (ECU State Manager) module.
    container EcuMConfiguration  # This container contains the configuration (parameters) of the ECU State Manager.
      container EcuMCommonConfiguration  # This container contains the common configuration (parameters) of the ECU State Manager.
        integer EcuMConfigConsistencyHash: 0..18446744073709551615, set at link  # In the pre-compile and link-time configuration phase a hash value is generated across all pre-compile and link-time parameters of all BSW modules. | In the post-build phase a hash value is generated across all pre-compile and link-time parameters, except for parameters located in EcucParamConfContainerDef instances or subContainers which have been introduced at post-build configuration time. This hash value is compared against each other and allows checking the consistency of the entire configuration.
        reference EcuMDefaultAppMode: post-build-variant-value=true, set at post-build, destination=OsAppMode  # The default application mode loaded when the ECU comes out of reset.
        reference EcuMOSResource [1..*]: multiplicity set at pre-compile, set at pre-compile, destination=OsResource  # This parameter is a reference to a OS resource which is used to bring the ECU into sleep mode. | In case of multi core each core shall have an own OsResource.
        container EcuMDefaultShutdownTarget  # This container describes the default shutdown target to be selected by EcuM. The actual shutdown target may be overridden by the EcuM_SelectShutdownTarget service.
          enumeration EcuMDefaultShutdownTarget: {EcuMShutdownTargetOff, EcuMShutdownTargetReset, EcuMShutdownTargetSleep}, post-build-variant-value=true, set at post-build  # This parameter describes the state part of the default shutdown target selected when the ECU comes out of reset. If EcuMShutdownTargetSleep is selected, the parameter EcuMDefaultSleepModeRef selects the specific sleep mode.
          symbolic name reference EcuMDefaultResetModeRef [0..1]: multiplicity set at post-build, post-build-variant-multiplicity=true, post-build-variant-value=true, set at post-build, destination=EcuMResetMode  # If EcuMDefaultShutdownTarget is EcuMShutdownTargetReset, this parameter selects the default reset mode. Otherwise this parameter may be ignored.
          symbolic name reference EcuMDefaultSleepModeRef [0..1]: multiplicity set at post-build, post-build-variant-multiplicity=true, post-build-variant-value=true, set at post-build, destination=EcuMSleepMode  # If EcuMDefaultShutdownTarget is EcuMShutdownTargetSleep, this parameter selects the default sleep mode. Otherwise this parameter may be ignored.
        container EcuMDriverInitListOne [0..1]  # Container for Init Block I. | This container holds a list of modules to be initialized. Each module in the list will be called for initialization in the list order. All modules in this list are initialized before the OS is started and so these modules require no OS support.
          container EcuMDriverInitItem [1..*]: requires-index=true  # These containers describe the entries in a driver init list.
            enumeration EcuMModuleParameter: {NULL_PTR, POSTBUILD_PTR, VOID}, set at pre-compile  # Definition of the function prototype and the parameter passed to the function.
            string EcuMModuleService [0..1]: multiplicity set at pre-compile, set at pre-compile  # The service to be called to initialize that module, e.g. Init, PreInit, Start etc. If nothing is defined "Init" is taken by default.
            foreign reference EcuMModuleRef: set at pre-compile, destination-type=ECUC-MODULE-CONFIGURATION-VALUES  # Foreign reference to the configuration of a module instance which shall be initialized by EcuM
        container EcuMDriverInitListZero [0..1]  # Container for Init Block 0. | This container holds a list of modules to be initialized. Each module in the list will be called for initialization in the list order. All modules in this list are initialized before the post-build configuration has been loaded and the OS is initialized. Therefore, these modules may not use post-build configuration.
          container EcuMDriverInitItem [1..*]: requires-index=true  # These containers describe the entries in a driver init list.
            enumeration EcuMModuleParameter: {NULL_PTR, POSTBUILD_PTR, VOID}, set at pre-compile  # Definition of the function prototype and the parameter passed to the function.
            string EcuMModuleService [0..1]: multiplicity set at pre-compile, set at pre-compile  # The service to be called to initialize that module, e.g. Init, PreInit, Start etc. If nothing is defined "Init" is taken by default.
            foreign reference EcuMModuleRef: set at pre-compile, destination-type=ECUC-MODULE-CONFIGURATION-VALUES  # Foreign reference to the configuration of a module instance which shall be initialized by EcuM
        container EcuMDriverRestartList [0..1]  # List of modules to be initialized.
          container EcuMDriverInitItem [1..*]: requires-index=true  # These containers describe the entries in a driver init list.
            enumeration EcuMModuleParameter: {NULL_PTR, POSTBUILD_PTR, VOID}, set at pre-compile  # Definition of the function prototype and the parameter passed to the function.
            string EcuMModuleService [0..1]: multiplicity set at pre-compile, set at pre-compile  # The service to be called to initialize that module, e.g. Init, PreInit, Start etc. If nothing is defined "Init" is taken by default.
            foreign reference EcuMModuleRef: set at pre-compile, destination-type=ECUC-MODULE-CONFIGURATION-VALUES  # Foreign reference to the configuration of a module instance which shall be initialized by EcuM
        container EcuMSleepMode [1..256]  # These containers describe the configured sleep modes. | The names of these containers specify the symbolic names of the different sleep modes.
          integer EcuMSleepModeId: 0..255, scope=ECU, set at pre-compile, symbolic-name-value=true  # This ID identifies this sleep mode in services like EcuM_SelectShutdownTarget.
          boolean EcuMSleepModeSuspend: set at pre-compile  # Flag, which is set true, if the CPU is suspended, halted, or powered off in the sleep mode. If the CPU keeps running in this sleep mode, then this flag must be set to false.
          symbolic name reference EcuMSleepModeMcuModeRef: set at pre-compile, destination=McuModeSettingConf  # This parameter is a reference to the corresponding MCU mode for this sleep mode.
          symbolic name reference EcuMWakeupSourceMask [1..*]: multiplicity set at pre-compile, set at pre-compile, destination=EcuMWakeupSource  # These parameters are references to the wakeup sources that shall be enabled for this sleep mode.
        container EcuMWakeupSource [1..32]  # These containers describe the configured wakeup sources.
          float EcuMCheckWakeupTimeout [0..1]: 0..10, multiplicity set at pre-compile, set at pre-compile, default-value=0  # This Parameter is the initial Value for the Time of the EcuM to delay shut down of the ECU if the check of the Wakeup Source is done asynchronously (CheckWakeupTimer). | The unit is in seconds.
          float EcuMValidationTimeout [0..1]: 0..Inf, multiplicity set at pre-compile, set at pre-compile  # The validation timeout (period for which the ECU State Manager will wait for the validation of a wakeup event) can be defined for each wakeup source independently. The timeout is specified in seconds. | When the timeout is not instantiated, there is no validation routine and the ECU Manager shall not validate the wakeup source.
          integer EcuMWakeupSourceId: 0..31, scope=ECU, set at pre-compile, symbolic-name-value=true  # This parameter defines the identifier of this wakeup source.
          boolean EcuMWakeupSourcePolling: set at pre-compile  # This parameter describes if the wakeup source needs polling.
          symbolic name reference EcuMComMChannelRef [0..1]: multiplicity set at pre-compile, set at pre-compile, destination=ComMChannel  # This parameter is a reference to a Network (channel) defined in the Communication Manager. No reference indicates that the wakeup source is not a communication channel.
          symbolic name reference EcuMComMPNCRef [0..*]: multiplicity set at pre-compile, post-build-variant-multiplicity=true, set at pre-compile, destination=ComMPnc  # This is a reference to a one or more PNC's defined in the Communication Manager. | No reference indicates that the wakeup source is not assigned to a partial network.
          symbolic name reference EcuMResetReasonRef [0..*]: multiplicity set at pre-compile, set at pre-compile, destination=McuResetReasonConf  # This parameter describes the mapping of reset reasons detected by the MCU driver into wakeup sources.
      container EcuMFixedConfiguration [0..1]  # This container contains the configuration (parameters) of the EcuMFixed. | Only applicable if EcuMFixed is implemented.
        float EcuMNvramReadallTimeout: 0..Inf, post-build-variant-value=true, set at post-build  # Period given in seconds for which the ECU State Manager will wait until it considers a ReadAll job of the NVRAM Manager as failed.
        float EcuMNvramWriteallTimeout: 0..Inf, post-build-variant-value=true, set at post-build  # Period given in seconds for which the ECU State Manager will wait until it considers a WriteAll job of the NVRAM Manager as failed.
        float EcuMRunMinimumDuration: 0..Inf, post-build-variant-value=true, set at post-build  # Duration given in seconds for which the ECU State Manager will | stay in RUN state even when no one requests RUN. This duration should be long at least as long as a SW-Cs needs to request RUN.
        symbolic name reference EcuMComMCommunicationAllowedList [0..*]: multiplicity set at pre-compile, set at pre-compile, destination=ComMChannel  # These parameters contain references to the ComMChannels for which EcuM has to call ComM_CommunicationAllowed.
        symbolic name reference EcuMNormalMcuModeRef: set at pre-compile, destination=McuModeSettingConf  # This parameter is a reference to the normal MCU mode to be restored after a sleep.
        container EcuMDriverInitListThree [0..1]  # Container for Init Block III. | This container holds a list of modules to be initialized. Each module in the list will be called for initialization in the list order. All modules in this list are initialized after the OS is started and so these modules may use OS support. These modules may also rely on the Nvram ReadAll job to have provided all data.
          container EcuMDriverInitItem [1..*]: requires-index=true  # These containers describe the entries in a driver init list.
            enumeration EcuMModuleParameter: {NULL_PTR, POSTBUILD_PTR, VOID}, set at pre-compile  # Definition of the function prototype and the parameter passed to the function.
            string EcuMModuleService [0..1]: multiplicity set at pre-compile, set at pre-compile  # The service to be called to initialize that module, e.g. Init, PreInit, Start etc. If nothing is defined "Init" is taken by default.
            foreign reference EcuMModuleRef: set at pre-compile, destination-type=ECUC-MODULE-CONFIGURATION-VALUES  # Foreign reference to the configuration of a module instance which shall be initialized by EcuM
        container EcuMDriverInitListTwo [0..1]  # Container for Init Block II. | This container holds a list of modules to be initialized. Each module in the list will be called for initialization in the list order. All modules in this list are initialized after the OS is started and so these modules may use OS support. These modules may not rely on the Nvram ReadAll job to have provided all data.
          container EcuMDriverInitItem [1..*]: requires-index=true  # These containers describe the entries in a driver init list.
            enumeration EcuMModuleParameter: {NULL_PTR, POSTBUILD_PTR, VOID}, set at pre-compile  # Definition of the function prototype and the parameter passed to the function.
            string EcuMModuleService [0..1]: multiplicity set at pre-compile, set at pre-compile  # The service to be called to initialize that module, e.g. Init, PreInit, Start etc. If nothing is defined "Init" is taken by default.
            foreign reference EcuMModuleRef: set at pre-compile, destination-type=ECUC-MODULE-CONFIGURATION-VALUES  # Foreign reference to the configuration of a module instance which shall be initialized by EcuM
        container EcuMFixedUserConfig [1..*]  # These containers describe the identifiers that are needed to refer to a software component or another appropriate entity in the system which is designated to request the RUN state. Application requestors refer to entities above RTE, system requestors to entities below RTE (e.g. Communication Manager).
          integer EcuMFixedUser: 0..255, set at pre-compile, symbolic-name-value=true  # Parameter used to identify one user.
        container EcuMTTII [0..*]  # These containers describe the structures and the following configuration items describe its elements. These structures are concatenated to build a list as indicated by Figure 27 - Configuration Container Diagram. | The list must contain at least one element when ECUM_TTII_ENABLED is set to true.
          integer EcuMDivisor: 0..18446744073709551615, set at pre-compile  # This parameter defines the divisor preload value.
          symbolic name reference EcuMSleepModeRef: set at pre-compile, destination=EcuMSleepMode  # This configuration parameter is a reference to a configured sleep mode that is used for TTII.
          symbolic name reference EcuMSuccessorRef [0..1]: multiplicity set at pre-compile, set at pre-compile, destination=EcuMSleepMode  # This parameter is a reference to the next sleep mode in the TTII protocol.
      container EcuMFlexConfiguration [0..1]  # This container contains the configuration (parameters) of the EcuMFlex. | Only applicable if EcuMFlex is implemented.
        symbolic name reference EcuMNormalMcuModeRef: set at pre-compile, destination=McuModeSettingConf  # This parameter is a reference to the normal MCU mode to be restored after a sleep.
        reference EcuMPartitionRef [0..*]: multiplicity set at pre-compile, set at pre-compile, destination=EcucPartition  # Reference denotes the partition a EcuM shall run inside. | Please note that in case of a multicore ECU this reference is mandatory.
        container EcuMAlarmClock [0..*]  # These containers describe the configured alarm clocks. | The name of these conatiners allows giving a symbolic name to one alarm clock.
          integer EcuMAlarmClockId: 0..255, set at pre-compile, symbolic-name-value=true  # This ID identifies this alarmclock.
          float EcuMAlarmClockTimeOut: 0..Inf, set at pre-compile  # This parameter allows to define a timeout for this alarm clock.
          symbolic name reference EcuMAlarmClockUser: set at pre-compile, destination=EcuMFlexUserConfig  # This parameter allows an alarm to be assigned to a user.
        container EcuMDriverInitListBswM [0..*]  # This container holds a list of modules to be initialized by the BswM.
          container EcuMDriverInitItem [1..*]: requires-index=true  # These containers describe the entries in a driver init list.
            enumeration EcuMModuleParameter: {NULL_PTR, POSTBUILD_PTR, VOID}, set at pre-compile  # Definition of the function prototype and the parameter passed to the function.
            string EcuMModuleService [0..1]: multiplicity set at pre-compile, set at pre-compile  # The service to be called to initialize that module, e.g. Init, PreInit, Start etc. If nothing is defined "Init" is taken by default.
            foreign reference EcuMModuleRef: set at pre-compile, destination-type=ECUC-MODULE-CONFIGURATION-VALUES  # Foreign reference to the configuration of a module instance which shall be initialized by EcuM
        container EcuMFlexUserConfig [1..256]  # These containers describe the identifiers that are needed to refer to a software component or another appropriate entity in the system which uses the EcuMFlex Interfaces.
          integer EcuMFlexUser: 0..255, set at pre-compile, symbolic-name-value=true  # Parameter used to identify one user.
          reference EcuMFlexEcucPartitionRef [0..1]: multiplicity set at pre-compile, set at pre-compile, destination=EcucPartition  # Denotes in which "EcucPartition" the user of the EcuM is executed.
        container EcuMGoDownAllowedUsers [0..1]  # This container describes the collection of allowed users which are allowed to call the EcuM_GoDown API.
          symbolic name reference EcuMGoDownAllowedUserRef [1..*]: multiplicity set at pre-compile, set at pre-compile, destination=EcuMFlexUserConfig  # These parameters describe the references to the users which are allowed to call the EcuM_GoDown API.
        container EcuMResetMode [1..256]  # These containers describe the configured reset modes. | The name of these containers allows one of the following symbolic names to be given to the different reset modes: - ECUM_RESET_MCU - ECUM_RESET_WDG - ECUM_RESET_IO.
          integer EcuMResetModeId: 0..255, set at pre-compile, symbolic-name-value=true  # This ID identifies this reset mode in services like EcuM_SelectShutdownTarget.
        container EcuMSetClockAllowedUsers [0..1]  # This container describes the collection of allowed users which are allowed to call the EcuM_SetClock API.
          symbolic name reference EcuMSetClockAllowedUserRef [1..*]: multiplicity set at pre-compile, set at pre-compile, destination=EcuMFlexUserConfig  # These parameters describe the references to the users which are allowed to call the EcuM_SetClock API.
        container EcuMShutdownCause [1..256]  # These containers describe the configured shut down or reset causes. | The name of these containers allows to give one of the following symbolic names to the different shut down causes: - ECUM_CAUSE_ECU_STATE - ECU state machine entered a state for shutdown, - ECUM_CAUSE_WDGM - WdgM detected failure, - ECUM_CAUSE_DCM - Dcm requests shutdown (split into UDS services?), - and values from configuration.
          integer EcuMShutdownCauseId: 0..255, set at pre-compile, symbolic-name-value=true  # This ID identifies this shut down cause.
    container EcuMFixedGeneral [0..1]  # This container holds the general, pre-compile configuration parameters for the EcuMFixed. | Only applicable if EcuMFixed is implemented.
      boolean EcuMIncludeComM: set at pre-compile  # This configuration parameter defines whether the communication manager is supported by EcuM. This feature is presented for development purpose to compile out the communication manager in the early debugging phase.
      boolean EcuMTTIIEnabled: set at pre-compile  # Boolean switch to enable / disable TTII
      symbolic name reference EcuMTTIIWakeupSourceRef: set at pre-compile, destination=EcuMWakeupSource  # This configuration parameter references the initial sleep mode to be used by TTII when TTII is activated after a RUN mode.
    container EcuMFlexGeneral [0..1]  # This container holds the general, pre-compile configuration parameters for the EcuMFlex. | Only applicable if EcuMFlex is implemented.
      boolean EcuMAlarmClockPresent: set at pre-compile  # This flag indicates whether the optional AlarmClock feature is present.
      boolean EcuMModeHandling [0..1]: multiplicity set at pre-compile, set at pre-compile  # If false, Run Request Protocol is not performed.
      boolean EcuMResetLoopDetection [0..1]: multiplicity set at pre-compile, set at pre-compile  # If false, no reset loop detection is performed. If this configuration parameter exists and is set to true, the callout "EcuM_LoopDetection" is called during startup of EcuM (during StartPreOS).
      boolean EcuMSetProgrammableInterrupts [0..1]: multiplicity set at pre-compile, set at pre-compile  # If this configuration parameter exists and is to true, the callout "EcuM_AL_SetProgrammableInterrupts" is called during startup of EcuM (during StartPreOS).
      symbolic name reference EcuMAlarmWakeupSource [0..1]: multiplicity set at pre-compile, set at pre-compile, destination=EcuMWakeupSource  # This parameter describes the reference to the EcuMWakeupSource being used for the EcuM AlarmClock.
    container EcuMGeneral  # This container holds the general, pre-compile configuration parameters.
      boolean EcuMDevErrorDetect: set at pre-compile, default-value=false  # Switches the development error detection and notification on or off. | * true: detection and notification is enabled. * false: detection and notification is disabled.
      boolean EcuMIncludeDet: set at pre-compile  # If defined, the according BSW module will be initialized by the ECU State Manager
      float EcuMMainFunctionPeriod: 0..Inf, scope=ECU, set at pre-compile  # This parameter defines the schedule period of EcuM_MainFunction. | Unit: [s]
      boolean EcuMVersionInfoApi: set at pre-compile, default-value=false  # Switches the version info API on or off
  module definition Eep [0..*]: post-build-variant-support=true, variants post-build/pre-compile  # Configuration of the Eep (internal or external EEPROM driver) module. | Its multiplicity describes the number of EEPROM drivers present, so there will be one container for each EEPROM driver in the ECUC template. When no EEPROM driver is present then the multiplicity is 0.
    container EepGeneral  # Container for general configuration parameters of the EEPROM driver. These parameters are always pre-compile.
      boolean EepDevErrorDetect: set at pre-compile, default-value=false  # Switches the development error detection and notification on or off. | * true: detection and notification is enabled. * false: detection and notification is disabled.
      integer EepDriverIndex: 0..254, scope=ECU, set at pre-compile, symbolic-name-value=true  # Index of the driver, used by EA.
      boolean EepUseInterrupts: set at pre-compile, default-value=false  # Switches to activate or deactivate interrupt controlled job processing. | true: Interrupt controlled job processing enabled. false: Interrupt controlled job processing disabled.
      boolean EepVersionInfoApi: set at pre-compile, default-value=false  # Pre-processor switch to enable / disable the API to read out the modules version information. | true: Version info API enabled. false: Version info API disabled.
      boolean EepWriteCycleReduction: set at pre-compile, default-value=false  # Switches to activate or deactivate write cycle reduction (EEPROM value is read and compared before being overwritten). | true: Write cycle reduction enabled. false: Write cycle reduction disabled.
    container EepInitConfiguration  # Container for runtime configuration parameters of the EEPROM driver. | Implementation Type: Eep_ConfigType.
      integer EepBaseAddress: 0..4294967295, post-build-variant-value=true, set at post-build in variant post-build / pre-compile in variant pre-compile  # This parameter is the EEPROM device base address. | Implementation Type: Eep_AddressType.
      enumeration EepDefaultMode: {MEMIF_MODE_FAST, MEMIF_MODE_SLOW}, post-build-variant-value=true, set at post-build in variant post-build / pre-compile in variant pre-compile, default-value=MEMIF_MODE_SLOW  # This parameter is the default EEPROM device mode after initialization. | Implementation Type: MemIf_ModeType.
      integer EepFastReadBlockSize: 0..4294967295, post-build-variant-value=true, set at post-build in variant post-build / pre-compile in variant pre-compile  # Number of bytes read within one job processing cycle in fast mode. If the hardware does not support burst mode this parameter shall be set to the same value as EepNormalReadBlockSize. | Implementation Type: Eep_LengthType.
      integer EepFastWriteBlockSize: 0..4294967295, post-build-variant-value=true, set at post-build in variant post-build / pre-compile in variant pre-compile  # Number of bytes written within one job processing cycle in fast mode. If the hardware does not support burst mode this parameter shall be set to the same value as EepNormalWriteBlockSize. | Implementation Type: Eep_LengthType.
      float EepJobCallCycle [0..1]: 0..Inf, multiplicity set at post-build in variant post-build / pre-compile in variant pre-compile, post-build-variant-multiplicity=true, post-build-variant-value=true, set at post-build in variant post-build / pre-compile in variant pre-compile  # Call cycle time of the EEPROM driver's main function. Unit: [s]
      function name EepJobEndNotification [0..1]: multiplicity set at post-build in variant post-build / pre-compile in variant pre-compile, post-build-variant-multiplicity=true, post-build-variant-value=true, set at post-build in variant post-build / pre-compile in variant pre-compile  # This parameter is a reference to a callback function for positive job result (see EEP045).
      function name EepJobErrorNotification [0..1]: multiplicity set at post-build in variant post-build / pre-compile in variant pre-compile, post-build-variant-multiplicity=true, post-build-variant-value=true, set at post-build in variant post-build / pre-compile in variant pre-compile  # This parameter is a reference to a callback function for negative job result (see EEP046).
      integer EepNormalReadBlockSize: 0..4294967295, post-build-variant-value=true, set at post-build in variant post-build / pre-compile in variant pre-compile  # Number of bytes read within one job processing cycle in normal mode. | Implementation Type: Eep_LengthType.
      integer EepNormalWriteBlockSize: 0..4294967295, post-build-variant-value=true, set at post-build in variant post-build / pre-compile in variant pre-compile  # Number of bytes written within one job processing cycle in normal mode. | Implementation Type: Eep_LengthType.
      integer EepSize: 0..4294967295, post-build-variant-value=true, set at post-build in variant post-build / pre-compile in variant pre-compile  # This parameter is the used size of EEPROM device in bytes. | Implementation Type: Eep_LengthType.
      container EepDemEventParameterRefs [0..1]  # Container for the references to DemEventParameter elements which shall be invoked using the API Dem_SetEventStatus in case the corresponding error occurs. The EventId is taken from the referenced DemEventParameter's DemEventId symbolic value. The standardized errors are provided in this container and can be extended by vendor-specific error references.
        symbolic name reference EEP_E_COMPARE_FAILED [0..1]: multiplicity set at post-build in variant post-build / pre-compile in variant pre-compile, post-build-variant-multiplicity=true, post-build-variant-value=true, set at post-build in variant post-build / pre-compile in variant pre-compile, destination=DemEventParameter  # Reference to the DemEventParameter which shall be issued when the error "EEPROM compare failed (HW)" has occurred.
        symbolic name reference EEP_E_ERASE_FAILED [0..1]: multiplicity set at post-build in variant post-build / pre-compile in variant pre-compile, post-build-variant-multiplicity=true, post-build-variant-value=true, set at post-build in variant post-build / pre-compile in variant pre-compile, destination=DemEventParameter  # Reference to the DemEventParameter which shall be issued when the error "EEPROM erase failed (HW)" has occurred.
        symbolic name reference EEP_E_READ_FAILED [0..1]: multiplicity set at post-build in variant post-build / pre-compile in variant pre-compile, post-build-variant-multiplicity=true, post-build-variant-value=true, set at post-build in variant post-build / pre-compile in variant pre-compile, destination=DemEventParameter  # Reference to the DemEventParameter which shall be issued when the error "EEPROM read failed (HW)" has occurred.
        symbolic name reference EEP_E_WRITE_FAILED [0..1]: multiplicity set at post-build in variant post-build / pre-compile in variant pre-compile, post-build-variant-multiplicity=true, post-build-variant-value=true, set at post-build in variant post-build / pre-compile in variant pre-compile, destination=DemEventParameter  # Reference to the DemEventParameter which shall be issued when the error "EEPROM write failed (HW)" has occurred.
      container EepExternalDriver [0..1]  # This container is present for external EEPROM drivers only. Internal EEPROM drivers do not use the parameter listed in this container, hence its multiplicity is 0 for internal drivers.
        symbolic name reference EepSpiReference [1..*]: multiplicity set at post-build in variant post-build / pre-compile in variant pre-compile, post-build-variant-multiplicity=true, post-build-variant-value=true, set at post-build in variant post-build / pre-compile in variant pre-compile, destination=SpiSequence  # Reference to SPI sequence (required for external EEPROM drivers).
    container EepPublishedInformation  # Additional published parameters not covered by CommonPublishedInformation container. | Note that these parameters do not have any configuration class setting, since they are published information.
      integer EepAllowedWriteCycles: 0..4294967295, set at published-information  # Specified maximum number of write cycles under worst case conditions of specific EEPROM hardware (e.g. +90°C)
      float EepEraseTime: 0..Inf, set at published-information  # Maximum time for erasing one EEPROM data unit.
      integer EepEraseUnitSize: 0..4294967295, set at published-information  # Size of smallest erasable EEPROM data unit in bytes.
      integer EepEraseValue: 0..255, set at published-information  # Value of an erased EEPROM cell.
      integer EepMinimumAddressType: 0..4294967295, set at published-information  # Minimum expected size of Eep_AddressType.
      integer EepMinimumLengthType: 0..4294967295, set at published-information  # Minimum expected size of Eep_LengthType.
      integer EepReadUnitSize: 0..4294967295, set at published-information  # Size of smallest readable EEPROM data unit in bytes.
      integer EepSpecifiedEraseCycles: 0..4294967295, set at published-information  # Number of erase cycles specified for the EEP device (usually given in the device data sheet).
      integer EepTotalSize: 0..4294967295, set at published-information  # Total size of EEPROM in bytes. | Implementation Type: Eep_LengthType.
      float EepWriteTime: 0..Inf, set at published-information  # Maximum time for writing one EEPROM data unit.
      integer EepWriteUnitSize: 0..4294967295, set at published-information  # Size of smallest writeable EEPROM data unit in bytes.
  module definition Eth [0..*]: post-build-variant-support=true, variants link-time/post-build/pre-compile  # Configuration of the Eth (Ethernet Driver) module.
    container EthConfigSet  # This container contains the configuration parameters and sub containers of the AUTOSAR Eth module.
      container EthCtrlConfig [1..*]  # Configuration of the individual controller
        boolean EthCtrlEnableMii: set at pre-compile  # Enables / Disables Media Independent Interface (MII) for transceiver access
        boolean EthCtrlEnableRxInterrupt: set at pre-compile  # Enables / Disables receive interrupt
        boolean EthCtrlEnableTxInterrupt: set at pre-compile  # Enables / Disables transmit interrupt
        integer EthCtrlIdx: 0..255, scope=ECU, set at pre-compile, symbolic-name-value=true  # Specifies the instance ID of the configured controller.
        enumeration EthCtrlMacLayerType: {ETH_MAC_LAYER_TYPE_XGMII, ETH_MAC_LAYER_TYPE_XMII, ETH_MAC_LAYER_TYPE_XXGMII}, scope=ECU, post-build-variant-value=true, set at link in variant link-time / post-build in variant post-build / pre-compile in variant pre-compile  # Defines the MAC layer type of the ethernet controller.
        string EthCtrlPhyAddress [0..1]: multiplicity set at link in variant link-time / post-build in variant post-build / pre-compile in variant pre-compile, post-build-variant-multiplicity=true, post-build-variant-value=true, set at link in variant link-time / post-build in variant post-build / pre-compile in variant pre-compile, max-length=17, min-length=17  # Specifies the unique 48-bit physical address (MAC address) of the controller in network byte order. | Regular Expression: [0-9a-fA-F]{2}[[:-][0-9a-fA-F]{2}]{5}
        container EthCtrlConfigEgress  # Configuration of one Ethernet controler egress behavior.
          reference EthCtrlConfigEgressLastSchedulerRef: set at pre-compile, destination=EthCtrlConfigScheduler  # Reference to the scheduler which is the last in the egress structure.
          container EthCtrlConfigEgressFifo [0..*]: multiplicity set at link in variant link-time / post-build in variant post-build / pre-compile in variant pre-compile, post-build-variant-multiplicity=true  # Represents a Fifo at the egress side.
            integer EthCtrlConfigEgressFifoBufLenByte: 0..65535, post-build-variant-value=true, set at link in variant link-time / post-build in variant post-build / pre-compile in variant pre-compile  # Fifo buffer length in bytes.
            integer EthCtrlConfigEgressFifoBufTotal: 0..65535, post-build-variant-value=true, set at link in variant link-time / post-build in variant post-build / pre-compile in variant pre-compile  # Fifo buffer count.
            integer EthCtrlConfigEgressFifoIdx: 0..255, post-build-variant-value=true, set at link in variant link-time / post-build in variant post-build / pre-compile in variant pre-compile  # Egress Fifo index.
            integer EthCtrlConfigEgressFifoPriorityAssignment [0..*]: 0..7, multiplicity set at link in variant link-time / post-build in variant post-build / pre-compile in variant pre-compile, post-build-variant-multiplicity=true, post-build-variant-value=true, set at link in variant link-time / post-build in variant post-build / pre-compile in variant pre-compile  # Message egress prority assignment.
          container EthCtrlConfigScheduler [1..*]  # Represents a Scheduler on the egress side.
            container EthCtrlConfigSchedulerPredecessor [1..*]  # Defines an ordered list of predecessors for this scheduler.
              integer EthCtrlConfigSchedulerPredecessorOrder: 0..18446744073709551615, post-build-variant-value=true, set at link in variant link-time / post-build in variant post-build / pre-compile in variant pre-compile  # Defines the order of the scheduler predecessors.
              choice reference EthCtrlConfigSchedulerPredecessorRef: set at pre-compile, destination=[EthCtrlConfigEgressFifo, EthCtrlConfigScheduler, EthCtrlConfigShaper]  # Choice reference to the scheduler predecessor.
          container EthCtrlConfigShaper [0..*]  # Represents a Shaper an the egress side.
            integer EthCtrlConfigShaperIdleSlope [0..1]: 0..18446744073709551615, post-build-variant-value=true, set at link in variant link-time / post-build in variant post-build / pre-compile in variant pre-compile  # Defines the increase of credit in bits per second for the AVB shaper.
            reference EthCtrlConfigShaperPredecessorFifoRef: set at pre-compile, destination=EthCtrlConfigEgressFifo  # Reference to the fifo which is the predecessor for this shaper.
        container EthCtrlConfigIngress  # Configuration of one Ethernet controler ingress behavior.
          container EthCtrlConfigIngressFifo [0..*]: multiplicity set at link in variant link-time / post-build in variant post-build / pre-compile in variant pre-compile, post-build-variant-multiplicity=true  # Represents a Fifo at the ingress side.
            integer EthCtrlConfigIngressFifoBufLenByte: 0..65535, post-build-variant-value=true, set at link in variant link-time / post-build in variant post-build / pre-compile in variant pre-compile  # Fifo buffer length in bytes.
            integer EthCtrlConfigIngressFifoBufTotal: 0..65535, post-build-variant-value=true, set at link in variant link-time / post-build in variant post-build / pre-compile in variant pre-compile  # Fifo buffer count.
            integer EthCtrlConfigIngressFifoIdx: 0..255, post-build-variant-value=true, set at link in variant link-time / post-build in variant post-build / pre-compile in variant pre-compile, symbolic-name-value=true  # Ingress Fifo index.
            integer EthCtrlConfigIngressFifoPriorityAssignment [0..*]: 0..7, multiplicity set at link in variant link-time / post-build in variant post-build / pre-compile in variant pre-compile, post-build-variant-multiplicity=true, post-build-variant-value=true, set at link in variant link-time / post-build in variant post-build / pre-compile in variant pre-compile  # Message ingress prority assignment.
        container EthDemEventParameterRefs [0..1]  # Container for the references to DemEventParameter elements which shall be invoked using the API Dem_SetEventStatus in case the corresponding error occurs. The EventId is taken from the referenced DemEventParameter's DemEventId symbolic value. The standardized errors are provided in this container and can be extended by vendor-specific error references.
          symbolic name reference ETH_E_ACCESS [0..1]: multiplicity set at link in variant link-time / post-build in variant post-build / pre-compile in variant pre-compile, post-build-variant-multiplicity=true, post-build-variant-value=true, set at link in variant link-time / post-build in variant post-build / pre-compile in variant pre-compile, destination=DemEventParameter  # Reference to the DemEventParameter which shall be issued when the error "Controller access failed" has occured.
          symbolic name reference ETH_E_ALIGNMENT [0..1]: multiplicity set at link in variant link-time / post-build in variant post-build / pre-compile in variant pre-compile, post-build-variant-multiplicity=true, post-build-variant-value=true, set at link in variant link-time / post-build in variant post-build / pre-compile in variant pre-compile, destination=DemEventParameter  # Reference to the DemEventParameter which shall be issued when the error "Alignment Error" has occured.
          symbolic name reference ETH_E_CRC [0..1]: multiplicity set at link in variant link-time / post-build in variant post-build / pre-compile in variant pre-compile, post-build-variant-multiplicity=true, post-build-variant-value=true, set at link in variant link-time / post-build in variant post-build / pre-compile in variant pre-compile, destination=DemEventParameter  # Reference to the DemEventParameter which shall be issued when the error "CRC Failure" has occured.
          symbolic name reference ETH_E_LATECOLLISION [0..1]: multiplicity set at link in variant link-time / post-build in variant post-build / pre-compile in variant pre-compile, post-build-variant-multiplicity=true, post-build-variant-value=true, set at link in variant link-time / post-build in variant post-build / pre-compile in variant pre-compile, destination=DemEventParameter  # Reference to the DemEventParameter which shall be issued when the error "Late Collisions" has occured.
          symbolic name reference ETH_E_MULTIPLECOLLISION [0..1]: multiplicity set at link in variant link-time / post-build in variant post-build / pre-compile in variant pre-compile, post-build-variant-multiplicity=true, post-build-variant-value=true, set at link in variant link-time / post-build in variant post-build / pre-compile in variant pre-compile, destination=DemEventParameter  # Reference to the DemEventParameter which shall be issued when the error "Multiple Collisions" has occured.
          symbolic name reference ETH_E_OVERSIZEFRAME [0..1]: multiplicity set at link in variant link-time / post-build in variant post-build / pre-compile in variant pre-compile, post-build-variant-multiplicity=true, post-build-variant-value=true, set at link in variant link-time / post-build in variant post-build / pre-compile in variant pre-compile, destination=DemEventParameter  # Reference to the DemEventParameter which shall be issued when the error "Oversized Frame" has occured.
          symbolic name reference ETH_E_RX_FRAMES_LOST [0..1]: multiplicity set at link in variant link-time / post-build in variant post-build / pre-compile in variant pre-compile, post-build-variant-multiplicity=true, post-build-variant-value=true, set at link in variant link-time / post-build in variant post-build / pre-compile in variant pre-compile, destination=DemEventParameter  # Reference to the DemEventParameter which shall be issued when the error "receive frames lost" has occured.
          symbolic name reference ETH_E_SINGLECOLLISION [0..1]: multiplicity set at link in variant link-time / post-build in variant post-build / pre-compile in variant pre-compile, post-build-variant-multiplicity=true, post-build-variant-value=true, set at link in variant link-time / post-build in variant post-build / pre-compile in variant pre-compile, destination=DemEventParameter  # Reference to the DemEventParameter which shall be issued when the error "Single Collisions" has occured.
          symbolic name reference ETH_E_UNDERSIZEFRAME [0..1]: multiplicity set at link in variant link-time / post-build in variant post-build / pre-compile in variant pre-compile, post-build-variant-multiplicity=true, post-build-variant-value=true, set at link in variant link-time / post-build in variant post-build / pre-compile in variant pre-compile, destination=DemEventParameter  # Reference to the DemEventParameter which shall be issued when the error "Undersized Frame" has occured.
    container EthGeneral  # General configuration of Ethernet Driver module
      boolean EthDevErrorDetect: set at pre-compile, default-value=false  # Switches the development error detection and notification on or off. | * true: detection and notification is enabled. * false: detection and notification is disabled.
      boolean EthGetDropCountApi: set at pre-compile  # Enables / Disables Eth_GetCounterValues API.
      boolean EthGetEtherStatsApi: set at pre-compile  # Enables / Disables Eth_GetEtherStats API.
      boolean EthGetTxErrorCounterValuesApi: set at pre-compile, default-value=false  # Enables/Disables Eth_GetTxErrorCounterValues API.
      boolean EthGetTxStatsApi: set at pre-compile, default-value=false  # Enables/Disables Eth_GetTxStats API.
      boolean EthGlobalTimeSupport: set at pre-compile  # Enables/Disables the GlobalTime APIs used amongst others by Global Time Synchronization over Ethernet.
      integer EthIndex: 0..255, set at pre-compile  # Specifies the InstanceId of this module instance. If only one instance is present it shall have the Id 0.
      float EthMainFunctionPeriod: 0..Inf, set at pre-compile  # Specifies the period of main function Eth_MainFunction in seconds. Ethernet driver does not require this information but the BSW scheduler.
      integer EthMaxCtrlsSupported: 1..255, set at pre-compile  # Limits the total number of supported controllers.
      boolean EthUpdatePhysAddrFilter: set at pre-compile, default-value=false  # Enables/Disables optional API Eth_UpdatePhysAddrFilter.
      boolean EthVersionInfoApi: set at pre-compile, default-value=false  # Enables / Disables version info API
      container EthCtrlOffloading  # Configuration of hardware offloading features.
        boolean EthCtrlEnableOffloadChecksumICMP: set at pre-compile  # Enables / Disables hardware offloading for ICMP checksums.
        boolean EthCtrlEnableOffloadChecksumIPv4: set at pre-compile  # Enables / Disables hardware offloading for IPv4 checksums.
        boolean EthCtrlEnableOffloadChecksumTCP: set at pre-compile  # Enables / Disables hardware offloading for TCP checksums.
        boolean EthCtrlEnableOffloadChecksumUDP: set at pre-compile  # Enables / Disables hardware offloading for UDP checksums.
  module definition EthIf [0..1]: post-build-variant-support=true, variants link-time/post-build/pre-compile  # Configuration of the EthIf (Ethernet Interface) module.
    container EthIfConfigSet  # Collecting container for all parameters with post-build configuration classes.
      container EthIfController [1..*]  # This container contains the configuration of EthIfController.
        integer EthIfCtrlIdx: 0..255, scope=ECU, set at pre-compile, symbolic-name-value=true  # This parameter provides a zero-based consecutive index of the Ethernet Communication Controllers. Upper layer BSW modules and the EthIf itself use this index to identify a Ethernet CC.
        integer EthIfCtrlMtu: 64..9000, scope=ECU, post-build-variant-value=true, set at link in variant link-time / post-build in variant post-build / pre-compile in variant pre-compile  # Specifies the maximum transmission unit (MTU) of the EthIfCtrl in [bytes]. | Note: in case a VLAN tag is used for the EthIfCtrl, the MTU is 4 bytes smaller than the maximum payload size of an Ethernet frame which can be transmitted on the network.
        integer EthIfMaxTxBufsTotal: 1..4294967295, set at pre-compile  # Limits the total number of transmit buffers.
        integer EthIfVlanId [0..1]: 0..4095, scope=ECU, multiplicity set at link in variant link-time / post-build in variant post-build / pre-compile in variant pre-compile, post-build-variant-multiplicity=true, post-build-variant-value=true, set at link in variant link-time / post-build in variant post-build / pre-compile in variant pre-compile  # A virtual-LAN is identified by this attribute according to IEEE 802.1Q.
        symbolic name reference EthIfEthTrcvRef [0..1]: scope=ECU, multiplicity set at link in variant link-time / post-build in variant post-build / pre-compile in variant pre-compile, post-build-variant-multiplicity=true, post-build-variant-value=true, set at link in variant link-time / post-build in variant post-build / pre-compile in variant pre-compile, destination=EthIfTransceiver  # Reference to an Ethernet transceiver, which is handled by the Ethernet Interface.
        symbolic name reference EthIfPhysControllerRef: scope=ECU, post-build-variant-value=true, set at link in variant link-time / post-build in variant post-build / pre-compile in variant pre-compile, destination=EthIfPhysController  # Reference to a physical Ethernet controller, which is handled by the Ethernet Interface.
        choice reference EthIfSwitchRefOrPortGroupRef [0..1]: multiplicity set at link in variant link-time / post-build in variant post-build / pre-compile in variant pre-compile, post-build-variant-multiplicity=true, post-build-variant-value=true, set at link in variant link-time / post-build in variant post-build / pre-compile in variant pre-compile, destination=[EthIfSwitch, EthIfSwitchPortGroup]  # The choice reference allows to configure either the EthIfController references an EthIfSwitch or an EthIfSwitchPortGroup. | Reference to a EthIfSwitchPortGroup. In case port groups are controlled by PNC EthIfSwitchPortGroupRefSemantics shall have the value ETHIF_SWITCH_PORT_GROUP_LINK_INFO. In case port groups are controlled by the EhtIfController EthIfSwitchPortGroupRefSemantics shall have the value ETHIF_SWITCH_PORT_GROUP_CONTROL.
      container EthIfFrameOwnerConfig [1..*]  # Configuration of Ethernet frame owner
        integer EthIfFrameType: 0..65535, post-build-variant-value=true, set at link in variant link-time / post-build in variant post-build / pre-compile in variant pre-compile  # Selects the Ethernet frame type.
        integer EthIfOwner: 0..255, post-build-variant-value=true, set at link in variant link-time / post-build in variant post-build / pre-compile in variant pre-compile  # Selects the owner of an Ethernet frame type. The owner is a zero based index into the callback function configuration 'EthIfRxIndicationConfig'. I.e. an Ethernet frame of type IPv4 (0x800) at index 0 will call the first callback function configured in 'EthIfRxIndicationConfig'.
      container EthIfPhysController [1..*]  # This container contains the configuration of EthIfPhysController. | The usage of EthIfEthCtrlRef and EthIfWEthCtrlRef is exclusive OR.
        integer EthIfPhysControllerIdx: 0..255, scope=ECU, set at pre-compile, symbolic-name-value=true  # This parameter provides a zero-based consecutive index of the physical Ethernet controllers. Upper layer BSW modules and the Ethernet Interface itself use this index to identify a physical Ethernet controller.
        symbolic name reference EthIfEthCtrlRef [0..1]: scope=ECU, post-build-variant-value=true, set at link in variant link-time / post-build in variant post-build / pre-compile in variant pre-compile, destination=EthCtrlConfig  # Reference to a physical Ethernet controller, which is handled by a specific Ethernet controller driver.
        symbolic name reference EthIfWEthCtrlRef [0..1]: scope=ECU, post-build-variant-value=true, set at link in variant link-time / post-build in variant post-build / pre-compile in variant pre-compile, destination=WEthCtrlConfig  # Reference to a physical Wireless Ethernet controller, which is handled by a specific Wireless Ethernet controller driver.
        container EthIfPhysCtrlRxMainFunctionPriorityProcessing [0..*]: multiplicity set at pre-compile  # Configuration of ingress FIFO based main function processing.
          integer EthIfPhysCtrlRxIndicationIterations: 0..18446744073709551615, set at pre-compile  # Max number of Ethernet frames polled per main function invocation.
          float EthIfPhysCtrlRxMainFunctionPeriod: set at pre-compile  # Specifies the period of main function in seconds.
          symbolic name reference EthIfPhysCtrlRxIngressFifoRef: set at pre-compile, destination=EthCtrlConfigIngressFifo  # Reference to the reception FIFO.
      container EthIfRxIndicationConfig [1..*]  # Configuration of receive callback functions.
        function name EthIfRxIndicationFunction: post-build-variant-value=true, set at link in variant link-time / post-build in variant post-build / pre-compile in variant pre-compile  # Specifies receive indication callback function.
      container EthIfSwitch [0..*]  # This container contains the configuration of EthIfSwitches.
        integer EthIfSwitchIdx: 0..255, scope=ECU, set at pre-compile, symbolic-name-value=true  # This parameter provides a zero-based consecutive index of the Ethernet Interface Switches. Upper layer BSW modules and the EthIf itself use this index to identify a Ethernet Switch.
        symbolic name reference EthIfSwitchRef: scope=ECU, post-build-variant-value=true, set at link in variant link-time / post-build in variant post-build / pre-compile in variant pre-compile, destination=EthSwtConfig  # Reference to a Ethernet Switch, which is handled by a specific Ethernet Switch driver.
      container EthIfSwitchMgmtInfoIndicationConfig [0..*]: multiplicity set at pre-compile  # Configuration of Switch Management callback function.
        function name EthIfSwitchMgmtInfoIndicationFunction: post-build-variant-value=true, set at link in variant link-time / post-build in variant post-build / pre-compile in variant pre-compile  # Enables/Disables the ingress Switch management info indication redirected call to upper layers who registered for the call.
      container EthIfSwitchPortGroup [0..*]  # This container contains the configuration of EthIfSwitchPortGroups. | If EthIfSwitchPortGroups are controlled by PNC one EthIfSwitchPortGroup per PNC shall exist. The host port shall be part of all EthIfSwitchPortGroups. The up link port of a master switch and the up link port of the slave switch shall be part of all EthIfSwitchPortGroups that contain EthSwtPorts belonging to the slave switch.
        integer EthIfSwitchPortGroupIdx: 0..255, scope=ECU, set at pre-compile, symbolic-name-value=true  # This parameter provides a zero-based consecutive index of the Ethernet Switch Port Groups. Upper layer BSW modules and the EthIf itself use this index to identify an Ethernet Switch Port Group.
        enumeration EthIfSwitchPortGroupRefSemantics [0..1]: {ETHIF_SWITCH_PORT_GROUP_CONTROL, ETHIF_SWITCH_PORT_GROUP_LINK_INFO}, post-build-variant-value=true, set at link in variant link-time / post-build in variant post-build / pre-compile in variant pre-compile  # Defines how the EthIfSwitchRefOrPortGroupRef refering to a EthIfSwitchPortGroup shall be interpreted.
        symbolic name reference EthIfPortRef [1..*]: post-build-variant-value=true, set at link in variant link-time / post-build in variant post-build / pre-compile in variant pre-compile, destination=EthSwtPort  # Reference to an Ethernet Switch Port.
      container EthIfSwitchTimeStampIndicationConfig [0..*]: multiplicity set at pre-compile  # Configuration of Switch timestamp indications.
        function name EthIfSwitchEgressTimeStampIndicationFunction: post-build-variant-value=true, set at link in variant link-time / post-build in variant post-build / pre-compile in variant pre-compile  # Enables/Disables to upper layers an egress timestamp indication function.
        function name EthIfSwitchIngressTimeStampIndicationFunction: post-build-variant-value=true, set at link in variant link-time / post-build in variant post-build / pre-compile in variant pre-compile  # Enables/Disables to upper layers an ingress timestamp indication function.
      container EthIfTransceiver [0..*]  # This container contains the configuration of EthIfTransceiver. | The usage of EthIfEthTrcvRef and EthIfWEthTrcvRefis exclusive OR.
        integer EthIfTransceiverIdx: 0..255, scope=ECU, set at pre-compile, symbolic-name-value=true  # This parameter provides a zero-based consecutive index of the Ethernet transceivers. Upper layer BSW modules and the Ethernet Interface itself use this index to identify an Ethernet tranceiver.
        symbolic name reference EthIfEthTrcvRef [0..1]: scope=ECU, post-build-variant-value=true, set at link in variant link-time / post-build in variant post-build / pre-compile in variant pre-compile, destination=EthTrcvConfig  # Reference to an Ethernet transceiver, which is handled by a specific Ethernet transceiver driver.
        symbolic name reference EthIfWEthTrcvRef [0..1]: scope=ECU, post-build-variant-value=true, set at link in variant link-time / post-build in variant post-build / pre-compile in variant pre-compile, destination=WEthTrcvConfig  # Reference to an Wireless Ethernet transceiver, which is handled by a specific Wireless Ethernet transceiver driver.
      container EthIfTrcvLinkStateChgConfig [1..*]  # Specifies link state change callback function
        function name EthIfTrcvLinkStateChgFunction: post-build-variant-value=true, set at link in variant link-time / post-build in variant post-build / pre-compile in variant pre-compile  # Specifies link state change callback function
      container EthIfTxConfirmationConfig [0..*]  # Configuration of transmit indication callback functions.
        function name EthIfTxConfirmationFunction: post-build-variant-value=true, set at link in variant link-time / post-build in variant post-build / pre-compile in variant pre-compile  # Specifies transmit indication callback function
    container EthIfGeneral  # This container contains the general configuration parameters of the Ethernet Interface.
      boolean EthIfDevErrorDetect: set at pre-compile, default-value=false  # Switches the development error detection and notification on or off. | * true: detection and notification is enabled. * false: detection and notification is disabled.
      boolean EthIfEnableRxInterrupt: set at pre-compile  # Enables / Disables receive interrupt.
      boolean EthIfEnableTxInterrupt: set at pre-compile  # Enables / Disables the transmit interrupt.
      boolean EthIfEnableWEthApi [0..1]: multiplicity set at pre-compile, set at pre-compile, default-value=false  # Enables / Disables API's for WEth / WEthTrcv
      boolean EthIfGetAndResetMeasurementDataApi: set at pre-compile, default-value=false  # Enables / Disables the Get and Reset Measurement Data API
      boolean EthIfGetBaudRate: set at pre-compile  # Enables / Disables GetBaudRate API.
      boolean EthIfGetCounterState: set at pre-compile  # Enables / Disables GetCounterState API.
      boolean EthIfGetCtrlIdxList: set at pre-compile, default-value=false  # Enables / Disables GetCtrlIdxList API.
      boolean EthIfGetTransceiverWakeupModeApi [0..1]: multiplicity set at pre-compile, set at pre-compile, default-value=false  # Enables / Disables EthIf_GetTransceiverWakeupMode API
      boolean EthIfGetVlanIdSupport: set at pre-compile, default-value=false  # Enables / Disables GetVlanId API.
      boolean EthIfGlobalTimeSupport: set at pre-compile  # Enables/Disables the Global Time APIs used amongst others by Global Time Synchronization over Ethernet.
      float EthIfMainFunctionPeriod: 0..Inf, set at pre-compile  # Specifies the period of main function EthIf_MainFunctionRx and EthIf_MainFunctionTx in seconds. Ethernet Interface does not require this information but the BSW scheduler.
      float EthIfMainFunctionStatePeriod [0..1]: 0..Inf, multiplicity set at pre-compile, set at pre-compile  # Specifies the period of main function EthIf_MainFunctionState in seconds. Ethernet Interface does not require this information but the BSW scheduler.
      integer EthIfMaxTrcvsTotal: 1..255, set at pre-compile  # Limits the total number of transceivers.
      float EthIfPortStartupActiveTime [0..1]: 0.001..65.535, multiplicity set at link in variant link-time / post-build in variant post-build / pre-compile in variant pre-compile, post-build-variant-multiplicity=true, post-build-variant-value=true, set at link in variant link-time+post-build / pre-compile in variant pre-compile  # Denote the time delay after the mode "ETHTRCV_MODE_ACTIVE" of all EthIfSwitchPorts are requested via EthIf_StartAllPorts. | This is only used for ports in EthIfSwtPortGroups which are not referenced by a EthIfController or the reference is of type "link-information".
      string EthIfPublicCddHeaderFile [0..*]: scope=ECU, multiplicity set at pre-compile, set at pre-compile, max-length=32, min-length=1  # Defines header files for callback functions which shall be included in case of CDDs. Range of characters is 1.. 32.
      integer EthIfRxIndicationIterations [0..1]: 0..65535, set at pre-compile  # Maximum number of Ethernet frames per Ethernet controller polled from the Ethernet driver within EthIf_MainFunctionRx.
      boolean EthIfSetForwardingModeApi: set at pre-compile, default-value=false  # Enables /disables EthIf_SetForwardingMode API.
      boolean EthIfStartAutoNegotiation: set at pre-compile  # Enables / Disables StartAutoNegotiation API.
      boolean EthIfSwitchManagementSupport: set at pre-compile  # Enables/Disables the Switch management APIs to support a Switch-port specific communication attribute access.
      float EthIfSwitchOffPortTimeDelay [0..1]: 0.001..65.535, multiplicity set at link in variant link-time / post-build in variant post-build / pre-compile in variant pre-compile, post-build-variant-multiplicity=true, post-build-variant-value=true, set at link in variant link-time+post-build / pre-compile in variant pre-compile  # Denote the time delay after the mode "ETHTRCV_MODE_DOWN" of a EthIfSwitchPortGroup will be executed. | This is only used for EthIfSwtPortGroups which not referenced by a EthIfController or the reference is of type "link-information". The time delay shall be greater than the UdpNm timings, because UdpNm shall finish its shutdown handling. (Repeat Message State, Prepare Bus-Sleep state, Bus-Sleep state).
      integer EthIfTrcvLinkStateChgMainReload: 1..255, set at pre-compile  # Specifies the frequency of transceiver link state change checks in each | period of main function EthIf_MainFunctionTx.
      boolean EthIfVerifyConfigApi: set at pre-compile, default-value=false  # Enables /disables EthIf_VerifyConfig API.
      boolean EthIfVersionInfoApi: set at pre-compile, default-value=false  # Enables / Disables version info API
      boolean EthIfVersionInfoApiMacro: set at pre-compile, default-value=false  # Enables / Disables version info API macro implementation.
      boolean EthIfWakeUpSupport: set at pre-compile, default-value=false  # Configures if wakeup is supported or not.
  module definition EthSM [0..1]: variants pre-compile  # Configuration of the Ethernet State Manager
    container EthSMGeneral  # This container contains the global parameter of the Ethernet State Manager.
      boolean EthSMDevErrorDetect: set at pre-compile, default-value=false  # Switches the development error detection and notification on or off. | * true: detection and notification is enabled. * false: detection and notification is disabled.
      boolean EthSMDummyMode: set at pre-compile  # Disables the API to the EthIf. The API to the ComM is available but the functionality is deactivated. The function calls from the ComM will be answered with the return value E_OK.
      float EthSMMainFunctionPeriod: 0..Inf, set at pre-compile  # Specifies the period in seconds that the MainFunction has to be triggered with.
      boolean EthSMVersionInfoApi: set at pre-compile, default-value=false  # Enables and disables the version info API.
    container EthSMNetwork [1..*]  # This container contains the Ethernet network-specific parameters of each Ethernet network. It also contains the reference to combination of controller and transceiver assigned to an Ethernet network.
      symbolic name reference EthSMComMNetworkHandleRef: set at pre-compile, destination=ComMChannel  # Unique handle to identify one certain Ethernet network. Reference to one of the network handles configured for the ComM.
      symbolic name reference EthSMEthIfControllerRef: set at pre-compile, destination=EthIfController  # Reference to EthIfCtrl container where a ETH controller and | transceiver (optional) combination is configured.
      container EthSMDemEventParameterRefs [0..1]  # Container for the references to DemEventParameter elements which shall be invoked using the API Dem_SetEventStatus in case the corresponding error occurs. The EventId is taken from the referenced DemEventParameter's DemEventId symbolic value. The standardized errors are provided in this container and can be extended by vendor-specific error references.
        symbolic name reference ETHSM_E_LINK_DOWN [0..1]: multiplicity set at pre-compile, set at pre-compile, destination=DemEventParameter  # Reference to configured DEM event to report bus off errors for this Eth network.
