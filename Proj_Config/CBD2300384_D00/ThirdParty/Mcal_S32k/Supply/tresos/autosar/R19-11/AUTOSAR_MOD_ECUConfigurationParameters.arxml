[part 9 of 10: package /AUTOSAR/EcucDefs]
AUTOSAR XML (schema 00048)
package /AUTOSAR/EcucDefs  (continued)
  module definition PduR [0..1]: post-build-variant-support=true, variants post-build/pre-compile  # Configuration of the PduR (PDU Router) module.
    container PduRBswModules [0..*]: multiplicity set at pre-compile  # Each container describes a specific BSW module (upper/CDD/lower/IpduM) that the PDU Router shall interface to. | The reason to have it as own configuration container instead of implication of the routing path is to be able to configure CDDs properly and to force module's to be used in a post-build situation even though no routing is made to/from this module (future configurations may include these modules).
      boolean PduRCancelReceive: set at pre-compile  # Specifies if the Transport protocol module supports the CancelReceive API or not. Value true the API is supported.
      boolean PduRCancelTransmit: set at pre-compile  # Specifies if the BSW module supports the CancelTransmit API or not. Value true the API is supported.
      boolean PduRCommunicationInterface: set at pre-compile  # Specifies if the BSW module supports the Communication Interface APIs or not. Value true the APIs are supported. | A module can have both Communication Interface APIs and Transport Protocol APIs (e.g. the COM module).
      boolean PduRCopyRxData: scope=ECU, set at pre-compile  # Specifies if the Transport protocol module supports the CopyRxData API or not. Value true the API is supported.
      boolean PduRCopyTxData: scope=ECU, set at pre-compile  # Specifies if the Transport protocol module supports the CopyTxData API or not. Value true the API is supported.
      boolean PduRLowerModule: set at pre-compile  # The PduRLowerModule will decide who will call the APIs and who will implement the APIs. | For example, if the CanIf module is referenced then the PDU Router module will implement the PduR_CanIfRxIndication API. And the PDUR module will call the CanIf_Transmit API. Other APIs are of course also covered. An upper module can also be an lower module (e.g. the IpduM module).
      boolean PduRRetransmission: set at pre-compile  # If set to true this means that the destination transport protocol module will use the retransmission feature. This parameter might be set to false if the retransmission feature is not used, even though the destination transport protocol is supporting it. | This parameter is only valid for transport protocol modules and gateway operations. If transmission from a local upper layer module this module will handle the retransmission.
      boolean PduRRxIndication: scope=ECU, set at pre-compile  # Specifies if BSW module supports the RxIndication API or not. Value true the API is supported.
      boolean PduRStartOfReception: scope=ECU, set at pre-compile  # Specifies if the Transport protocol module supports the StartOfReception API or not. Value true the API is supported.
      boolean PduRTpRxIndication: scope=ECU, set at pre-compile  # Specifies if the Transport protocol module supports the TpRxIndication API or not. Value true the API is supported.
      boolean PduRTpTransmit: scope=ECU, set at pre-compile  # Specifies if BSW module supports the TP Transmit API or not. Value true the API is supported.
      boolean PduRTpTxConfirmation: scope=ECU, set at pre-compile  # Specifies if the Transport protocol module supports the TpTxConfirmation API or not. Value true the API is supported.
      boolean PduRTransmit: scope=ECU, set at pre-compile  # Specifies if BSW module supports the (IF) Transmit API or not. Value true the API is supported.
      boolean PduRTransportProtocol: set at pre-compile  # The PDU Router module shall use the API parameters specified for transport protocol interface.
      boolean PduRTriggertransmit: set at pre-compile  # Specifies if the BSW module supports the TriggerTransmit API or not. Value true means that the BSW module supports the TriggerTransmit interface which a lower layer module can call and also that it can call the TriggerTransmit interface of an upper layer module. Value false means that the BSW module does not support the TriggerTransmit interface which a lower layer module can call and also that it shall not call the TriggerTransmit interface of an upper layer module.
      boolean PduRTxConfirmation: set at pre-compile  # Specifies if the BSW module supports the TxConfirmation API or not. Value true the API is supported.
      boolean PduRUpperModule: set at pre-compile  # The PduRUpperModule will decide who will call the APIs and who will implement the APIs. | For example, if the COM module is referenced then the PDU Router module will implement the PduR_Transmit API. And the PDUR module will call the Com_RxIndication API. Other APIs are of course also covered. An upper module can also be an lower module (e.g. the IpduM module).
      boolean PduRUseTag: set at pre-compile  # This parameter, if set to true, enables the usage of the tag (<up>) in the following API calls: | * PduR_<Up>CancelReceive * PduR_<Up>CancelTransmit Example: If used by COM and the parameter is enabled the PduR_ComCancelTransmit is used. The background is that upper layer modules differ in usage of this tag (e.g. COM is using the tag, DCM is not).
      foreign reference PduRBswModuleRef: set at pre-compile, destination-type=ECUC-MODULE-CONFIGURATION-VALUES  # This is a reference to one BSW module's configuration (i.e. not the ECUC parameter definition template). | Example, there could be several configurations of LinIf and this reference selects one of them.
    container PduRGeneral  # This container is a subcontainer of PduR and specifies the general configuration parameters of the PDU Router.
      boolean PduRDevErrorDetect: set at pre-compile, default-value=false  # Switches the development error detection and notification on or off. | * true: detection and notification is enabled. * false: detection and notification is disabled.
      boolean PduRMetaDataSupport [0..1]: multiplicity set at pre-compile, set at pre-compile, default-value=false  # Enable support for MetaData handling. The MetaData is defined by the referenced MetaDataType of the global PDU definitions. This feature may be used for efficient address based routing and generic CAN-CAN-routing, where the MetaData contains the CAN ID.
      boolean PduRVersionInfoApi: set at pre-compile, default-value=false  # If true the PduR_GetVersionInfo API is available.
      boolean PduRZeroCostOperation: set at pre-compile  # If set the PduR configuration generator will report an error if zero-cost-operation cannot be fulfilled. | This parameter shall be seen as an input requirement to the configuration generator.
    container PduRRoutingPaths  # Represents one table of routing paths. | This routing table allows multiple configurations that can be used to create several routing tables in the same configuration. This is mainly used for post-build (e.g. post-build selectable) but can be used by pre-compile and link-time for variant handling.
      integer PduRConfigurationId: 0..65535, post-build-variant-value=true, set at post-build in variant post-build / pre-compile in variant pre-compile  # Identification of the configuration of the PduR configuration. This identification can be read using the PduR API.
      integer PduRMaxRoutingPathCnt [0..1]: 0..65535, multiplicity set at pre-compile, set at pre-compile  # Maximum number of RoutingPaths in all RoutingTables. This parameter is needed only in case of post-build loadable implementation using static memory allocation.
      integer PduRMaxRoutingPathGroupCnt [0..1]: 0..65535, multiplicity set at pre-compile, set at pre-compile  # Maximum number of RoutingPathGroups. This parameter is needed only in case of post-build loadable implementation using static memory allocation.
      container PduRDestPdu [0..*]: multiplicity set at post-build in variant post-build / pre-compile in variant pre-compile, post-build-variant-multiplicity=true  # This container is a subcontainer of PduRRoutingPath and specifies one destination for the PDU to be routed.
        enumeration PduRDestPduDataProvision [0..1]: {PDUR_DIRECT, PDUR_TRIGGERTRANSMIT}, multiplicity set at post-build in variant post-build / pre-compile in variant pre-compile, post-build-variant-multiplicity=true, post-build-variant-value=true, set at post-build in variant post-build / pre-compile in variant pre-compile  # Specifies how data are provided: direct (as part of the Transmit call) or via | the TriggerTransmit callback function. Only required for non-TP gatewayed I-PDUs.
        integer PduRDestPduHandleId [0..1]: 0..65535, scope=ECU, multiplicity set at pre-compile, set at pre-compile, symbolic-name-value=true  # PDU identifier assigned by PDU Router. Used by communication interface and transport protocol modules for confirmation (PduR_<Lo>TxConfirmation) and for TriggerTransmit (PduR_<Lo>TriggerTransmit).
        boolean PduRTransmissionConfirmation: multiplicity set at pre-compile, set at pre-compile  # This parameter is only for communication interfaces. Transport protocol modules will always call the TxConfirmation function. | If set the destination communication interface module will call the TxConfirmation. However the TxConfirmation may be not called due to error. So the PduR shall not block until the TxConfirmation is called. One background for this parameter is for the PduR to know when all modules have confirmed a multicast operation.
        reference PduRDestPduRef: post-build-variant-value=true, set at post-build in variant post-build / pre-compile in variant pre-compile, destination=Pdu  # Destination PDU reference; reference to unique PDU identifier which shall be used by the PDU Router instead of the source PDU ID when calling the related function of the destination module.
      container PduRRoutingPath [0..*]: multiplicity set at post-build in variant post-build / pre-compile in variant pre-compile, post-build-variant-multiplicity=true  # This container is a subcontainer of PduRRoutingTable and specifies the routing path of a PDU.
        integer PduRQueueDepth [0..1]: 1..255, multiplicity set at post-build in variant post-build / pre-compile in variant pre-compile, post-build-variant-multiplicity=true, post-build-variant-value=true, set at post-build in variant post-build / pre-compile in variant pre-compile  # This parameter defines the queue depth for this routing path.
        integer PduRTpThreshold [0..1]: 0..65535, multiplicity set at post-build in variant post-build / pre-compile in variant pre-compile, post-build-variant-multiplicity=true, post-build-variant-value=true, set at post-build in variant post-build / pre-compile in variant pre-compile  # This parameter is only relevant for TP routings. | When configured, it enables on-the-fly routing and defines the number of bytes which must have been received before transmission on the destination bus may start. When omitted, direct TP routing is enforced. The PduRouter shall ensure that a buffer is allocated for this routing path which is at least as large as the threshold.
        reference PduRDestPduRRef: post-build-variant-value=true, set at post-build in variant post-build / pre-compile in variant pre-compile, destination=PduRDestPdu
        reference PduRDestTxBufferRef [0..*]: multiplicity set at post-build in variant post-build / pre-compile in variant pre-compile, post-build-variant-multiplicity=true, post-build-variant-value=true, set at post-build in variant post-build / pre-compile in variant pre-compile, destination=PduRTxBuffer  # Reference to a buffer in the PduR. This buffer is required for communication interface gatewaying, and for transport protocol gatewaying.
        reference PduRRoutingPathGroupRef [0..1]: post-build-variant-multiplicity=true, post-build-variant-value=true, set at post-build in variant post-build / pre-compile in variant pre-compile, destination=PduRRoutingPathGroup  # Reference to routing path destinations.
        reference PduRSrcPduRRef: post-build-variant-value=true, set at post-build in variant post-build / pre-compile in variant pre-compile, destination=PduRSrcPdu
        container PduRDefaultValue [0..1]  # Specifies the default value of the I-PDU. Only required for gateway operation and if at least one PDU specified by PduRDestPdu uses TriggerTransmit Data provision. | Represented as an array of IntegerParamDef.
          container PduRDefaultValueElement [0..*]: multiplicity set at post-build in variant post-build / pre-compile in variant pre-compile, post-build-variant-multiplicity=true  # Each value element is represented by the element and the position in an array.
            integer PduRDefaultValueElement: 0..255, post-build-variant-value=true, set at post-build in variant post-build / pre-compile in variant pre-compile  # The default value consists of a number of elements. Each element is one byte long and the number of elements is specified by SduLength. The position of this parameter in the container is specified by the PduRElementBytePosition parameter.
            integer PduRDefaultValueElementBytePosition: 0..4294967294, post-build-variant-value=true, set at post-build in variant post-build / pre-compile in variant pre-compile  # This parameter specifies the byte position of the element within the default value
      container PduRRoutingPathGroup [0..*]: multiplicity set at post-build in variant post-build / pre-compile in variant pre-compile, post-build-variant-multiplicity=true  # This container groups routing path destinations. Destinations are used instead of routing paths since a routing path can be 1:n. It is desirable to be able to enable/disable a specific bus (i.e. a destination) rather than a routing path. Of course it is possible to create groups that covers specific routing paths as well. | Enabling and disabling of routing path groups are made using the PduR API
        boolean PduRIsEnabledAtInit: post-build-variant-value=true, set at post-build in variant post-build / pre-compile in variant pre-compile  # If set to true this routing path group will be enabled after initializing the PDU Router module (i.e. enabled in the PduR_Init function).
        integer PduRRoutingPathGroupId: 0..65535, scope=ECU, set at pre-compile, symbolic-name-value=true  # Identification of the routing group. | The identification will be used by the disable/enable API in the PDU Router module API.
      container PduRSrcPdu [0..*]  # This container is a subcontainer of PduRRoutingPath and specifies the source of the PDU to be routed.
        integer PduRSourcePduBlockSize [0..1]: 1..4294967295, multiplicity set at post-build in variant post-build / pre-compile in variant pre-compile, post-build-variant-multiplicity=true, post-build-variant-value=true, set at post-build in variant post-build / pre-compile in variant pre-compile  # Minimum amount of buffer space required by receiving transport protocol layer to continue reception.
        integer PduRSourcePduHandleId: 0..65535, scope=ECU, set at pre-compile, symbolic-name-value=true  # PDU identifier assigned by PDU Router.
        boolean PduRSrcPduUpTxConf: scope=ECU, multiplicity set at post-build in variant post-build / pre-compile in variant pre-compile, post-build-variant-multiplicity=true, post-build-variant-value=true, set at post-build in variant post-build / pre-compile in variant pre-compile, default-value=true  # When enabled, the TxConfirmation will be | forwarded to the upper layer. Prerequisites: Lower layer and upper layer support TxConfirmation.
        reference PduRSrcPduRef: post-build-variant-value=true, set at post-build in variant post-build / pre-compile in variant pre-compile, destination=Pdu  # Source PDU reference; reference to unique PDU identifier which shall be used for the requested PDU Router operation.
      container PduRTxBuffer [0..*]: multiplicity set at pre-compile  # Specifies a buffer used for gatewaying via communication interfaces or transport protocols.
        integer PduRPduMaxLength: 1..4294967295, set at pre-compile  # Length of the Tx buffer in bytes. This parameter limits the size of buffered routed PDUs.
  module definition Port [0..1]: post-build-variant-support=true, variants post-build/pre-compile  # Configuration of the Port module.
    container PortConfigSet  # This container contains the configuration parameters and sub containers of the AUTOSAR Port module.
      container PortContainer [1..*]  # Container collecting the PortPins.
        integer PortNumberOfPortPins: 1..65535, set at pre-compile  # The number of specified PortPins in this PortContainer.
        container PortPin [1..*]  # Configuration of the individual port pins.
          enumeration PortPinDirection: {PORT_PIN_IN, PORT_PIN_OUT}, post-build-variant-value=true, set at post-build in variant post-build / pre-compile in variant pre-compile  # The initial direction of the pin (IN or OUT). If the direction is not changeable, the value configured here is fixed. | The direction must match the pin mode. E.g. a pin used for an ADC must be configured to be an in port. Implementation Type: Port_PinDirectionType
          boolean PortPinDirectionChangeable: post-build-variant-value=true, set at post-build in variant post-build / pre-compile in variant pre-compile  # Parameter to indicate if the direction is changeable on a port pin during runtime. | true: Port Pin direction changeable enabled. false: Port Pin direction changeable disabled.
          integer PortPinId: 1..65535, set at pre-compile, symbolic-name-value=true  # Pin Id of the port pin. This value will be assigned to the symbolic name derived from the port pin container short name.
          enumeration PortPinInitialMode: {PORT_PIN_MODE_ADC, PORT_PIN_MODE_CAN, PORT_PIN_MODE_DIO, PORT_PIN_MODE_DIO_GPT, PORT_PIN_MODE_DIO_WDG, PORT_PIN_MODE_FLEXRAY, PORT_PIN_MODE_ICU, PORT_PIN_MODE_LIN, PORT_PIN_MODE_MEM, PORT_PIN_MODE_PWM, PORT_PIN_MODE_SPI}, post-build-variant-value=true, set at post-build in variant post-build / pre-compile in variant pre-compile  # Port pin mode from mode list for use with Port_Init() function.
          enumeration PortPinLevelValue: {PORT_PIN_LEVEL_HIGH, PORT_PIN_LEVEL_LOW}, post-build-variant-value=true, set at post-build in variant post-build / pre-compile in variant pre-compile  # Port Pin Level value from Port pin list.
          enumeration PortPinMode [1..*]: {PORT_PIN_MODE_ADC, PORT_PIN_MODE_CAN, PORT_PIN_MODE_DIO, PORT_PIN_MODE_DIO_GPT, PORT_PIN_MODE_DIO_WDG, PORT_PIN_MODE_FLEXRAY, PORT_PIN_MODE_ICU, PORT_PIN_MODE_LIN, PORT_PIN_MODE_MEM, PORT_PIN_MODE_PWM, PORT_PIN_MODE_SPI}, multiplicity set at post-build in variant post-build / pre-compile in variant pre-compile, post-build-variant-multiplicity=true, post-build-variant-value=true, set at post-build in variant post-build / pre-compile in variant pre-compile  # Port pin mode from mode list. | Note that more than one mode is allowed by default. That way it is e.g. possible to combine DIO with another mode such as ICU.
          boolean PortPinModeChangeable: post-build-variant-value=true, set at post-build in variant post-build / pre-compile in variant pre-compile  # Parameter to indicate if the mode is changeable on a port pin during runtime. True: Port Pin mode changeable allowed. False: Port Pin mode changeable not permitted.
          reference PortPinEcucPartitionRef [0..*]: scope=ECU, multiplicity set at pre-compile, post-build-variant-multiplicity=true, post-build-variant-value=true, set at pre-compile, destination=EcucPartition  # Maps the Port pin to zero a multiple ECUC partitions. The ECUC partitions referenced are a subset of the ECUC partitions where the Port driver is mapped to.
    container PortGeneral  # Module wide configuration parameters of the PORT driver.
      boolean PortDevErrorDetect: set at pre-compile, default-value=false  # Switches the development error detection and notification on or off. | * true: detection and notification is enabled. * false: detection and notification is disabled.
      boolean PortSetPinDirectionApi: set at pre-compile  # Pre-processor switch to enable / disable the use of the function Port_SetPinDirection(). | TRUE: Enabled - Function Port_SetPinDirection() is available. FALSE: Disabled - Function Port_SetPinDirection() is not available.
      boolean PortSetPinModeApi: set at pre-compile  # Pre-processor switch to enable / disable the use of the function Port_SetPinMode(). | true: Enabled - Function Port_SetPinMode() is available. false: Disabled - Function Port_SetPinMode() is not available.
      boolean PortVersionInfoApi: set at pre-compile, default-value=false  # Pre-processor switch to enable / disable the API to read out the modules version information. | true: Version info API enabled. false: Version info API disabled.
      reference PortEcucPartitionRef [0..*]: scope=ECU, multiplicity set at pre-compile, post-build-variant-multiplicity=true, post-build-variant-value=true, set at pre-compile, destination=EcucPartition  # Maps the Port driver to zero a multiple ECUC partitions to make the modules API available in this partition.
  module definition Pwm [0..*]: post-build-variant-support=true, variants post-build/pre-compile  # Configuration of Pwm (Pulse Width Modulation) module.
    container PwmChannelConfigSet  # This container contains the configuration parameters and sub containers of the AUTOSAR Pwm module.
      container PwmChannel [1..*]  # Configuration of an individual PWM channel.
        enumeration PwmChannelClass [0..1]: {PWM_FIXED_PERIOD, PWM_FIXED_PERIOD_SHIFTED, PWM_VARIABLE_PERIOD}, multiplicity set at post-build in variant post-build / pre-compile in variant pre-compile, post-build-variant-multiplicity=true, post-build-variant-value=true, set at post-build in variant post-build / pre-compile in variant pre-compile  # Class of PWM Channel. | ImplementationType: Pwm_ChannelClassType
        integer PwmChannelId: 0..4294967295, set at pre-compile, symbolic-name-value=true  # Channel Id of the PWM channel. This value will be assigned to the symbolic name derived of the PwmChannel container short name.
        integer PwmDutycycleDefault: 0..32768, post-build-variant-value=true, set at post-build in variant post-build / pre-compile in variant pre-compile  # Value of duty cycle used for Initialization | 0, represents 0% 0x8000 represents 100%
        enumeration PwmIdleState: {PWM_HIGH, PWM_LOW}, post-build-variant-value=true, set at post-build in variant post-build / pre-compile in variant pre-compile  # The parameter PWM_IDLE_STATE represents the output state of the PWM after the signal is stopped (e.g. call of Pwm_SetOutputToIdle).
        function name PwmNotification [0..1]: multiplicity set at post-build in variant post-build / pre-compile in variant pre-compile, post-build-variant-multiplicity=true, post-build-variant-value=true, set at post-build in variant post-build / pre-compile in variant pre-compile, default-value="NULL"  # Definition of the Callback function.
        float PwmPeriodDefault: 0..INF, post-build-variant-value=true, set at post-build in variant post-build / pre-compile in variant pre-compile  # Value of period used for Initialization.(in seconds).
        enumeration PwmPolarity: {PWM_HIGH, PWM_LOW}, post-build-variant-value=true, set at post-build in variant post-build / pre-compile in variant pre-compile  # Defines the starting polarity of each PWM channel.
        reference PwmChannelEcucPartitionRef [0..*]: scope=ECU, multiplicity set at pre-compile, post-build-variant-multiplicity=true, post-build-variant-value=true, set at pre-compile, destination=EcucPartition  # Maps a PWM channel to zero or multiple ECUC partitions to limit the access to this channe. The ECUC partitions referenced are a subset of the ECUC partitions where the PWM driver is mapped to.
        reference PwmMcuClockReferencePoint: scope=ECU, post-build-variant-value=true, set at post-build in variant post-build / pre-compile in variant pre-compile, destination=McuClockReferencePoint  # This parameter contains reference to the McuClockReferencePoint
    container PwmConfigurationOfOptApiServices
      boolean PwmDeInitApi: set at pre-compile  # Adds / removes the service Pwm_DeInit() from the code.
      boolean PwmGetOutputState: set at pre-compile
      boolean PwmSetDutyCycle: set at pre-compile
      boolean PwmSetOutputToIdle: set at pre-compile
      boolean PwmSetPeriodAndDuty: set at pre-compile
      boolean PwmVersionInfoApi: set at pre-compile, default-value=false  # Switch to indicate that the Pwm_ GetVersionInfo is supported
    container PwmGeneral
      boolean PwmDevErrorDetect: set at pre-compile, default-value=false  # Switches the development error detection and notification on or off. | * true: detection and notification is enabled. * false: detection and notification is disabled.
      boolean PwmDutycycleUpdatedEndperiod: set at pre-compile  # Switch for enabling the update of the duty cycle parameter at the end of the current period. | TRUE: update of duty cycle is done at the end of period of currently generated waveform (current waveform is finished). FALSE: update of duty cycle is done immediately (just after service call, current waveform is cut).
      integer PwmIndex: 0..4294967295, set at pre-compile  # Specifies the InstanceId of this module instance. If only one instance is present it shall have the Id 0.
      boolean PwmLowPowerStatesSupport [0..1]: multiplicity set at pre-compile, set at pre-compile, default-value=false  # Adds / removes all power state management related APIs (PWM_SetPowerState, PWM_GetCurrentPowerState, PWM_GetTargetPowerState, PWM_PreparePowerState, PWM_Main_PowerTransitionManager), indicating if the HW offers low power state management.
      boolean PwmNotificationSupported: set at pre-compile  # Switch to indicate that the notifications are supported
      boolean PwmPeriodUpdatedEndperiod: set at pre-compile  # Switch for enabling the update of the period parameter at the end of the current period. | TRUE: update of period/duty cycle is done at the end of period of currently generated waveform (current waveform is finished). FALSE: update of period/duty cycle is done immediately (just after service call, current waveform is cut).
      boolean PwmPowerStateAsynchTransitionMode [0..1]: multiplicity set at pre-compile, set at pre-compile, default-value=false  # Enables / disables support of the PWM Driver to the asynchronous power state transition.
      reference PwmEcucPartitionRef [0..*]: scope=ECU, multiplicity set at pre-compile, post-build-variant-multiplicity=true, post-build-variant-value=true, set at pre-compile, destination=EcucPartition  # Maps the PWM driver to zero or multiple ECUC partitions to make the driver API available in the according partition.
      reference PwmKernelEcucPartitionRef [0..1]: scope=ECU, multiplicity set at pre-compile, post-build-variant-multiplicity=true, post-build-variant-value=true, set at pre-compile, destination=EcucPartition  # Maps the PWM kernel to zero or one ECUC partitions to assign the driver kernel to a certain core. The ECUC partition referenced is a subset of the ECUC partitions where the PWM driver is mapped to.
      container PwmPowerStateConfig [0..*]  # Each instance of this parameter defines a power state and the callback to be called when this power state is reached.
        integer PwmPowerState: 0..18446744073709551615, set at pre-compile, symbolic-name-value=true  # Each instance of this parameter describes a different power state supported by the PWM HW. It should be defined by the HW supplier and used by the PWMDriver to reference specific HW configurations which set the PWM HW module in the referenced power state. | At least the power mode corresponding to full power state shall be always configured.
        function name PwmPowerStateReadyCbkRef: set at pre-compile  # Each instance of this parameter contains a reference to a power mode callback defined in a CDD or IoHwAbs component.
  module definition RamTst [0..1]: variants link-time/pre-compile  # Configuration of the RamTst module.
    container RamTstCommon  # This container holds a list of all available functions in the RamTst module. Each function is turned ON or OFF before compiling so that only the desired functions and test algorithms are in the compiled code.
      boolean RamTstAllowApi: set at pre-compile  # Preprocessor switch to disable / enable the function "RamTst_Allow".
      boolean RamTstChangeNumOfTestedCellsApi: set at pre-compile  # Preprocessor switch to disable / enable the function "RamTst_ChangeNumberOfTestedCells".
      boolean RamTstDevErrorDetect: set at pre-compile, default-value=false  # Switches the development error detection and notification on or off. | * true: detection and notification is enabled. * false: detection and notification is disabled.
      boolean RamTstGetAlgParamsApi: set at pre-compile  # Preprocessor switch to disable / enable the function "RamTst_GetAlgParams".
      boolean RamTstGetExecutionStatusApi: set at pre-compile  # Preprocessor switch to disable / enable the function | "RamTst_GetExecutionStatus"
      boolean RamTstGetNumberOfTestedCellsApi: set at pre-compile  # Preprocessor switch to disable / enable the function "RamTst_GetNumberOfTestedCells".
      boolean RamTstGetTestAlgorithmApi: set at pre-compile  # Preprocessor switch to disable / enable the function | "RamTst_GetTestAlgorithm"
      boolean RamTstGetTestResultApi: set at pre-compile  # Preprocessor switch to disable / enable the function | "RamTst_GetTestResult"
      boolean RamTstGetTestResultPerBlockApi: set at pre-compile  # Preprocessor switch to disable / enable the function | "RamTst_GetTestResultPerBlock"
      boolean RamTstResumeApi: set at pre-compile  # Preprocessor switch to disable / enable the function "RamTst_Resume".
      boolean RamTstRunFullTestApi: set at pre-compile  # Preprocessor switch to disable / enable the function | "RamTst_RunFullTest"
      boolean RamTstRunPartialTestApi: set at pre-compile  # Preprocessor switch to disable / enable the function | "RamTst_RunPartialTest"
      boolean RamTstSelectAlgParamsApi: set at pre-compile  # Preprocessor switch to disable / enable the function "RamTst_SelectAlgParams".
      boolean RamTstStopApi: set at pre-compile  # Preprocessor switch to disable / enable the function | "RamTst_Stop"
      boolean RamTstSuspendApi: set at pre-compile  # Preprocessor switch to disable / enable the function "RamTst_Suspend".
      boolean RamTstVersionInfoApi: set at pre-compile, default-value=false  # Preprocessor switch to disable / enable the function | "RamTst_GetVersionInfo"
      reference RamTstEcucPartitionRef [0..*]: scope=ECU, multiplicity set at pre-compile, set at pre-compile, destination=EcucPartition  # Maps the RAM test to zero or multiple ECUC partitions to make the modules API available in this partition. The RAM test will operate as an independent instance in each of the partitions.
      container RamTstAlgorithms  # This container holds all of the available test algorithms for the specific microcontroller. Each test algorithm is selected ON or OFF before compiling so that only the desired test algorithms are in the compiled code.
        boolean RamTstAbrahamTestSelected: set at pre-compile  # Preprocessor switch to select the Abraham Test ON or OFF
        boolean RamTstCheckerboardTestSelected: set at pre-compile  # Preprocessor switch to select the Checkerboard Test ON or OFF
        boolean RamTstGalpatTestSelected: set at pre-compile  # Preprocessor switch to select the Galpat Test ON or OFF
        boolean RamTstMarchTestSelected: set at pre-compile  # Preprocessor switch to select the March Test ON or OFF
        boolean RamTstTranspGalpatTestSelected: set at pre-compile  # Preprocessor switch to select the Transparent Galpat Test ON or OFF
        boolean RamTstWalkPathTestSelected: set at pre-compile  # Preprocessor switch to select the Walking Path Test ON or OFF
      container RamTstConfigParams  # This container specifies configuration parameters which are set at pre-compile or link time.
        integer RamTstDefaultAlgParamsId: 1..255, set at link in variant link-time / pre-compile in variant pre-compile  # This is the identifier for the default "RamTstAlgParams" valid after the "RamTst_Init(..)" function. It is the initial value for a RAM variable which could be changed by the function "RamTst_SelectAlgParams".
        integer RamTstMinNumberOfTestedCells: 1..4294967295, set at link in variant link-time / pre-compile in variant pre-compile  # Minimum number of tested cells for one cycle of a background test, as defined by implementer.
        integer RamTstNumberOfAlgParamSets: 1..255, set at link in variant link-time / pre-compile in variant pre-compile  # Number of configured parameter sets for the available test algorithms. | calculationFormula = count of the container RamTst_AlgParams
        function name RamTstTestCompletedNotification: set at link in variant link-time / pre-compile in variant pre-compile  # This function will be called from a background test after finishing the RAM test without an error.
        function name RamTstTestErrorNotification: set at link in variant link-time / pre-compile in variant pre-compile  # This function will be called from a background test if an error occurs during the RAM test.
        container RamTstAlgParams [1..255]  # This container holds parameters for configuring an algorithm. For each algorithm selected in the RamTst_Algorithms container there can be one or more RamTstAlgParams containers. The multiplicity of the included container RamTstBlockParams depends on the number of separate blocks of RAM which are defined for the particular test configuration.
          enumeration RamTstAlgorithm: {RAMTST_ABRAHAM_TEST, RAMTST_CHECKERBOARD_TEST, RAMTST_GALPAT_TEST, RAMTST_MARCH_TEST, RAMTST_TRANSP_GALPAT_TEST, RAMTST_WALK_PATH_TEST}, set at link in variant link-time / pre-compile in variant pre-compile  # This is the algorithm for which this RamTstAlgParams set is defined. Note that the same algorithm can be used in more than one RamTstAlgParams. | Constraint: Only the algorithms selected by RamTstCommon/ RamTstAlgorithms can be used.
          integer RamTstAlgParamsId: 1..255, set at link in variant link-time / pre-compile in variant pre-compile  # This is the identifier by which this RamTstAlgParams set can be selected.
          integer RamTstExtNumberOfTestedCells: 1..4294967295, set at link in variant link-time / pre-compile in variant pre-compile  # This is the absolute maximum value for the number of cells that NUMBER_OF_TESTED_CELLS and MAX_NUMBER_OF_TESTED_CELLS can be.
          integer RamTstMaxNumberOfTestedCells: 1..4294967295, set at link in variant link-time / pre-compile in variant pre-compile  # This is the maximum value for the number of cells that can be tested in one cycle of a background test.
          integer RamTstNumberOfBlocks: 1..65535, set at link in variant link-time / pre-compile in variant pre-compile  # Number of RAM blocks configured using the container | "RamTst_BlockParams" calculationFormula = Count of RamTstBlockParams contained in this RamTstAlgParams.
          integer RamTstNumberOfTestedCells: 1..4294967295, set at link in variant link-time / pre-compile in variant pre-compile  # This is the initial value for a RAM variable, which can be changed by the function "RamTst_ChangeNumberOfTestedCells"
          reference RamTstBlockParamsEcucPartitionRef [0..1]: scope=ECU, multiplicity set at pre-compile, set at pre-compile, destination=EcucPartition  # Maps the RAM test block parameter configuration of an individual RAM block to zero or one ECUC partitions. The ECUC partition referenced is a subset of the ECUC partitions where the RamTst driver is mapped to. The according test shall run in the referenced ECUC partition.
          container RamTstBlockParams [1..65535]  # This container holds the description for one block of RAM. For each RAM block to be tested by a given algorithm, there is one container which describes the block. Multiple instances of this container are included in each container RamTst_AlgParams.
            integer RamTstBlockId: 1..65535, set at link in variant link-time / pre-compile in variant pre-compile  # ID of the RAM block
            integer RamTstEndAddress: 1..4294967295, set at link in variant link-time / pre-compile in variant pre-compile  # End Address of the RAM block. | Constraint: It must be larger than the RamTstStartAddress.
            integer RamTstFillPattern: 0..4294967295, set at link in variant link-time / pre-compile in variant pre-compile  # Pattern to be filled into each memory cell after destructive test of this block.
            integer RamTstStartAddress: 0..4294967295, set at link in variant link-time / pre-compile in variant pre-compile  # Start Address of the RAM block. | Constraint: It must be smaller than the RamTstEndAddress.
            enumeration RamTstTestPolicy: {RAMTEST_DESTRUCTIVE, RAMTEST_NON_DESTRUCTIVE}, set at link in variant link-time / pre-compile in variant pre-compile  # Policy regarding destruction or non-destruction of memory content.
    container RamTstDemEventParameterRefs [0..1]  # Container for the references to DemEventParameter elements which shall be invoked using the API Dem_SetEventStatus in case the corresponding error occurs. The EventId is taken from the referenced DemEventParameter's DemEventId symbolic value. The standardized errors are provided in this container and can be extended by vendor-specific error references.
      reference RAMTST_MAIN_RAM_FAILURE [0..1]: multiplicity set at pre-compile, set at pre-compile, requires-symbolic-name-value=true, destination=DemEventParameter  # Reference to the DemEventParameter which shall be issued when the error "RAM main test failure" has occurred.
      reference RAMTST_PART_RAM_FAILURE [0..1]: multiplicity set at pre-compile, set at pre-compile, requires-symbolic-name-value=true, destination=DemEventParameter  # Reference to the DemEventParameter which shall be issued when the error "RAM partial test failure" has occurred.
      reference RAMTST_RUNFL_RAM_FAILURE [0..1]: multiplicity set at pre-compile, set at pre-compile, requires-symbolic-name-value=true, destination=DemEventParameter  # Reference to the DemEventParameter which shall be issued when the error "RAM full test failure" has occurred.
    container RamTstPublishedInformation  # Container holding all RamTst specific published information parameter.
      integer RamTstCellSize: 1..64, set at published-information  # Size of RAM cells (in bits) which can be tested individually by the given implementation.
  module definition Rte [0..1]: post-build-variant-support=true, variants post-build/pre-compile  # Configuration of the Rte (Runtime Environment) module.
    container RteBswGeneral  # General configuration parameters of the Bsw Scheduler section.
      boolean RteSchMVersionInfoApi: set at pre-compile, default-value=false  # Enables the generation of the SchM_GetVersionInfo() API.
    container RteBswModuleInstance [0..*]  # Represents one instance of a Bsw-Module configured on one ECU.
      foreign reference RteBswImplementationRef: set at pre-compile, destination-type=BSW-IMPLEMENTATION  # Reference to the BswImplementation for which the Rte /SchM is configured.
      foreign reference RteBswModuleConfigurationRef [0..1]: multiplicity set at pre-compile, set at pre-compile, destination-type=ECUC-MODULE-CONFIGURATION-VALUES  # Reference to the ECU Configuration Values provided for this BswImplementation.
      container RteBswEventToIsrMapping [0..*]  # Maps a BswModuleEntity onto an OsIsr based on the activating BswExternalTriggerOccurredEvent.
        integer RteBswPositionInIsr: 0..65535, set at pre-compile  # Each BswSchedulableEntity activation mapped to an OsIsr has a specific position within the ISR2 execution.
        foreign reference RteBswIsrEventRef: set at pre-compile, destination-type=BSW-EVENT  # Reference to the BswExternalTriggerOccurredEvent or BswTimingEvent.
        reference RteBswMappedToIsrRef: set at pre-compile, destination=OsIsr  # Reference to the OsISR the BswSchedulableEntity activated by the RteBswEventRef is mapped to.
        uri reference RteBswRipsFillRoutineRef [0..*]: multiplicity set at pre-compile, requires-index=true, set at pre-compile, destination-uri=RteRipsPluginFillFlushRoutine  # Reference to a Buffer-Fill Routine implemented by an RTE Implementation Plug-In. This routine gets invoked directly before the ExecutableEntity is started.
        uri reference RteBswRipsFlushRoutineRef [0..*]: multiplicity set at pre-compile, requires-index=true, set at pre-compile, destination-uri=RteRipsPluginFillFlushRoutine  # Reference to a Buffer-Flush Routine implemented by an RTE Implementation Plug-In. This routine gets invoked directly after the ExecutableEntity has terminated.
      container RteBswEventToTaskMapping [0..*]  # Maps a BswModuleEntity onto an OsTask based on the activating BswEvent. A BswModuleEntity can be activated by more than one BswEvent and thus be mapped to more than one OsTask. In the case of a BswSchedulableEntity executed via a direct or trusted function call this RteBswEventToTaskMapping is still specified but no RteBswMappedToTaskRef element is included. The RteBswPositionInTask parameter is necessary to provide an ordering of events invoked by the same RTE API.
        float RteBswActivationOffset [0..1]: 0..INF, multiplicity set at pre-compile, set at pre-compile  # Activation offset in seconds.
        boolean RteBswImmediateRestart: set at pre-compile, default-value=false  # When RteBswImmediateRestart is set to true the BswSchedulableEntitiy shall be immediately re-started after termination if it was activated by this BswEvent while it was already started. | This parameter shall not be set to true when the mapped BswEvent refers to a BswSchedulableEntitiy which minimumStartInterval attribute is > 0.
        integer RteBswPositionInTask [0..1]: 0..65535, multiplicity set at pre-compile, set at pre-compile  # Each BswSchedulableEntity activation mapped to an OsTask has a specific position within the task execution. | For periodic activation this is the order of execution. For event driver activation this is the order of evaluation which actual BswSchedulableEntity has to be executed. In case of direct or trusted function calls this parameter is necessary to provide an ordering of events when several ExecutableEntities are invoked by the same RTE API.
        integer RteBswServerQueueLength [0..1]: 0..65535, multiplicity set at pre-compile, set at pre-compile  # Specifies the length of the queue for the server call serialization.
        enumeration RteOsSchedulePoint [0..1]: {CONDITIONAL, NONE, UNCONDITIONAL}, multiplicity set at pre-compile, set at pre-compile  # Introduce a schedule point by explicitly calling Os Schedule service after the execution of the ExecutableEntity. The Rte generator is allowed to optimize several consecutive calls to Os schedule into one single call if the ExecutableEntity executions in between have been skipped. | The absence of this parameter is interpreted as "NONE". It shall be considered an invalid configuration if the task is preemptable and the value of this parameter is not set to "NONE" or the parameter is absent.
        reference RteBswEventPredecessorSyncPointRef [0..1]: multiplicity set at pre-compile, set at pre-compile, destination=RteSyncPoint  # The RteBswEventPredecessorSyncPointRef is necessary to provide a cross core synchronization in case of BswEvents triggered by the same event source but mapped to tasks belonging to different partitions on different cores. | The synchronization point must be reached by all referencing BswEvents before the execution in all related tasks is continued. In case of RteBswEventPredecessorSyncPointRef the BswModuleEntity activated by the mapped BswEvent is executed after the synchronization point is passed.
        foreign reference RteBswEventRef [1..*]: set at pre-compile, destination-type=BSW-EVENT  # Reference to the BswEvent.
        reference RteBswEventSuccessorSyncPointRef [0..1]: multiplicity set at pre-compile, set at pre-compile, destination=RteSyncPoint  # The RteBswEventSuccessorSyncPointRef is necessary to provide a cross core synchronization in case of BswEvents triggered by the same event source but mapped to tasks belonging to different partitions on different cores. | The synchronization point must be reached by all referencing BswEvents before the execution in all related tasks is continued. In case of RteBswEventSuccessorSyncPointRef the BswModuleEntity activated by the mapped BswEvent is executed before the synchronization point is entered.
        reference RteBswMappedToTaskRef [0..1]: multiplicity set at pre-compile, set at pre-compile, destination=OsTask  # Reference to the OsTask the BswSchedulableEntity activated by the RteBswEventRef is mapped to. | If no reference to the OsTask is specified the BswSchedulableEntity activated by this BswEvent is executed in the context of the caller.
        reference RteBswUsedOsAlarmRef [0..1]: multiplicity set at pre-compile, set at pre-compile, destination=OsAlarm  # If an OsAlarm is used to activate the OsTask this BswEvent is mapped to it shall be referenced here.
        reference RteBswUsedOsEventRef [0..1]: multiplicity set at pre-compile, set at pre-compile, destination=OsEvent  # If an OsEvent is used to activate the OsTask this BswEvent is mapped to it shall be referenced here.
        reference RteBswUsedOsSchTblExpiryPointRef [0..1]: multiplicity set at pre-compile, set at pre-compile, destination=OsScheduleTableExpiryPoint  # If an OsScheduleTableExpiryPoint is used to activate the OsTask this BswEvent is mapped to it shall be referenced here.
        uri reference RteRipsFillRoutineRef [0..*]: multiplicity set at pre-compile, requires-index=true, set at pre-compile, destination-uri=RteRipsPluginFillFlushRoutine  # Reference to a Buffer-Fill Routine implemented by an RTE Implementation Plug-In. | This routine gets invoked directly before the ExecutableEntity is started.
        uri reference RteRipsFlushRoutineRef [0..*]: multiplicity set at pre-compile, requires-index=true, set at pre-compile, destination-uri=RteRipsPluginFillFlushRoutine  # Reference to a Buffer-Flush Routine implemented by an RTE Implementation Plug-In. | This routine gets invoked directly after the ExecutableEntity has terminated.
      container RteBswExclusiveAreaImpl [0..*]  # Represents one ExclusiveArea of one BswImplementation. Used to specify the implementation means of this ExclusiveArea.
        enumeration RteExclusiveAreaImplMechanism: {ALL_INTERRUPT_BLOCKING, NONE, OS_INTERRUPT_BLOCKING, OS_RESOURCE, OS_SPINLOCK, RTE_PLUGIN}, set at pre-compile  # To be used implementation mechanism for the specified ExclusiveArea.
        reference RteBswExclusiveAreaOsResourceRef [0..1]: multiplicity set at pre-compile, set at pre-compile, destination=OsResource  # Optional reference to an OsResource in case RteExclusiveAreaImplMechanism is configured to OS_RESOURCE for this ExclusiveArea.
        reference RteBswExclusiveAreaOsSpinlockRef [0..1]: multiplicity set at pre-compile, set at pre-compile, destination=OsSpinlock  # Optional reference to an OsSpinlock in case RteExclusiveAreaImplMechanism is configured to OS_SPINLOCK for this ExclusiveArea.
        foreign reference RteBswExclusiveAreaRef: set at pre-compile, destination-type=EXCLUSIVE-AREA  # Reference to the ExclusiveArea for which the implementation mechanism shall be specified.
        uri reference RteBswExclusiveAreaResponsibleRipsPluginRef [0..1]: multiplicity set at pre-compile, set at pre-compile, destination-uri=RteRipsPlugin  # Optional reference to the configuration container of the RTE Implementation Plug-in implementing the ExclusiveArea. | It's required in case RteExclusiveAreaImplMechanism is configured to RTE_PLUGIN for this ExclusiveArea.
      container RteBswExternalTriggerConfig [0..*]  # Defines the configuration of Inter Basic Software Module Entity Triggering
        integer RteBswTriggerSourceQueueLength: 0..4294967295, set at pre-compile, default-value=0  # Length of trigger queue on the trigger source side. | The queue is implemented by the RTE. A value greater or equal to 1 requests an queued behavior. Setting the value of RteTriggerSourceQueueLength to 0 requests an none queued implementation of the trigger communication. If there is no RteBswTriggerSourceQueueLength configured for a Trigger Emitter the default value of 0 applies as well.
        foreign reference RteBswTriggerSourceRef: set at pre-compile, destination-type=TRIGGER  # Reference to a Trigger instance in the role releasedTrigger of the related BSW Module instance. | The referenced Trigger has to belong to the same BSW Module instance as the RteBswModuleInstance owning this parameter configures.
      container RteBswInternalTriggerConfig [0..*]  # Defines the configuration of internal Basic Software Module Entity Triggering
        integer RteBswTriggerSourceQueueLength: 0..4294967295, set at pre-compile, default-value=0  # Length of trigger queue on the trigger source side. | The queue is implemented by the RTE. A value greater or equal to 1 requests an queued behavior. Setting the value of RteTriggerSourceQueueLength to 0 requests an none queued implementation of the trigger communication. If there is no RteBswTriggerSourceQueueLength configured for a Trigger Emitter the default value of 0 applies as well.
        foreign reference RteBswTriggerSourceRef: set at pre-compile, destination-type=BSW-INTERNAL-TRIGGERING-POINT  # Reference to a BswInternalTriggeringPoint of the related BSW Module instance. | The referenced BswInternalTriggeringPoint has to belong to the same BSW Module instance as the RteBswModuleInstance owning this parameter configures.
      container RteBswModeMachineInstanceConfig [0..*]  # Defines the configuration of Basic Software Scheduler assigned ( SWS_Rte_07534) mode machine instances.
        integer RteBswModeMachineQueueLength: 0..4294967295, set at pre-compile, default-value=1  # Length of mode machine instance queue on the trigger source side. | If there is no RteBswModeMachineQueueLength configured for a mode machine instance the value given in the BswModeSenderPolicy.queueLength applies.
        foreign reference RteBswModeManagerRef: set at pre-compile, destination-type=MODE-DECLARATION-GROUP-PROTOTYPE  # Reference to a ModeDeclarationGroupPrototype of the related BSW Module instance. | The referenced ModeDeclarationGroupPrototype has to belong to the same BSW Module instance as the RteBswModuleInstance owning this parameter configures.
        uri reference RteModeMachineInstanceResponsibleRipsPluginRef [0..1]: multiplicity set at pre-compile, set at pre-compile, destination-uri=RteRipsPlugin  # Optional reference to the configuration container of the RTE Implementation Plug-in implementing the protection of the mode machine instance.
      container RteBswRequiredClientServerConnection [0..*]  # Defines the connection between one requiredClientServerEntry and one providedClientServerEntry of a BswModuleDescription. This container shall be provided on the client side of the connection.
        reference RteBswProvidedClientServerEntryModInstRef: set at pre-compile, destination=RteBswModuleInstance  # Reference to the RteBswModuleInstance configuration container which identifies the instance of the BSW Module. | Used with the RteBswProvidedClientServerEntryRef to unambiguously identify the BswModuleClientServerEntry instance.
        foreign reference RteBswProvidedClientServerEntryRef: set at pre-compile, destination-type=BSW-MODULE-CLIENT-SERVER-ENTRY  # Reference the providedClientServerEntry for this connection.
        foreign reference RteBswRequiredClientServerEntryRef: set at pre-compile, destination-type=BSW-MODULE-CLIENT-SERVER-ENTRY  # Reference the requiredClientServerEntry for this connection.
      container RteBswRequiredModeGroupConnection [0..*]  # Defines the connection between one requiredModeGroup of this BSW Module instance and one providedModeGroup instance.
        foreign reference RteBswProvidedModeGroupRef: set at pre-compile, destination-type=MODE-DECLARATION-GROUP-PROTOTYPE  # References the providedModeGroupPrototype to which this requiredModeGroup shall be connected.
        reference RteBswProvidedModeGrpModInstRef: set at pre-compile, destination=RteBswModuleInstance  # Reference to the RteBswModuleInstance configuration container which identifies the instance of the BSW Module. | Used with the RteBswProvidedModeGroupRef to unambiguously identify the ModeDeclarationGroupPrototype instance.
        foreign reference RteBswRequiredModeGroupRef: set at pre-compile, destination-type=MODE-DECLARATION-GROUP-PROTOTYPE  # References requiredModeGroupPrototype which shall be connected to the providedModeGroupPrototype.
        foreign reference RteModeDeclarationMappingSetRef [0..1]: multiplicity set at pre-compile, set at pre-compile, destination-type=MODE-DECLARATION-MAPPING-SET  # This defines the effective ModeDeclarationMappingSet in the case that the provided ModeDeclarationGroupPrototype and the required ModeDeclarationGroupPrototype are not compatible.
      container RteBswRequiredSenderReceiverConnection [0..*]  # Defines the connection between one requiredData and one providedData of a BswModuleDescription. This container shall be provided on the receiver side of the connection.
        reference RteBswProvidedDataModInstRef: set at pre-compile, destination=RteBswModuleInstance  # Reference to the RteBswModuleInstance configuration container which identifies the instance of the BSW Module. | Used with the RteBswProvidedVariableDataPrototypeRef to unambiguously identify the VariableDataPrototype instance.
        foreign reference RteBswProvidedVariableDataPrototypeRef: set at pre-compile, destination-type=VARIABLE-DATA-PROTOTYPE  # Reference the providedData for this connection.
        foreign reference RteBswRequiredVariableDataPrototypeRef: set at pre-compile, destination-type=VARIABLE-DATA-PROTOTYPE  # Reference the requiredData for this connection.
      container RteBswRequiredTriggerConnection [0..*]  # Defines the connection between one requiredTrigger of this BSW Module instance and one releasedTrigger instance.
        reference RteBswReleasedTriggerModInstRef: set at pre-compile, destination=RteBswModuleInstance  # Reference to the RteBswModuleInstance configuration container which identifies the instance of the BSW Module. | Used with the RteBswReleasedTriggerRef to unambiguously identify the Trigger instance.
        foreign reference RteBswReleasedTriggerRef: set at pre-compile, destination-type=TRIGGER  # References the releasedTrigger to which this requiredTrigger shall be connected.
        foreign reference RteBswRequiredTriggerRef: set at pre-compile, destination-type=TRIGGER  # References one requiredTrigger which shall be connected to the releasedTrigger.
    container RteDistributedSharedModeQueue [0..*]  # This container holds the configuration of a distributed shared mode queue.
      choice reference RteDSMQModeMachineInstanceRef [1..*]: multiplicity set at pre-compile, set at pre-compile, destination=[RteBswModeMachineInstanceConfig, RteModeMachineInstanceConfig]  # Reference to the mode machine instances which participate in this distributed shared mode queue.
      reference RteDSMQOsTaskRef [1..*]: multiplicity set at pre-compile, set at pre-compile, destination=OsTask  # Reference to the DSMQ transition OsTasks which are used to exclusively schedule on-entry ExecutableEntitys, on-transition ExecutableEntitys, on-exit ExecutableEntitys, and ModeSwitchAck ExecutableEntity activated by mode machine instances of this distributed shared mode queue.
      uri reference RteDSMQResponsibleRipsPluginRef [0..1]: multiplicity set at pre-compile, set at pre-compile, destination-uri=RteRipsPlugin  # Optional reference to the configuration container of the RTE Implementation Plug-in implementing the protection of all mode machine instances assigned to this distributed shared mode queue.
    container RteExclusiveAccessOptimization [0..*]  # Configuration of the optimized access behavior to be generated. In other words, access shall be mutually exclusive. How this is realized e.g. non preemptive task mapping, exclusive areas, mode management, exclusive access during ECU startup and shutdown or scheduling in exclusive time slots is up to the ECU integrator. Tags: atp.Status=draft
      foreign reference RteAccessingEntityRef [0..*]  # Reference to executable entities (e.g. NvM main function) that access the CommunicationGraph with non-modeled standardized interfaces. Tags: atp.Status=draft
      instance reference RteSoftwareComponentReadRef [0..1]: destination-context=ROOT-SW-COMPOSITION-PROTOTYPE SW-COMPONENT-PROTOTYPE, destination-type=VARIABLE-ACCESS  # Reference to the read variableAccess role. Tags: atp.Status=draft
      instance reference RteSoftwareComponentWriteRef [0..1]: destination-context=ROOT-SW-COMPOSITION-PROTOTYPE SW-COMPONENT-PROTOTYPE, destination-type=VARIABLE-ACCESS  # Reference to the VariableAccess in the dataSendPoint role of the writing software-component. Tags: atp.Status=draft
    container RteGeneration  # This container holds the parameters for the configuration of the RTE Generation.
      enumeration RteBypassSupport: {COMPONENT_WRAPPER, EXTENDED_BUFFER_ACCESS, NONE}, set at pre-compile, default-value=NONE  # General switch to enable and select the bypass support method.
      enumeration RteCalibrationSupport: {DOUBLE_POINTERED, INITIALIZED_RAM, NONE, SINGLE_POINTERED}, set at pre-compile, default-value=NONE  # The RTE generator shall have the option to switch off support for calibration for generated RTE code. This option shall influence complete RTE code at once.
      integer RteCodeVendorId: 0..65535, set at pre-compile  # Holds the vendor ID of the generated Rte code.
      boolean RteDevErrorDetect: set at pre-compile, default-value=false  # Switches the development error detection and notification on or off. | * true: detection and notification is enabled. * false: detection and notification is disabled.
      boolean RteDevErrorDetectUninit: set at pre-compile, default-value=false  # The Rte shall detect if it is started when its APIs are called, and the BSW Scheduler shall check if it is initialized when its APIs are called.
      enumeration RteGenerationMode: {COMPATIBILITY_MODE, VENDOR_MODE}, set at pre-compile, default-value=COMPATIBILITY_MODE  # Switch between the two available generation modes of the RTE generator.
      boolean RteInExclusiveAreaCheckEnabled: set at pre-compile, default-value=true  # Enables the check for RTE_E_IN_EXCLUSIVE_AREA (for blocking APIs).
      boolean RteMeasurementSupport: set at pre-compile, default-value=false  # The RTE generator shall have the option to switch off support for measurement for generated RTE code. This option shall influence complete RTE code at once.
      enumeration RteOptimizationMode: {MEMORY, RUNTIME}, set at pre-compile, default-value=RUNTIME  # Switch between the two available optimization modes of the RTE generator.
      integer RteToolChainSignificantCharacters [0..1]: 0..65535, multiplicity set at pre-compile, set at pre-compile, default-value=31  # If present, the RTE generator shall provide the list of C RTE identifiers whose name is not unique when only the first RteToolChainSignificantCharacters characters are considered.
      boolean RteValueRangeCheckEnabled: set at pre-compile, default-value=false  # If set to true the RTE generator shall enable the value range checking for the specified VariableDataPrototypes.
      boolean RteVfbTraceAnonymousClientEnabled: set at pre-compile, default-value=false  # The RTE generator shall globally enable VFB trace functions without client prefix when RteVfbTraceAnonymousClientEnabled is set to "true".
      boolean RteVfbTraceEnabled: set at pre-compile, default-value=false  # The RTE generator shall globally enable VFB tracing when RteVfbTrace is set to "true".
      container RteVfbTraceClient [0..*]: multiplicity set at pre-compile  # The RTE shall add the VFB Trace client with the ShortName of this container as the client's prefix.
        function name RteVfbTraceFunction [0..*]: multiplicity set at pre-compile, set at pre-compile  # The RTE generator shall enable VFB tracing for a given hook function when its name starts with the string configured here. | Example: If Rte_Dbg_WriteHook_i2 is configured, Rte_Dbg_WriteHook_i1_p1_a_Start will be enabled.
    container RteImplicitCommunication [0..*]  # Configuration of the Implicit Communication behavior to be generated.
      boolean RteCoherentAccess: set at pre-compile, default-value=false  # If set to true the referenced VariableAccess'es of this RteImplicitCommunication container are in one CoherencyGroup. | Data values for Coherent Implicit Read Access'es are read before the first reading RunnbaleEntity starts and are stable during the execution of all the reading RunnableEntitys; except Coherent Implicit Write Access'es belongs to the same Coherency Group. Data values written by Coherent Implicit Write Access'es are available for readers not belonging to the Coherency Group after the last writing RunnableEntity has terminated. Please note that a Coherent Implicit Data Access can be defined for VariableAccess'es to same and different data element. Nevertheless all Coherent Implicit Data Access'es of one Coherency Group have to be executed in the same task.
      boolean RteImmediateBufferUpdate: set at pre-compile, default-value=false  # If set to true the RTE will perform preemption area specific buffer update immediately before (for VariableAccess in the role dataReadAccess) resp. after (for VariableAccess in the role dataWriteAccess) Runnable execution.
      instance reference RteSoftwareComponentInstanceRef [1..*]: multiplicity set at pre-compile, set at pre-compile, destination-context=ROOT-SW-COMPOSITION-PROTOTYPE, destination-type=SW-COMPONENT-PROTOTYPE  # Reference to a SwComponentPrototype. | This denotes the instances of the VariableAccess belonging to the RteImplicitCommunication.
      foreign reference RteVariableReadAccessRef [0..*]: multiplicity set at pre-compile, set at pre-compile, destination-type=VARIABLE-ACCESS  # Reference to the VariableAccess in the dataReadAccess role.
      foreign reference RteVariableWriteAccessRef [0..*]: multiplicity set at pre-compile, set at pre-compile, destination-type=VARIABLE-ACCESS  # Reference to the VariableAccess in the dataWriteAccess role.
    container RteInitializationBehavior [1..*]  # Specifies the initialization strategy for variables allocated by RTE with the purpose to implement VariableDataPrototypes. | The container defines a set of RteSectionInitializationPolicys and one RteInitializationStrategy which is applicable for this set.
      enumeration RteInitializationStrategy: {RTE_INITIALIZATION_STRATEGY_AT_DATA_DECLARATION, RTE_INITIALIZATION_STRATEGY_AT_DATA_DECLARATION_AND_PARTITION_RESTART, RTE_INITIALIZATION_STRATEGY_AT_RTE_START_AND_PARTITION_RESTART, RTE_INITIALIZATION_STRATEGY_NONE}, set at pre-compile  # Definition of the initialization strategy applicable for the SectionInitializationPolicys selected by RteSectionInitializationPolicy.
      string RteSectionInitializationPolicy [1..*]: multiplicity set at pre-compile, set at pre-compile  # This parameter describes the SectionInitializationPolicys for which a particular RTE initialization strategy applies. | The SectionInitializationPolicy describes the intended initialization of MemorySections. The following values are standardized in AUTOSAR Methodology: * '''NO-INIT''': No initialization and no clearing is performed. Such data elements must not be read before one has written a value into it. * '''INIT''': To be used for data that are initialized by every reset to the specified value (initValue). * '''POWER-ON-INIT''': To be used for data that are initialized by "Power On" to the specified value (initValue). Note: there might be several resets between power on resets. * '''CLEARED''': To be used for data that are initialized by every reset to zero. * '''POWER-ON-CLEARED''': To be used for data that are initialized by "Power On" to zero. Note: there might be several resets between power on resets.
    container RteInitializationRunnableBatch [0..*]  # This container corresponds to an Rte_Init_<shortName of this container> function invoking the mapped RunnableEntities.
    container RteOsInteraction [1..*]  # Interaction of the Rte with the Os.
      container RteModeToScheduleTableMapping [0..*]  # Provides configuration input in which Modes of a ModeDeclarionGroupPrototype of a Mode Manager a OsScheudleTable shall be active. | The Mode Manager is either specified as a SwComponentPrototype (RteModeSchtblMapSwc) or as a BSW-Module (RteModeSchtblMapBsw).
        reference RteModeScheduleTableRef: set at pre-compile, destination=OsScheduleTable  # Reference to the OsScheduleTable which shall be active in the specified RteModeSchblMapModeDeclarationRefs.
        foreign reference RteModeSchtblMapModeDeclarationRef [1..*]: multiplicity set at pre-compile, set at pre-compile, destination-type=MODE-DECLARATION  # Reference to the ModeDeclarations.
        container RteModeSchtblMapBsw [0..1]  # Specifies an instance of a ModeDeclarationGroupPrototype of a Bsw-Module.
          reference RteModeSchtblMapBswInstanceRef: set at pre-compile, destination=RteBswModuleInstance  # Reference to an instance specification of a Bsw-Module.
          foreign reference RteModeSchtblMapBswProvidedModeGroupRef: set at pre-compile, destination-type=MODE-DECLARATION-GROUP-PROTOTYPE  # Reference to an instance of a ModeDeclarationGroupPrototype of a Bsw-Module.
        container RteModeSchtblMapSwc [0..1]  # Specifies an instance of a ModeDeclarationGroupPrototype of a SwComponentPrototype.
          reference RteModeSchtblMapSwcInstanceRef: set at pre-compile, destination=RteSwComponentInstance  # Reference to an instance specification of a SwComponentPrototype.
          foreign reference RteModeSchtblMapSwcPortRef: set at pre-compile, destination-type=ABSTRACT-PROVIDED-PORT-PROTOTYPE  # Reference to the PPortPrototype of a SwComponentPrototype.
      container RteOsTaskChain [0..*]  # This container holds the configuration of one task chain configuration.
        reference RtePredecessorOsTaskRef: scope=ECU, set at pre-compile, destination=OsTask  # OsTask which shall chain another OsTask when it terminates.
        reference RteSuccessorOsTaskRef: scope=ECU, set at pre-compile, destination=OsTask  # OsTask which shall be chained from the predecessor OsTask.
      container RteSyncPoint [0..*]  # The RteSyncPoint is necessary to provide an cross core synchronization in case of RteEvents triggered by the same event source but mapped to tasks belonging to different partitions on different cores. | The synchronization point must be reached by all referencing RteEvents before the execution in all related tasks is continued. In case of Rte(Bsw)EventSuccessorSyncPointRef the ExecutableEntity activated by the mapped event is executed before the synchronization point is entered. In case of Rte(Bsw)EventPredecessorSyncPointRef the ExecutableEntity activated by the mapped event is executed after the synchronization point is passed.
      container RteUsedOsActivation [0..*]  # Attributes used in the activation of OsTasks and Runnable Entities.
        float RteExpectedActivationOffset: 0..INF, set at pre-compile  # Activation offset in seconds. | Important: This is a requirement from the Rte towards the Os/Mcu setup. The Rte Generator shall assume this activation offset to be fulfilled.
        float RteExpectedTickDuration: 0..INF, set at pre-compile  # The expected tick duration in seconds which shall be configured to drive the OsScheduleTables or OsAlarm. | Important: This is a requirement from the Rte towards the Os/Mcu setup. The Rte Generator shall assume this tick duration to be fulfilled.
        reference RteActivationOsAlarmRef [0..1]: multiplicity set at pre-compile, set at pre-compile, destination=OsAlarm  # Reference to an OsAlarm.
        reference RteActivationOsSchTblRef [0..1]: multiplicity set at pre-compile, set at pre-compile, destination=OsScheduleTable  # Reference to an OsScheduleTable.
        reference RteActivationOsTaskRef [0..1]: multiplicity set at pre-compile, set at pre-compile, destination=OsTask  # Reference to an OsTask.
    container RtePostBuildVariantConfiguration [0..1]  # Specifies the PostbuildVariantSets for each of the PostBuild configurations of the RTE.
      foreign reference RtePostBuildUsedPredefinedVariant [1..*]: multiplicity set at post-build in variant post-build / pre-compile in variant pre-compile, post-build-variant-multiplicity=true, post-build-variant-value=true, set at post-build in variant post-build / pre-compile in variant pre-compile, destination-type=PREDEFINED-VARIANT  # Reference to the PredefinedVariant element which defines the values for PostBuildVariationCriterion elements. | The shortName of the referenced PredefinedVariant defines the name of the RtePostBuildVariant.
    container RteRips [0..1]: multiplicity set at pre-compile  # This container provides the configuration of the Rte Implementation Plug-In support by RTE. | If the container is NOT defined, the support for Rte Implementation Plug-Ins (RIPS) is globally disabled.
      enumeration RteRipsSupport: {RTE_RIPS_OFF, RTE_RIPS_ON}, set at pre-compile, default-value=RTE_RIPS_OFF  # Globally enables or disables the support for Rte Implementation Plug-Ins (RIPS)
      uri reference RteRipsPluginConfigurationRef [0..*]: multiplicity set at pre-compile, requires-index=true, set at pre-compile, destination-uri=RteRipsPlugin  # Reference to the configuration container of the RTE Implementation Plug-in holding the RTE relevant settings. | All referenced RTE Implementation Plug-ins are considered for the RTE generation.
    container RteSwComponentInstance [0..*]  # Representation of one SwComponentPrototype located on the to be configured ECU. All subcontainer configuration aspects are in relation to this SwComponentPrototype. | The RteSwComponentInstance can be associated with either a AtomicSwComponentType or ParameterSwComponentType.
      foreign reference RteSoftwareComponentInstanceRef [0..1]: multiplicity set at pre-compile, set at pre-compile, destination-type=SW-COMPONENT-PROTOTYPE  # Reference to a SwComponentPrototype.
      container RteEventToIsrMapping [0..*]  # Maps a RunnableEntity onto one OsIsr based on the activating ExternalTriggerOccurredEvent.
        integer RtePositionInIsr: 0..65535, set at pre-compile  # Each RunnableEntity mapped to an OsIsr has a specific position within the ISR2 execution. For event driven activation this is the order of evaluation which actual RunnableEntity has to be executed.
        foreign reference RteIsrEventRef: set at pre-compile, destination-type=RTE-EVENT  # Reference to the description of the ExternalTriggerOccurredEvent or TimingEvent which is pointing to the RunnableEntity being mapped. This allows a fine grained mapping of RunnableEntites based on the activating RTEEvent.
        reference RteMappedToIsrRef: set at pre-compile, destination=OsIsr  # Reference to the OsISR the RunnableEntity activated by the RteEventRef is mapped to.
        uri reference RteRipsFillRoutineRef [0..*]: multiplicity set at pre-compile, requires-index=true, set at pre-compile, destination-uri=RteRipsPluginFillFlushRoutine  # Reference to a Buffer-Fill Routine implemented by an RTE Implementation Plug-In. This routine gets invoked directly before the ExecutableEntity is started.
        uri reference RteRipsFlushRoutineRef [0..*]: multiplicity set at pre-compile, requires-index=true, set at pre-compile, destination-uri=RteRipsPluginFillFlushRoutine  # Reference to a Buffer-Flush Routine implemented by an RTE Implementation Plug-In. This routine gets invoked directly after the ExecutableEntity has terminated.
      container RteEventToTaskMapping [0..*]  # Maps an instance of a RunnableEntity onto one OsTask based on the activating RTEEvent. | In the case of a RunnableEntity executed via a direct or trusted function call this RteEventToTaskMapping is still specified but no RteMappedToTask element is included. The RtePositionInTask parameter is necessary to provide an ordering of events invoked by the same RTE API.
        float RteActivationOffset [0..1]: 0..INF, multiplicity set at pre-compile, set at pre-compile  # Activation offset in seconds.
        boolean RteImmediateRestart: set at pre-compile, default-value=false  # When RteImmediateRestart is set to true the RunnableEntitiy shall be immediately re-started after termination if it was activated by this RTEEvent while it was already started. | This parameter shall not be set to true when the mapped RTEEvent refers to a RunnableEntity which minimumStartInterval attribute is > 0.
        enumeration RteOsSchedulePoint [0..1]: {CONDITIONAL, NONE, UNCONDITIONAL}, multiplicity set at pre-compile, set at pre-compile  # Introduce a schedule point by explicitly calling Os Schedule service after the execution of the ExecutableEntity. The Rte generator is allowed to optimize several consecutive calls to Os schedule into one single call if the ExecutableEntity executions in between have been skipped. | The absence of this parameter is interpreted as "NONE". It shall be considered an invalid configuration if the task is preemptable and the value of this parameter is not set to "NONE" or the parameter is absent.
        integer RtePositionInTask [0..1]: 0..65535, multiplicity set at pre-compile, set at pre-compile  # Each RunnableEntity mapped to an OsTask has a specific position within the task execution. | For periodic activation this is the order of execution. For event driver activation this is the order of evaluation which actual RunnableEntity has to be executed. In case of direct or trusted function calls this parameter is necessary to provide an ordering of events when several ExecutableEntities are invoked by the same RTE API.
        integer RteServerQueueLength [0..1]: 0..65535, multiplicity set at pre-compile, set at pre-compile  # Specifies the length of the queue for the server call serialization. This value overwrites the queueLength specified at the ServerComSpec.
        reference RteEventPredecessorSyncPointRef [0..1]: multiplicity set at pre-compile, set at pre-compile, destination=RteSyncPoint  # The RteEventPredecessorSyncPointRef is necessary to provide a cross core synchronization in case of RteEvents triggered by the same event source but mapped to tasks belonging to different partitions on different cores. | The synchronization point must be reached by all referencing RteEvents before the execution in all related tasks is continued. In case of RteEventPredecessorSyncPointRef the RunnableEntity activated by the mapped RteEvent is executed after the synchronization point is passed.
        foreign reference RteEventRef [1..*]: set at pre-compile, destination-type=RTE-EVENT  # Reference to the description of the RTEEvent which is pointing to the RunnableEntity being mapped. This allows a fine grained mapping of RunnableEntites based on the activating RTEEvent.
        reference RteEventSuccessorSyncPointRef [0..1]: multiplicity set at pre-compile, set at pre-compile, destination=RteSyncPoint  # The RteEventSuccessorSyncPointRef is necessary to provide a cross core synchronization in case of RteEvents triggered by the same event source but mapped to tasks belonging to different partitions on different cores. | The synchronization point must be reached by all referencing RteEvents before the execution in all related tasks is continued. In case of RteEventSuccessorSyncPointRef the RunnableEntity activated by the mapped RteEvent is executed before the synchronization point is entered.
        reference RteMappedToTaskRef [0..1]: multiplicity set at pre-compile, set at pre-compile, destination=OsTask  # Reference to the OsTask the RunnableEntity activated by the RteEventRef is mapped to. | If no reference to the OsTask is specified the RunnableEntity shall be executed via a direct or trusted function call. The fact that no reference to an OsTask is specified for a RunnableEntity does not necessarily imply that every RTE generator has to support the implementation of this RunnableEntity as a direct or trusted function call. The standard set of use cases for direct or trusted function calls that has to be supported by every RTE generator is explicitly stated as requirements in this document. For further optimization RTE vendors are free to support additional scenarios of direct or trusted function call implementations that are not explicitly required in this document.
        uri reference RteRipsFillRoutineRef [0..*]: multiplicity set at pre-compile, requires-index=true, set at pre-compile, destination-uri=RteRipsPluginFillFlushRoutine  # Reference to a Buffer-Fill Routine implemented by an RTE Implementation Plug-In. | This routine gets invoked directly before the ExecutableEntity is started.
        uri reference RteRipsFlushRoutineRef [0..*]: multiplicity set at pre-compile, requires-index=true, set at pre-compile, destination-uri=RteRipsPluginFillFlushRoutine  # Reference to a Buffer-Flush Routine implemented by an RTE Implementation Plug-In. | This routine gets invoked directly after the ExecutableEntity has terminated.
        uri reference RteRipsInvocationHandlerRef [0..1]: multiplicity set at pre-compile, set at pre-compile, destination-uri=RteRipsInvocationHandler  # Reference to a Buffer-Fill Routine implemented by an RTE Implementation Plug-In. | This routine gets invoked directly before the ExecutableEntity is started.
        reference RteUsedInitFnc [0..1]: multiplicity set at pre-compile, set at pre-compile, destination=RteInitializationRunnableBatch  # The RunnableEntity is executed during initialization in the context of the Rte_Init_<InitContainer> function.
        reference RteUsedOsAlarmRef [0..1]: multiplicity set at pre-compile, set at pre-compile, destination=OsAlarm  # If an OsAlarm is used to activate the OsTask this RteEvent is mapped to it shall be referenced here.
        reference RteUsedOsEventRef [0..1]: multiplicity set at pre-compile, set at pre-compile, destination=OsEvent  # If an OsEvent is used to activate the OsTask this RteEvent is mapped to it shall be referenced here.
        reference RteUsedOsSchTblExpiryPointRef [0..1]: multiplicity set at pre-compile, set at pre-compile, destination=OsScheduleTableExpiryPoint  # If an OsScheduleTableExpiryPoint is used to activate the OsTask this RteEvent is mapped to it shall be referenced here.
        reference RteVirtuallyMappedToTaskRef [0..1]: multiplicity set at pre-compile, set at pre-compile, destination=OsTask  # Optional reference to an OsTask where the activation of this RteEvent shall be evaluated. The actual execution of the Runnable Entity shall happen in the OsTask referenced by RteMappedToTaskRef.
      container RteExclusiveAreaImplementation [0..*]  # Specifies the implementation to be used for the data consistency of this ExclusiveArea.
        enumeration RteExclusiveAreaImplMechanism: {ALL_INTERRUPT_BLOCKING, NONE, OS_INTERRUPT_BLOCKING, OS_RESOURCE, OS_SPINLOCK, RTE_PLUGIN}, set at pre-compile  # To be used implementation mechanism for the specified ExclusiveArea.
        reference RteExclusiveAreaOsResourceRef [0..1]: multiplicity set at pre-compile, set at pre-compile, destination=OsResource  # Optional reference to an OsResource in case RteExclusiveAreaImplMechanism is configured to OS_RESOURCE for this ExclusiveArea.
        foreign reference RteExclusiveAreaRef: set at pre-compile, destination-type=EXCLUSIVE-AREA  # Reference to the ExclusiveArea.
        uri reference RteExclusiveAreaResponsibleRipsPluginRef [0..1]: multiplicity set at pre-compile, set at pre-compile, destination-uri=RteRipsPlugin  # Optional reference to the configuration container of the RTE Implementation Plug-in implementing the ExclusiveArea. | It's required in case RteExclusiveAreaImplMechanism is configured to RTE_PLUGIN for this ExclusiveArea.
      container RteExternalTriggerConfig [0..*]  # Defines the configuration of External Trigger Event Communication for Software Components
        integer RteTriggerSourceQueueLength: 0..4294967295, set at pre-compile, default-value=0  # Length of trigger queue on the trigger source side. | The queue is implemented by the RTE. A value greater or equal to 1 requests an queued behavior. Setting the value of RteTriggerSourceQueueLength to 0 requests an none queued implementation of the trigger communication. If there is no RteTriggerSourceQueueLength configured for a Trigger Emitter the default value of 0 applies as well.
        instance reference RteSwcTriggerSourceRef: set at pre-compile, destination-context=ABSTRACT-PROVIDED-PORT-PROTOTYPE, destination-type=TRIGGER  # Reference to a Trigger instance in the pPortPrototype of the related component instance. | The referenced Trigger instance has to belong to the same software component instance as the RteSwComponentInstance owning this parameter configures.
      container RteInternalTriggerConfig [0..*]  # Defines the configuration of Inter Runnable Triggering for Software Components
        integer RteTriggerSourceQueueLength: 0..4294967295, set at pre-compile, default-value=0  # Length of trigger queue on the trigger source side. | The queue is implemented by the RTE. A value greater or equal to 1 requests an queued behavior. Setting the value of RteTriggerSourceQueueLength to 0 requests an none queued implementation of the trigger communication. If there is no RteTriggerSourceQueueLength configured for a Trigger Emitter the default value of 0 applies as well.
        foreign reference RteSwcTriggerSourceRef: set at pre-compile, destination-type=INTERNAL-TRIGGERING-POINT  # Reference to an InternalTriggeringPoint of the related component instance. | The referenced InternalTriggeringPoint has to belong to the same software component instance as the RteSwComponentInstance owning this parameter configures.
      container RteModeMachineInstanceConfig [0..*]  # Defines the configuration of RTE assigned ( SWS_Rte_07533) mode machine instances.
        integer RteModeMachineQueueLength: 0..4294967295, set at pre-compile, default-value=1  # Length of mode machine instance queue on the trigger source side. | If there is no RteModeMachineQueueLength configured for a mode machine instance the value given in the ModeSwitchSenderComSpec.queueLength applies.
        uri reference RteModeMachineInstanceResponsibleRipsPluginRef [0..1]: multiplicity set at pre-compile, set at pre-compile, destination-uri=RteRipsPlugin  # Optional reference to the configuration container of the RTE Implementation Plug-in implementing the protection of the mode machine instance.
        instance reference RteSwcModeManagerRef: set at pre-compile, destination-context=ABSTRACT-PROVIDED-PORT-PROTOTYPE, destination-type=MODE-DECLARATION-GROUP-PROTOTYPE  # Reference to a ModeDeclarationGroupPrototype instance in the provided PortPrototype (AbstractProvidedPortPrototype) of the related component instance. | The referenced ModeDeclarationGroupPrototype instance has to belong to the same software component instance as the RteSwComponentInstance owning this parameter configures.
      container RteNvRamAllocation [0..*]  # Specifies the relationship between the AtomicSwComponentType's NVRAMMapping / NVRAM needs and the NvM module configuration.
        linker symbol RteNvmRamBlockLocationSymbol [0..1]: multiplicity set at pre-compile, set at pre-compile  # This is the name of the linker object name where the NVRam Block will be mirrored by the Nvm. | This symbol will be resolved into the parameter "NvmRamBlockDataAddress" from the "NvmBlockDescriptor".
        linker symbol RteNvmRomBlockLocationSymbol [0..1]: multiplicity set at pre-compile, set at pre-compile  # This is the name of the linker object name where the NVRom Block will be accessed by the Nvm. | This symbol will be resolved into the parameter "NvmRomBlockDataAddress" from the "NvmBlockDescriptor".
        reference RteNvmBlockRef: set at pre-compile, requires-symbolic-name-value=true, destination=NvMBlockDescriptor  # Reference to the used NvM block for storage of the NVRAMMapping information.
        foreign reference RteSwNvBlockDescriptorRef [0..1]: multiplicity set at pre-compile, set at pre-compile, destination-type=NV-BLOCK-DESCRIPTOR  # Reference to the NvBlockDescriptor in case the RTE needs to call the NvM directly (e.g. for the supportDirtyFlag feature, storeCyclic feature, server invocation for NV data management or mode switch based invocation NvM services).
        foreign reference RteSwNvRamMappingRef [0..1]: multiplicity set at pre-compile, set at pre-compile, destination-type=SWC-SERVICE-DEPENDENCY  # Reference to the SwSeriveDependency which is used to specify the NvBlockNeeds. | XOR
    container RteSwComponentType [0..*]  # Representation of one SwComponentType for the base of all configuration parameter which are affecting the whole type and not a specific instance.
      boolean RteBypassSupportEnabled [0..1]: multiplicity set at pre-compile, set at pre-compile, default-value=false  # Individual switch to enable the bypass support for this software component type.
      foreign reference RteComponentTypeRef: set at pre-compile, destination-type=SW-COMPONENT-TYPE  # Reference to either AtomicSwComponentType or ParameterSwComponentType.
      foreign reference RteImplementationRef [0..1]: multiplicity set at pre-compile, set at pre-compile, destination-type=SWC-IMPLEMENTATION  # The Implementation which shall be assigned to the SwComponentType.
      container RteComponentTypeCalibration [0..1]  # Specifies for each ParameterSwComponentType or AtomicSwComponentType whether calibration is enabled. | If references to SwAddrMethod are provided in RteCalibrationSwAddrMethodRef only ParameterDataPrototypes with the referenced SwAddrMethod shall have software calibration support enabled.
        boolean RteCalibrationSupportEnabled: set at pre-compile  # Enables calibration support for the specified ParameterSwComponentType or AtomicSwComponentType.
        foreign reference RteCalibrationSwAddrMethodRef [0..*]: multiplicity set at pre-compile, set at pre-compile, destination-type=SW-ADDR-METHOD  # Reference to the SwAddrMethod for which software calibration support shall be enabled.
  module definition Sd [0..1]: post-build-variant-support=true, variants link-time/post-build/pre-compile  # Configuration of the Service Discovery module.
    container SdConfig  # This container contains the configuration parameters and sub containers of the AUTOSAR Service Discovery module.
      container SdCapabilityRecordMatchCallout [0..*]  # Callout that is invoked by the Sd implementation to determine whether the configuration options contained in the entries of a received SD message match the capability record elements configured in SdServerCapabilityRecord or SdClientCapabilityRecord.
        function name SdCapabilityRecordMatchCalloutName: multiplicity set at link in variant link-time+post-build / pre-compile in variant pre-compile, set at link in variant link-time+post-build / pre-compile in variant pre-compile  # Function name (i.e., C-identifier) of the SdCapabilityRecordMatchCallout.
      container SdInstance [0..*]  # This container represents an instance of the SD; i.e. the SD configuration for a certain link.
        string SdInstanceHostname [0..1]: multiplicity set at link in variant link-time / post-build in variant post-build / pre-compile in variant pre-compile, post-build-variant-multiplicity=true, post-build-variant-value=true, set at link in variant link-time / post-build in variant post-build / pre-compile in variant pre-compile  # Configuration parameter to specify the Hostname.
        integer SdInstanceLocalAdressCheckLength [0..1]: 0..128, scope=ECU, multiplicity set at link in variant link-time / post-build in variant post-build / pre-compile in variant pre-compile, post-build-variant-multiplicity=true, post-build-variant-value=true, set at link in variant link-time / post-build in variant post-build / pre-compile in variant pre-compile  # This item describes on how many bits of the addresses shall be compared to determine, if a remote address is acceptable to be used. | This shall support IPv4 (0..32) and IPv6 (0..128). If this item is not present, the security checks use the configured netmask instead. "0" meaning not to check at all. For example "8" means that the first 8 bits of a remote address must be equal to the local address to be considered acceptable.
        container SdClientService [0..*]  # This container specifies all parameters used by Client services.
          boolean SdClientServiceAutoRequire: post-build-variant-value=true, set at link in variant link-time / post-build in variant post-build / pre-compile in variant pre-compile, default-value=false  # If existing and set to true, this Service will be set to "required" on start.
          integer SdClientServiceHandleId: 0..65535, set at pre-compile, symbolic-name-value=true  # The HandleId by which the BswM can identify this Client Service Instance.
          integer SdClientServiceId: 0..65534, post-build-variant-value=true, set at link in variant link-time / post-build in variant post-build / pre-compile in variant pre-compile  # Id to identify the service. This is unique for the service interface.
          integer SdClientServiceInstanceId: 0..65534, post-build-variant-value=true, set at link in variant link-time / post-build in variant post-build / pre-compile in variant pre-compile  # Configuration parameter to specify Instance Id of the service as used in SD entries.
          integer SdClientServiceMajorVersion: 0..254, post-build-variant-value=true, set at link in variant link-time / post-build in variant post-build / pre-compile in variant pre-compile  # Major version number of the Service as used in the SD entries.
          integer SdClientServiceMinorVersion: 0..4294967295, post-build-variant-value=true, set at link in variant link-time / post-build in variant post-build / pre-compile in variant pre-compile  # Minor version number of the Service as used in the SD Service Entries. If configured to 0xffffffff (any), SD will accept all Minor Versions.
          enumeration SdVersionDrivenFindBehavior [0..1]: {EXACT_OR_ANY_MINOR_VERSION, MINIMUM_MINOR_VERSION}, multiplicity set at link in variant link-time+post-build / pre-compile in variant pre-compile, post-build-variant-value=true, set at link in variant link-time / post-build in variant post-build / pre-compile in variant pre-compile, default-value=EXACT_OR_ANY_MINOR_VERSION  # Defined the possible acceptance kinds for required service instances. Tags: atp.Status=draft
          reference SdClientCapabilityRecordMatchCalloutRef [0..1]: multiplicity set at link in variant link-time / post-build in variant post-build / pre-compile in variant pre-compile, post-build-variant-multiplicity=true, post-build-variant-value=true, set at link in variant link-time / post-build in variant post-build / pre-compile in variant pre-compile, destination=SdCapabilityRecordMatchCallout  # Reference to a SdCapabilityRecordMatchCallout, The referenced SdCapabilityRecordMatchCallout is invoked to determine whether the configuration options contained in the entries of a received SD message match the client's configured SdClientCapabilityRecord elements.
          reference SdClientServiceTcpRef [0..1]: multiplicity set at link in variant link-time / post-build in variant post-build / pre-compile in variant pre-compile, post-build-variant-multiplicity=true, post-build-variant-value=true, set at link in variant link-time / post-build in variant post-build / pre-compile in variant pre-compile, destination=SoAdSocketConnectionGroup  # Reference to the SoAdSocketConnection representing the data path (TCP) for communication with methods. | This element is also used to set the remote address of the server and to open the TCP connection.
          reference SdClientServiceTimerRef: scope=ECU, post-build-variant-value=true, set at link in variant link-time / post-build in variant post-build / pre-compile in variant pre-compile, destination=SdClientTimer  # The reference of the SdClientTimer container for this service.
          reference SdClientServiceUdpRef [0..1]: multiplicity set at link in variant link-time / post-build in variant post-build / pre-compile in variant pre-compile, post-build-variant-multiplicity=true, post-build-variant-value=true, set at link in variant link-time / post-build in variant post-build / pre-compile in variant pre-compile, destination=SoAdSocketConnectionGroup  # Reference to the SoAdSocketConnection representing the data path (UDP) for communication with methods. | This element is also used to set the remote address of the server.
          reference SdServiceGroupRef [0..*]: multiplicity set at link in variant link-time / post-build in variant post-build / pre-compile in variant pre-compile, post-build-variant-multiplicity=true, post-build-variant-value=true, set at link in variant link-time / post-build in variant post-build / pre-compile in variant pre-compile, destination=SdServiceGroup  # Reference to the SdServiceGroupS this SdClientService belongs to.
          container SdBlacklistedVersions [0..1]: multiplicity set at link in variant link-time / post-build in variant post-build / pre-compile in variant pre-compile, post-build-variant-multiplicity=true  # Collection of blacklisted versions. Tags: atp.Status=draft
            integer SdBlacklistedMinorVersions [0..*]: 0..4294967295, multiplicity set at link in variant link-time / post-build in variant post-build / pre-compile in variant pre-compile, post-build-variant-multiplicity=true, post-build-variant-value=true, set at link in variant link-time / post-build in variant post-build / pre-compile in variant pre-compile  # Blaclisted MinorVersions. Tags: atp.Status=draft
          container SdClientCapabilityRecord [0..*]  # Sd uses capability records to store arbitrary name/value pairs conveying additional information about the named service. | The following use cases are supported: 1) Key present, with no value (e.g. "passreq" -- password required for this service) 2) Key present, with empty value (e.g. "PlugIns=" server supports plugins, but none are presently installed) 3) Key present, with non-empty value (e.g. "PlugIns=JPEG,MPEG2,MPEG4")
            string SdClientServiceCapabilityRecordKey: set at pre-compile  # Defines a CapabilityRecord key.
            string SdClientServiceCapabilityRecordValue [0..1]: multiplicity set at pre-compile, set at pre-compile  # Defines the corresponding CapabilityRecord value.
          container SdConsumedEventGroup [0..*]  # A Service may have event groups which can be consumed. A service consumer has to subscribe to the corresponding event-group. After the subscription the event consumer takes the role of a server and the event provider that of a client.
            boolean SdConsumedEventGroupAutoRequire: post-build-variant-value=true, set at link in variant link-time / post-build in variant post-build / pre-compile in variant pre-compile, default-value=false  # If existing and set to true, this EventGroup will be set to "required" on start.
            integer SdConsumedEventGroupHandleId: 0..65535, set at pre-compile, symbolic-name-value=true  # The HandleId by which the BswM can identify this EventGroup.
            integer SdConsumedEventGroupId: 0..65534, set at pre-compile  # The Eventgroup Id of this eventGroup as a unique identifier of the eventgroup in this service. This identifier is used for EventGroup entries as well. | Please note, that the Eventgroup ID 0x0000 is reserved.
            reference SdConsumedEventGroupMulticastActivationRef [0..1]: multiplicity set at link in variant link-time / post-build in variant post-build / pre-compile in variant pre-compile, post-build-variant-multiplicity=true, post-build-variant-value=true, set at link in variant link-time / post-build in variant post-build / pre-compile in variant pre-compile, requires-symbolic-name-value=true, destination=SoAdRoutingGroup  # The reference of a Routing Group in order to activate and setup the Socket Connection for Multicast Events of this EventGroup. The multicast address from the received Multicast option is setup by SoAd_RequestIpAddrAssignment. | The local address is the same as for the unicast events; thus, it was sent in the UDP Endpoint option of the Subscribe EventGroup entry. This is usually equal to the SdConsumedEventGroupUdpActivationRef.
            reference SdConsumedEventGroupMulticastGroupRef [0..*]: multiplicity set at link in variant link-time / post-build in variant post-build / pre-compile in variant pre-compile, post-build-variant-multiplicity=true, post-build-variant-value=true, set at link in variant link-time / post-build in variant post-build / pre-compile in variant pre-compile, destination=SoAdSocketConnectionGroup  # Reference to the SoAdSocketConnectionGroup representing the multicast data path (UDP).
            reference SdConsumedEventGroupTcpActivationRef [0..1]: multiplicity set at link in variant link-time / post-build in variant post-build / pre-compile in variant pre-compile, post-build-variant-multiplicity=true, post-build-variant-value=true, set at link in variant link-time / post-build in variant post-build / pre-compile in variant pre-compile, requires-symbolic-name-value=true, destination=SoAdRoutingGroup  # The reference of the Routing Group for activation of the data path for receiving TCP events. | This element is also being used for getting the IP address and port number for building the TCP endpoint option for the Subscribe EventGroup entry. If no TCP methods are used in the service, this element is also being used for setting the remote address (TCP Endpoint option referenced by the Offer Service entry) and opening the TCP connection to the server before sending the Subscribe EventGroup entry. If multiple EventGroups of the same Service Instance are subscribed the TCP connection will be shared and must be opened only once.
            reference SdConsumedEventGroupTimerRef: post-build-variant-value=true, set at link in variant link-time / post-build in variant post-build / pre-compile in variant pre-compile, destination=SdClientTimer  # The reference of the SdClientTimer container for this eventGroup.
            reference SdConsumedEventGroupUdpActivationRef [0..1]: multiplicity set at link in variant link-time / post-build in variant post-build / pre-compile in variant pre-compile, post-build-variant-multiplicity=true, post-build-variant-value=true, set at link in variant link-time / post-build in variant post-build / pre-compile in variant pre-compile, requires-symbolic-name-value=true, destination=SoAdRoutingGroup  # The reference of the Routing Group for activation of the data path for receiving UDP events. | This element is also being used for getting the IP address and port number for building the UDP endpoint option for the Subscribe EventGroup entry. If no UDP methods are used in the service, this element is also being used for setting the remote address (UDP Endpoint option referenced by the Offer Service entry). If multiple EventGroups of the same Service Instance are subscribed the UDP Socket Connection will be shared and must be set only once.
          container SdConsumedMethods [0..1]  # Container element for representing the data path for accessing the server methods.
            reference SdClientServiceActivationRef: post-build-variant-value=true, set at link in variant link-time / post-build in variant post-build / pre-compile in variant pre-compile, requires-symbolic-name-value=true, destination=SoAdRoutingGroup  # Reference to a SoAdRoutingGroupRef to activate/deactivate the data path for the methods.
        container SdClientTimer [0..*]  # This container specifies all timers used by the Service Discovery module for Client Services.
          float SdClientTimerInitialFindDelayMax [0..1]: 0..INF, scope=ECU, multiplicity set at link in variant link-time / post-build in variant post-build / pre-compile in variant pre-compile, post-build-variant-multiplicity=true, post-build-variant-value=true, set at link in variant link-time / post-build in variant post-build / pre-compile in variant pre-compile  # Max value in [s] to delay randomly the transmission of a find message. This parameter is mandatory for ClientService.
          float SdClientTimerInitialFindDelayMin [0..1]: 0..INF, scope=ECU, multiplicity set at link in variant link-time / post-build in variant post-build / pre-compile in variant pre-compile, post-build-variant-multiplicity=true, post-build-variant-value=true, set at link in variant link-time / post-build in variant post-build / pre-compile in variant pre-compile  # Min value in [s] to delay randomly the transmission of a find message. This parameter is mandatory for ClientService.
          float SdClientTimerInitialFindRepetitionsBaseDelay [0..1]: 0..INF, scope=ECU, multiplicity set at link in variant link-time / post-build in variant post-build / pre-compile in variant pre-compile, post-build-variant-multiplicity=true, post-build-variant-value=true, set at link in variant link-time / post-build in variant post-build / pre-compile in variant pre-compile  # The base delay in [s] for find repetitions. Successive finds have an exponential back off delay (1x base delay, 2x base delay, 4x base delay, ...). This parameter is mandatory for ClientService.
          integer SdClientTimerInitialFindRepetitionsMax [0..1]: 0..10, scope=ECU, multiplicity set at link in variant link-time / post-build in variant post-build / pre-compile in variant pre-compile, post-build-variant-multiplicity=true, post-build-variant-value=true, set at link in variant link-time / post-build in variant post-build / pre-compile in variant pre-compile  # Configuration for the maximum number of find repetitions. This parameter is mandatory for ClientService.
          float SdClientTimerRequestResponseMaxDelay [0..1]: 0..INF, scope=ECU, multiplicity set at link in variant link-time / post-build in variant post-build / pre-compile in variant pre-compile, post-build-variant-multiplicity=true, post-build-variant-value=true, set at link in variant link-time / post-build in variant post-build / pre-compile in variant pre-compile  # Maximum allowable response delay to entries received by multicast in seconds. This parameter is mandatory for ConsumedEventGroups.
          float SdClientTimerRequestResponseMinDelay [0..1]: 0..INF, scope=ECU, multiplicity set at link in variant link-time / post-build in variant post-build / pre-compile in variant pre-compile, post-build-variant-multiplicity=true, post-build-variant-value=true, set at link in variant link-time / post-build in variant post-build / pre-compile in variant pre-compile  # Minimum allowable response delay to the find message in seconds. This parameter is mandatory for ConsumedEventGroups.
          integer SdClientTimerTTL: 1..16777215, scope=ECU, post-build-variant-value=true, set at link in variant link-time / post-build in variant post-build / pre-compile in variant pre-compile  # Time to live for find and subscribe messages.
          float SdSubscribeEventgroupRetryDelay [0..1]: 0.001..50, multiplicity set at link in variant link-time / post-build in variant post-build / pre-compile in variant pre-compile, post-build-variant-multiplicity=true, post-build-variant-value=true, set at link in variant link-time / post-build in variant post-build / pre-compile in variant pre-compile, default-value=0.01  # Time in seconds when a subscription to an event group shall be retriggered, if no SubscribeEventGroupAck or SubscribeEventGroupNack was received.
          integer SdSubscribeEventgroupRetryMax [0..1]: 0..255, multiplicity set at link in variant link-time / post-build in variant post-build / pre-compile in variant pre-compile, post-build-variant-multiplicity=true, post-build-variant-value=true, set at link in variant link-time / post-build in variant post-build / pre-compile in variant pre-compile, default-value=0  # Maximum count of retry a subscription, if a subscription to an event group is not acknowledged by SubscribeEventGroupAck or SubscribeEventGroupNack. 0x0=no retry, 0xFF=retry forever (as long as the event group is requested)
        container SdInstanceDemEventParameterRefs [0..1]  # Container for the references to DemEventParameter elements which shall be invoked using the API Dem_SetEventStatus in case the corresponding error occurs. The EventId is taken from the referenced DemEventParameter's DemEventId symbolic value. The standardized errors are provided in this container and can be extended by vendor-specific error references.
          reference SD_E_MALFORMED_MSG [0..1]: multiplicity set at pre-compile, post-build-variant-value=true, set at link in variant link-time / post-build in variant post-build / pre-compile in variant pre-compile, requires-symbolic-name-value=true, destination=DemEventParameter  # Reference to the DemEventParameter which shall be issued when the SD Instance received malformed messsage.
          reference SD_E_OUT_OF_RES [0..1]: multiplicity set at pre-compile, post-build-variant-value=true, set at link in variant link-time / post-build in variant post-build / pre-compile in variant pre-compile, requires-symbolic-name-value=true, destination=DemEventParameter  # Reference to the DemEventParameter which shall be issued when the SD Instance does not have enough resources to handle client.
          reference SD_E_SUBSCR_NACK_RECV [0..1]: multiplicity set at pre-compile, post-build-variant-value=true, set at link in variant link-time / post-build in variant post-build / pre-compile in variant pre-compile, requires-symbolic-name-value=true, destination=DemEventParameter  # Reference to the DemEventParameter which shall be issued when receiving SubscribeEventgroupNack entry.
        container SdInstanceMulticastRxPdu  # This container specifies the received PDU.
          integer SdRxPduId: 0..65535, scope=ECU, post-build-variant-value=true, set at link in variant link-time / post-build in variant post-build / pre-compile in variant pre-compile  # ID of the PDU that will be received via the API Sd_SoAdIfRxIndication().
          reference SdRxPduRef: post-build-variant-value=true, set at link in variant link-time / post-build in variant post-build / pre-compile in variant pre-compile, destination=Pdu  # Reference to the "global" Pdu structure to allow harmonization of handle IDs in the COM-Stack.
        container SdInstanceTxPdu  # This container specifies the transmitted PDU.
          reference SdTxPduRef: post-build-variant-value=true, set at link in variant link-time / post-build in variant post-build / pre-compile in variant pre-compile, destination=Pdu  # Reference to the "global" Pdu structure to allow harmonization of handle IDs in the COM-Stack.
        container SdInstanceUnicastRxPdu  # This container specifies the received PDU.
          integer SdRxPduId: 0..65535, scope=ECU, post-build-variant-value=true, set at link in variant link-time / post-build in variant post-build / pre-compile in variant pre-compile  # ID of the PDU that will be received via the API Sd_SoAdIfRxIndication().
          reference SdRxPduRef: post-build-variant-value=true, set at link in variant link-time / post-build in variant post-build / pre-compile in variant pre-compile, destination=Pdu  # Reference to the "global" Pdu structure to allow harmonization of handle IDs in the COM-Stack.
        container SdServerService [0..*]  # This container specifies all parameters used by Server services.
          boolean SdServerServiceAutoAvailable: post-build-variant-value=true, set at link in variant link-time / post-build in variant post-build / pre-compile in variant pre-compile, default-value=false  # If existing and set to true, this Service will be set to "Available" on start.
          integer SdServerServiceHandleId: 0..65535, set at pre-compile, symbolic-name-value=true  # The HandleId by which the BswM can identify this Server Service Instance.
          integer SdServerServiceId: 0..65534, post-build-variant-value=true, set at link in variant link-time / post-build in variant post-build / pre-compile in variant pre-compile  # Id to identify the service. This is unique for the service interface.
          integer SdServerServiceInstanceId: 0..65534, post-build-variant-value=true, set at link in variant link-time / post-build in variant post-build / pre-compile in variant pre-compile  # Configuration parameter to specify Instance Id of the Service implemented by the Server Service.
          integer SdServerServiceLoadBalancingPriority [0..1]: 0..65535, post-build-variant-value=true, set at link in variant link-time / post-build in variant post-build / pre-compile in variant pre-compile  # Defines the value to be used for load balancing priority in the service offer. Lower value means higher priority.
          integer SdServerServiceLoadBalancingWeight [0..1]: 0..65535, post-build-variant-value=true, set at link in variant link-time / post-build in variant post-build / pre-compile in variant pre-compile  # Defines the value to be used for load balancing weight in the service offer. Higher value means higher probability to be chosen.
          integer SdServerServiceMajorVersion: 0..254, post-build-variant-value=true, set at link in variant link-time / post-build in variant post-build / pre-compile in variant pre-compile  # Major version number of the Service as used in SD Entries.
          integer SdServerServiceMinorVersion: 0..4294967294, post-build-variant-value=true, set at link in variant link-time / post-build in variant post-build / pre-compile in variant pre-compile  # Minor version number of the Service as used e.g. in Offer Service entries.
          reference SdServerCapabilityRecordMatchCalloutRef [0..1]: multiplicity set at link in variant link-time / post-build in variant post-build / pre-compile in variant pre-compile, post-build-variant-multiplicity=true, post-build-variant-value=true, set at link in variant link-time / post-build in variant post-build / pre-compile in variant pre-compile, destination=SdCapabilityRecordMatchCallout  # Reference to a SdCapabilityRecordMatchCallout, The referenced SdCapabilityRecordMatchCallout is invoked to determine whether the configuration options contained in the entries of a received SD message match the server's configured SdServerCapabilityRecord elements.
          reference SdServerServiceTcpRef [0..1]: scope=ECU, multiplicity set at link in variant link-time / post-build in variant post-build / pre-compile in variant pre-compile, post-build-variant-multiplicity=true, post-build-variant-value=true, set at link in variant link-time / post-build in variant post-build / pre-compile in variant pre-compile, destination=SoAdSocketConnectionGroup  # Reference to SoAdSocketConnectionGroup used for methods. | This is used to access the local IP address and port for building the endpoint option for offers of this service.
          reference SdServerServiceTimerRef: scope=ECU, post-build-variant-value=true, set at link in variant link-time / post-build in variant post-build / pre-compile in variant pre-compile, destination=SdServerTimer  # The reference of the SdServerTimer container for this service.
          reference SdServerServiceUdpRef [0..1]: scope=ECU, multiplicity set at link in variant link-time / post-build in variant post-build / pre-compile in variant pre-compile, post-build-variant-multiplicity=true, post-build-variant-value=true, set at link in variant link-time / post-build in variant post-build / pre-compile in variant pre-compile, destination=SoAdSocketConnectionGroup  # Reference to SoAdSocketConnectionGroup used for methods. | This is used to access the local IP address and port for building the endpoint option for offers of this service.
          reference SdServiceGroupRef [0..*]: multiplicity set at link in variant link-time / post-build in variant post-build / pre-compile in variant pre-compile, post-build-variant-multiplicity=true, post-build-variant-value=true, set at link in variant link-time / post-build in variant post-build / pre-compile in variant pre-compile, destination=SdServiceGroup  # Reference to the SdServiceGroupS this SdServerService belongs to.
          container SdEventHandler [0..*]  # Container Element for representing an EventGroup as part of the Service Instance.
            integer SdEventHandlerEventGroupId: 0..65534, set at pre-compile  # The EventGroup Id of this EventGroup as a unique identifier of the EventGroup in this service. This identifier is used for EventGroup entries as well. | Please note, that the Eventgroup ID 0x0000 is reserved.
            integer SdEventHandlerHandleId: 0..65535, scope=ECU, set at pre-compile, symbolic-name-value=true  # The HandleId by which the BswM can identify this EventGroup.
            integer SdEventHandlerMulticastThreshold: 0..65535, post-build-variant-value=true, set at link in variant link-time / post-build in variant post-build / pre-compile in variant pre-compile  # Specifies the number of subscribed clients that trigger the Server to change the transmission of events to Multicast. | If configured to 0 only unicast will be used. If configured to 1 the first client will be already served by multicast. If configured to 2 the first client will be served with unicast and as soon as the second client arrives both will be served by multicast. This does not influence the handling of initial events, which are served using unicast only.
            reference SdEventHandlerTimerRef: post-build-variant-value=true, set at link in variant link-time / post-build in variant post-build / pre-compile in variant pre-compile, destination=SdServerTimer  # The reference of the SdServerTimer container for this EventGroup.
            container SdEventHandlerMulticast [0..1]  # The subcontainer including the Routing Group for Activation of Events sent over Multicast. | The activation ref is also being used for identification of the related Socket Connection in order to find the Multicast Address used in the Multicast Option referenced by the Subscribe EventGroup Ack entry.
              reference SdEventActivationRef [0..1]: multiplicity set at link in variant link-time / post-build in variant post-build / pre-compile in variant pre-compile, post-build-variant-multiplicity=true, post-build-variant-value=true, set at link in variant link-time / post-build in variant post-build / pre-compile in variant pre-compile, requires-symbolic-name-value=true, destination=SoAdRoutingGroup  # Reference to a SoAdRoutingGroup for activation of the data path for a subscribed client (start sending events after subscribe). This is usually equal to the SdEventActivationRef referenced by SdEventHandlerUdp
              reference SdMulticastEventSoConRef: multiplicity set at link in variant link-time / post-build in variant post-build / pre-compile in variant pre-compile, post-build-variant-multiplicity=true, post-build-variant-value=true, set at link in variant link-time / post-build in variant post-build / pre-compile in variant pre-compile, requires-symbolic-name-value=true, destination=SoAdSocketConnection  # Reference to the SoAdSocketConnection representing the multicast data path (UDP).
            container SdEventHandlerTcp [0..1]  # The subcontainer including the Routing Groups for Activation and Trigger Transmit for Events sent over TCP. | The activation ref (or triggering ref if no activation ref exists) is also being used for identification of the related socket connections in order to find the related client by iterating the SdEventHandlerTcp elements (remote address statically configured or automatically set by opening TCP connection before subscription).
              reference SdEventActivationRef [0..1]: multiplicity set at link in variant link-time / post-build in variant post-build / pre-compile in variant pre-compile, post-build-variant-multiplicity=true, post-build-variant-value=true, set at link in variant link-time / post-build in variant post-build / pre-compile in variant pre-compile, requires-symbolic-name-value=true, destination=SoAdRoutingGroup  # Reference to a SoAdRoutingGroup for activation of the data path for a subscribed client (start sending events after subscribe). This is usually equal to the SdEventActivationRef referenced by SdEventHandlerUdp
              reference SdEventTriggeringRef [0..1]: multiplicity set at link in variant link-time / post-build in variant post-build / pre-compile in variant pre-compile, post-build-variant-multiplicity=true, post-build-variant-value=true, set at link in variant link-time / post-build in variant post-build / pre-compile in variant pre-compile, requires-symbolic-name-value=true, destination=SoAdRoutingGroup  # Reference to a SoAdRoutingGroup that is used for triggered transmit. Triggering is needed to sent out initial events on the server side after a client got subscribed.
            container SdEventHandlerUdp [0..1]  # The subcontainer including the Routing Groups for Activation and Trigger Transmit for Events sent over UDP. | The activation ref (or triggering ref if no activation ref exists) is also being used for identification of the related socket connections in order to set the remote address of the client or find the related client by iterating the SdEventHandlerUdp elements (remote address statically configured or automatically set by method call before subscription).
              reference SdEventActivationRef [0..1]: multiplicity set at link in variant link-time / post-build in variant post-build / pre-compile in variant pre-compile, post-build-variant-multiplicity=true, post-build-variant-value=true, set at link in variant link-time / post-build in variant post-build / pre-compile in variant pre-compile, requires-symbolic-name-value=true, destination=SoAdRoutingGroup  # Reference to a SoAdRoutingGroup for activation of the data path for a subscribed client (start sending events after subscribe). This is usually equal to the SdEventActivationRef referenced by SdEventHandlerUdp
              reference SdEventTriggeringRef [0..1]: multiplicity set at link in variant link-time / post-build in variant post-build / pre-compile in variant pre-compile, post-build-variant-multiplicity=true, post-build-variant-value=true, set at link in variant link-time / post-build in variant post-build / pre-compile in variant pre-compile, requires-symbolic-name-value=true, destination=SoAdRoutingGroup  # Reference to a SoAdRoutingGroup that is used for triggered transmit. Triggering is needed to sent out initial events on the server side after a client got subscribed.
          container SdProvidedMethods [0..1]  # Container element for representing the needed elements of the data path for the methods provided by the service.
            reference SdServerServiceActivationRef: scope=ECU, post-build-variant-value=true, set at link in variant link-time / post-build in variant post-build / pre-compile in variant pre-compile, requires-symbolic-name-value=true, destination=SoAdRoutingGroup  # Reference to a SoAdRoutingGroup to activated and deactivate the data path for methods of the service.
          container SdServerCapabilityRecord [0..*]  # Sd uses capability records to store arbitrary name/value pairs conveying additional information about the named service. | The following use cases are supported: 1) Key present, with no value (e.g. "passreq" -- password required for this service) 2) Key present, with empty value (e.g. "PlugIns=" server supports plugins, but none are presently installed) 3) Key present, with non-empty value (e.g. "PlugIns=JPEG,MPEG2,MPEG4")
            string SdServerCapabilityRecordKey: set at pre-compile  # Defines a CapabilityRecord key.
            string SdServerCapabilityRecordValue [0..1]: multiplicity set at pre-compile, set at pre-compile  # Defines the corresponding CapabilityRecord value.
        container SdServerTimer [0..*]  # This container specifies all timers used by the Service Discovery module for Server Services.
          float SdServerTimerInitialOfferDelayMax [0..1]: 0..INF, scope=ECU, multiplicity set at link in variant link-time / post-build in variant post-build / pre-compile in variant pre-compile, post-build-variant-multiplicity=true, post-build-variant-value=true, set at link in variant link-time / post-build in variant post-build / pre-compile in variant pre-compile  # Max value in [s] to delay randomly the first offer. This parameter is mandatory for ServerService.
          float SdServerTimerInitialOfferDelayMin [0..1]: 0..INF, scope=ECU, multiplicity set at link in variant link-time / post-build in variant post-build / pre-compile in variant pre-compile, post-build-variant-multiplicity=true, post-build-variant-value=true, set at link in variant link-time / post-build in variant post-build / pre-compile in variant pre-compile  # Min value in [s] to delay randomly the first offer. This parameter is mandatory for ServerService.
          float SdServerTimerInitialOfferRepetitionBaseDelay [0..1]: 0..INF, scope=ECU, multiplicity set at link in variant link-time / post-build in variant post-build / pre-compile in variant pre-compile, post-build-variant-multiplicity=true, post-build-variant-value=true, set at link in variant link-time / post-build in variant post-build / pre-compile in variant pre-compile  # The base delay in [s] for offer repetitions. Successive offers have an exponential back off delay (1x base delay, 2x base delay, 4x base delay, ...). This parameter is mandatory for ServerService.
          integer SdServerTimerInitialOfferRepetitionsMax [0..1]: 0..10, scope=ECU, multiplicity set at link in variant link-time / post-build in variant post-build / pre-compile in variant pre-compile, post-build-variant-multiplicity=true, post-build-variant-value=true, set at link in variant link-time / post-build in variant post-build / pre-compile in variant pre-compile  # Configure the maximum amount of offer repetition. This parameter is mandatory for ServerService.
          float SdServerTimerOfferCyclicDelay [0..1]: 0..INF, multiplicity set at link in variant link-time / post-build in variant post-build / pre-compile in variant pre-compile, post-build-variant-multiplicity=true, post-build-variant-value=true, set at link in variant link-time / post-build in variant post-build / pre-compile in variant pre-compile  # Interval between cyclic offers in the main phase. This parameter is mandatory for ServerService.
          float SdServerTimerRequestResponseMaxDelay: 0..INF, scope=ECU, post-build-variant-value=true, set at link in variant link-time / post-build in variant post-build / pre-compile in variant pre-compile  # Maximum allowable response delay to entries received by multicast in seconds.
          float SdServerTimerRequestResponseMinDelay: 0..INF, scope=ECU, post-build-variant-value=true, set at link in variant link-time / post-build in variant post-build / pre-compile in variant pre-compile  # Minimum allowable response delay to entries received by multicast in seconds.
          integer SdServerTimerTTL: 1..16777215, scope=ECU, post-build-variant-value=true, set at link in variant link-time / post-build in variant post-build / pre-compile in variant pre-compile  # Time to live for offer service.
      container SdServiceGroup [0..*]: multiplicity set at link in variant link-time / post-build in variant post-build / pre-compile in variant pre-compile, post-build-variant-multiplicity=true  # Contains the configuration parameters of the AUTOSAR SD module's SdServiceGroupS.
        integer SdServiceGroupHandleId: 0..65535, scope=ECU, set at pre-compile, symbolic-name-value=true  # The numerical value used as the ID of this SdServiceGroup. The SdServiceHandleId is required by the API calls to start and stop SdServiceGroupS.
    container SdGeneral  # This container lists the general configuration parameters for the Service Discovery module.
      boolean SdDevErrorDetect: set at pre-compile, default-value=false  # Switches the development error detection and notification on or off. | * true: detection and notification is enabled. * false: detection and notification is disabled.
      float SdMainFunctionCycleTime: 0..INF, set at pre-compile  # This parameter defines the cycle time in seconds of the periodic calling of Sd main function.
      boolean SdSetRemAddrOfClientRxMulticastSoCon: scope=ECU, set at pre-compile, default-value=true  # If SdSetRemAddrOfClientRxMulticastSoCon is set to TRUE, the Service Discovery module shall choose an multicast socket connection which match to the received Endpoint option of the corresponding OfferService. If no particular socket connection exist, then an unused socket connection with its remote address set to wildcard shall be used and the remote address shall be updated accordingly. If SdSetRemAddrOfClientRxMulticastSoCon is set to FALSE, the Service Discovery shall choose an unused socket connection with its remote address set to wildcard and skip to update the remote address, i.e. the wildcard for the remote address is kept. | Note: setting SdSetRemAddrOfClientRxMulticastSoCon to FALSE supports the re-use of a multicast socket connection for multiple ClientServices which are located on the same ECU and subscribed to ServerServices which are located on differen ECUs. The configuration of the ECU where the ClientServices are located, could be simplified by only configuring one socket connection within the multicast socket connection group.
      boolean SdSubscribeEventgroupRetryEnable: set at pre-compile, default-value=false  # Switch to enable or disable the retry functionality to subscribe to Eventgroups of ServerServices with TTL set to 0xFFFFFF.
      boolean SdVersionInfoApi: set at pre-compile, default-value=false  # Enables and disables the version info API.
  module definition SecOC [0..1]: post-build-variant-support=true, variants link-time/post-build/pre-compile  # Configuration of the SecOC (SecureOnboardCommunication) module.
    container SecOCGeneral  # Contains the general configuration parameters of the SecOC module.
      integer SecOCDefaultAuthenticationInformationPattern [0..1]: 0..255, multiplicity set at pre-compile, set at pre-compile  # The parameter describes the behaviour of SecOC when authentication build counter has reached the configuration value SecOCAuthenticationBuildAttempts, or the query of the freshness function returns E_NOT_OK or the calculation of the authenticator has returned a non-recoverable error such as returning E_NOT_OK or KEY_FAILURE. | If the configuration parameter is not present, SecOC module shall remove the Authentic I-PDU from its internal buffer and cancel the transmission request If the configuration parameter is present, SecOC will use this value for each byte of Freshness Value and Authenticator when building the Authentication Information, and will not cancel the transmission request.
      boolean SecOCDevErrorDetect: set at pre-compile, default-value=false  # Switches the development error detection and notification on or off. | * true: detection and notification is enabled. * false: detection and notification is disabled.
      boolean SecOCEnableForcedPassOverride: set at pre-compile, default-value=false  # When this configuration option is set to TRUE then the functionality inside the function SecOC_VerifyStatusOverride to send I-PDUs to upper layer independent of the verification result is enabled.
      boolean SecOCIgnoreVerificationResult: set at pre-compile, default-value=false  # The result of the authentication process (e.g. MAC Verify) is ignored after the first try and the SecOC proceeds like the result was a success. The calculation of the authenticator is still done, only its result will be ignored. | - true: enabled (verification result is ignored). - false: disabled (verification result is NOT ignored).
      float SecOCMainFunctionPeriodRx: 0..INF, scope=ECU, set at pre-compile  # Allows to configure the time for the MainFunction of the Rx path (as float in seconds).
      float SecOCMainFunctionPeriodTx: 0..INF, scope=ECU, set at pre-compile  # Allows to configure the time for the MainFunction of the Tx path (as float in seconds).
      string SecOCMaxAlignScalarType: set at pre-compile  # The scalar type which has the maximum alignment restrictions on the given platform. This type can be e.g. uint8, uint16 or uint32.
      boolean SecOCOverrideStatusWithDataId [0..1]: set at pre-compile, default-value=false  # This option defines if the parameter "ValueId" of the function SecOC_VerifyStatusOverride() accepts the freshness value (as a collection of one or more Secured I-PDUs to freshness) or the dataID for individual Secured I-PDUs. | * true: Function SecOC_VerifyStatusOverride accepts SecOCDataId as parameter. * false: Function SecOC_VerifyStatusOverride accepts SecOCFreshnessValueId as parameter.
      enumeration SecOCQueryFreshnessValue: {CFUNC, RTE}, set at pre-compile, default-value=CFUNC  # This parameter specifies if the freshness value shall be determined through a C-function (CD) or a software component (SW-C).
      function name SecOCVerificationStatusCallout [0..*]: multiplicity set at pre-compile, set at pre-compile  # Entry address of the customer specific call out routine which shall be invoked in case of a verification attempt.
      boolean SecOCVersionInfoApi: set at pre-compile, default-value=false  # If true the SecOC_GetVersionInfo API is available.
      reference SecOCEcucPartitionRef [0..1]: multiplicity set at pre-compile, set at pre-compile, destination=EcucPartition  # Reference to EcucPartition, where SecOC module is assigned to. Tags: atp.Status=draft
    container SecOCRxPduProcessing [0..*]  # Contains the parameters to configure the RxPdus to be verified by the SecOC module.
      integer SecOCAuthDataFreshnessLen [0..1]: 0..65535, scope=ECU, set at pre-compile  # The length of the external authentic PDU data in bits (uint16).
      integer SecOCAuthDataFreshnessStartPosition [0..1]: 0..65535, scope=ECU, set at pre-compile  # This value determines the start position in bits (uint16) of the Authentic PDU that shall be passed on to the Freshness SWC. The bit position starts counting from the MSB of the first byte of the PDU.
      integer SecOCAuthenticationBuildAttempts [0..1]: 0..65535, set at pre-compile  # This parameter specifies the number of authentication build attempts.
      integer SecOCAuthenticationVerifyAttempts [0..1]: 0..65535, set at pre-compile, default-value=0  # This parameter specifies the number of authentication verify attempts that are to be carried out when the verification of the authentication information failed for a given Secured I-PDU. If zero is set, then only one authentication verification attempt is done.
      integer SecOCAuthInfoTruncLength: 1..65535, post-build-variant-value=true, set at link in variant link-time / post-build in variant post-build / pre-compile in variant pre-compile  # This parameter defines the length in bits of the authentication code to be included in the payload of the Secured I-PDU.
      integer SecOCDataId: 0..65535, post-build-variant-value=true, set at link in variant link-time / post-build in variant post-build / pre-compile in variant pre-compile  # This parameter defines a unique numerical identifier for the Secured I-PDU.
      integer SecOCFreshnessValueId: 0..65535, post-build-variant-value=true, set at link in variant link-time / post-build in variant post-build / pre-compile in variant pre-compile  # This parameter defines the Id of the Freshness Value. | The Freshness Value might be a normal counter or a time value.
      integer SecOCFreshnessValueLength: 0..64, post-build-variant-value=true, set at link in variant link-time / post-build in variant post-build / pre-compile in variant pre-compile  # This parameter defines the complete length in bits of the Freshness Value. As long as the key doesn't change the counter shall not overflow. The length of the counter shall be determined based on the expected life time of the corresponding key and frequency of usage of the counter.
      integer SecOCFreshnessValueTruncLength: 0..64, post-build-variant-value=true, set at link in variant link-time / post-build in variant post-build / pre-compile in variant pre-compile  # This parameter defines the length in bits of the Freshness Value to be included in the payload of the Secured I-PDU. This length is specific to the least significant bits of the complete Freshness Counter. If the parameter is 0 no Freshness Value is included in the Secured I-PDU.
      enumeration SecOCReceptionOverflowStrategy: {QUEUE, REJECT, REPLACE}, set at pre-compile  # This parameter defines the overflow strategy for receiving PDUs
      integer SecOCReceptionQueueSize [0..1]: 1..65535, set at pre-compile  # This parameter defines the queue size in case the overflow strategy for receiving PDUs is set to QUEUE.
      boolean SecOCUseAuthDataFreshness: scope=ECU, set at pre-compile, default-value=false  # A Boolean value that indicates if a part of the Authentic-PDU shall be passed on to the SWC that verifies and generates the Freshness. If it is set to TRUE, the values SecOCAuthDataFreshnessStartPosition and SecOCAuthDataFreshnessLen must be set to specify the bit position and length within the Authentic-PDU.
      enumeration SecOCVerificationStatusPropagationMode: {BOTH, FAILURE_ONLY, NONE}, post-build-variant-value=true, set at link in variant link-time / post-build in variant post-build / pre-compile in variant pre-compile  # This parameter is used to describe the propagation of the status of each verification attempt from the SecOC module to SWCs.
      reference SecOCRxAuthServiceConfigRef: requires-symbolic-name-value=true, destination=CsmJob  # This reference is used to define which crypto service function is called for authentication. | If PDUs with a dynamic length are used (e.g. CanTP or Dynamic Length PDUs) a MAC algorithm has to be chosen, that is not vulnerable to length extension attack (e.g. CMAC/HMAC).
      reference SecOCSameBufferPduRef [0..1]: multiplicity set at pre-compile, set at pre-compile, destination=SecOCSameBufferPduCollection  # This reference is used to collect Pdus that are using the same SecOC buffer.
      container SecOCRxAuthenticPduLayer  # This container specifies the Pdu that is transmitted by the SecOC module to the PduR after the Mac was verified.
        enumeration SecOCPduType: {SECOC_IFPDU, SECOC_TPPDU}, set at pre-compile  # This parameter defines API Type to use for communication with PduR.
        reference SecOCRxAuthenticLayerPduRef: post-build-variant-value=true, set at link in variant link-time / post-build in variant post-build / pre-compile in variant pre-compile, destination=Pdu  # Reference to the global Pdu.
      container SecOCRxPduSecuredArea [0..1]  # This container specifies an area in the Authentic I-Pdu that will be the input to the Authenticator verification algorithm. If this container does not exist in the configuration the complete Authentic I-Pdu will be the input to the Authenticator verification algorithm.
        integer SecOCSecuredRxPduLength: 0..4294967295, post-build-variant-value=true, set at link in variant link-time / post-build in variant post-build / pre-compile in variant pre-compile  # This parameter defines the length (in bytes) of the area within the Pdu which is secured
        integer SecOCSecuredRxPduOffset: 0..4294967295, post-build-variant-value=true, set at link in variant link-time / post-build in variant post-build / pre-compile in variant pre-compile, default-value=0  # This parameter defines the start position (offset in bytes) of the area within the Pdu which is secured
      choice container SecOCRxSecuredPduLayer  # This container specifies the Pdu that is received by the SecOC module from the PduR. For this Pdu the Mac verification is provided.
        container SecOCRxSecuredPdu [0..1]  # This container specifies the Pdu that is received by the SecOC module from the PduR. For this Pdu the Mac verification is provided.
          integer SecOCAuthPduHeaderLength [0..1]: 0..4, set at pre-compile, default-value=0  # This parameter indicates the length (in bytes) of the Secured I-PDU Header in the Secured I-PDU. The length of zero means there's no header in the PDU.
          integer SecOCRxSecuredLayerPduId: 0..65535, set at pre-compile, symbolic-name-value=true  # PDU identifier assigned by SecOC module. Used by PduR for <nowiki>SecOC_[If|Tp]RxIndication</nowiki>.
          boolean SecOCSecuredRxPduVerification: post-build-variant-value=true, set at pre-compile, default-value=false  # This parameter defines whether the signature authentication or MAC verification shall be performed on this Secured I-PDU. If set to false, the SecOC module extracts the Authentic I-PDU from the Secured I-PDU without verification.
          reference SecOCRxSecuredLayerPduRef: post-build-variant-value=true, set at link in variant link-time / post-build in variant post-build / pre-compile in variant pre-compile, destination=Pdu  # Reference to the global Pdu.
        container SecOCRxSecuredPduCollection [0..1]  # This container specifies two Pdus that are received by the SecOC module from the PduR and a message linking between them. | SecOCRxAuthenticPdu contains the original Authentic I-PDU, i.e. the secured data, and the SecOCRxCryptographicPdu contains the Authenticator, i.e. the actual Authentication Information.
          boolean SecOCSecuredRxPduVerification: post-build-variant-value=true, set at pre-compile, default-value=false  # This parameter defines whether the signature authentication or MAC verification shall be performed on this Secured I-PDU. If set to false, the SecOC module extracts the Authentic I-PDU from the Secured I-PDU without verification.
          container SecOCRxAuthenticPdu  # This container specifies the PDU (that is received by the SecOC module from the PduR) which contains the Secured I-PDU Header and the Authentic I-PDU.
            integer SecOCAuthPduHeaderLength [0..1]: 0..4, set at pre-compile, default-value=0  # This parameter indicates the length (in bytes) of the Secured I-PDU Header in the Secured I-PDU. The length of zero means there's no header in the PDU.
            integer SecOCRxAuthenticPduId: 0..65535, set at pre-compile, symbolic-name-value=true  # PDU identifier of the Authentic I-PDU assigned by SecOC module. Used by PduR for SecOC_IfRxIndication.
            reference SecOCRxAuthenticPduRef: post-build-variant-value=true, set at link in variant link-time / post-build in variant post-build / pre-compile in variant pre-compile, destination=Pdu  # Reference to the global Pdu.
          container SecOCRxCryptographicPdu  # This container specifies the Cryptographic Pdu that is received by the SecOC module from the PduR.
            integer SecOCRxCryptographicPduId: 0..65535, set at pre-compile, symbolic-name-value=true  # PDU identifier of the Cryptographic I-PDU assigned by SecOC module. Used by PduR for SecOC_IfRxIndication.
            reference SecOCRxCryptographicPduRef: post-build-variant-value=true, set at link in variant link-time / post-build in variant post-build / pre-compile in variant pre-compile, destination=Pdu  # Reference to the global Pdu.
          container SecOCUseMessageLink [0..1]  # SecOC links an Authentic I-PDU and Cryptographic I-PDU together by repeating a specific part (Message Linker) of the Authentic I-PDU in the Cryptographic I-PDU.
            integer SecOCMessageLinkLen: 0..65535, set at pre-compile  # Length of the Message Linker inside the Authentic I-PDU in bits.
            integer SecOCMessageLinkPos: 0..65535, set at pre-compile  # The position of the Message Linker inside the Authentic I-PDU in bits.
    container SecOCSameBufferPduCollection [0..*]: multiplicity set at pre-compile  # SecOCBuffer configuration that may be used by a collection of Pdus.
      integer SecOCBufferLength: 0..4294967295, set at pre-compile  # This parameter defines the Buffer in bytes that is used by the SecOC module.
    container SecOCTxPduProcessing [0..*]  # Contains the parameters to configure the TxPdus to be secured by the SecOC module.
      integer SecOCAuthenticationBuildAttempts [0..1]: 0..65535, set at pre-compile  # This parameter specifies the number of authentication build attempts.
      integer SecOCAuthInfoTruncLength: 1..65535, post-build-variant-value=true, set at link in variant link-time / post-build in variant post-build / pre-compile in variant pre-compile  # This parameter defines the length in bits of the authentication code to be included in the payload of the Secured I-PDU.
      integer SecOCDataId: 0..65535, post-build-variant-value=true, set at link in variant link-time / post-build in variant post-build / pre-compile in variant pre-compile  # This parameter defines a unique numerical identifier for the Secured I-PDU.
      integer SecOCFreshnessValueId: 0..65535, post-build-variant-value=true, set at link in variant link-time / post-build in variant post-build / pre-compile in variant pre-compile  # This parameter defines the Id of the Freshness Value. | The Freshness Value might be a normal counter or a time value.
      integer SecOCFreshnessValueLength: 0..64, post-build-variant-value=true, set at link in variant link-time / post-build in variant post-build / pre-compile in variant pre-compile  # This parameter defines the complete length in bits of the Freshness Value. As long as the key doesn't change the counter shall not overflow. The length of the counter shall be determined based on the expected life time of the corresponding key and frequency of usage of the counter.
      integer SecOCFreshnessValueTruncLength: 0..64, post-build-variant-value=true, set at link in variant link-time / post-build in variant post-build / pre-compile in variant pre-compile  # This parameter defines the length in bits of the Freshness Value to be included in the payload of the Secured I-PDU. This length is specific to the least significant bits of the complete Freshness Counter. If the parameter is 0 no Freshness Value is included in the Secured I-PDU.
      boolean SecOCProvideTxTruncatedFreshnessValue: set at pre-compile, default-value=false  # This parameter specifies if the Tx query freshness function provides the truncated freshness info instead of generating this by SecOC In this case, SecOC shall add this data to the Authentic PDU instead of truncating the freshness value.
      boolean SecOCUseTxConfirmation [0..1]: set at pre-compile, default-value=false  # A Boolean value that indicates if the function SecOC_SPduTxConfirmation shall be called for this PDU.
      reference SecOCSameBufferPduRef [0..1]: multiplicity set at pre-compile, set at pre-compile, destination=SecOCSameBufferPduCollection  # This reference is used to collect Pdus that are using the same SecOC buffer.
      reference SecOCTxAuthServiceConfigRef: requires-symbolic-name-value=true, destination=CsmJob  # This reference is used to define which crypto service function is called for authentication. | If PDUs with a dynamic length are used (e.g. CanTP or Dynamic Length PDUs) a MAC algorithm has to be chosen, that is not vulnerable to length extension attack (e.g. CMAC/HMAC).
      container SecOCTxAuthenticPduLayer  # This container specifies the Pdu that is received by the SecOC module from the PduR. For this Pdu the Mac generation is provided.
        enumeration SecOCPduType: {SECOC_IFPDU, SECOC_TPPDU}, set at pre-compile  # This parameter defines API Type to use for communication with PduR.
        integer SecOCTxAuthenticLayerPduId: 0..65535, set at pre-compile, symbolic-name-value=true  # PDU identifier assigned by SecOC module. Used by PduR for <nowiki>SecOC_[If|Tp]Transmit</nowiki>.
        reference SecOCTxAuthenticLayerPduRef: post-build-variant-value=true, set at link in variant link-time / post-build in variant post-build / pre-compile in variant pre-compile, destination=Pdu  # Reference to the global Pdu.
      container SecOCTxPduSecuredArea [0..1]  # This container specifies an area in the Authentic I-Pdu that will be the input to the Authenticator generation algorithm. If this container does not exist in the configuration the complete Authentic I-Pdu will be the input to the Authenticator generation algorithm.
        integer SecOCSecuredTxPduLength: 0..4294967295, post-build-variant-value=true, set at link in variant link-time / post-build in variant post-build / pre-compile in variant pre-compile  # This parameter defines the length (in bytes) of the area within the Pdu which shall be secured
        integer SecOCSecuredTxPduOffset: 0..4294967295, post-build-variant-value=true, set at link in variant link-time / post-build in variant post-build / pre-compile in variant pre-compile, default-value=0  # This parameter defines the start position (offset in bytes) of the area within the Pdu which shall be secured
      choice container SecOCTxSecuredPduLayer  # This container specifies the Pdu that is transmitted by the SecOC module to the PduR after the Mac was generated.
        container SecOCTxSecuredPdu [0..1]  # This container specifies one Pdu that is transmitted by the SecOC module to the PduR after the Mac was generated. This Pdu contains the cryptographic information.
          integer SecOCAuthPduHeaderLength [0..1]: 0..4, set at pre-compile, default-value=0  # This parameter indicates the length (in bytes) of the Secured I-PDU Header in the Secured I-PDU. The length of zero means there's no header in the PDU.
          integer SecOCTxSecuredLayerPduId: 0..65535, set at pre-compile, symbolic-name-value=true  # PDU identifier assigned by SecOC module. | Used by PduR for confirmation (<nowiki>SecOC_[If|Tp]TxConfirmation</nowiki>) and for TriggerTransmit.
          reference SecOCTxSecuredLayerPduRef: post-build-variant-value=true, set at link in variant link-time / post-build in variant post-build / pre-compile in variant pre-compile, destination=Pdu  # Reference to the global Pdu.
        container SecOCTxSecuredPduCollection [0..1]  # This container specifies the Pdu that is transmitted by the SecOC module to the PduR after the Mac was generated. Two separate Pdus are transmitted to the PduR: | Authentic I-PDU and Cryptographic I-PDU.
          container SecOCTxAuthenticPdu  # This container specifies the PDU (that is transmitted by the SecOC module to the PduR) which contains the Secured I-PDU Header and the Authentic I-PDU.
            integer SecOCAuthPduHeaderLength [0..1]: 0..4, set at pre-compile, default-value=0  # This parameter indicates the length (in bytes) of the Secured I-PDU Header in the Secured I-PDU. The length of zero means there's no header in the PDU.
            integer SecOCTxAuthenticPduId: 0..65535, set at pre-compile, symbolic-name-value=true  # PDU identifier of the Authentic I-PDU assigned by SecOC module. Used by PduR for confirmation (SecOC_IfTxConfirmation) and for TriggerTransmit.
            reference SecOCTxAuthenticPduRef: post-build-variant-value=true, set at link in variant link-time / post-build in variant post-build / pre-compile in variant pre-compile, destination=Pdu  # Reference to the global Pdu.
          container SecOCTxCryptographicPdu  # This container specifies the Cryptographic Pdu that is transmitted by the SecOC module to the PduR after the Mac was generated.
            integer SecOCTxCryptographicPduId: 0..65535, set at pre-compile, symbolic-name-value=true  # PDU identifier of the Cryptographic I-PDU assigned by SecOC module. Used by PduR for confirmation (SecOC_IfTxConfirmation) and for TriggerTransmit.
            reference SecOCTxCryptographicPduRef: post-build-variant-value=true, set at link in variant link-time / post-build in variant post-build / pre-compile in variant pre-compile, destination=Pdu  # Reference to the global Pdu.
          container SecOCUseMessageLink [0..1]  # SecOC links an Authentic I-PDU and Cryptographic I-PDU together by repeating a specific part (Message Linker) of the Authentic I-PDU in the Cryptographic I-PDU.
            integer SecOCMessageLinkLen: 0..65535, set at pre-compile  # Length of the Message Linker inside the Authentic I-PDU in bits.
            integer SecOCMessageLinkPos: 0..65535, set at pre-compile  # The position of the Message Linker inside the Authentic I-PDU in bits.
  module definition SoAd [0..1]: post-build-variant-support=true, variants link-time/post-build/pre-compile  # Configuration of the SoAd (Socket Adaptor) module.
    container SoAdBswModules [0..*]  # Each container describes a specific BSW module that the SoAd shall interface to.
      boolean SoAdIf: set at pre-compile  # Specifies if the BSW module supports the Communication Interface APIs or not. Value true means that the APIs are supported. A module can have both Communication Interface APIs and Transport Protocol APIs (e.g. the PduR module).
      boolean SoAdIfTriggerTransmit: set at pre-compile, default-value=false  # Specifies if the BSW module supports the TriggerTransmit API or not. Value true means that the API is supported.
      boolean SoAdIfTxConfirmation: set at pre-compile  # Specifies if the BSW module supports the TxConfirmation API or not. Value true means that the API is supported.
      boolean SoAdLocalIpAddrAssigmentChg: set at pre-compile  # Specifies if the BSW module supports the LocalIpAddrAssigmentChg API or not. Value true means that the API is supported.
      boolean SoAdSoConModeChg: set at pre-compile  # Specifies if the BSW module supports the SoConModeChg API or not. Value true means that the API is supported.
      boolean SoAdTp: set at pre-compile  # Specifies if the BSW module supports the TransportProtocol APIs or not. Value true means that the APIs are supported. A module can have both Communication Interface APIs and Transport Protocol APIs (e.g. the PduR module).
      boolean SoAdUseCallerInfix: set at pre-compile, default-value=true  # Specifies if SoAd shall use (TRUE) the infix "SoAd" when calling an upper layer module function or not (FALSE). E.g. if SoAdUseCallerInfix is TRUE for the upper layer "ABC" then SoAd will call ABC_SoAdIfRxIndication() otherwise SoAd would call ABC_IfRxIndication().
      boolean SoAdUseTypeInfix: set at pre-compile, default-value=true  # Specifies if SoAd shall use (TRUE) the API type infix "Tp" or "If" when calling an upper layer module function or not (FALSE). E.g. if SoAdUseTypeInfix is TRUE for the upper layer "ABC" then SoAd will call ABC_IfRxIndication(), otherwise SoAd would call ABC_RxIndication().
      foreign reference SoAdBswModuleRef: set at pre-compile, destination-type=ECUC-MODULE-CONFIGURATION-VALUES  # This is a reference to one BSW module's configuration (i.e. not the ECUC parameter definition template). | Example, there could be several configurations of PduR and this reference selects one of them. SoAd has to figure out from the structure of the referenced BSW module's configuration, what kind of upper layer he deals with. In case of a CDD SoAd expects UL-APIs in form of _SoAd<If|Tp><function> and expects CDD Pdu configuration structures according to the Ecu Configuration specification (chapter CDD module\Socket Adaptor). In case it is one of the standardized AUTOSAR BSW modules, the configuration structures and API names for interaction with SoAd are defined in the corresponding SWS.
    container SoAdConfig  # This container contains the configuration parameters and sub containers of the AUTOSAR SoAd module.
      container SoAdPduRoute [0..*]  # Describes the path of a PDU from an upper layer of the SoAd to the socket in the TCP/IP stack for transmission. This PDU can consume meta data items of type SOCKET_CONNECTION_ID_16.
        enumeration SoAdTxPduCollectionSemantics: {SOAD_COLLECT_LAST_IS_BEST, SOAD_COLLECT_QUEUED}, post-build-variant-value=true, set at link in variant link-time / post-build in variant post-build / pre-compile in variant pre-compile, default-value=SOAD_COLLECT_QUEUED  # Specifies if this PDU shall be collected using a queued or last-is-best semantics. This parameter is only relevant if the PDU collection feature is enabled. Shall only be set to SOAD_COLLECT_LAST_IS_BEST if the related upper layer is configured with SoAdIfTriggerTransmit set to TRUE.
        integer SoAdTxPduId: 0..65535, scope=ECU, set at pre-compile, symbolic-name-value=true  # Tx PDU ID of the PDU coming from the PDU Router.
        enumeration SoAdTxUpperLayerType: {IF, TP}, scope=ECU, post-build-variant-value=true, set at link in variant link-time / post-build in variant post-build / pre-compile in variant pre-compile  # Specifies the upper layer interface type (must be "IF" in case of multiple PduRoutes).
        reference SoAdTxPduRef: scope=ECU, post-build-variant-value=true, set at link in variant link-time / post-build in variant post-build / pre-compile in variant pre-compile, destination=Pdu  # Reference to the global PDU structure
        container SoAdPduRouteDest [1..*]  # Specifies the PDU route destination.
          integer SoAdTxPduHeaderId [0..1]: 0..4294967296, multiplicity set at link in variant link-time / post-build in variant post-build / pre-compile in variant pre-compile, post-build-variant-multiplicity=true, post-build-variant-value=true, set at link in variant link-time / post-build in variant post-build / pre-compile in variant pre-compile  # ID to be sent on the TCP/IP connection if the PDU header option is enabled.
          enumeration SoAdTxUdpTriggerMode [0..1]: {TRIGGER_ALWAYS, TRIGGER_NEVER}, multiplicity set at link in variant link-time / post-build in variant post-build / pre-compile in variant pre-compile, post-build-variant-multiplicity=true, post-build-variant-value=true, set at link in variant link-time / post-build in variant post-build / pre-compile in variant pre-compile  # Specifies whether a PDU triggers the transmission of the nPduUdpTxBuffer. | If this parameter is set to TRIGGER_NEVER, SoAd shall use an nPduUdpTxBuffer for the related socket connection. nPduUdpTxBuffer can only be used for upper layers with IF API, i.e. this parameter shall only be set to TRIGGER_NEVER if all upper layers belonging to the related socket connection have SoAdTxUpperLayerType set to "IF". This parameter is only relevant for UDP connections.
          float SoAdTxUdpTriggerTimeout [0..1]: 0..INF, multiplicity set at link in variant link-time / post-build in variant post-build / pre-compile in variant pre-compile, post-build-variant-multiplicity=true, post-build-variant-value=true, set at link in variant link-time / post-build in variant post-build / pre-compile in variant pre-compile  # Specifies the timeout in [s] the nPduUdpTxBuffer shall be transmitted at the latest after this PDU is put into the buffer. This optional parameter is only relevant if SoAdTxUdpTriggerMode is TRIGGER_NEVER.
          reference SoAdTxRoutingGroupRef [0..*]: multiplicity set at link in variant link-time / post-build in variant post-build / pre-compile in variant pre-compile, post-build-variant-multiplicity=true, post-build-variant-value=true, set at link in variant link-time / post-build in variant post-build / pre-compile in variant pre-compile, destination=SoAdRoutingGroup  # Reference to the routing group.
          choice reference SoAdTxSocketConnOrSocketConnBundleRef: post-build-variant-value=true, set at link in variant link-time / post-build in variant post-build / pre-compile in variant pre-compile, destination=[SoAdSocketConnection, SoAdSocketConnectionGroup]  # Choice Reference to a SocketConnection or to a SocketConnectionGroup on which the PDU is to be sent on. The reference to a SocketConnectionGroup shall only be used for upper layers with IF API.
      container SoAdRoutingGroup [0..*]  # Each container describes a specific routing group which can be enabled or disabled. A routing group consists of PDUs. Routing of PDUs can either be forwarding of PDUs from the upper layer to a TCP or UDP socket of the TCP/IP stack specified by a SoAdPduRoute or the other way around specified by a SoAdSocketRoute.
        integer SoAdRoutingGroupId: 0..65535, scope=ECU, set at pre-compile, symbolic-name-value=true  # Unique ID of Routing Group
        boolean SoAdRoutingGroupIsEnabledAtInit: post-build-variant-value=true, set at link in variant link-time / post-build in variant post-build / pre-compile in variant pre-compile  # If set to true this routing group will be enabled after initializing the SoAd module (i.e. enabled in the SoAd_Init function).
        boolean SoAdRoutingGroupTxTriggerable: set at pre-compile, default-value=false  # Specifies if the If-TxPDUs related to the PduRouteDest containers | referenced by this routing group can be triggered via SoAd_IfRoutingGroupTransmit (TRUE) or not (FALSE).
      container SoAdSocketConnectionGroup [1..*]  # Specifies the configuration of a socket connection group, i.e. specifies the socket connections belonging to the group and the parameters which are common for all socket connections of the group. A socket connection specifies how data can be received and transmited via a TCP or UDP socket.
        boolean SoAdPduHeaderEnable: post-build-variant-value=true, set at link in variant link-time / post-build in variant post-build / pre-compile in variant pre-compile  # Enables the transmission of the PDU header (ID, length) on this socket connection. | TRUE: add SoAd PDU header before PDU data FALSE: No SoAd PDU header is used
        boolean SoAdSocketAutomaticSoConSetup: post-build-variant-value=true, set at link in variant link-time / post-build in variant post-build / pre-compile in variant pre-compile, default-value=true  # Specifies if the setup of the socket connection shall be done automatically (TRUE) or manually (FALSE) via SoAd_OpenSoCon() and SoAd_CloseSoCon().
        integer SoAdSocketDifferentiatedServicesField [0..1]: 0..63, multiplicity set at link in variant link-time / post-build in variant post-build / pre-compile in variant pre-compile, post-build-variant-multiplicity=true, post-build-variant-value=true, set at link in variant link-time / post-build in variant post-build / pre-compile in variant pre-compile  # The 6-bit Differentiated Service Field in the IP headers may be used for classifying network traffic. If not set a value of zero is used to indicate packets that have not been classified.
        integer SoAdSocketFlowLabel [0..1]: 0..1048575, multiplicity set at link in variant link-time / post-build in variant post-build / pre-compile in variant pre-compile, post-build-variant-multiplicity=true, post-build-variant-value=true, set at link in variant link-time / post-build in variant post-build / pre-compile in variant pre-compile  # The 20-bit Flow Label field in the IPv6 header may be used by a source to label sequences of packets for which it requests special handling by the IPv6 routers, such as non-default quality of service. If not set a Flow Label of zero is used to indicate packets that have not been labeled.
        integer SoAdSocketFramePriority [0..1]: 0..7, multiplicity set at link in variant link-time / post-build in variant post-build / pre-compile in variant pre-compile, post-build-variant-multiplicity=true, post-build-variant-value=true, set at link in variant link-time / post-build in variant post-build / pre-compile in variant pre-compile  # Specifies the priority of the Ethernet frame. | If IEEE 802.1Q VLAN Tags are used, the specified priority will be used in the VLAN Tag PCP filed. If this optional parameter is not available the default priority specified in the TcpIp module is used.
        boolean SoAdSocketIpAddrAssignmentChgNotification: post-build-variant-value=true, set at link in variant link-time / post-build in variant post-build / pre-compile in variant pre-compile, default-value=false  # Specifies if the local IP address assignment change notification callback function of the upper layer shall be called if the assignment of the local IP address used by this socket connection changes.
        integer SoAdSocketLocalPort: 0..65535, post-build-variant-value=true, set at link in variant link-time / post-build in variant post-build / pre-compile in variant pre-compile, default-value=0  # Local UDP or TCP port used for this connection. If this parameter set to 0 SoAd requests TcpIp to select an ephemeral port.
        boolean SoAdSocketMsgAcceptanceFilterEnabled: post-build-variant-value=true, set at link in variant link-time / post-build in variant post-build / pre-compile in variant pre-compile, default-value=true  # Specifies if the message acceptance filter is enabled (TRUE) or not (FALSE). | Note: if a wildcard is used in SoAdSocketRemoteAddress AND SoAdSocketUdpListenOnly is FALSE, this parameter must be TRUE. Note: if multiple SoAdSocketConnections are configured for one SoAdSocketConnectionGroup, this parameter must be TRUE.
        boolean SoAdSocketPathMTUEnable [0..1]: multiplicity set at link in variant link-time / post-build in variant post-build / pre-compile in variant pre-compile, post-build-variant-multiplicity=true, post-build-variant-value=true, set at link in variant link-time / post-build in variant post-build / pre-compile in variant pre-compile, default-value=false  # Specifies if path MTU discovery shall be performed for this connection. If this optional parameter is not available the default behavior configured for the controller in the TcpIp module via the parameter TcpIpIpV4PathMtuEnabled or TcpIpIpV6PathMtuEnabled is applied.
        boolean SoAdSocketSoConModeChgNotification: post-build-variant-value=true, set at link in variant link-time / post-build in variant post-build / pre-compile in variant pre-compile, default-value=false  # Specifies if the SoCon mode change notification callback function of the upper layer shall be called in case of SoCon mode change.
        integer SoAdSocketTpRxBufferMin [0..1]: 0..65535, multiplicity set at link in variant link-time / post-build in variant post-build / pre-compile in variant pre-compile, post-build-variant-multiplicity=true, post-build-variant-value=true, set at link in variant link-time / post-build in variant post-build / pre-compile in variant pre-compile  # Specifies the amount of data in bytes (PDU data for the upper layer and PDU Header if used) the SoAd shall at least be able to buffer for data reception via each socket connection of the socket connection group and using an upper layer with TP. | Note: in case of a TCP socket where PduHeaderMode is used and an upper layer with IF-API, the required buffer size can be determined automatically.
        reference SoAdSocketLocalAddressRef: post-build-variant-value=true, set at link in variant link-time / post-build in variant post-build / pre-compile in variant pre-compile, requires-symbolic-name-value=true, destination=TcpIpLocalAddr  # Local IP address and interface used for this connection.
        reference SoAdSocketSoConModeChgNotifUpperLayerRef [0..1]: multiplicity set at pre-compile, set at pre-compile, destination=SoAdBswModules  # Reference to an additional upper layer that shall receive socket connection state changes (although it is not a direct upper layer of the socket connection).
        container SoAdSocketConnection [1..*]  # Specifies the socket connection (Id and remote address information). | Note: Parameters which are common to all socket connections of a socket connection group are specified directly at the group.
          integer SoAdSocketId: 0..65535, scope=ECU, set at pre-compile, symbolic-name-value=true  # Socket connection identifier used as SoConId in the interaction with upper layers.
          container SoAdSocketRemoteAddress [0..1]  # Subcontainer of SoAdSocketConnection to specify the remote address (IP address and port) for a socket connection. | If SoAdSocketRemoteAddress is not specified the remote address has to be set by the upper layer via SoAd_SetRemoteAddr().
            string SoAdSocketRemoteIpAddress: post-build-variant-value=true, set at link in variant link-time / post-build in variant post-build / pre-compile in variant pre-compile  # IP address of remote node. The configured address must be of the same TcpIpDomainType (i.e. IPv4 or IPv6) as the TcpIpLocalAddr referred by SoAdSocketLocalAddressRef . | To accept any remote IP address, set SoAdSocketRemoteIpAddress to "ANY". See message acceptance policy for more details.
            integer SoAdSocketRemotePort: 0..65535, post-build-variant-value=true, set at link in variant link-time / post-build in variant post-build / pre-compile in variant pre-compile  # Remote UDP or TCP port used for this connection. | To accept any remote port, set SoAdSocketRemotePort to 0. See message acceptance policy for more details.
        choice container SoAdSocketProtocol  # Specifies the transport protocol and transport protocol specific parameters used for the socket connections of the socket connection group.
          container SoAdSocketTcp [0..1]  # Specifies that TCP is used as transport protocol for the socket connection group and parameters only related to TCP socket connections.
            boolean SoAdSocketTcpImmediateTpTxConfirmation: scope=ECU, post-build-variant-value=true, set at link in variant link-time / post-build in variant post-build / pre-compile in variant pre-compile, default-value=false  # If set to FALSE, SoAd notifies the TP upper layer via transmit confirmation after a Tcp Ack has been received. If set to TRUE, SoAd notifies the TP upper layer via transmit confirmation immediately after transmit has been accepted by TcpIp.
            boolean SoAdSocketTcpInitiate: post-build-variant-value=true, set at link in variant link-time / post-build in variant post-build / pre-compile in variant pre-compile  # Specifies the initiator for this TCP connection. It will not be defined for UDP sockets. | TRUE: This TCP connection is initiated by this module. FALSE: This TCP connection is to be initiated in the listen mode.
            boolean SoAdSocketTcpKeepAlive: post-build-variant-value=true, set at link in variant link-time / post-build in variant post-build / pre-compile in variant pre-compile, default-value=false  # Specifies to use the keep-alive mechanism for this connection. It will not be defined for UDP sockets. | TRUE: This TCP connection will use the keep-alive mechanism. FALSE: This TCP connection will not use the keep-alive mechanism. Note: This parameter must not be set to TRUE if TcpIpTcpKeepAliveEnabled is set to FALSE.
            float SoAdSocketTcpKeepAliveInterval [0..1]: 0..INF, multiplicity set at link in variant link-time / post-build in variant post-build / pre-compile in variant pre-compile, post-build-variant-multiplicity=true, post-build-variant-value=true, set at link in variant link-time / post-build in variant post-build / pre-compile in variant pre-compile  # Specifies the interval in seconds between subsequent keepalive probes.
            integer SoAdSocketTcpKeepAliveProbesMax [0..1]: 0..65535, multiplicity set at link in variant link-time / post-build in variant post-build / pre-compile in variant pre-compile, post-build-variant-multiplicity=true, post-build-variant-value=true, set at link in variant link-time / post-build in variant post-build / pre-compile in variant pre-compile  # Maximum number of times that TCP retransmits an individual data segment before aborting the connection.
            float SoAdSocketTcpKeepAliveTime [0..1]: 0..INF, multiplicity set at link in variant link-time / post-build in variant post-build / pre-compile in variant pre-compile, post-build-variant-multiplicity=true, post-build-variant-value=true, set at link in variant link-time / post-build in variant post-build / pre-compile in variant pre-compile, default-value=7200  # Specifies the time in seconds between the last data packet sent and the first keepalive probe.
            boolean SoAdSocketTcpNoDelay [0..1]: multiplicity set at link in variant link-time / post-build in variant post-build / pre-compile in variant pre-compile, post-build-variant-multiplicity=true, post-build-variant-value=true, set at link in variant link-time / post-build in variant post-build / pre-compile in variant pre-compile  # Specifies not to use the congestion control mechanism for this connection. It will not be defined for UDP sockets. | TRUE: This TCP connection will NOT use congestion control. FALSE: This TCP connection will use congestion control. If the optional parameter is not enabled, the default behavior configured for TcpIp via the parameter TcpIpTcpNagleEnabled is applied. Note: This parameter must not be set to FALSE if TcpIpTcpNagleEnabled is set to FALSE.
            integer SoAdSocketTcpTxQuota [0..1]: 0..4294967295, multiplicity set at link in variant link-time / post-build in variant post-build / pre-compile in variant pre-compile, post-build-variant-multiplicity=true, post-build-variant-value=true, set at link in variant link-time / post-build in variant post-build / pre-compile in variant pre-compile  # Specifies the maximum amount of bytes (PDU data provided by the upper layer and PDU Header if used) the SoAd may queue for transmission via TCP at the TcpIp module for each socket connection of this socket connection group. | Rationale: prohibits that a socket connection consumes all available transmit buffers at the TcpIp and blocks transmissions via other socket connections. If the optional parameter is not enabled, the amount of data is not limited.
            reference SoAdSocketTCPOptionFilterRef [0..1]: multiplicity set at link in variant link-time / post-build in variant post-build / pre-compile in variant pre-compile, post-build-variant-multiplicity=true, post-build-variant-value=true, set at link in variant link-time / post-build in variant post-build / pre-compile in variant pre-compile, requires-symbolic-name-value=true, destination=TcpIpTcpConfigOptionFilter  # Specifies which TCP option filter shall be applied on the related socket.
            reference SoAdSocketTcpTlsConnectionRef [0..1]: multiplicity set at pre-compile, set at pre-compile, requires-symbolic-name-value=true, destination=TcpIpTlsConnection  # If set the TCP socket is assigned to a TLS connection. The SoAd need to call Tcpip_ChangeParameter with the reference to the TLS connection as the parameter.
          container SoAdSocketUdp [0..1]  # Specifies that UDP is used as transport protocol for the socket connection group and parameters only related to UDP socket connections.
            integer SoAdSocketnPduUdpTxBufferMin [0..1]: 0..65535, multiplicity set at link in variant link-time / post-build in variant post-build / pre-compile in variant pre-compile, post-build-variant-multiplicity=true, post-build-variant-value=true, set at link in variant link-time / post-build in variant post-build / pre-compile in variant pre-compile  # Specifies the amount of data in bytes (PDU data provided by the upper layer and PDU Header if used) the SoAd shall be able to buffer for data transmission via this socket connection in case the UDP message shall be buffered for transmission of multiple PDUs per UDP. | Note: in case of a UDP socket and an upper layer with TP API is configured, the required buffer size can be determined automatically. This optional parameter is only relevant if a nPduUdpTxBuffer is used.
            float SoAdSocketUdpAliveSupervisionTimeout [0..1]: 0..INF, multiplicity set at link in variant link-time / post-build in variant post-build / pre-compile in variant pre-compile, post-build-variant-multiplicity=true, post-build-variant-value=true, set at link in variant link-time / post-build in variant post-build / pre-compile in variant pre-compile  # Specifies the time in [s] a UDP socket connection remains in the mode SOAD_SOCON_ONLINE after the latest reception of a frame from the remote peer specified by the remote address. If this optional parameter is not enabled UDP Alive Supervision is deactivated for the related socket connection group.
            boolean SoAdSocketUdpChecksumEnabled: post-build-variant-value=true, set at link in variant link-time / post-build in variant post-build / pre-compile in variant pre-compile, default-value=true  # Specifies if UDP checksum calculation shall be enabled (TRUE) or skipped (FALSE) on the related socket. FALSE implies that the upper layer of the socket connection is either capable to handle malformed messages or applies a checksum mechanism itself.
            boolean SoAdSocketUdpListenOnly: post-build-variant-value=true, set at link in variant link-time / post-build in variant post-build / pre-compile in variant pre-compile, default-value=false  # Specifies if the socket connection group is only used for reception (TRUE) or used for both reception and transmission (FALSE).
            boolean SoAdSocketUdpStrictHeaderLenCheckEnabled: post-build-variant-value=true, set at link in variant link-time / post-build in variant post-build / pre-compile in variant pre-compile, default-value=false  # Specifies if UDP messages shall be dropped (TRUE) if the length of all contained PDUs does not match the length of the whole message or not (FALSE). Shall only be set to TRUE if SoAdPduHeaderEnable is also set to TRUE.
            float SoAdSocketUdpTriggerTimeout [0..1]: 0..INF, multiplicity set at link in variant link-time / post-build in variant post-build / pre-compile in variant pre-compile, post-build-variant-multiplicity=true, post-build-variant-value=true, set at link in variant link-time / post-build in variant post-build / pre-compile in variant pre-compile  # Specifies the timeout in [s] a nPduUdpTxBuffer is waiting for a PDU with TriggerMode = TRIGGER_ALWAYS, i.e. when the timeout expires the nPduUdpTxBuffer is transmitted. Timer is reset after each UDP transmission. This optional parameter is only relevant if a nPduUdpTxBuffer is used.
      container SoAdSocketRoute [0..*]  # Describes the path of a PDU from a socket in the TCP/IP stack to an upper layer of the SoAd after reception in the TCP/IP Stack.
        integer SoAdRxPduHeaderId [0..1]: 0..4294967296, multiplicity set at link in variant link-time / post-build in variant post-build / pre-compile in variant pre-compile, post-build-variant-multiplicity=true, post-build-variant-value=true, set at link in variant link-time / post-build in variant post-build / pre-compile in variant pre-compile  # ID contained in the packet received on the TCP/IP connection if the PDU header option is enabled.
        choice reference SoAdRxSocketConnOrSocketConnBundleRef: post-build-variant-value=true, set at link in variant link-time / post-build in variant post-build / pre-compile in variant pre-compile, destination=[SoAdSocketConnection, SoAdSocketConnectionGroup]  # Choice Reference to a SocketConnection or to a SocketConnectionGroup on which the PDU was received. The reference to a SocketConnectionGroup shall only be used for upper layers with IF API.
        container SoAdSocketRouteDest [1..*]  # Describes the upper layer destination PDU for a message received on a TcpIp socket. This PDU can produce meta data items of type SOCKET_CONNECTION_ID_16. | Multiple socket route destinations in the SoAdSocketRoute can only be used for upper layers of interface type (IF) and only for SoAdSocketRoute referring a SocketConnectionGroup. In this case SoAdRoutingGroups shall be used to map each SoAdSocketRouteDest uniquely to different socket connections of the SocketConnectionGroup.
          integer SoAdRxPduId [0..1]: 0..65535, scope=ECU, multiplicity set at link in variant link-time / post-build in variant post-build / pre-compile in variant pre-compile, post-build-variant-multiplicity=true, post-build-variant-value=true, set at link in variant link-time / post-build in variant post-build / pre-compile in variant pre-compile  # This unique identifier is used for a receive cancellation request from an upper layer of the SoAd.
          enumeration SoAdRxUpperLayerType: {IF, TP}, scope=ECU, post-build-variant-value=true, set at link in variant link-time / post-build in variant post-build / pre-compile in variant pre-compile  # Specifies the upper layer interface type (must be "IF" in case of multiple RxPdus).
          reference SoAdRxPduRef: scope=ECU, post-build-variant-value=true, set at link in variant link-time / post-build in variant post-build / pre-compile in variant pre-compile, destination=Pdu  # Reference to the global PDU structure
          reference SoAdRxRoutingGroupRef [0..*]: multiplicity set at link in variant link-time / post-build in variant post-build / pre-compile in variant pre-compile, post-build-variant-multiplicity=true, post-build-variant-value=true, set at link in variant link-time / post-build in variant post-build / pre-compile in variant pre-compile, destination=SoAdRoutingGroup  # Reference to the routing group. Mandatory if the parent SoAdSocketRoute contains more than one SoAdSocketRouteDest."
    container SoAdGeneral  # This container contains all global configuration parameters of SoAd.
      boolean SoAdDevErrorDetect: set at pre-compile, default-value=false  # Switches the development error detection and notification on or off. | * true: detection and notification is enabled. * false: detection and notification is disabled.
      boolean SoAdGetAndResetMeasurementDataApi: scope=ECU, set at pre-compile  # Enables / Disables the Get and Reset Measurement Data API
      boolean SoAdIPv6AddressEnabled: scope=ECU, set at pre-compile  # Allows for increased memory allocation to store IPv6 addresses. | TRUE: Enables support for IPv6 addresses FALSE: Only IPv4 addresses are supported
      float SoAdMainFunctionPeriod: 0..INF, scope=ECU, set at pre-compile  # Determines the frequency at which the SoAd_MainFunction() is called in [s].
      integer SoAdRoutingGroupMax: 0..65535, set at pre-compile  # Specifies the maximum number of SoAd routing groups. Furthermore it defines the platform type used for RoutingGroupIdType. If SoAdRoutingGroupMax is not greater than 256, a uint8 is used, | otherwise a uint16.
      integer SoAdSoConMax: 0..65535, set at pre-compile  # Specifies the maximum number of SoAd socket connections. | Furthermore it defines the platform type used for SoAd_SoConIdType. If SoAdSoConMax is not greater than 256, a uint8 is used, otherwise uint16.
      boolean SoAdVersionInfoApi: set at pre-compile, default-value=false  # Activates the SoAd_GetVersionInfo() API. | TRUE: Enables the SoAd_GetVersionInfo() API. FALSE: SoAd_GetVersionInfo() API is not included.
  module definition SomeIpTp [0..1]: post-build-variant-support=true, variants link-time/post-build/pre-compile  # Configuration of the SomeIpTp module.
    container SomeIpTpChannel [1..*]: multiplicity set at link in variant link-time / post-build in variant post-build / pre-compile in variant pre-compile, post-build-variant-multiplicity=true  # This container contains the configuration parameters of the SomeIpTp channel.
      float SomeIpTpNPduSeparationTime: 0..INF, post-build-variant-value=true, set at link in variant link-time / post-build in variant post-build / pre-compile in variant pre-compile  # Sets the duration of the minimum time in seconds the SomeIpTp module shall wait between the transmissions of N-PDUs.
      float SomeIpTpRxTimeoutTime: 0..INF, post-build-variant-value=true, set at link in variant link-time / post-build in variant post-build / pre-compile in variant pre-compile  # Timer to monitor the successful reception. It is started when the first NPdu is received, restarted after reception of intermediate NPdus, and is stopped when the last NPdu has been received. The value shall be calculated as follows: (SomeIpTpRxTimeoutTime = SomeIpTpNPduSeparationTime + budget), where the time budget compensates intermediary hops and jitters within the ECU implementation.
      container SomeIpTpRxNSdu [0..*]: multiplicity set at link in variant link-time / post-build in variant post-build / pre-compile in variant pre-compile, post-build-variant-multiplicity=true  # The following parameters needs to be configured for each N-SDU which has to be passed as one assembled RxPdu to the upper layer.
        reference SomeIpTpRxSduRef: post-build-variant-value=true, set at link in variant link-time / post-build in variant post-build / pre-compile in variant pre-compile, destination=Pdu  # Reference to a Pdu in the COM-Stack that represents the assembled RxPdu which is passed via the PduR to the upper layer.
        container SomeIpTpRxNPdu  # This container contains the configuration parameters of the NPdu that is received from a lower layer
          integer SomeIpTpRxNPduHandleId: 0..65535, set at pre-compile, symbolic-name-value=true  # This parameter defines the handle ID that is used by the PduR when calling SomeIpTp_RxIndication.
          reference SomeIpTpRxNPduRef: post-build-variant-value=true, set at link in variant link-time / post-build in variant post-build / pre-compile in variant pre-compile, destination=Pdu  # Reference to a global Pdu that is used to harmonize HandleIDs in the COM-Stack.
      container SomeIpTpTxNSdu [0..*]: multiplicity set at link in variant link-time / post-build in variant post-build / pre-compile in variant pre-compile, post-build-variant-multiplicity=true  # The following parameters needs to be configured for each N-SDU that the SomeIpTp module transmits via the SomeIpTpChannel.
        integer SomeIpTpTxNSduHandleId: 0..65535, set at pre-compile, symbolic-name-value=true  # This parameter defines the handle ID of the NSdu that represents the original TxSdu which is segmented and passed via the PduR to the lower layer. This handle ID is used by PduR when calling SomeIpTp_Transmit.
        reference SomeIpTpTxNSduRef: post-build-variant-value=true, set at link in variant link-time / post-build in variant post-build / pre-compile in variant pre-compile, destination=Pdu  # Reference to a global Pdu in the COM-Stack that represents the original TxSdu which is segmented and passed via the PduR to the lower layer.
        container SomeIpTpTxNPdu  # This container contains the configuration parameters of the segmented Tx NPdus that are transmitted to a lower layer.
          integer SomeIpTpTxNPduHandleId: 0..65535, set at pre-compile, symbolic-name-value=true  # This parameter defines the handle ID that is used by PduR when calling SomeIpTp_TriggerTransmit.
          reference SomeIpTpTxNPduRef: post-build-variant-value=true, set at link in variant link-time / post-build in variant post-build / pre-compile in variant pre-compile, destination=Pdu  # Reference to a global Pdu that is used to harmonize HandleIDs in the COM-Stack.
    container SomeIpTpGeneral  # This container contains the general configuration parameters of the SomeIpTp module.
      boolean SomeIpTpDevErrorDetect: set at pre-compile  # Switches the Development Error Detection and Notification ON or OFF.
      float SomeIpTpRxMainFunctionPeriod: 0..INF, set at pre-compile  # This parameter defines the cycle time in seconds of the periodic call of the SomeIpTp_MainFunctionRx.
      float SomeIpTpTxMainFunctionPeriod: 0..INF, set at pre-compile  # This parameter defines the cycle time in seconds of the periodic call of the SomeIpTp_MainFunctionTx.
      boolean SomeIpTpVersionInfoApi: set at pre-compile, default-value=false  # Activates the SomeIpTp_GetVersionInfo() API. | TRUE: Enables the SomeIpTp_GetVersionInfo() API. FALSE: SomeIpTp_GetVersionInfo() API is not included.
