[part 7 of 10: package /AUTOSAR/EcucDefs]
AUTOSAR XML (schema 00048)
package /AUTOSAR/EcucDefs  (continued)
  module definition FrNm [0..1]: post-build-variant-support=true, variants link-time/post-build/pre-compile  # The Flexray Nm module
    container FrNmChannelConfig  # This container contains the configuration parameters for all FlexRay NM channels.
      container FrNmChannel [1..*]: multiplicity set at pre-compile  # This container contains the configuration parameters for a FlexRay NM Channel.
        container FrNmChannelIdentifiers  # This container contains instance specific identifiers related to the respective FlexRay Channel.
          boolean FrNmActiveWakeupBitEnabled [0..1]: multiplicity set at link in variant link-time+post-build / pre-compile in variant pre-compile, set at link in variant link-time+post-build / pre-compile in variant pre-compile, default-value=false  # Enables/Disables the handling of the Active Wakeup Bit in the FrNm module.
          integer FrNmCarWakeUpBitPosition [0..1]: 0..7, multiplicity set at link in variant link-time+post-build / pre-compile in variant pre-compile, set at link in variant link-time+post-build / pre-compile in variant pre-compile  # Specifies the Bit position of the CWU within the NM-Message.
          integer FrNmCarWakeUpBytePosition [0..1]: 2..7, multiplicity set at link in variant link-time+post-build / pre-compile in variant pre-compile, set at link in variant link-time+post-build / pre-compile in variant pre-compile  # Specifies the Byte position of the CWU within the NM-Message.
          boolean FrNmCarWakeUpFilterEnabled [0..1]: multiplicity set at link in variant link-time+post-build / pre-compile in variant pre-compile, set at link in variant link-time+post-build / pre-compile in variant pre-compile  # If CWU filtering is supported, only the CWU bit within the NM message with source node identifier | FrNmCarWakeUpFilterNodeId is considered as CWU request. FALSE - CWU Filtering is not supported TRUE - CWU Filtering is supported
          integer FrNmCarWakeUpFilterNodeId [0..1]: 0..255, multiplicity set at link in variant link-time+post-build / pre-compile in variant pre-compile, set at link in variant link-time+post-build / pre-compile in variant pre-compile  # Source node identifier for CWU filtering. If CWU filtering is supported, only the CWU bit within the NM | message with source node identifier FrNmCarWakeUpFilterNodeId is considered as CWU request.
          boolean FrNmCarWakeUpRxEnabled: set at link in variant link-time+post-build / pre-compile in variant pre-compile  # Enables or disables support of CarWakeUp bit evaluation in received NM messages. | FALSE - CarWakeUp not supported TRUE - CarWakeUp supported
          boolean FrNmNodeDetectionEnabled: set at link in variant link-time+post-build / pre-compile in variant pre-compile  # This parameter is used to enable or disable node detection support for a FrNm Channel.
          integer FrNmNodeId: 0..255, post-build-variant-value=true, set at link in variant link-time / post-build in variant post-build / pre-compile in variant pre-compile  # NM node identifier configured for the respective FlexRay Channel. | It is used for identifying the respective NM node in the NM-cluster. It must be unique for each NM node within one NM cluster.
          enumeration FrNmPduScheduleVariant: {FRNM_PDU_SCHEDULE_VARIANT_1, FRNM_PDU_SCHEDULE_VARIANT_2, FRNM_PDU_SCHEDULE_VARIANT_3, FRNM_PDU_SCHEDULE_VARIANT_4, FRNM_PDU_SCHEDULE_VARIANT_5, FRNM_PDU_SCHEDULE_VARIANT_6, FRNM_PDU_SCHEDULE_VARIANT_7}, origin=ECUC_AUTOSAR, set at link in variant link-time+post-build / pre-compile in variant pre-compile  # This parameter defines the PDU scheduling variant that should be used for this channel. | Option 1 NM-Vote and NM-Data in static segment (one PDU) Option 2 NM-Vote and NM-Data in dynamic segment (one PDU) Option 3 NM-Vote and NM-Data in static segment (separate PDU) Option 4 NM-Vote in static segment and NM-Data in dynamic segment Option 5 NM-Vote in dynamic segment and NM-Data in static segment Option 6 NM-Vote and NM-Data in dynamic segment (separate PDU) Option 7 Combined NM-Vote and CBV in static segment and NM-Data in dynamic segment
          boolean FrNmPnEnabled: post-build-variant-value=true, set at link in variant link-time / post-build in variant post-build / pre-compile in variant pre-compile, default-value=false  # Enables or disables support of partial networking. | false: Partial networking Range not supported true: Partial networking supported
          boolean FrNmPnEraCalcEnabled [0..1]: multiplicity set at link in variant link-time+post-build / pre-compile in variant pre-compile, set at link in variant link-time+post-build / pre-compile in variant pre-compile, default-value=false  # Specifies if FrNm calculates the PN request information for external requests. (ERA) | false: PN request are not calculated true: PN request are calculated
          boolean FrNmSourceNodeIdentifierEnabled: set at link in variant link-time+post-build / pre-compile in variant pre-compile  # This parameter is used to enable or disable SourceNodeIdentifier support for a FrNm Channel.
          boolean FrNmSynchronizationPointEnabled: set at link in variant link-time+post-build / pre-compile in variant pre-compile  # This parameter defines if this channel shall provide the synchronization point indication to the NM Interface.
          reference FrNmChannelHandle: scope=ECU, post-build-variant-value=true, set at link in variant link-time / post-build in variant post-build / pre-compile in variant pre-compile, requires-symbolic-name-value=true, destination=FrIfCluster  # Channel identifier configured for the respective instance of the NM. | The FrNmChannelHandle shall be encoded in the FrNmRxPduId parameter which is passed to FrNm_RxIndication() function called by the FrIf.
          reference FrNmComMNetworkHandleRef: post-build-variant-value=true, set at link in variant link-time / post-build in variant post-build / pre-compile in variant pre-compile, requires-symbolic-name-value=true, destination=ComMChannel  # This reference points to the unique channel defined by the ComMChannel and provides access to the unique channel index value in ComMChannelId.
          reference FrNmPnEraRxNSduRef [0..1]: multiplicity set at link in variant link-time+post-build / pre-compile in variant pre-compile, post-build-variant-value=true, set at link in variant link-time+post-build / pre-compile in variant pre-compile, destination=Pdu  # Reference to a global Pdu. The SduRef is required for every FrNm Channel, because ERA is reported per channel.
          container FrNmRxPdu [1..*]  # This container describes the FlexRay NM RX PDU:s.
            boolean FrNmRxPduContainsData: post-build-variant-value=true, set at link in variant link-time / post-build in variant post-build / pre-compile in variant pre-compile  # This parameter defines if the PDU contains NM Data.
            boolean FrNmRxPduContainsVote: post-build-variant-value=true, set at link in variant link-time / post-build in variant post-build / pre-compile in variant pre-compile  # This parameter defines if the PDU contains NM Vote information.
            integer FrNmRxPduId: 0..65535, post-build-variant-value=true, set at pre-compile, symbolic-name-value=true  # PDU identifier configured for the respective FlexRay Channel. | It is used for referring to the FlexRay Interface receive function. It must be consistent with the value configured in the FlexRay Interface. This ID is used for the combined reception of NM Vote and NM Data or for the reception of the NM Vote if NM Data is received in a separate PDU. ImplementationType: PduIdType
            reference FrNmRxPduRef: scope=ECU, post-build-variant-value=true, set at link in variant link-time / post-build in variant post-build / pre-compile in variant pre-compile, destination=Pdu  # The reference to a PDU in the global PDU structure described in the AUTOSAR ECU Configuration Specification. This reference will be used by the FrIf module to derive the PDU Id.
          container FrNmTxPdu [0..4]  # This container describes the FlexRay NM TX PDU:s.
            integer FrNmTxConfirmationPduId: 0..65535, post-build-variant-value=true, set at pre-compile, symbolic-name-value=true  # Handle Id used by the Lower Layer when calling FrNm_TriggerTransmit() or FrNm_TxConfirmation().
            boolean FrNmTxPduContainsData: post-build-variant-value=true, set at link in variant link-time / post-build in variant post-build / pre-compile in variant pre-compile  # This parameted defines if the PDU contains NM Data.
            boolean FrNmTxPduContainsVote: post-build-variant-value=true, set at link in variant link-time / post-build in variant post-build / pre-compile in variant pre-compile  # This parameted defines if the PDU contains NM Vote information.
            reference FrNmTxPduRef: scope=ECU, post-build-variant-value=true, set at link in variant link-time / post-build in variant post-build / pre-compile in variant pre-compile, destination=Pdu  # The reference to a PDU in the global PDU structure described in the AUTOSAR ECU Configuration Specification. This reference is used to derive the PDU Id that is defined by the FrIf module.
          container FrNmUserDataTxPdu [0..1]  # This optional container is used to configure the UserNm PDU. This container is only available if FrNmComUserDataSupport is enabled.
            integer FrNmTxUserDataPduId: 0..65535, set at pre-compile, symbolic-name-value=true  # This parameter defines the Handle ID of the NM User Data I-PDU.
            reference FrNmTxUserDataPduRef: post-build-variant-value=true, set at link in variant link-time / post-build in variant post-build / pre-compile in variant pre-compile, destination=Pdu  # Reference to the NM User Data I-PDU in the global PDU collection.
        container FrNmChannelTiming  # This container contains instance-specific timing related to the respective FlexRay Channel.
          enumeration FrNmDataCycle: {FRNM_CYCLE_VALUE_1, FRNM_CYCLE_VALUE_16, FRNM_CYCLE_VALUE_2, FRNM_CYCLE_VALUE_32, FRNM_CYCLE_VALUE_4, FRNM_CYCLE_VALUE_64, FRNM_CYCLE_VALUE_8}, set at link in variant link-time+post-build / pre-compile in variant pre-compile  # Number of FlexRay Schedule Cycles needed to transmit the NM Data of all ECUs on the FlexRay bus
          float FrNmMainFunctionPeriod: 0..INF, set at link in variant link-time+post-build / pre-compile in variant pre-compile  # This parameter defines the processing cycle of the main function of FrNm module in seconds.
          integer FrNmReadySleepCnt: 0..65535, set at link in variant link-time+post-build / pre-compile in variant pre-compile  # FrNm switches to bus sleep mode at the end of the FrNmReadySleepCnt+1 repetition cycle without any NM vote. E.g. on a value of "1", the NM-State Machine will leave the Ready Sleep State after two NM Repetition Cycles with no "keep awake" votes.
          float FrNmRemoteSleepIndTime: 0..65.535, set at link in variant link-time+post-build / pre-compile in variant pre-compile  # Timeout for Remote Sleep Indication. It defines the time in seconds how long it shall take to recognize that all other nodes are ready to sleep. | The value "0" denotes that no Remote Sleep Indication functionality is configured.
          float FrNmRepeatMessageTime: 0..65.535, scope=ECU, set at link in variant link-time+post-build / pre-compile in variant pre-compile  # Timeout for Repeat Message State. Defines the time in seconds how long the NM shall stay in the Repeat Message State. | The value "0" denotes that no Repeat Message State is configured, which means that Repeat Message State is transient and implies that it is left immediately after entry and consequently no startup stability is guaranteed and no node detection procedure is possible.
          enumeration FrNmRepetitionCycle: {FRNM_CYCLE_VALUE_1, FRNM_CYCLE_VALUE_16, FRNM_CYCLE_VALUE_2, FRNM_CYCLE_VALUE_32, FRNM_CYCLE_VALUE_4, FRNM_CYCLE_VALUE_64, FRNM_CYCLE_VALUE_8}, set at link in variant link-time+post-build / pre-compile in variant pre-compile  # Number of Flexray Schedule Cycles used to repeat the transmission of the Nm vote of all ECUs on the Flexray Bus.
          boolean FrNmVoteInhibitionEnabled: set at pre-compile  # Pre-processor switch for enabling the inhibition of vote changes from the next-to-last repetition cycle to the last repetition cycle before the Ready Sleep Counter expires.
          enumeration FrNmVotingCycle: {FRNM_CYCLE_VALUE_1, FRNM_CYCLE_VALUE_16, FRNM_CYCLE_VALUE_2, FRNM_CYCLE_VALUE_32, FRNM_CYCLE_VALUE_4, FRNM_CYCLE_VALUE_64, FRNM_CYCLE_VALUE_8}, set at link in variant link-time+post-build / pre-compile in variant pre-compile  # Number of FlexRay Schedule Cycles needed to transmit the Nm vote of all ECUs on the FlexRay Bus.
    container FrNmGlobalConfig  # This container contains all global configuration parameters for the FrNm module.
      container FrNmGlobalFeatures  # This container contains module features related to the FlexRay NM functionality.
        boolean FrNmBusSynchronizationEnabled: set at pre-compile  # Pre-processor switch for enabling the bus synchronization.
        boolean FrNmComUserDataSupport: set at pre-compile  # Preprocessor switch for enabling the Tx path of Com User Data. | Use case: Setting of NMUserData via SWC.
        boolean FrNmCoordinatorSyncSupport: set at pre-compile  # Enables/disables the coordinator synchronization support.
        boolean FrNmCycleCounterEmulation: set at pre-compile  # Pre-processor switch for enabling the cycle counter emulation.
        boolean FrNmDualChannelPduEnable: set at pre-compile  # Pre-processor switch for enabling the support of dual channel transmission and reception of NM messages.
        boolean FrNmHwVoteEnable: set at pre-compile  # Pre-processor switch for enabling the processing of FlexRay Hardware aggregated NM-Votes. This switch enables/disables the optional API FrIf_GetNmVector.
        boolean FrNmPassiveModeEnabled: set at pre-compile  # Pre-processor switch for enabling Passive Node Configuration support.
        boolean FrNmPduRxIndicationEnabled: set at pre-compile  # Pre-processor switch for enabling PDU reception indication.
        boolean FrNmPnEiraCalcEnabled [0..1]: multiplicity set at link in variant link-time+post-build / pre-compile in variant pre-compile, set at link in variant link-time+post-build / pre-compile in variant pre-compile, default-value=false  # Specifies if FrNm calculates the PN request information for internal an external requests. (EIRA) | true: PN request are calculated false: PN request are not calculated
        float FrNmPnResetTime [0..1]: 0.001..65.535, multiplicity set at link in variant link-time+post-build / pre-compile in variant pre-compile, set at link in variant link-time+post-build / pre-compile in variant pre-compile  # Specifies the runtime of the reset timer in seconds. This reset time is valid for the reset of PN requests in the EIRA and in the ERA. The value shall be the same for every channel. Thus it is a global config parameter.
        boolean FrNmRemoteSleepIndicationEnabled: set at pre-compile  # Pre-processor switch for enabling remote sleep indication. | calculationFormula = If (FrNmPassiveModeEnabled == True) then Equal(False) else Equal(False or True)
        boolean FrNmStateChangeIndicationEnabled: set at pre-compile  # Pre-processor switch for enabling state change indication.
        boolean FrNmUserDataEnabled: set at pre-compile  # Pre-processor switch for enabling user data support.
        boolean FrNmVotingNextToLastRepetitionCycleDisable: set at pre-compile  # Pre-processor switch for disabling vote changes in the last two | repetition cycles before the Ready Sleep Counter expires.
        reference FrNmPnEiraRxNSduRef [0..1]: multiplicity set at link in variant link-time+post-build / pre-compile in variant pre-compile, post-build-variant-value=true, set at link in variant link-time+post-build / pre-compile in variant pre-compile, destination=Pdu  # Reference to a Pdu in the COM-Stack. | Only one SduRef is required for FrNm because the EIRA is the aggregation over all FlexRay Channels.
        container FrNmPnInfo [0..1]  # PN information configuration
          integer FrNmPnInfoLength: 1..7, set at link in variant link-time+post-build / pre-compile in variant pre-compile, default-value=1  # Specifies the length of the PN request information in the NM message.
          integer FrNmPnInfoOffset: 1..7, set at link in variant link-time+post-build / pre-compile in variant pre-compile, default-value=1  # Specifies the offset of the PN request information in the NM message.
          container FrNmPnFilterMaskByte [0..7]  # Filter mask byte configuration
            integer FrNmPnFilterMaskByteIndex: 0..6, post-build-variant-value=true, set at link in variant link-time+post-build / pre-compile in variant pre-compile  # Index of the filter mask byte. Specifies the position within the filter mask byte array.
            integer FrNmPnFilterMaskByteValue: 0..255, post-build-variant-value=true, set at link in variant link-time / post-build in variant post-build / pre-compile in variant pre-compile, default-value=0  # Parameter to configure the filter mask byte.
      container FrNmGlobalProperties  # This container contains module properties related to the FlexRay NM functionality.
        boolean FrNmDevErrorDetect: set at pre-compile, default-value=false  # Switches the development error detection and notification on or off. | * true: detection and notification is enabled. * false: detection and notification is disabled.
        boolean FrNmMainAcrossFrCycle: set at link in variant link-time+post-build / pre-compile in variant pre-compile  # If the FlexRay NM MainFunction is executed completely within the FlexRay communication cycle where the last NM vote of the current vote cycle is received, the FrNmMainAcrossFrCycle shall be configured to FALSE. | If the FlexRay NM MainFunction is executed completely within the FlexRay communication cycle subsequent to the one where the last NM vote of the current vote cycle is received, the FrNmMainAcrossFrCycle shall be configured to TRUE.
        boolean FrNmVersionInfoApi: set at pre-compile, default-value=false  # Pre-processor switch for enabling version info API support.
  module definition FrSM [0..1]: post-build-variant-support=true, variants link-time/post-build/pre-compile  # Configuration of the FlexRay State Manager
    container FrSMConfig  # This container comprises the cluster specific configuration of the FlexRay State Manager.
      container FrSMCluster [1..*]  # This container specifies a FlexRay cluster and all related data. A FlexRay cluster may consist of more than one controller per ECU.
        boolean FrSMCheckWakeupReason: post-build-variant-value=true, set at link in variant link-time / post-build in variant post-build / pre-compile in variant pre-compile  # If FrSMCheckWakeupReason is true, the FrSM will check the wakeup reason in order to skip the wakeup in case of wakeup by bus. If FrSMCheckWakeupReason is false, the FrSM will always try to perform a wakeup.
        boolean FrSMDelayStartupWithoutWakeup: post-build-variant-value=true, set at link in variant link-time / post-build in variant post-build / pre-compile in variant pre-compile  # If true, timer t1 shall be started instead of immediately calling FrIf_AllowColdstart in case of a startup without wakeup.
        float FrSMDurationT1: 0..INF, post-build-variant-value=true, set at link in variant link-time / post-build in variant post-build / pre-compile in variant pre-compile  # The duration of timer t1 in seconds. | A value of 0 shall imply that the timer is not used.
        float FrSMDurationT2: 0..INF, post-build-variant-value=true, set at link in variant link-time / post-build in variant post-build / pre-compile in variant pre-compile  # The duration of timer t2 in seconds. | A value of 0 shall imply that the timer is not used. The value of this parameter shall be larger than the value of FrSMDurationT1 parameter.
        float FrSMDurationT3: 0..INF, post-build-variant-value=true, set at link in variant link-time / post-build in variant post-build / pre-compile in variant pre-compile  # The duration of timer t3 in seconds. The value of this parameter shall be larger than the value of FrSMDurationT1 parameter. | A value of 0 shall imply that the timer is not used. It shall only be possible to configure a value 0 if no FrNm is used.
        float FrSMDurationT4: 0..INF, post-build-variant-value=true, set at link in variant link-time / post-build in variant post-build / pre-compile in variant pre-compile  # The timer t4 ensures that a dual channel node will eventually clear its coldstart inhibit bit and become a leading coldstarter.
        boolean FrSMIsColdstartEcu: post-build-variant-value=true, set at link in variant link-time / post-build in variant post-build / pre-compile in variant pre-compile  # True: The ECU is a coldstart node for this FlexRay cluster. | False: The ECU is no coldstart node for this FlexRay cluster.
        boolean FrSMIsWakeupEcu: post-build-variant-value=true, set at link in variant link-time / post-build in variant post-build / pre-compile in variant pre-compile  # True: FrSM shall perform a wakeup for this cluster. | False: FrSM shall never perform a wakeup for this FlexRay cluster.
        float FrSMMainFunctionCycleTime: 0..INF, set at link in variant link-time+post-build / pre-compile in variant pre-compile  # This parameter defines the cycle time in seconds of the periodic calling of FrSM main function.
        integer FrSMMinNumberOfColdstarter [0..1]: 0..255, multiplicity set at link in variant link-time / post-build in variant post-build / pre-compile in variant pre-compile, post-build-variant-multiplicity=true, post-build-variant-value=true, set at link in variant link-time / post-build in variant post-build / pre-compile in variant pre-compile  # This parameter defines the number of coldstarter that should not be underrun. If this parameter is not configured the mainfunction shall not check the number of startup frames.
        integer FrSMNumWakeupPatterns: 0..65535, post-build-variant-value=true, set at link in variant link-time / post-build in variant post-build / pre-compile in variant pre-compile  # Maximum number of Wakeup Patterns the node may send before going to FRSM_STARTUP.
        integer FrSMStartupRepetitions [0..1]: 0..65535, multiplicity set at link in variant link-time / post-build in variant post-build / pre-compile in variant pre-compile, post-build-variant-multiplicity=true, post-build-variant-value=true, set at link in variant link-time / post-build in variant post-build / pre-compile in variant pre-compile  # The number of times an ECU may repeat the startup procedure for a FlexRay cluster.
        integer FrSMStartupRepetitionsWithWakeup [0..1]: 0..65535, multiplicity set at link in variant link-time / post-build in variant post-build / pre-compile in variant pre-compile, post-build-variant-multiplicity=true, post-build-variant-value=true, set at link in variant link-time / post-build in variant post-build / pre-compile in variant pre-compile  # The number of times an ECU may repeat the startup procedure including a wakeup for a FlexRay cluster.
        float FrSMTrcvStdbyDelay [0..1]: 0..INF, multiplicity set at link in variant link-time / post-build in variant post-build / pre-compile in variant pre-compile, post-build-variant-multiplicity=true, post-build-variant-value=true, set at link in variant link-time / post-build in variant post-build / pre-compile in variant pre-compile  # The duration of timer t_TrcvStdbyDelay in seconds. The granularity of this parameter shall be restricted to full FlexRay cycles (FrIfGdCycle). | A value of 0 shall imply that the timer is not used.
        reference FrSMComMNetworkHandleRef: set at link in variant link-time+post-build / pre-compile in variant pre-compile, requires-symbolic-name-value=true, destination=ComMChannel  # Reference to the unique handle to identify one certain FlexRay network correspond to one of the network handles of the ComM configuration.
        reference FrSMFrIfClusterRef: post-build-variant-value=true, set at link in variant link-time+post-build / pre-compile in variant pre-compile, requires-symbolic-name-value=true, destination=FrIfCluster  # References the cluster configuration in the FlexRay Interface configuration. | Note that the assigned controllers and transceivers are defined in the FrIf configuration and can be accessed via this reference.
        container FrSMClusterDemEventParameterRefs [0..1]  # Container for the references to DemEventParameter elements which shall be invoked using the API Dem_SetEventStatus in case the corresponding error occurs. The EventId is taken from the referenced DemEventParameter's DemEventId symbolic value. The standardized errors are provided in this container and can be extended by vendor-specific error references.
          reference FRSM_E_CLUSTER_STARTUP: set at link in variant link-time+post-build / pre-compile in variant pre-compile, requires-symbolic-name-value=true, destination=DemEventParameter  # Reference to the DemEventParameter which shall be issued when the error "FRSM_E_CLUSTER_STARTUP" has occurred. If the reference is not configured the error shall be reported as DET error.
          reference FRSM_E_CLUSTER_SYNC_LOSS: set at link in variant link-time+post-build / pre-compile in variant pre-compile, requires-symbolic-name-value=true, destination=DemEventParameter  # Reference to the DemEventParameter which shall be issued when the error "FRSM_E_CLUSTER_SYNC_LOSS" has occurred. If the reference is not configured the error shall be reported as DET error.
    container FrSMGeneral  # This container contains the general configuration parameters of the FlexRay State Manager.
      boolean FrSMAllSlotsSupport [0..1]: multiplicity set at pre-compile, set at pre-compile  # Configuration parameter to enable/disable FrSM support to enable/disable the switching from key-slot/single-slot mode to all-slot mode.
      boolean FrSMDevErrorDetect: set at pre-compile, default-value=false  # Switches the development error detection and notification on or off. | * true: detection and notification is enabled. * false: detection and notification is disabled.
      function name FrSMSyncLossErrorIndicationName [0..1]: multiplicity set at link in variant link-time+post-build / pre-compile in variant pre-compile, set at link in variant link-time+post-build / pre-compile in variant pre-compile  # Name of <Cdd>_SyncLossErrorIndication function that shall be called on loss of synchronization. If this parameter is omitted no indication shall take place.
      boolean FrSMVersionInfoApi: set at pre-compile, default-value=false  # Enables and disables the version info API
  module definition FrTSyn [0..1]: post-build-variant-support=true, variants pre-compile  # This represents the specific configuration variant for the TSyn on Flexray.
    container FrTSynGeneral  # This container holds the general parameters of the Flexray-specific Synchronized Time-base Manager
      boolean FrTSynDevErrorDetect: set at pre-compile, default-value=false  # Switches the development error detection and notification on or off. | * true: detection and notification is enabled. * false: detection and notification is disabled.
      float FrTSynMainFunctionPeriod: 0..INF, set at pre-compile  # Schedule period of the main function FrTSyn_MainFunction. Unit: [s].
      boolean FrTSynTimeValidationSupport: set at pre-compile, default-value=false  # Switches support for Time Validation on or off. | - true: Time Validation is enabled. - false:Time Validation is disabled.
      boolean FrTSynVersionInfoApi: set at pre-compile, default-value=false  # Activate/Deactivate the version information API (FrTSyn_GetVersionInfo). True: version information API activated False: version information API deactivated.
    container FrTSynGlobalTimeDomain [1..*]  # This represents the existence of a global time domain on Flexray. The FrTSyn module can administrate several global time domains at the same time that in itself form a hierarchy of domains and sub-domains. | If the FrTSyn exists it is assumed that at least one global time domain exists.
      boolean FrTSynEnableTimeValidation [0..1]: set at pre-compile  # Enables/disables time recording for Time Validation for a specific Time Domain.
      integer FrTSynGlobalTimeDomainId: 0..31, set at pre-compile  # The global time domain ID.
      integer FrTSynGlobalTimeSecureTmacLength: 0..16, set at pre-compile, default-value=0  # Represents the number of bytes for the used Truncated Message Authentication Code (TMAC). If 0, no message authentication will be used. Tags: atp.Status=draft
      boolean FrTSynUseExtendedMsgFormat: set at pre-compile, default-value=false  # * true: use at least 32 byte for Timesync messages (depending on configuration) Tags: atp.Status=draft | * false: use always 16 byte for Timesync messages
      reference FrTSynSynchronizedTimeBaseRef: set at pre-compile, requires-symbolic-name-value=true, destination=StbMSynchronizedTimeBase  # Mandatory reference to the required synchronized time-base.
      container FrTSynGlobalTimeMaster [0..1]: multiplicity set at pre-compile, post-build-variant-multiplicity=true  # Configuration of the global time master. Each global time domain is required to have exactly one global time master. This master may or may not exist on the configured ECU.
        float FrTSynCyclicMsgResumeTime: 0..INF, post-build-variant-value=true, set at pre-compile  # Defines the time where the 1st regular cycle time based message transmission takes place, after an immediate transmission before. Unit: seconds
        float FrTSynGlobalTimeDebounceTime: 0..INF, post-build-variant-value=true, set at pre-compile  # This represents the configuration of a TX debounce time for SYNC and OFS messages compared to a message before with the same PDU. Unit: seconds
        enumeration FrTSynGlobalTimeTxCrcSecured: {CRC_NOT_SUPPORTED, CRC_SUPPORTED}, post-build-variant-value=true, set at pre-compile  # This represents the configuration of whether or not CRC is supported.
        float FrTSynGlobalTimeTxPeriod: 0..INF, post-build-variant-value=true, set at pre-compile  # This represents the TX period. Unit: seconds
        boolean FrTSynImmediateTimeSync: post-build-variant-value=true, set at pre-compile  # Enables/Disables the cyclic polling of StbM_GetTimeBaseUpdateCounter() within FrTSyn_MainFunction().
        enumeration FrTSynTxTmacCalculated: {TMAC_CALCULATED, TMAC_NOT_CALCULATED}, post-build-variant-value=true, set at pre-compile  # This parameter controls whether or not TMAC calculation shall be supported. Tags: atp.Status=draft
        container FrTSynGlobalTimeMasterPdu  # This container carries all properties required to configure the PDU sent by the global time master for the given global time domain.
          integer FrTSynGlobalTimeMasterHandleId: 0..65535, post-build-variant-value=true, set at pre-compile, symbolic-name-value=true  # This represents the handle ID of the PDU that contains the global time information.
          reference FrTSynGlobalTimePduRef: post-build-variant-value=true, set at pre-compile, destination=Pdu  # This represents the reference to the Pdu taken to transmit the global time information. The global time master of a global time domain acts as the sender of the Pdu while all the time slaves are supposed to receive the Pdu.
      container FrTSynGlobalTimeOfsDataIDList [0..1]: multiplicity set at pre-compile, post-build-variant-multiplicity=true  # The DataIDList for OFS messages ensures the identification of data elements due to CRC calculation and message authentication process.
        container FrTSynGlobalTimeOfsDataIDListElement [16..16]  # Element of the DataIDList for OFS messages ensures the identification of data elements due to CRC calculation and message authentication process.
          integer FrTSynGlobalTimeOfsDataIDListIndex: 0..15, post-build-variant-value=true, set at pre-compile  # Index of the DataIDList for OFS messages ensures the identification of data elements due to CRC calculation and message authentication process.
          integer FrTSynGlobalTimeOfsDataIDListValue: 0..255, post-build-variant-value=true, set at pre-compile  # Value of the DataIDList for OFS messages ensures the identification of data elements due to CRC calculation and message authentication process.
      container FrTSynGlobalTimeSlave [0..1]: multiplicity set at pre-compile, post-build-variant-multiplicity=true  # This represents the time slave for the enclosing global time domain.
        float FrTSynGlobalTimeMinMsgGap: 0..INF, post-build-variant-value=true, set at pre-compile, default-value=0  # This parameter represents the configuration of a minimum message gap time for received SYNC and OFS messages compared to a message before with the same PDU. If PDUs are received more often in between than this parameter allows, they shall be ignored. Tags: atp.Status=draft | Unit: seconds
        integer FrTSynGlobalTimeSequenceCounterJumpWidth: 1..15, post-build-variant-value=true, set at pre-compile  # The SequenceCounterJumpWidth specifies the maximum allowed gap of the Sequence Counter between two SYNC resp. two OFS messages.
        float FrTSynGlobalTimeTmacTimeout: 0..INF, post-build-variant-value=true, set at pre-compile, default-value=0  # Rx timeout for the TMAC message. Tags: atp.Status=draft | Unit:seconds
        enumeration FrTSynRxCrcValidated: {CRC_IGNORED, CRC_NOT_VALIDATED, CRC_OPTIONAL, CRC_VALIDATED}, post-build-variant-value=true, set at pre-compile  # This parameter controls whether or not CRC validation shall be supported.
        enumeration FrTSynRxTmacValidated: {TMAC_NOT_VALIDATED, TMAC_VALIDATED}, post-build-variant-value=true, set at pre-compile  # This parameter controls whether or not TMAC validation shall be supported. Tags: atp.Status=draft
        container FrTSynGlobalTimeSlavePdu  # This container carries all properties required to configure the PDU received by the time slave for the given global time domain.
          integer FrTSynGlobalTimeSlaveHandleId: 0..65535, post-build-variant-value=true, set at pre-compile, symbolic-name-value=true  # This represents the handle ID of the PDU that contains the global time information.
          reference FrTSynGlobalTimePduRef: post-build-variant-value=true, set at pre-compile, destination=Pdu  # This represents the reference to the Pdu taken to transmit the global time information. The global time master of a global time domain acts as the sender of the Pdu while all the time slaves are supposed to receive the Pdu.
      container FrTSynGlobalTimeSyncDataIDList [0..1]: multiplicity set at pre-compile, post-build-variant-multiplicity=true  # The DataIDList for SYNC messages ensures the identification of data elements due to CRC calculation and message authentication process.
        container FrTSynGlobalTimeSyncDataIDListElement [16..16]  # Element of the DataIDList for SYNC messages ensures the identification of data elements due to CRC calculation and message authentication process.
          integer FrTSynGlobalTimeSyncDataIDListIndex: 0..15, post-build-variant-value=true, set at pre-compile  # Index of the DataIDList for SYNC messages ensures the identification of data elements due to CRC calculation and message authentication process.
          integer FrTSynGlobalTimeSyncDataIDListValue: 0..255, post-build-variant-value=true, set at pre-compile  # Value of the DataIDList for SYNC messages ensures the identification of data elements due to CRC calculation and message authentication process.
  module definition FrTp [0..1]: post-build-variant-support=true, variants post-build/pre-compile  # Configuration of the FlexRay Transport Protocol module according to ISO 10681-2.
    container FrTpGeneral  # This container contains the general configuration parameters of the FlexRay Transport Protocol module.
      boolean FrTpAckRt: set at pre-compile  # Preprocessor switch for enabling the Acknowledgement and retry mechanisms. | True: Acknowledge and Retry is enabled False: Acknowledge and Retry is disabled
      boolean FrTpChangeParamApi: set at pre-compile  # Preprocessor switch for enabling the API to change FrTp communication | parameters. True: ChangeParameter API is enabled False: ChangeParameter API is disabled.
      integer FrTpChanNum: 1..32, set at pre-compile  # Preprocessor switch for defining the number of concurrent channels the module supports. Up to 32 channels shall be definable here.
      boolean FrTpDevErrorDetect: set at pre-compile, default-value=false  # Switches the development error detection and notification on or off. | * true: detection and notification is enabled. * false: detection and notification is disabled.
      boolean FrTpFullDuplexEnable: set at pre-compile, default-value=false  # Preprocessor switch for enabling full duplex mechanisms for all channels. | True: Full duplex is enabled False: Fullduplex is disabled (Half duplex is enabled)
      float FrTpMainFuncCycle: 0..INF, set at pre-compile  # This parameter contains the calling period of the TPs Main Function. The parameter is specified in seconds.
      boolean FrTpTransmitCancellation: set at pre-compile, default-value=false  # Preprocessor switch for enabling Transmit Cancellation and Receive Cancellation. | True: Transmit/Receive Cancellation is enabled False: Transmit/Receive Cancellation is disabled
      boolean FrTpUnknownMsgLength: set at pre-compile  # Preprocessor switch to support data transfer with unknown message length. | True: Transmission with unknown message length is enabled False: Transmission with unknown message length is disabled
      boolean FrTpVersionInfoApi: set at pre-compile, default-value=false  # Preprocessor switch for enabling the Version info API. | True: Version Info API is enabled False: Version Info API is disabled
    container FrTpMultipleConfig  # This container contains the configuration parameters and sub containers of the AUTOSAR FrTp module.
      integer FrTpMaxConnectionCnt [0..1]: 0..18446744073709551615, multiplicity set at pre-compile, set at pre-compile  # Maximum number of TP connections. This parameter is needed only in case of post-build loadable implementation using static memory allocation.
      container FrTpConnection [1..*]: multiplicity set at post-build in variant post-build / pre-compile in variant pre-compile, post-build-variant-multiplicity=true  # This container contains the connection specific parameters to transfer N-PDUs via FlexRay TP.
        boolean FrTpBandwidthLimitation: post-build-variant-value=true, set at post-build in variant post-build / pre-compile in variant pre-compile  # This parameter indicates whether the connection requires a bandwidth limitation or not. If FrTpBandwidthLimitation=True the sender shall send a StartFrame always on the first PDU of a PDU-Pool.
        integer FrTpLa [0..1]: 0..65535, post-build-variant-value=true, set at post-build in variant post-build / pre-compile in variant pre-compile  # This parameter defines the Local Address for the respective connection. When the local instance is the sender, this is the Source Address within the TP frame. When the local instance is the receiver, this is the Target Address within the TP frame. If this parameter is not configured, all related Rx N-SDUs must be configured to use the meta data item TARGET_ADDRESS_16, and all related Tx-N-SDUs must be configured to use the meta data item SOURCE_ADDRESS_16.
        boolean FrTpMultipleReceiverCon: post-build-variant-value=true, set at post-build in variant post-build / pre-compile in variant pre-compile  # This parameter defines, whether this connection is an 1:1 ('false') or an 1:n ('true') connection. If data segmentation is required this parameter is used to check whether segmentation is possible or not. If the connection is 1:n segmentation is not possible and an error will occur.
        integer FrTpRa [0..1]: 0..65535, post-build-variant-value=true, set at post-build in variant post-build / pre-compile in variant pre-compile  # This parameter defines the Remote Address for the respective connection. When the local instance is the sender, this is the Target Address within the TP frame. When the local instance is the receiver, this is the Source Address within the TP frame. If this parameter is not configured, all related Rx N-SDUs must be configured to use the meta data item SOURCE_ADDRESS_16, and all related Tx-N-SDUs must be configured to use the meta data item TARGET_ADDRESS_16.
        reference FrTpConCtrlRef: post-build-variant-value=true, set at post-build in variant post-build / pre-compile in variant pre-compile, destination=FrTpConnectionControl  # FrTpConnectionControlReference: | This parameter defines a reference to a connection control container.
        reference FrTpRxPduPoolRef [0..1]: multiplicity set at post-build in variant post-build / pre-compile in variant pre-compile, post-build-variant-multiplicity=true, post-build-variant-value=true, set at post-build in variant post-build / pre-compile in variant pre-compile, destination=FrTpRxPduPool  # This parameter defines a reference to a RxPduPool.
        reference FrTpTxPduPoolRef [0..1]: multiplicity set at post-build in variant post-build / pre-compile in variant pre-compile, post-build-variant-multiplicity=true, post-build-variant-value=true, set at post-build in variant post-build / pre-compile in variant pre-compile, destination=FrTpTxPduPool  # This parameter defines a reference to a TxPduPool.
        container FrTpRxSdu [0..1]  # This parameter defines the Rx Service Data Unit Identifier (Sdu Id) which uniquely identifies a data transfer (inter-module communication) between FrTp and PDUR. This N-SDU can produce meta data items of type SOURCE_ADDRESS_16 and TARGET_ADDRESS_16.
          integer FrTpRxSduId: 0..65535, set at pre-compile, symbolic-name-value=true  # This unique identifier is used for change parameter request or receive cancellation from PduR to FrTp. | ImplementationType: PduIdType
          reference FrTpRxSduRef: post-build-variant-value=true, set at post-build in variant post-build / pre-compile in variant pre-compile, destination=Pdu  # Reference to a PDU in the global PDU structure.
        container FrTpTxSdu [0..1]  # This parameter defines the Tx Service Data Unit Identifier (Sdu Id) which uniquely identifies a data transfer (inter-module communication) between FrTp and PDUR. This N-SDU can consume meta data items of type SOURCE_ADDRESS_16 and TARGET_ADDRESS_16.
          integer FrTpTxSduId: 0..65535, set at pre-compile, symbolic-name-value=true  # This is a unique identifier for a to be transmitted message from the PduR to the FrTp. | ImplementationType: PduIdType
          reference FrTpTxSduRef: post-build-variant-value=true, set at post-build in variant post-build / pre-compile in variant pre-compile, destination=Pdu  # Reference to a PDU in the global PDU structure.
      container FrTpConnectionControl [1..*]: multiplicity set at post-build in variant post-build / pre-compile in variant pre-compile, post-build-variant-multiplicity=true  # This container contains the configuration parameters to control a FlexRay TP connection.
        enumeration FrTpAckType: {FRTP_ACK_WITH_RT, FRTP_NO}, post-build-variant-value=true, set at post-build in variant post-build / pre-compile in variant pre-compile  # This parameter defines the type of acknowledgement which is used for the specific channel.
        integer FrTpMaxFCWait: 0..255, post-build-variant-value=true, set at post-build in variant post-build / pre-compile in variant pre-compile  # This parameter defines the maximum number of FlowControl N-PDUs with FlowState "WAIT"
        integer FrTpMaxNbrOfNPduPerCycle: 0..31, post-build-variant-value=true, set at post-build in variant post-build / pre-compile in variant pre-compile  # This parameter is part of the ISO 10681-2 protocol's FlowControl parameter "Bandwidth Control (BC)". It limits the number of N-Pdus the sender is allowed to transmit within a FlexRay cycle.
        integer FrTpMaxRn: 0..255, post-build-variant-value=true, set at post-build in variant post-build / pre-compile in variant pre-compile  # This parameter defines the maximum number of retries (if retry is configured).
        integer FrTpSCexp: 0..7, post-build-variant-value=true, set at post-build in variant post-build / pre-compile in variant pre-compile  # This parameter is part of the ISO 10681-2 protocol's FlowControl parameter "Bandwidth Control (BC)". It represents the exponent to calculate the minimum number of "Separation Cycles" the sender has to wait for the next transmission of an FrTp N-Pdu.
        float FrTpTimeBr: 0..0.255, post-build-variant-value=true, set at post-build in variant post-build / pre-compile in variant pre-compile  # This parameter defines the time in seconds the FrTp requires to transmit a corresponding FlowControl Frame. According to ISO 10681-2 this parameter is a performance requirement.
        float FrTpTimeCs: 0..65.535, post-build-variant-value=true, set at post-build in variant post-build / pre-compile in variant pre-compile  # This parameter defines the time in seconds between the sending of two CFs or between the sending of a CF and LF or between the reception of a FC and sending of the next CF.
        float FrTpTimeoutAr: 0..65.535, post-build-variant-value=true, set at post-build in variant post-build / pre-compile in variant pre-compile  # This parameter states the timeout in seconds between the PDU transmit request of the Transport Layer to the FlexRay Interface and the corresponding confirmation of the FlexRay Interface on the receiver side (for FC or AF).
        float FrTpTimeoutAs: 0..65.535, post-build-variant-value=true, set at post-build in variant post-build / pre-compile in variant pre-compile  # This parameter specifies the timeout in seconds the FrIf shall confirm a transmitted Pdu to the FrTp.
        float FrTpTimeoutBs: 0..65.535, post-build-variant-value=true, set at post-build in variant post-build / pre-compile in variant pre-compile  # This parameter defines the timeout in seconds for waiting for an FC or AF on the sender side in a 1:1 connection.
        float FrTpTimeoutCr: 0..65.535, post-build-variant-value=true, set at post-build in variant post-build / pre-compile in variant pre-compile  # This parameter defines the timeout value in seconds a receiver is waiting for a CF or a LF.
      container FrTpRxPduPool [0..*]: multiplicity set at post-build in variant post-build / pre-compile in variant pre-compile, post-build-variant-multiplicity=true  # This container contains all Pdus that are assigned to that Pdu Pool.
        container FrTpRxPdu [1..*]: multiplicity set at post-build in variant post-build / pre-compile in variant pre-compile, post-build-variant-multiplicity=true  # Container to hold the PDU parameters. | ImplementationType: PduInfoType
          integer FrTpRxPduId: 0..65535, set at pre-compile, symbolic-name-value=true  # This is a unique identifier for a received message which is forwarded from the FrIf to the FrTp. | ImplementationType: PduIdType
          reference FrTpRxPduRef: post-build-variant-value=true, set at post-build in variant post-build / pre-compile in variant pre-compile, destination=Pdu  # Reference to a PDU in the global PDU structure.
      container FrTpTxPduPool [0..*]: multiplicity set at post-build in variant post-build / pre-compile in variant pre-compile, post-build-variant-multiplicity=true  # This container contains all Pdus that are assigned to that Pdu Pool.
        container FrTpTxPdu [1..*]: multiplicity set at post-build in variant post-build / pre-compile in variant pre-compile, post-build-variant-multiplicity=true  # Container to hold the PDU parameters. | ImplementationType: PduInfoType
          integer FrTpTxConfirmationPduId: 0..65535, set at pre-compile, symbolic-name-value=true  # Handle Id to be used by the FrIf to confirm the transmission of the FrTpTxPdu to the FrIf module (FrTp_TxConfirmation) and for TriggerTransmit (FrTp_TriggerTransmit).
          reference FrTpTxPduRef: post-build-variant-value=true, set at post-build in variant post-build / pre-compile in variant pre-compile, destination=Pdu  # Reference to a PDU in the global PDU structure.
  module definition FrTrcv [0..*]: variants pre-compile  # Configuration of the FrTrcv (FlexRay Transceiver driver) module.
    container FrTrcvChannel [1..*]  # Container gives FlexRay transceiver driver information about a single FlexRay transceiver channel. | Any FlexRay transceiver driver has such FlexRay transceiver channels.
      integer FrTrcvChannelId: 0..255, set at pre-compile, symbolic-name-value=true  # Unique identifier of the FlexRay Transceiver Channel.
      boolean FrTrcvChannelUsed: set at pre-compile, default-value=true  # Shall the related FlexRay transceiver channel be used?
      boolean FrTrcvControlsPowerSupply: set at pre-compile, default-value=false  # Is ECU power supply controlled by this transceiver?
      enumeration FrTrcvInitState: {FRTRCV_TRCVMODE_SLEEP, FRTRCV_TRCVMODE_STANDBY}, set at pre-compile  # State of FlexRay transceiver after power on. | ImplementationType: FrTrcv_TrcvModeType
      enumeration FrTrcvMaxBaudrate: {FR_10M, FR_2M5, FR_5M0}, set at pre-compile  # Max baudrate for transceiver hardware type. Only used for validation purposes. Value shall be configured by configuration tool based on | FRTRCV_HARDWARE_NAME and internal information about ability of this hardware typel.
      boolean FrTrcvWakeupByBusUsed: set at pre-compile  # Is wake up by node supported? If FlexRay transceiver hardware does not support wake up by node value is always FALSE. If FlexRay transceiver hardware supports wake up by node value is TRUE or FALSE depending whether it is used or not.
      reference FrTrcvChannelEcucPartitionRef [0..1]: scope=ECU, multiplicity set at pre-compile, set at pre-compile, destination=EcucPartition  # Maps one single Flexray transceiver channel to zero or one ECUC partitions. The ECUC partition referenced is a subset of the ECUC partitions where the Flexray transceiver driver is mapped to.
      reference FrTrcvIcuChannelRef [0..1]: scope=ECU, multiplicity set at pre-compile, set at pre-compile, requires-symbolic-name-value=true, destination=IcuChannel  # Reference to the IcuChannel to enable/disable the interrupts for wakeups.
      reference FrTrcvWakeupSourceRef [0..1]: scope=ECU, multiplicity set at pre-compile, set at pre-compile, requires-symbolic-name-value=true, destination=EcuMWakeupSource  # Reference to a wakeup source in the EcuM configuration. If | FrTrcvWakeUpSupport is configured as FRTRCV_WAKEUP_NOT_SUPPORTED the FrTrcvWakeupSourceRef is not needed. Implementation Type: reference to EcuM_WakeupSourceType
      choice container FrTrcvAccess
        container FrTrcvDioAccess [0..1]  # Container gives FR transceiver driver information about accessing ports and port pins. If a FR transceiver hardware has no Dio interface, there is no instance of this container.
          container FrTrcvDioChannelAccess [1..*]  # In this Container the relation between FR transceiver hardware pin names and Dio port access information is given.
            string FrTrcvHardwareInterfaceName: set at pre-compile  # FR transceiver hardware interface name. It is typically the name of a pin. From a Dio point of view it is either a port, a single channel or a channel group. Depending on this fact either FRTRCV_DIO_PORT_SYMBOLIC_NAME or FRTRCV_DIO_CHANNEL_SYMBOLIC_NAME or FRTRCV_DIO_CHANNEL_GROUP_SYMBOLIC_NAME shall reference a Dio configuration. The FR transceiver driver implementation description shall list up this name for the appropriate FR transceiver hardware.
            choice reference FrTrcvDioSymNameRef: set at pre-compile, destination=[DioChannel, DioChannelGroup, DioPort]  # Choice Reference to a DIO Port, DIO Channel or DIO Channel Group. This reference replaces the FRTRCV_DIO_PORT_SYM_NAME, FRTRCV_DIO_CHANNEL_SYM_NAME and FRTRCV_DIO_GROUP_SYM_NAME references in the Fr Trcv SWS.
        container FrTrcvSpiSequence [0..1]  # Container gives FlexRay transceiver driver information about one SPI sequence. One SPI sequence used by FlexRay transceiver driver is in exclusive use for it. No other driver is allowed to access this sequence. FlexRay transceiver driver may use one sequence to access n FlexRay transceiver hardwares chips of the same type or n sequences are used to access one single FlexRay transceiver hardware chip. If a FlexRay transceiver hardware has no SPI interface, there is no instance of this container. | Note: as ChannelIDs and JobIDs are hardlinked to the SequenceID through the SPI configuration, if the SPI configuration is modified (in particular the ChannelIDs associated to the SPI sequence FrTrcvSpiSequence refers to), FrTrcv must be compiled again to reflect the latest changes.
          reference FrTrcvSpiSequenceName: set at pre-compile, requires-symbolic-name-value=true, destination=SpiSequence  # Reference to a Spi sequence configuration container.
      container FrTrcvBranchIdContainer [1..*]  # Only one SymbolicNameValue can be defined per container. Therefore this container is necessary.
        integer FrTrcvBranchId: 0..255, set at pre-compile, symbolic-name-value=true  # Unique branch id. It is used by CDDs and internally.
      container FrTrcvChannelDemEventParameterRefs [0..1]  # Container for the references to DemEventParameter elements which shall be invoked using the API Dem_SetEventStatus in case the corresponding error occurs. The EventId is taken from the referenced DemEventParameter's DemEventId symbolic value. The standardized errors are provided in this container and can be extended by vendor-specific error references.
        reference FRTRCV_E_FR_BUSERROR_TRCV [0..1]: scope=ECU, multiplicity set at pre-compile, set at pre-compile, requires-symbolic-name-value=true, destination=DemEventParameter  # Reference to configured DEM event to report "Error Status of Class B (SPI) transceiver bus errors where TrcvIdx is the transceiver index"
        reference FRTRCV_E_FR_ERRN_TRCV [0..1]: scope=ECU, multiplicity set at pre-compile, set at pre-compile, requires-symbolic-name-value=true, destination=DemEventParameter  # Reference to configured DEM event to report "Error Status of Class A (GPIO) transceiver"
    container FrTrcvGeneral  # Container gives FlexRay transceiver driver basic information.
      function name FrTrcvDemReportErrorStatusConfiguration [0..1]: multiplicity set at pre-compile, set at pre-compile  # Name of a C function which substitutes Dem_SetEventStatus.
      boolean FrTrcvDevErrorDetect: set at pre-compile, default-value=false  # Switches the development error detection and notification on or off. | * true: detection and notification is enabled. * false: detection and notification is disabled.
      boolean FrTrcvErrorCheckDuringCommunication: set at pre-compile  # Enable a functionality to check transceiver's state during communication.
      boolean FrTrcvErrorCheckInInit: set at pre-compile  # Enable a functionality to check transceiver's state while initialization process of FrTrcv.
      integer FrTrcvIndex: 0..255, set at pre-compile  # Specifies the InstanceId of this module instance. If only one instance is present it shall have the Id 0.
      float FrTrcvMainFunctionCycleTime [0..1]: 0..INF, set at pre-compile  # Cyclic call time for function FrTrcvMainFunction in seconds. A multiplicity of 0 indicates no calls for this function. In this case function need not be present in compiled code.
      integer FrTrcvRetryCountInInit: 0..255, set at pre-compile  # Specifies the number of retry count when error occurs while initialization process of FrTrcv.
      enumeration FrTrcvTimerType [0..1]: {None, Timer_1us16bit}, multiplicity set at pre-compile, set at pre-compile  # Type of the Time Service Predefined Timer.
      boolean FrTrcvVersionInfoApi: set at pre-compile, default-value=false  # Switches version information API on and off. If switched off, function need not be present in compiled code.
      float FrTrcvWaitTime [0..1]: 0..2.55E-4, multiplicity set at pre-compile, set at pre-compile  # Wait time for transceiver state changes in seconds.
      enumeration FrTrcvWakeUpSupport: {FRTRCV_WAKEUP_BY_POLLING, FRTRCV_WAKEUP_NOT_SUPPORTED}, set at pre-compile  # Informs whether wake up is supported by polling or whether it is not supported. | In case no wake up is supported by FlexRay transceiver hardware setting has to be always NO. Only in case wake up is supported by polling main function FlexRayTrcv_main has to be present in source code. In case of support for wake up either by polling wake up ability may be switched on or off for each channel of one FlexRay transceiver channel independently by FrTrcvWakeupByBusUsed.
      reference FrTrcvEcucPartitionRef [0..*]: scope=ECU, multiplicity set at pre-compile, set at pre-compile, destination=EcucPartition  # Maps the Flexray transceiver driver to zero or multiple ECUC partitions to make the modules API available in this partition. The Flexray transceiver driver will operate as an independent instance in each of the partitions.
  module definition Gpt [0..1]: post-build-variant-support=true, variants post-build/pre-compile  # Configuration of the Gpt (General Purpose Timer) module.
    container GptChannelConfigSet  # This container is the base of a Configuration Set which contains the configured GPT channels. This way, different configuration sets can be defined for post-build process.
      container GptChannelConfiguration [1..*]  # Configuration of an individual GPT channel.
        integer GptChannelId: 0..4294967295, scope=ECU, set at pre-compile, symbolic-name-value=true  # Channel Id of the GPT channel. This value will be assigned to the symbolic name derived of the GptChannelConfiguration container short name.
        enumeration GptChannelMode: {GPT_CH_MODE_CONTINUOUS, GPT_CH_MODE_ONESHOT}, scope=ECU, post-build-variant-value=true, set at post-build in variant post-build / pre-compile in variant pre-compile  # Specifies the behavior of the timer channel after the target time is reached.
        float GptChannelTickFrequency: 0..INF, scope=ECU, post-build-variant-value=true, set at post-build in variant post-build / pre-compile in variant pre-compile  # Specifies the tick frequency of the timer channel in Hz.
        integer GptChannelTickValueMax: 0..18446744073709551615, scope=ECU, post-build-variant-value=true, set at post-build in variant post-build / pre-compile in variant pre-compile  # Maximum value in ticks, the timer channel is able to count. With the next tick, the timer rolls over to zero.
        boolean GptEnableWakeup: post-build-variant-value=true, set at post-build in variant post-build / pre-compile in variant pre-compile  # Enables wakeup capability of MCU for a channel.
        function name GptNotification [0..1]: multiplicity set at post-build in variant post-build / pre-compile in variant pre-compile, post-build-variant-multiplicity=true, post-build-variant-value=true, set at post-build in variant post-build / pre-compile in variant pre-compile  # Function pointer to callback function (for non-wakeup notification)
        reference GptChannelClkSrcRef: post-build-variant-value=true, set at post-build in variant post-build / pre-compile in variant pre-compile, destination=GptClockReferencePoint  # Reference to the GptClockReferencePoint from which the channel | clock is derived.
        reference GptChannelEcucPartitionRef [0..*]: scope=ECU, multiplicity set at pre-compile, post-build-variant-multiplicity=true, post-build-variant-value=true, set at pre-compile, destination=EcucPartition  # Maps a GPT channel to zero or multiple ECUC partitions to limit the access to this channel group. The ECUC partitions referenced are a subset of the ECUC partitions where the GPT driver is mapped to.
        container GptWakeupConfiguration [0..1]  # Function pointer to callback function (for wakeup notification).
          reference GptWakeupSourceRef: post-build-variant-value=true, set at post-build in variant post-build / pre-compile in variant pre-compile, requires-symbolic-name-value=true, destination=EcuMWakeupSource  # In case the wakeup-capability is true this value is transmitted to the Ecu State Manager. | Implementation Type: reference to EcuM_WakeupSourceType
    container GptConfigurationOfOptApiServices  # This container contains all configuration switches for configuring optional API services of the GPT driver.
      boolean GptDeinitApi: set at pre-compile  # Adds / removes the service Gpt_DeInit() from the code.
      boolean GptEnableDisableNotificationApi: set at pre-compile  # Adds / removes the services Gpt_EnableNotification() and Gpt_DisableNotification from the code.
      boolean GptTimeElapsedApi: set at pre-compile  # Adds / removes the service Gpt_GetTimeElapsed() from the code
      boolean GptTimeRemainingApi: set at pre-compile  # Adds / removes the service Gpt_GetTimeRemaining() from the code.
      boolean GptVersionInfoApi: set at pre-compile, default-value=false  # Adds / removes the service Gpt_GetVersionInfo() from the code.
      boolean GptWakeupFunctionalityApi: set at pre-compile  # Adds / removes the services Gpt_SetMode(), Gpt_EnableWakeup() Gpt_DisableWakeup() and Gpt_CheckWakeup() from the code.
    container GptDriverConfiguration  # This container contains the module-wide configuration (parameters) of the GPT Driver
      boolean GptDevErrorDetect: set at pre-compile, default-value=false  # Switches the development error detection and notification on or off. | * true: detection and notification is enabled. * false: detection and notification is disabled.
      boolean GptPredefTimer100us32bitEnable: scope=ECU, set at pre-compile  # Enables/disables the GPT Predef Timer 100µs32bit.
      enumeration GptPredefTimer1usEnablingGrade: {GPT_PREDEF_TIMER_1US_16BIT_ENABLED, GPT_PREDEF_TIMER_1US_16_24BIT_ENABLED, GPT_PREDEF_TIMER_1US_16_24_32BIT_ENABLED, GPT_PREDEF_TIMER_1US_DISABLED}, scope=ECU, set at pre-compile  # Specifies the grade of enabling the GPT Predef Timers with 1µs tick duration.
      boolean GptReportWakeupSource: set at pre-compile  # Enables/Disables wakeup source reporting.
      reference GptEcucPartitionRef [0..*]: scope=ECU, multiplicity set at pre-compile, post-build-variant-multiplicity=true, post-build-variant-value=true, set at pre-compile, destination=EcucPartition  # Maps the GPT driver to zero or multiple ECUC partitions to make the driver API available in the according partition. Depending on the addressed timer resource the interfaces operate as follows: | a) In case of partition local timer resources (n:1 mapping) the API operates as an independent instance in the according ECUC partition. b) In case of global timer resources (1:m mapping) the API operates on the global timer resource either by protected access to the resource or by implementing an according kernel.
      reference GptKernelEcucPartitionRef [0..1]: scope=ECU, multiplicity set at pre-compile, post-build-variant-multiplicity=true, post-build-variant-value=true, set at pre-compile, destination=EcucPartition  # Maps the GPT kernel to zero or one ECUC partitions to assign the driver kernel to a certain core. The ECUC partition referenced is a subset of the ECUC partitions where the GPT driver is mapped to. | Note: The kernel reference shall not be set in case the GPT driver is implemented without a kernel (refer to definition of GptEcucPartitionRef).
      container GptClockReferencePoint [1..*]  # This container contains a parameter, which represents a reference to a container of the type McuClockReferencePoint (defined in module MCU). | A container is needed to support multiple clock references (hardware dependent).
        reference GptClockReference: set at pre-compile, destination=McuClockReferencePoint  # Reference to a container of the type McuClockReferencePoint, to select an input clock. | The configuration editor for the GPT module can support the integrator by only allowing a selection of those clock reference points that can be connected physically to the GPT hardware peripheral. The desired frequency (desired by GPT) has to be the same as the selected and provided frequency of the MCU configuration. This has to be checked automatically.
  module definition HTTMS [0..1]: variants pre-compile  # Configuration of the Hardware Test Management start up and shutdown (HTMSS) module.
    container HTTMSSConfigSet [1..*]  # This is the base container that contains the configuration parameters & sub containers of HTMSS module.
    container HTTMSSGeneral  # This container holds the general parameters of the HTMSS module.
      boolean HTMSSDevErrorDetect: set at pre-compile, default-value=false  # Switch for enabling the DET.
      boolean HTMSSVersionInfoApi: set at pre-compile, default-value=false  # Activate/Deactivate the version information API.
  module definition IKE [0..1]: variants pre-compile  # Description for the Internet Key Exchange.
    container IKECertificates  # Container for configuration of IKE certificates.
      integer IKEMaxPublicKeyLength: 64..4096, multiplicity set at pre-compile, set at pre-compile, default-value=96  # The maximum length of the public key in a certificate. | Choose 64 for ECDSA-256, 96 for ECDSA-384, etc.
      integer IKEMaxSubjectNameSize: 32..1024, multiplicity set at pre-compile, set at pre-compile, default-value=256  # The maximum size of the Subject Name field in certificates.
      reference IKECertificateBufferRef [2..2]: multiplicity set at pre-compile, set at pre-compile, requires-symbolic-name-value=true, destination=CsmKey  # The referenced keys are used as buffers for temporarily storing the peer certificates.
      container IKECertificate [2..65534]: multiplicity set at pre-compile  # Container for configuration of an identity certificate and its issuer certificate. | Use this container to configure a valid chain of certificates. The top-level certificate must be a self-signed certificate.
        reference IKEIssuerCertificateRef: multiplicity set at pre-compile, set at pre-compile, destination=IKECertificate  # The referenced certificate is the Issuer Certificate. The Issuer Certificate is used to identifiy the certificate authority (CA) which is the issuer of the Identity Certificate. The associated public key is used for verification of the certificate.
        reference KEIdentityCertificateRef: multiplicity set at pre-compile, set at pre-compile, requires-symbolic-name-value=true, destination=CsmKey  # The referenced key is the Identity Certificate which is used to identifiy an entity and to associate that identiy with a public key.
    container IKEConnections  # Container for configuration of IKE connections.
      float IKEConnectionTimeout: 1..60, multiplicity set at pre-compile, set at pre-compile, default-value=30  # Timeout for etsablishing a connection in order to handle a "half open" state.
      integer IKEFragmentSize: 576..4096, multiplicity set at pre-compile, set at pre-compile, default-value=1280  # The maximum size of IKE fragment messages when fragmentation is used. | The resulting buffer size for subsequent fragment messages is (Number of Fragments * Fragment Size). This fragment size is the maximum IP datagram size, used for both RX and TX.
      integer IKELocalPort: 0..65535, multiplicity set at pre-compile, set at pre-compile, default-value=500  # The local port is the UDP port to listen to.
      integer IKEMaxNumFragments: 1..10, multiplicity set at pre-compile, set at pre-compile, default-value=3  # The maximum number of fragment messages into which the an IKE message might be divided. If this value is set to 1, fragmentation is not supported. | The resulting buffer size for subsequent fragment messages is (Number of Fragments * Fragment Size). Used for both RX and TX and affects size of TX buffer.
      float IKEReassemblingTimeout: 0.1..60, multiplicity set at pre-compile, set at pre-compile, default-value=0.5  # The timeout for reassembling a fragmented message. All fragments of a message must be received within this interval, Otherwise all so far received fragments are discarded.
      float IKERetransmitBase: 1..2, multiplicity set at pre-compile, set at pre-compile, default-value=1.3  # The base used for calculation of the exponantioal back-off of the retransmit timeouts.
      float IKERetransmitTimeout: 1..60, multiplicity set at pre-compile, set at pre-compile, default-value=1.5  # The initial retransmit timeout.
      integer IKERetransmitTries: 0..255, multiplicity set at pre-compile, set at pre-compile, default-value=10  # The maximum number of retransmits of a request before giving up.
      container IKEConnection [1..*]: multiplicity set at pre-compile  # Container for configuration of IKE connection.
        boolean IKEAutostart: multiplicity set at pre-compile, set at pre-compile, default-value=true  # If enabled, IKE wil automatically initiate an IKE SA on this connection after start-up of the module.
        integer IKEConnectionId: 0..4294967295, multiplicity set at pre-compile, set at pre-compile, default-value=0  # Identifier of the connection.
        float IKEDpdDelay: 0..1000000000, multiplicity set at pre-compile, set at pre-compile, default-value=30  # Specifies the interval in which Dead Peer Detection (DPD) packets shall be sent in the absence of other traffic | Set to 0 to disable sending DPD packets.
        float IKEIkeLifetime: 0..1000000000, multiplicity set at pre-compile, set at pre-compile, default-value=86400  # Specifies the time after which an IKE SA is terminated. | Set to 0 if IKE SA never expires.
        float IKEIkeMarginTime: 10..1000000000, multiplicity set at pre-compile, set at pre-compile, default-value=600  # Specifies how many seconds before expiry an IKE SA should be renegotiated.
        string IKERemoteAddress: multiplicity set at pre-compile, set at pre-compile  # The remote address is the IP address of the ECU which a IKE connection shall be established with, e.g. 192.168.50.101.
        integer IKERemotePort: 0..65535, multiplicity set at pre-compile, set at pre-compile, default-value=500  # The remote port is the UDP port of the ECU which a IKE connection shall be established with.
        reference IKEECUCertificateRef [0..1]: multiplicity set at pre-compile, set at pre-compile, destination=IKECertificate  # The ECU certificate is the end-entity certificate. | The referenced certificate is the ECU certificate which cortains the public key used for authentication during the IKE connection setup.
        reference IKEECUPreSharedKeyRef [0..1]: multiplicity set at pre-compile, set at pre-compile, requires-symbolic-name-value=true, destination=CsmKey  # The ECU's pre-shared key.
        reference IKERemotePreSharedKeyRef [0..1]: multiplicity set at pre-compile, set at pre-compile, requires-symbolic-name-value=true, destination=CsmKey  # The referenced key is the key which is used to identify the remote ECU during the IKE connection setup.
        reference IKETcpIpLocalAddressRef: multiplicity set at pre-compile, set at pre-compile, requires-symbolic-name-value=true, destination=TcpIpLocalAddr  # IP address table identifier assigned by TCP/IP stack.
        reference IKETrustAnchorCertificateRef [0..1]: multiplicity set at pre-compile, set at pre-compile, destination=IKECertificate  # The referenced certificate is the Trust Anchor certificate which is used to identify the trusted Certification Authorities during the IKE connection setup.
        container IKESession [1..255]: multiplicity set at pre-compile  # Container for configuration of IKE session.
          container IKEChildSaProposal [1..65536]: multiplicity set at pre-compile  # Container for configuration of IKE Authentication Header (AH) or Encapsulating Security Payload (ESP) Security Association Proposals.
            enumeration IKESecurityProtocol: {IKE_PROTOCOL_AH, IKE_PROTOCOL_ESP}, multiplicity set at pre-compile, set at pre-compile, default-value=IKE_PROTOCOL_AH  # The security protocol (i.e., AH or ESP) to be used for this Child SA.
            boolean IKEUseExtendedSequenceNumbers: multiplicity set at pre-compile, set at pre-compile, default-value=true  # Whether this Child SA should use Extended Sequence Numbers (ESN), i.e., 64-Bit instead of 32-Bit sequence numbers.
            reference IKEEncrTransformRef [0..1]: multiplicity set at pre-compile, set at pre-compile, destination=TcpIpEncryptionAlgorithm  # The referenced Encryption Algorithm is added to this proposal. | Leave empty for AH and ESP in authentication-only mode.
            reference IKEIntegTransformRef: multiplicity set at pre-compile, set at pre-compile, destination=TcpIpIntegrityAlgorithm  # The referenced Integrity Algorithm is added to this proposal.
          container IKEIkeSaProposal [1..*]: multiplicity set at pre-compile  # Container for configuration of IKE IKE Security Association Proposal.
            reference IKEDhTransformRef: multiplicity set at pre-compile, set at pre-compile, destination=IKEDhTransform  # The referenced Diffie-Hellman Group Transform is added to this proposal.
            reference IKEEncrTransformRef: multiplicity set at pre-compile, set at pre-compile, destination=IKEEncrTransform  # The referenced Encryption Algorithm Transform is added to this proposal.
            reference IKEIntegTransformRef: multiplicity set at pre-compile, set at pre-compile, destination=IKEIntegTransform  # The referenced Integrity Algorithm Transform is added to this proposal.
            reference IKEPrfTransformRef: multiplicity set at pre-compile, set at pre-compile, destination=IKEPrfTransform  # The referenced Pseudorandom Function Transform is added to this proposal.
          container IKESignatureAuthenticationVariant [1..*]: multiplicity set at pre-compile  # Defining variants for the IKEv2 Authentication Method "Digitial Signature".
            enumeration IKEHashAlgorithm: {IKE_HASH_ALGO_SHA1, IKE_HASH_ALGO_SHA2_256, IKE_HASH_ALGO_SHA2_384, IKE_HASH_ALGO_SHA2_512}, multiplicity set at pre-compile, set at pre-compile, default-value=IKE_HASH_ALGO_SHA1  # Pre-hashing Algorithm. | Please adapt to the referenced Csm jobs.
            enumeration IKESignatureAlgorithm: {IKE_SIGNATURE_DSA, IKE_SIGNATURE_ECDSA, IKE_SIGNATURE_RSASSA_PSS, IKE_SIGNATURE_RSA_ENCRYPTION}, multiplicity set at pre-compile, set at pre-compile, default-value=IKE_SIGNATURE_ECDSA  # Signature Algorithm. | Please adapt to the referenced Csm jobs.
            integer IKESignatureLength: 64..1024, multiplicity set at pre-compile, set at pre-compile, default-value=96  # The length of a signature generated by the configured generation job and verified by the configured verification job. | E.g. 64 for ECDSA-256 or 96 for ECDSA-386.
            reference IKESignatureGenerateJobRef: multiplicity set at pre-compile, set at pre-compile, requires-symbolic-name-value=true, destination=CsmJob  # The referenced Csm job is used for the execution of the CsmSignatureGenerate primitive needed for this transform.
            reference IKESignatureVerifyJobRef: multiplicity set at pre-compile, set at pre-compile, requires-symbolic-name-value=true, destination=CsmJob  # The referenced Csm job is used for the execution of the CsmSignatureVerify primitive needed for this transform.
    container IKEGeneral  # General module settings.
      boolean IKEVersionInfoApi: multiplicity set at pre-compile, set at pre-compile, default-value=false  # Pre-processor switch to enable and disable availability of the API IKE_GetVersionInfo(). | - True: API IKE_GetVersionInfo() is available. - False: API IKE_GetVersionInfo() is not available.
      reference IKEHashJobRef: requires-symbolic-name-value=true, destination=CsmJob  # The referenced crypto job is used to calculate the SHA-1 hash of the Subject Public Key Info element needed for the encoding of the certification authorities.
      reference IKERandomJobRef: multiplicity set at pre-compile, set at pre-compile, requires-symbolic-name-value=true, destination=CsmJob  # The referenced crypto job is used for random number generation.
      reference IKETcpIpSocketOwner: multiplicity set at pre-compile, set at pre-compile, requires-symbolic-name-value=true, destination=TcpIpSocketOwner  # The ID of the socket user.
      container IKEMessageFormat: multiplicity set at pre-compile  # In order to deserialize the byte stream of IKE messages to data structures memory is statically allocated. Use the parameters in this container to minimize the used memory. But, configuring too low maximum values might result in unsuccessful deserializations of received IKE messages.
        integer IKEMaxAttributesPerTransform: 1..2, multiplicity set at pre-compile, set at pre-compile, default-value=2  # The maximum number of attributes a transform may contain.
        integer IKEMaxCertPayloadsPerMessage: 1..4, multiplicity set at pre-compile, set at pre-compile, default-value=4  # The maximum number of Certificate payloads an IKE message may contain.
        integer IKEMaxCertreqPayloadsPerMessage: 1..4, multiplicity set at pre-compile, set at pre-compile, default-value=4  # The maximum number of Certificate Request payloads an IKE message may contain.
        integer IKEMaxDeletePayloadsPerMessage: 1..2, multiplicity set at pre-compile, set at pre-compile, default-value=2  # The maximum number of Delete payloads an IKE message may contain.
        integer IKEMaxInitMessageSize: 256..3000, multiplicity set at pre-compile, set at pre-compile, default-value=512  # The maximum size of incoming IKE_INIT messages.
        integer IKEMaxNonceSize: 32..512, multiplicity set at pre-compile, set at pre-compile, default-value=64  # The maximum size of incoming nonces. | Must be be at least 32 bytes and at least half the key size of the largest configured pseudorandom function (PRF).
        integer IKEMaxNotifyPayloadsPerMessage: 1..10, multiplicity set at pre-compile, set at pre-compile, default-value=10  # The maximum number of Notify payloads an IKE message may contain.
        integer IKEMaxPayloadsPerMessage: 1..20, multiplicity set at pre-compile, set at pre-compile, default-value=20  # The maximum number of payloads an IKE message may contain.
        integer IKEMaxProposalsPerSaPayload: 1..5, multiplicity set at pre-compile, set at pre-compile, default-value=5  # The maximum number of proposals a SA payload may contain.
        integer IKEMaxSpisPerDeletePayload: 1..2, multiplicity set at pre-compile, set at pre-compile, default-value=2  # The maximum number of SPIs a Delete payload may contain.
        integer IKEMaxTrafficSelectorsPerTsPayload: 1..2, multiplicity set at pre-compile, set at pre-compile, default-value=2  # The maximum number of traffic selectors a Traffic Selector payload may contain.
        integer IKEMaxTransformsPerProp: 1..5, multiplicity set at pre-compile, set at pre-compile, default-value=5  # The maximum number of transforms a proposal may contain.
    container IKETransforms  # Container for configuration of IKE transforms.
      container IKEDhTransform [1..*]: multiplicity set at pre-compile  # Container for configuration of Diffie-Hellman Group Transform.
        enumeration IKETransformId: {IKE_TRANSFORM_DH_1024_BIT_MODP_GROUP, IKE_TRANSFORM_DH_1024_BIT_MODP_GROUP_WITH_160_BIT_PRIME_ORDER_SUBGROUP, IKE_TRANSFORM_DH_1536_BIT_MODP_GROUP, IKE_TRANSFORM_DH_192_BIT_RANDOM_ECP_GROUP, IKE_TRANSFORM_DH_2048_BIT_MODP_GROUP, IKE_TRANSFORM_DH_2048_BIT_MODP_GROUP_WITH_224_BIT_PRIME_ORDER_SUBGROUP, IKE_TRANSFORM_DH_2048_BIT_MODP_GROUP_WITH_256_BIT_PRIME_ORDER_SUBGROUP, IKE_TRANSFORM_DH_224_BIT_RANDOM_ECP_GROUP, IKE_TRANSFORM_DH_256_BIT_RANDOM_ECP_GROUP, IKE_TRANSFORM_DH_3072_BIT_MODP_GROUP, IKE_TRANSFORM_DH_384_BIT_RANDOM_ECP_GROUP, IKE_TRANSFORM_DH_4096_BIT_MODP_GROUP, IKE_TRANSFORM_DH_521_BIT_RANDOM_ECP_GROUP, IKE_TRANSFORM_DH_6144_BIT_MODP_GROUP, IKE_TRANSFORM_DH_768_BIT_MODP_GROUP, IKE_TRANSFORM_DH_8192_BIT_MODP_GROUP, IKE_TRANSFORM_DH_BRAINPOOLP224R1, IKE_TRANSFORM_DH_BRAINPOOLP256R1, IKE_TRANSFORM_DH_BRAINPOOLP384R1, IKE_TRANSFORM_DH_BRAINPOOLP512R1, IKE_TRANSFORM_DH_CURVE25519, IKE_TRANSFORM_DH_CURVE448}, multiplicity set at pre-compile, set at pre-compile, default-value=IKE_TRANSFORM_DH_256_BIT_RANDOM_ECP_GROUP  # Diffie-Hellman Group Transform ID.
        reference IKEKeyRef: multiplicity set at pre-compile, set at pre-compile, requires-symbolic-name-value=true, destination=CsmKey  # The referenced Csm key is used for the execution of key management functions needed for this transform.
      container IKEEncrTransform [1..*]: multiplicity set at pre-compile  # Container for configuration of Encryption Algorithm Transform.
        integer IKEKeyLength: 0..255, multiplicity set at pre-compile, set at pre-compile, default-value=16  # The key length of the encryption algorithm in bytes.
        enumeration IKETransformId: {IKE_TRANSFORM_ENCR_3DES, IKE_TRANSFORM_ENCR_3IDEA, IKE_TRANSFORM_ENCR_AES_CBC, IKE_TRANSFORM_ENCR_AES_CCM_12, IKE_TRANSFORM_ENCR_AES_CCM_16, IKE_TRANSFORM_ENCR_AES_CCM_8, IKE_TRANSFORM_ENCR_AES_CTR, IKE_TRANSFORM_ENCR_AES_GCM_12, IKE_TRANSFORM_ENCR_AES_GCM_16, IKE_TRANSFORM_ENCR_AES_GCM_8, IKE_TRANSFORM_ENCR_BLOWFISH, IKE_TRANSFORM_ENCR_CAMELLIA_CBC, IKE_TRANSFORM_ENCR_CAMELLIA_CCM_12, IKE_TRANSFORM_ENCR_CAMELLIA_CCM_16, IKE_TRANSFORM_ENCR_CAMELLIA_CCM_8, IKE_TRANSFORM_ENCR_CAMELLIA_CTR, IKE_TRANSFORM_ENCR_CAST, IKE_TRANSFORM_ENCR_CHACHA20_POLY1305, IKE_TRANSFORM_ENCR_DES, IKE_TRANSFORM_ENCR_DES_IV32, IKE_TRANSFORM_ENCR_DES_IV64, IKE_TRANSFORM_ENCR_IDEA, IKE_TRANSFORM_ENCR_RC5}, multiplicity set at pre-compile, set at pre-compile, default-value=IKE_TRANSFORM_ENCR_AES_CBC  # Encryption Algorithm Transform ID.
        reference IKEDecryptJobRef: multiplicity set at pre-compile, set at pre-compile, requires-symbolic-name-value=true, destination=CsmJob  # The referenced Csm job is used for the execution of the CsmDecrypt primitive needed for this transform.
        reference IKEEncryptJobRef: multiplicity set at pre-compile, set at pre-compile, requires-symbolic-name-value=true, destination=CsmJob  # The referenced Csm job is used for the execution of the CsmEncrypt primitive needed for this transform.
      container IKEIntegTransform [1..*]: multiplicity set at pre-compile  # Container for configuration of Integrity Algorithm Transform.
        enumeration IKETransformId: {IKE_TRANSFORM_AUTH_AES_CMAC_96, IKE_TRANSFORM_AUTH_AES_XCBC_96, IKE_TRANSFORM_AUTH_DES_MAC, IKE_TRANSFORM_AUTH_HMAC_MD5_128, IKE_TRANSFORM_AUTH_HMAC_MD5_96, IKE_TRANSFORM_AUTH_HMAC_SHA1_160, IKE_TRANSFORM_AUTH_HMAC_SHA1_96, IKE_TRANSFORM_AUTH_HMAC_SHA2_256_128, IKE_TRANSFORM_AUTH_HMAC_SHA2_384_192, IKE_TRANSFORM_AUTH_HMAC_SHA2_512_256, IKE_TRANSFORM_AUTH_KPDK_MD5}, multiplicity set at pre-compile, set at pre-compile, default-value=IKE_TRANSFORM_AUTH_AES_CMAC_96  # Integrity Algorithm Transform ID.
        reference IKEGenerateJobRef: multiplicity set at pre-compile, set at pre-compile, requires-symbolic-name-value=true, destination=CsmJob  # The referenced Csm job is used for the execution of the CsmMacGenerate primitive needed for this transform.
        reference IKEVerifyJobRef: multiplicity set at pre-compile, set at pre-compile, requires-symbolic-name-value=true, destination=CsmJob  # The referenced Csm job is used for the execution of the CsmMacVerify primitive needed for this transform.
      container IKEPrfTransform [1..*]: multiplicity set at pre-compile  # Container for configuration of Pseudorandom Function Transform.
        enumeration IKETransformId: {IKE_TRANSFORM_PRF_AES128_CMAC, IKE_TRANSFORM_PRF_AES128_XCBC, IKE_TRANSFORM_PRF_HMAC_MD5, IKE_TRANSFORM_PRF_HMAC_SHA1, IKE_TRANSFORM_PRF_HMAC_SHA2_256, IKE_TRANSFORM_PRF_HMAC_SHA2_384, IKE_TRANSFORM_PRF_HMAC_SHA2_512, IKE_TRANSFORM_PRF_HMAC_TIGER}, multiplicity set at pre-compile, set at pre-compile, default-value=IKE_TRANSFORM_PRF_HMAC_SHA2_256  # Pseudorandom Function Transform ID.
        reference IKEJobRef: multiplicity set at pre-compile, set at pre-compile, requires-symbolic-name-value=true, destination=CsmJob  # The referenced Csm job is used for the execution of the CsmMacGenerate primitive needed for this transform.
  module definition Icu [0..1]: post-build-variant-support=true, variants post-build/pre-compile  # Configuration of the Icu (Input Capture Unit) module.
    container IcuConfigSet  # This container contains the configuration parameters and sub containers of the AUTOSAR Icu module.
      integer IcuMaxChannel: 0..65535, post-build-variant-value=true, set at post-build in variant post-build / pre-compile in variant pre-compile  # This parameter contains the number of Channels configured. It will be gathered by tools during the configuration stage. | calculationFormula = Number of configured Icu Channels Implementation Type: Icu_ChannelType
      container IcuChannel [1..*]  # Configuration of an individual ICU channel.
        integer IcuChannelId: 0..65535, scope=ECU, set at pre-compile, symbolic-name-value=true  # Channel Id of the ICU channel. This value will be assigned to the symbolic name derived of the IcuChannel container short name.
        enumeration IcuDefaultStartEdge: {ICU_BOTH_EDGES, ICU_FALLING_EDGE, ICU_RISING_EDGE}, post-build-variant-value=true, set at post-build in variant post-build / pre-compile in variant pre-compile  # Configures the default-activation-edge which shall be used for this channel if there was no activation-edge configured by the call of service Icu_SetActivationCondition(). | In case the Measurement Mode is "IcuSignalMeasurement" and the properties "DutyCycle" or "Period" are set, the edge configured here is used as Default Period Start Edge. Implementation Type: Icu_ActivationType
        enumeration IcuMeasurementMode: {ICU_MODE_EDGE_COUNTER, ICU_MODE_SIGNAL_EDGE_DETECT, ICU_MODE_SIGNAL_MEASUREMENT, ICU_MODE_TIMESTAMP}, post-build-variant-value=true, set at post-build in variant post-build / pre-compile in variant pre-compile  # Configures the measurement mode of this channel. | Implementation Type: Icu_MeasurementModeType
        boolean IcuWakeupCapability: post-build-variant-value=true, set at post-build in variant post-build / pre-compile in variant pre-compile  # Information about the wakeup-capability of this channel. | true: Channel is wakeup capable. false: Channel is not wakeup capable.
        reference IcuChannelEcucPartitionRef [0..*]: scope=ECU, multiplicity set at pre-compile, post-build-variant-multiplicity=true, post-build-variant-value=true, set at pre-compile, destination=EcucPartition  # Maps an ICU channel to zero or multiple ECUC partitions to limit the access to this channel. The ECUC partitions referenced are a subset of the ECUC partitions where the ICU driver is mapped to.
        container IcuSignalEdgeDetection [0..1]  # This container contains the configuration (parameters) in case the measurement mode is "IcuSignalEdgeDetection"
          function name IcuSignalNotification [0..1]: multiplicity set at post-build in variant post-build / pre-compile in variant pre-compile, post-build-variant-multiplicity=true, post-build-variant-value=true, set at post-build in variant post-build / pre-compile in variant pre-compile  # Notification function for signal notification.
        container IcuSignalMeasurement [0..1]  # This container contains the configuration (parameters) in case the measurement mode is "IcuSignalMeasurement"
          enumeration IcuSignalMeasurementProperty: {ICU_DUTY_CYCLE, ICU_HIGH_TIME, ICU_LOW_TIME, ICU_PERIOD_TIME}, post-build-variant-value=true, set at post-build in variant post-build / pre-compile in variant pre-compile  # Configures the property that could be measured in case the mode is "IcuSignalMeasurement". | This property can not be changed during runtime. Implementation Type: Icu_SignalMeasurementPropertyType
        container IcuTimestampMeasurement [0..1]  # This container contains the configuration (parameters) in case the measurement mode is "IcuTimestamp"
          enumeration IcuTimestampMeasurementProperty: {ICU_CIRCULAR_BUFFER, ICU_LINEAR_BUFFER}, post-build-variant-value=true, set at post-build in variant post-build / pre-compile in variant pre-compile  # Configures the handling of the buffer in case the mode is "Timestamp" | Implementation Type: Icu_TimestampBufferType
          function name IcuTimestampNotification [0..1]: multiplicity set at post-build in variant post-build / pre-compile in variant pre-compile, post-build-variant-multiplicity=true, post-build-variant-value=true, set at post-build in variant post-build / pre-compile in variant pre-compile  # Notification function if the number of requested timestamps | (Notification interval > 0) are acquired.
        container IcuWakeup [0..1]  # This container contains the configuration (parameters) needed to configure a wakeup capable channel
          reference IcuChannelWakeupInfo [0..1]: multiplicity set at post-build in variant post-build / pre-compile in variant pre-compile, post-build-variant-multiplicity=true, post-build-variant-value=true, set at post-build in variant post-build / pre-compile in variant pre-compile, requires-symbolic-name-value=true, destination=EcuMWakeupSource  # If the wakeup-capability is true the wakeup source referenced is transmitted to the ECU State Manager (EcuM) . | Implementation Type: reference to EcuM_WakeupSourceType
    container IcuGeneral  # Configuration of general ICU parameters.
      boolean IcuDevErrorDetect: set at pre-compile, default-value=false  # Switches the development error detection and notification on or off. | * true: detection and notification is enabled. * false: detection and notification is disabled.
      boolean IcuReportWakeupSource: set at pre-compile  # Switch for enabling Wakeup source reporting. | true: Report Wakeup source. false: Do not report Wakeup source.
      reference IcuEcucPartitionRef [0..*]: scope=ECU, multiplicity set at pre-compile, post-build-variant-multiplicity=true, post-build-variant-value=true, set at pre-compile, destination=EcucPartition  # Maps the ICU driver to zero or multiple ECUC partitions to make the driver API available in the according partition.
      reference IcuKernelEcucPartitionRef [0..1]: scope=ECU, multiplicity set at pre-compile, post-build-variant-multiplicity=true, post-build-variant-value=true, set at pre-compile, destination=EcucPartition  # Maps the ICU kernel to zero or one ECUC partitions to assign the driver kernel to a certain core. The ECUC partition referenced is a subset of the ECUC partitions where the ICU driver is mapped to.
    container IcuOptionalApis  # This container contains all configuration switches for configuring optional API services of the ICU driver.
      boolean IcuDeInitApi: set at pre-compile  # Adds / removes the service Icu_DeInit() from the code. | true: Icu_DeInit() can be used. false: Icu_DeInit() can not be used.
      boolean IcuDisableWakeupApi: set at pre-compile  # Adds / removes the service Icu_DisableWakeup() from the code. | true: Icu_DisableWakeup() can be used. false: Icu_DisableWakeup() can not be used.
      boolean IcuEdgeCountApi: set at pre-compile  # Adds / removes all services related to the edge counting functionality as listed below, from the code: Icu_ResetEdgeCount(), Icu_EnableEdgeCount(), Icu_DisableEdgeCount(), Icu_GetEdgeNumbers(). | true: The services listed above can be used. false: The services listed above can not be used.
      boolean IcuEdgeDetectApi: set at pre-compile  # Adds / removes the services related to the edge detection functionality, from the code: | Icu_EnableEdgeDetection() and Icu_DisableEdgeDetection(). true: These services can be used. false: These services can not be used.
      boolean IcuEnableWakeupApi: set at pre-compile  # Adds / removes the service Icu_EnableWakeup() from the code. | true: Icu_EnableWakeup() can be used. false: Icu_EnableWakeup() can not be used.
      boolean IcuGetDutyCycleValuesApi: set at pre-compile  # Adds / removes the service Icu_GetDutyCycleValues() from the code. | true: Icu_GetDutyCycleValues() can be used. false: Icu_GetDutyCycleValues() can not be used.
      boolean IcuGetInputStateApi: set at pre-compile  # Adds / removes the service Icu_GetInputState() from the code. | true: Icu_GetInputState() can be used. false: Icu_GetInputState() can not be used.
      boolean IcuGetTimeElapsedApi: set at pre-compile  # Adds / removes the service Icu_GetTimeElapsed() from the code. | true: Icu_GetTimeElapsed() can be used. false: Icu_GetTimeElapsed() can not be used.
      boolean IcuGetVersionInfoApi: set at pre-compile, default-value=false  # Adds / removes the service Icu_GetVersionInfo() from the code. | true: Icu_GetVersionInfo() can be used. false: Icu_GetVersionInfo() can not be used.
      boolean IcuSetModeApi: set at pre-compile  # Adds / removes the service Icu_SetMode() from the code. | true: Icu_SetMode() can be used. false: Icu_SetMode() can not be used.
      boolean IcuSignalMeasurementApi: set at pre-compile  # Adds / removes the services Icu_StartSignalMeasurement() and Icu_StopSignalMeasurement() from the code. | true: Icu_StartSignalMeasurement() and Icu_StopSignalMeasurement() can be used. false: Icu_StartSignalMeasurement() and Icu_StopSignalMeasurement() can not be used.
      boolean IcuTimestampApi: set at pre-compile  # Adds / removes all services related to the timestamping functionality as listed below from the code: Icu_StartTimestamp(), Icu_StopTimestamp(), Icu_GetTimestampIndex(). | true: The services listed above can be used. false: The services listed above can not be used.
      boolean IcuWakeupFunctionalityApi: set at pre-compile  # Adds / removes the service Icu_CheckWakeup() from the code. | true: Icu_CheckWakeup() can be used. false: Icu_CheckWakeup() cannot be used.
  module definition IpduM [0..1]: post-build-variant-support=true, variants link-time/post-build/pre-compile  # Configuration of the IpduM (Ipdu Multiplexer) module.
    container IpduMConfig  # This container contains the sub containers of the IpduM module. | * The IpduMTxPathway subcontainer includes information about sent I-PDUs. * The IpduMRxPathway includes information about received I-PDUs. * The IpduMContainerTxPdu and IpduMContainedTxPdu include information about the sending of ContainerPdus. * The IpduMContainerRxPdu and IpduMContainedRxPdu include information about the reception of ContainerPdus.
      integer IpduMMaxTxBufferSize [0..1]: 0..65535, multiplicity set at link in variant link-time+post-build / pre-compile in variant pre-compile, set at link in variant link-time+post-build / pre-compile in variant pre-compile  # Maximum total size of all Tx buffers. This parameter is needed only in case of post-build loadable implementation using static memory allocation.
      integer IpduMMaxTxPathwayCnt [0..1]: 0..65535, multiplicity set at link in variant link-time+post-build / pre-compile in variant pre-compile, set at link in variant link-time+post-build / pre-compile in variant pre-compile  # Maximum number of transmitted IPdus. This parameter is needed only in case of post-build loadable implementation using static memory allocation.
      container IpduMContainedRxPdu [0..*]: multiplicity set at link in variant link-time / post-build in variant post-build / pre-compile in variant pre-compile, post-build-variant-multiplicity=true  # Configuration of a received contained Pdu.
        integer IpduMContainedPduOffset [0..1]: 0..4294967295, scope=ECU, post-build-variant-value=true, set at link in variant link-time / post-build in variant post-build / pre-compile in variant pre-compile  # Static offset (in bytes) of the ContainedPdu. Tags: atp.Status=draft
        integer IpduMContainedRxPduLongHeaderId [0..1]: 1..4294967295, multiplicity set at link in variant link-time / post-build in variant post-build / pre-compile in variant pre-compile, post-build-variant-multiplicity=true, post-build-variant-value=true, set at link in variant link-time / post-build in variant post-build / pre-compile in variant pre-compile  # LongHeader Id which is part of the ContainerPdu when this ContainedPdu is inside.
        integer IpduMContainedRxPduShortHeaderId [0..1]: 1..16777215, multiplicity set at link in variant link-time / post-build in variant post-build / pre-compile in variant pre-compile, post-build-variant-multiplicity=true, post-build-variant-value=true, set at link in variant link-time / post-build in variant post-build / pre-compile in variant pre-compile  # ShortHeader Id which is part of the ContainerPdu when this ContainedPdu is inside.
        integer IpduMPduUpdateBitPosition [0..1]: 0..4294967295, post-build-variant-value=true, set at link in variant link-time / post-build in variant post-build / pre-compile in variant pre-compile  # This value specifies where the PDU's Update-Bit is stored in the Container PDU (bit location of PDU's Update-Bit in the Container PDU). Tags: atp.Status=draft
        reference IpduMContainedRxInContainerPduRef [0..1]: multiplicity set at link in variant link-time / post-build in variant post-build / pre-compile in variant pre-compile, post-build-variant-multiplicity=true, post-build-variant-value=true, set at link in variant link-time / post-build in variant post-build / pre-compile in variant pre-compile, destination=IpduMContainerRxPdu  # Optional reference to an IpduMContainerRxPdu this IpduMContainedRxPdu may be received in. | If this IpduMContainedRxPdu shall be received in exactly one IpduMContainerRxPdu with IpduMContainerRxAcceptContainedPdu=IPDUM_ACCEPT_CONFIGURED then the IpduMContainedRxInContainerPduRef shall be defined. If this IpduMContainedRxPdu can be received in any IpduMContainerRxPdu with IpduMContainerRxAcceptContainedPdu=IPDUM_ACCEPT_ALL then the IpduMContainedRxInContainerPduRef shall NOT be defined.
        reference IpduMContainedRxPduRef: scope=ECU, post-build-variant-value=true, set at link in variant link-time / post-build in variant post-build / pre-compile in variant pre-compile, destination=Pdu  # Reference to the Pdu which represents this ContainedPdu and is used for reception indication.
      container IpduMContainedTxPdu [0..*]: multiplicity set at link in variant link-time / post-build in variant post-build / pre-compile in variant pre-compile, post-build-variant-multiplicity=true  # Configuration of a sender ContainedPdu.
        integer IpduMContainedPduHeaderId [0..1]: 1..4294967295, post-build-variant-value=true, set at link in variant link-time / post-build in variant post-build / pre-compile in variant pre-compile  # Header Id which is part of the ContainerPdu when this ContainedPdu is inside.
        integer IpduMContainedPduOffset [0..1]: 0..4294967295, scope=ECU, post-build-variant-value=true, set at link in variant link-time / post-build in variant post-build / pre-compile in variant pre-compile  # Static offset (in bytes) of the ContainedPdu. Tags: atp.Status=draft
        enumeration IpduMContainedTxPduCollectionSemantics: {IPDUM_COLLECT_LAST_IS_BEST, IPDUM_COLLECT_QUEUED}, post-build-variant-value=true, set at link in variant link-time / post-build in variant post-build / pre-compile in variant pre-compile  # Defines whether this IpduMContainedTxPdu shall be collected using a last-is-best or queued semantics.
        boolean IpduMContainedTxPduConfirmation [0..1]: multiplicity set at pre-compile, set at pre-compile, default-value=false  # This Parameter determines whether for this contained I-PDU a TxConfirmation shall be provided. If set to TRUE a TxConfirmation is issued. It is not used when an I-PDU is requested using the trigger transmit API. | If this Parameter is omitted, the default value shall be used.
        integer IpduMContainedTxPduHandleId: 0..65535, scope=ECU, set at pre-compile, symbolic-name-value=true  # Handle Id of the ContainedPdu.
        integer IpduMContainedTxPduPriority [0..1]: 0..255, multiplicity set at link in variant link-time / post-build in variant post-build / pre-compile in variant pre-compile, post-build-variant-multiplicity=true, post-build-variant-value=true, set at link in variant link-time / post-build in variant post-build / pre-compile in variant pre-compile, default-value=255  # Defines a priority of a ContainedTxPdu. 255 represents the lowest priority and 0 represent the highest priority.
        float IpduMContainedTxPduSendTimeout [0..1]: 0..65.535, multiplicity set at link in variant link-time / post-build in variant post-build / pre-compile in variant pre-compile, post-build-variant-multiplicity=true, post-build-variant-value=true, set at link in variant link-time / post-build in variant post-build / pre-compile in variant pre-compile  # Defines a ContainedPdu specific sender timeout which can reduce the ContainerPdu timer when this ContainedPdu is put inside the ContainerPdu. | Defined in seconds.
        enumeration IpduMContainedTxPduTrigger: {IPDUM_TRIGGER_ALWAYS, IPDUM_TRIGGER_NEVER}, post-build-variant-value=true, set at link in variant link-time / post-build in variant post-build / pre-compile in variant pre-compile  # Defines whether this Pdu triggers the sending of the ContainerPdu.
        integer IpduMPduUpdateBitPosition [0..1]: 0..4294967295, post-build-variant-value=true, set at link in variant link-time / post-build in variant post-build / pre-compile in variant pre-compile  # This value specifies where the PDU's Update-Bit is stored in the Container PDU (bit location of PDU's Update-Bit in the Container PDU). Tags: atp.Status=draft
        reference IpduMContainedTxInContainerPduRef: post-build-variant-value=true, set at link in variant link-time / post-build in variant post-build / pre-compile in variant pre-compile, destination=IpduMContainerTxPdu  # Reference to the container Pdu which this contained Pdu shall be collected in.
        reference IpduMContainedTxPduRef: scope=ECU, post-build-variant-value=true, set at link in variant link-time / post-build in variant post-build / pre-compile in variant pre-compile, destination=Pdu  # Reference to the Pdu which represents this ContainedPdu and is used for transmission.
      container IpduMContainerRxPdu [0..*]: multiplicity set at link in variant link-time / post-build in variant post-build / pre-compile in variant pre-compile, post-build-variant-multiplicity=true  # Configuration of a receiver ContainerPdu which may collect several ContainedPdus.
        enumeration IpduMContainerHeaderSize: post-build-variant-value=true, set at link in variant link-time / post-build in variant post-build / pre-compile in variant pre-compile  # Defines the layout of the header information (header id and length).
          IPDUM_HEADERTYPE_LONG
          IPDUM_HEADERTYPE_NONE  # Tags: atp.Status=draft
          IPDUM_HEADERTYPE_SHORT
        enumeration IpduMContainerPduProcessing: {IPDUM_PROCESSING_DEFERRED, IPDUM_PROCESSING_IMMEDIATE}, post-build-variant-value=true, set at link in variant link-time / post-build in variant post-build / pre-compile in variant pre-compile  # Defines whether the handling of this ContainerPdu shall be done in the context of the caller (IMMEDIATE) or in the next call to IpduM_MainFunctionRx (DEFERRED).
        integer IpduMContainerQueueSize [0..1]: 1..255, multiplicity set at link in variant link-time / post-build in variant post-build / pre-compile in variant pre-compile, post-build-variant-multiplicity=true, post-build-variant-value=true, set at link in variant link-time / post-build in variant post-build / pre-compile in variant pre-compile, default-value=1  # Defines a local queue for handling of each ContainerPdu. | Defined in number of instances of this ContainerPdu.
        enumeration IpduMContainerRxAcceptContainedPdu: {IPDUM_ACCEPT_ALL, IPDUM_ACCEPT_CONFIGURED}, post-build-variant-value=true, set at link in variant link-time / post-build in variant post-build / pre-compile in variant pre-compile  # Defines for the received IpduMContainerRxPdu whether the list of referencing IpduMContainedRxPdus (via the reference IpduMContainedPduContainerRefRx) is a closed set.
        integer IpduMContainerRxHandleId: 0..65535, scope=ECU, set at pre-compile, symbolic-name-value=true  # Handle Id used by the PduR for RxIndication.
        reference IpduMContainerRxPduRef: scope=ECU, post-build-variant-value=true, set at link in variant link-time / post-build in variant post-build / pre-compile in variant pre-compile, destination=Pdu  # Reference to the Pdu which represents the container and is used for reception.
        reference IpduMMainFunctionRxRef [0..1]: multiplicity set at pre-compile, post-build-variant-multiplicity=true, post-build-variant-value=true, set at pre-compile, destination=IpduMMainFunctionRx  # Reference to the IpduM_MainFunctionRx instance this container PDU belongs to. Tags: atp.Status=draft | Mandatory, if more than one IpduM_MainFunctionRx is defined.
      container IpduMContainerTxPdu [0..*]: multiplicity set at link in variant link-time / post-build in variant post-build / pre-compile in variant pre-compile, post-build-variant-multiplicity=true  # Configuration of a transmitted container Pdu.
        enumeration IpduMContainerHeaderSize: post-build-variant-value=true, set at link in variant link-time / post-build in variant post-build / pre-compile in variant pre-compile  # Defines the layout of the header information (header id and length).
          IPDUM_HEADERTYPE_LONG
          IPDUM_HEADERTYPE_NONE  # Tags: atp.Status=draft
          IPDUM_HEADERTYPE_SHORT
        integer IpduMContainerQueueSize [0..1]: 1..255, multiplicity set at link in variant link-time / post-build in variant post-build / pre-compile in variant pre-compile, post-build-variant-multiplicity=true, post-build-variant-value=true, set at link in variant link-time / post-build in variant post-build / pre-compile in variant pre-compile, default-value=1  # Defines a local queue for handling of each ContainerPdu. | Defined in number of instances of this ContainerPdu.
        boolean IpduMContainerTxFirstContainedPduTrigger: post-build-variant-value=true, set at link in variant link-time / post-build in variant post-build / pre-compile in variant pre-compile  # Defines if the transmission of this IpduMContainerTxPdu shall be requested right after the first IpduMContainedTxPdu was put into it.
        integer IpduMContainerTxHandleId [0..1]: 0..65535, scope=ECU, multiplicity set at pre-compile, set at pre-compile, symbolic-name-value=true  # Handle Id used by the PduR for TxConfirmation and for TriggerTransmit of the ContainerPdu.
        float IpduMContainerTxSendTimeout [0..1]: 0..65.535, multiplicity set at link in variant link-time / post-build in variant post-build / pre-compile in variant pre-compile, post-build-variant-multiplicity=true, post-build-variant-value=true, set at link in variant link-time / post-build in variant post-build / pre-compile in variant pre-compile  # When this timeout expires the ContainerPdu is triggered for sending. The respective timer is started when the first Pdu is put into the ContainerPdu. | Defined in seconds.
        integer IpduMContainerTxSizeThreshold [0..1]: 0..4294967295, multiplicity set at link in variant link-time / post-build in variant post-build / pre-compile in variant pre-compile, post-build-variant-multiplicity=true, post-build-variant-value=true, set at link in variant link-time / post-build in variant post-build / pre-compile in variant pre-compile  # Defines the size threshold in bytes which, when exceeded, triggers the sending of the ContainerPdu although the maxium Pdu size (PduLength parameter of Pdu object) has not been reached yet.
        enumeration IpduMContainerTxTriggerMode: {IPDUM_DIRECT, IPDUM_TRIGGERTRANSMIT}, post-build-variant-value=true, set at link in variant link-time / post-build in variant post-build / pre-compile in variant pre-compile  # Defines whether this ContainerPdu is fetched via trigger transmit.
        integer IpduMUnusedAreasDefault [0..1]: 0..255, scope=ECU, post-build-variant-value=true, set at link in variant link-time / post-build in variant post-build / pre-compile in variant pre-compile  # IpduM fills not updated areas of the Container PDU with this byte-pattern. Tags: atp.Status=draft
        reference IpduMContainerTxPduRef: scope=ECU, post-build-variant-value=true, set at link in variant link-time / post-build in variant post-build / pre-compile in variant pre-compile, destination=Pdu  # Reference to the Pdu which represents the container and is used for transmission.
        reference IpduMMainFunctionTxRef [0..1]: multiplicity set at pre-compile, post-build-variant-multiplicity=true, post-build-variant-value=true, set at pre-compile, destination=IpduMMainFunctionTx  # Reference to the IpduM_MainFunctionTx instance this container PDU belongs to. Tags: atp.Status=draft | Mandatory, if more than one IpduM_MainFunctionTx is defined.
      container IpduMMainFunctionRx [0..*]: multiplicity set at pre-compile, post-build-variant-multiplicity=true  # Each element of this container defines one instance IpduM_MainFunctionRx, in case multi-core distribution feature is active. Tags: atp.Status=draft
        float IpduMMainRxTimeBase: 0..INF, set at pre-compile  # The period between successive calls to according instance of IpduM_MainFunctionRx in seconds. This parameter may be used by the IpduM generator to transform the values of the reception related timing configuration parameters of the IpduM module to internal implementation specific counter or tick values. The IpduM module's internal timing handling is implementation specific. Tags: atp.Status=draft | The IpduM module (generator) may rely on the fact that IpduM_MainFunctionRx is scheduled according to the value configured here.
        reference IpduMMainRxPartitionRef: set at pre-compile, destination=EcucPartition  # Reference to EcucPartition, where the according IpduM_MainFunction instance is assigned to. Tags: atp.Status=draft
      container IpduMMainFunctionTx [0..*]: multiplicity set at pre-compile, post-build-variant-multiplicity=true  # Each element of this container defines one instance IpduM_MainFunctionTx, in case multi-core distribution feature is active (mutual exclusive to ComTimeBase). Tags: atp.Status=draft
        float IpduMMainTxTimeBase: 0..INF, set at pre-compile  # The period between successive calls to IpduM_MainFunctionTx in seconds. This parameter may be used by the IpduM generator to transform the values of the reception related timing configuration parameters of the IpduM module to internal implementation specific counter or tick values. The IpduM module's internal timing handling is implementation specific. Tags: atp.Status=draft | The IpduM module (generator) may rely on the fact that IpduM_MainFunctionTx is scheduled according to the value configured here.
        reference IpduMMainTxPartitionRef: set at pre-compile, destination=EcucPartition  # Reference to EcucPartition, where the according IpduM_MainFunction instance is assigned to. Tags: atp.Status=draft
      container IpduMRxPathway [0..*]: multiplicity set at link in variant link-time / post-build in variant post-build / pre-compile in variant pre-compile, post-build-variant-multiplicity=true  # Contains the configuration parameters received I-PDUs by the IpduM module.
        container IpduMRxIndication  # Contains the configuration for incoming RxIndication calls.
          enumeration IpduMByteOrder: {BIG_ENDIAN, LITTLE_ENDIAN}, post-build-variant-value=true, set at link in variant link-time / post-build in variant post-build / pre-compile in variant pre-compile  # This parameter defines the ByteOrder for all segments (static and dynamic part) and for the selectorField within the MultiplexedPdu. | The absolute position of a segment in the MultiplexedIPdu is determined by the definition of the ByteOrder parameter: If BIG_ENDIAN is specified, the SegmentPosition indicates the bit position of the most significant bit in an IPDU. If LITTLE_ENDIAN is specified, the SegmentPosition indicates the bit position of the least significant bit in an IPDU.
          integer IpduMRxHandleId: 0..65535, scope=ECU, set at pre-compile, symbolic-name-value=true  # This is the I-PDU ID of the incoming I-PDU. If an incoming RxIndication's I-PDU ID matches this value then it is unpacked according to the specification in this container.
          reference IpduMRxIndicationPduRef: scope=ECU, post-build-variant-value=true, set at link in variant link-time / post-build in variant post-build / pre-compile in variant pre-compile, destination=Pdu  # Reference to the received Pdu representation in the ECU Configuration Description exchange file.
          container IpduMRxDynamicPart [0..*]: multiplicity set at link in variant link-time / post-build in variant post-build / pre-compile in variant pre-compile, post-build-variant-multiplicity=true  # This container contains the configuration for the dynamic part of incoming RxIndication calls. When an incoming received I-PDU's selector field matches the IpduMRxSelectorValue, the new outgoing I-PDU for the dynamic part is constructed as defined by the segments (defined in the IpduMDynamicSegment container) and sent out with the I-PDU ID referenced by IpduMOutgoingDynamicPduRef. | In case no dynamic part shall be extracted from this received I-PDU this container does not exist. This use-case can occur in case a MultiplexedIPdu is received by an ECU which is only interested in the static part of the MultiplexedIPdu.
            integer IpduMRxSelectorValue: 0..65535, post-build-variant-value=true, set at link in variant link-time / post-build in variant post-build / pre-compile in variant pre-compile  # This is the selector value that this container refers to.
            reference IpduMOutgoingDynamicPduRef: scope=ECU, post-build-variant-value=true, set at link in variant link-time / post-build in variant post-build / pre-compile in variant pre-compile, destination=Pdu  # When the new I-PDU is sent out it is sent with this I-PDU ID. Reference to the sent PDU representation in the ECU Configuration Description exchange file.
          container IpduMRxDynamicSegment [0..*]: multiplicity set at link in variant link-time / post-build in variant post-build / pre-compile in variant pre-compile, post-build-variant-multiplicity=true  # The dynamic part of the multiplexed incoming I-Pdu (referenced by IpduMRxIndicationPduRef) can be separated into several segments. | For each segment one IpduMRxDynamicSegment container shall be created that contains the location and the length of the segment. Please note that each configured segment will be copied into the destination I-Pdu that is referenced in the IpduMRxDynamicPart container and will be copied from the same location in the multiplexed incoming I-Pdu. The segment layout for all dynamic Parts is always identical.
            integer IpduMSegmentLength: 1..2032, post-build-variant-value=true, set at link in variant link-time / post-build in variant post-build / pre-compile in variant pre-compile  # Length of the segment in bits.
            integer IpduMSegmentPosition: 0..2031, post-build-variant-value=true, set at link in variant link-time / post-build in variant post-build / pre-compile in variant pre-compile  # Segments bit position in the multiplexed Pdu.
          container IpduMRxStaticPart [0..1]: multiplicity set at link in variant link-time / post-build in variant post-build / pre-compile in variant pre-compile, post-build-variant-multiplicity=true  # This container contains the configuration for the static part of incoming RxIndication calls. On reception, the new outgoing I-PDU for the static part is constructed as defined by the segments (defined in the IpduMStaticSegment container) and sent out with the I-PDU ID referenced by IpduMOutgoingStaticPduRef.
            reference IpduMOutgoingStaticPduRef: scope=ECU, post-build-variant-value=true, set at link in variant link-time / post-build in variant post-build / pre-compile in variant pre-compile, destination=Pdu  # When the new I-PDU is sent out it is sent with this I-PDU ID. Reference to the sent Pdu representation in the ECU Configuration Description exchange file.
          container IpduMRxStaticSegment [0..*]: multiplicity set at link in variant link-time / post-build in variant post-build / pre-compile in variant pre-compile, post-build-variant-multiplicity=true  # The static part of the multiplexed incoming I-Pdu (referenced by IpduMRxIndicationPduRef) can be separated into several segments. | For each segment one IpduMRxStaticSegment container shall be created that contains the location and the length of the segment. Please note that each configured segment will be copied into the destination I-Pdu that is referenced in the IpduMRxStaticPart container and will be copied from the same location in the multiplexed incoming I-Pdu.
            integer IpduMSegmentLength: 1..2032, post-build-variant-value=true, set at link in variant link-time / post-build in variant post-build / pre-compile in variant pre-compile  # Length of the segment in bits.
            integer IpduMSegmentPosition: 0..2031, post-build-variant-value=true, set at link in variant link-time / post-build in variant post-build / pre-compile in variant pre-compile  # Segments bit position in the multiplexed Pdu.
          container IpduMSelectorField  # This contains the location and the length of the selector field.
            integer IpduMSelectorFieldLength: 1..16, post-build-variant-value=true, set at link in variant link-time / post-build in variant post-build / pre-compile in variant pre-compile  # Length of the selector field in bits.
            integer IpduMSelectorFieldPosition: 0..2031, post-build-variant-value=true, set at link in variant link-time / post-build in variant post-build / pre-compile in variant pre-compile  # Selector field bit position in the multiplexed Pdu. | Range: 0..63 for CAN/ LIN I-PDUs, 0..511 for CAN FD I-PDUs, 0..2031 for FlexRay I-PDUs.
      container IpduMTxPathway [0..*]: multiplicity set at link in variant link-time / post-build in variant post-build / pre-compile in variant pre-compile, post-build-variant-multiplicity=true  # Contains the configuration parameters transmitted I-PDUs by the IpduM module.
        container IpduMTxRequest  # This container is used to specify the configuration for Transmit requests. | There will be one instance of this container for each I-PDU that can be requested for transmission (the outgoing I-PDUs) by the IpduM.
          enumeration IpduMByteOrder: {BIG_ENDIAN, LITTLE_ENDIAN}, post-build-variant-value=true, set at link in variant link-time / post-build in variant post-build / pre-compile in variant pre-compile  # This parameter defines the ByteOrder for all segments (static and dynamic part) and for the selectorField within the MultiplexedPdu. | The absolute position of a segment in the MultiplexedIPdu is determined by the definition of the ByteOrder parameter: If BIG_ENDIAN is specified, the SegmentPosition indicates the bit position of the most significant bit in an IPDU. If LITTLE_ENDIAN is specified, the SegmentPosition indicates the bit position of the least significant bit in an IPDU.
          integer IpduMIPduUnusedAreasDefault [0..1]: 0..255, multiplicity set at link in variant link-time / post-build in variant post-build / pre-compile in variant pre-compile, post-build-variant-multiplicity=true, post-build-variant-value=true, set at link in variant link-time / post-build in variant post-build / pre-compile in variant pre-compile  # IpduM module fills not used areas of an I-PDU with this bit-pattern | If this attribute is omitted the IpduM module does not fill the I-PDU.
          integer IpduMTxConfirmationPduId [0..1]: 0..65535, multiplicity set at pre-compile, set at pre-compile, symbolic-name-value=true  # Handle Id used by the PduR for confirmation (IpduM_TxConfirmation) and for TriggerTransmit (IpduM_TriggerTransmit). | The existence of this parameter is essential for the PduR generation tool to actually find a symbolicNameValue for the OutgoingPdu.
          enumeration IpduMTxTriggerMode: {DYNAMIC_PART_TRIGGER, NONE, STATIC_OR_DYNAMIC_PART_TRIGGER, STATIC_PART_TRIGGER}, post-build-variant-value=true, set at link in variant link-time / post-build in variant post-build / pre-compile in variant pre-compile  # Selects whether to send the multiplexed I-PDU immediately or at some later date.
          reference IpduMInitialDynamicPart: post-build-variant-value=true, set at link in variant link-time / post-build in variant post-build / pre-compile in variant pre-compile, destination=IpduMTxDynamicPart  # Reference to the dynamic part that shall be used to initialize this multiplexed TX-I-PDU.
          reference IpduMOutgoingPduRef: scope=ECU, post-build-variant-value=true, set at link in variant link-time / post-build in variant post-build / pre-compile in variant pre-compile, destination=Pdu  # Reference to the PDU defining the outgoing I-PDU. | When the outgoing I-PDU is sent this is the I-PDU ID to give it. It is the IpduM I-PDU ID of the assembled I-PDU.
          container IpduMSelectorField  # This contains the location and the length of the selector field.
            integer IpduMSelectorFieldLength: 1..16, post-build-variant-value=true, set at link in variant link-time / post-build in variant post-build / pre-compile in variant pre-compile  # Length of the selector field in bits.
            integer IpduMSelectorFieldPosition: 0..2031, post-build-variant-value=true, set at link in variant link-time / post-build in variant post-build / pre-compile in variant pre-compile  # Selector field bit position in the multiplexed Pdu. | Range: 0..63 for CAN/ LIN I-PDUs, 0..511 for CAN FD I-PDUs, 0..2031 for FlexRay I-PDUs.
          container IpduMTxDynamicPart [1..*]: multiplicity set at link in variant link-time / post-build in variant post-build / pre-compile in variant pre-compile, post-build-variant-multiplicity=true  # Configuration parameters for an instance of a TxRequest call into the IpduM. When a Tx Request with the IpduMTxDynamicHandleId is received by the IpduM, all segments (defined in the IpduMDynamicSegment container) are copied from the incoming I-PDU into the outgoing I-PDU buffer and then the send mode honored. This container is used by the dynamic part of a TxRequest configuration. Therefore, for each outgoing I-PDU there will be one instance of this container for the dynamic part.
            boolean IpduMJitUpdate [0..1]: multiplicity set at link in variant link-time / post-build in variant post-build / pre-compile in variant pre-compile, post-build-variant-multiplicity=true, post-build-variant-value=true, set at link in variant link-time / post-build in variant post-build / pre-compile in variant pre-compile, default-value=false  # If configured to true fetch the data of this part Just-In-Time via the triggerTransmit API of the PduR.
            boolean IpduMTxDynamicConfirmation: post-build-variant-value=true, set at link in variant link-time / post-build in variant post-build / pre-compile in variant pre-compile  # A transmit request can be confirmed by the lower layer. If this parameter is set to true a confirmation of the I-PDU in COM representing the dynamic part is generated.
            integer IpduMTxDynamicHandleId: 0..65535, scope=ECU, set at pre-compile, symbolic-name-value=true  # This defines an incoming handle id. When the handle of an incoming Tx Request matches this id, the configured dynamic segments are copied and the IpduMTxTriggerMode is honored.
            reference IpduMTxDynamicPduRef: scope=ECU, post-build-variant-value=true, set at link in variant link-time / post-build in variant post-build / pre-compile in variant pre-compile, destination=Pdu  # Reference to the Pdu representation in the ECU Configuration Description exchange file to be transmitted.
          container IpduMTxDynamicSegment [1..*]: multiplicity set at link in variant link-time / post-build in variant post-build / pre-compile in variant pre-compile, post-build-variant-multiplicity=true  # The dynamic part of the multiplexed outgoing I-Pdu (referenced by IpduMOutgoingPduRef) can be separated into several segments. | For each segment one IpduMTxDynamicSegment container shall be created that contains the location and the length of the segment. Please note that each configured segment will be copied out of the source I-Pdu that is referenced in the IpduMTxDynamicPart container and will be copied to the same location in the multiplexed outgoing I-Pdu. The segment layout for all dynamic Parts is always identical.
            integer IpduMSegmentLength: 1..2032, post-build-variant-value=true, set at link in variant link-time / post-build in variant post-build / pre-compile in variant pre-compile  # Length of the segment in bits.
            integer IpduMSegmentPosition: 0..2031, post-build-variant-value=true, set at link in variant link-time / post-build in variant post-build / pre-compile in variant pre-compile  # Segments bit position in the multiplexed Pdu.
          container IpduMTxStaticPart [0..1]: multiplicity set at link in variant link-time / post-build in variant post-build / pre-compile in variant pre-compile, post-build-variant-multiplicity=true  # Configuration parameters for an instance of a Tx_Request call into the IpduM. When a Tx Request with the IpduMTxStaticHandleId is received by the IpduM, all segments (defined in the IpduMStaticSegment container) are copied from the incoming I-PDU into the outgoing I-PDU buffer and then the send mode honored. This container is used for the static part of a TxRequest configuration. Therefore, for each outgoing I-PDU there will be one instance of this container for the static part if it exists.
            boolean IpduMJitUpdate [0..1]: multiplicity set at link in variant link-time / post-build in variant post-build / pre-compile in variant pre-compile, post-build-variant-multiplicity=true, post-build-variant-value=true, set at link in variant link-time / post-build in variant post-build / pre-compile in variant pre-compile, default-value=false  # If configured to true fetch the data of this part Just-In-Time via the triggerTransmit API of the PduR.
            boolean IpduMTxStaticConfirmation: post-build-variant-value=true, set at link in variant link-time / post-build in variant post-build / pre-compile in variant pre-compile  # A transmit request can be confirmed by the lower layer. If this parameter is set to true a confirmation of the I-PDU in COM representing the static part is generated.
            integer IpduMTxStaticHandleId: 0..65535, scope=ECU, set at pre-compile, symbolic-name-value=true  # This defines an incoming handle id. When the handle of an incoming Tx Request matches this id, the configured static segments are copied and the IpduMTxTriggerMode is honored.
            reference IpduMTxStaticPduRef: scope=ECU, post-build-variant-value=true, set at link in variant link-time / post-build in variant post-build / pre-compile in variant pre-compile, destination=Pdu  # Reference to the Pdu representation in the ECU Configuration Description exchange file to be transmitted.
          container IpduMTxStaticSegment [0..*]: multiplicity set at link in variant link-time / post-build in variant post-build / pre-compile in variant pre-compile, post-build-variant-multiplicity=true  # The static part of the multiplexed outgoing I-Pdu (referenced by IpduMOutgoingPduRef) can be separated into several segments. | For each segment one IpduMTxStaticSegment container shall be created that contains the location and the length of the segment. Please note that each segment in the source I-Pdu that is referenced in the IpduMTxStaticPart container will be copied to the same location in the multiplexed outgoing I-Pdu.
            integer IpduMSegmentLength: 1..2032, post-build-variant-value=true, set at link in variant link-time / post-build in variant post-build / pre-compile in variant pre-compile  # Length of the segment in bits.
            integer IpduMSegmentPosition: 0..2031, post-build-variant-value=true, set at link in variant link-time / post-build in variant post-build / pre-compile in variant pre-compile  # Segments bit position in the multiplexed Pdu.
    container IpduMGeneral  # Contains the general configuration parameters of IpduM.
      boolean IpduMContainedTxPduPriorityHandling [0..1]: scope=ECU, multiplicity set at pre-compile, set at pre-compile, default-value=false  # This parameter enables/disables handling of priority for IpduMContainedTxPdu's with IpduMContainedTxPduCollectionSemantics IPDUM_LAST_IS_BEST. | true: enabled false: disabled
      boolean IpduMDevErrorDetect: set at pre-compile, default-value=false  # Switches the development error detection and notification on or off. | * true: detection and notification is enabled. * false: detection and notification is disabled.
      enumeration IpduMHeaderByteOrder [0..1]: {IPDUM_BIG_ENDIAN, IPDUM_LITTLE_ENDIAN}, set at pre-compile  # This parameter defines the ByteOrder of the headers inside a Container I-PDU.
      boolean IpduMMetaDataSupport [0..1]: scope=ECU, multiplicity set at pre-compile, set at pre-compile, default-value=false  # This parameter enables/disables the support of meta-data feature. | true: enabled false: disabled
      boolean IpduMStaticPartExists: set at pre-compile  # This is to allow optimizations in the case the IpduM will never be used with a static part. | Note that this is a pre-compile option. If this is set to False then it will not be possible to add static parts after compilation. True: A static part may exist. False: A static part will never exist.
      boolean IpduMVersionInfoApi: set at pre-compile, default-value=false  # Active/Deactivate the version information API. | true: version information activated false: version information deactivated
    container IpduMPublishedInformation  # Additional published parameters not covered by | CommonPublishedInformation container. Note that these parameters do not have any configuration class setting, since they are published information.
      boolean IpduMRxDirectComInvocation: set at published-information  # If set to TRUE the COM invocation optimization as defined in | IPDUM140 is implemented.
  module definition J1939Dcm [0..1]: post-build-variant-support=true, variants link-time/post-build/pre-compile  # The SAE J1939 Dcm module
    container J1939DcmConfigSet  # This container contains the configuration parameters and sub containers of the AUTOSAR J1939Dcm module.
      container J1939DcmChannel [1..*]  # Contains the J1939DcmChannel parameters.
        enumeration J1939DcmBusType: {J1939DCM_ISO9141, J1939DCM_J1587, J1939DCM_J1850, J1939DCM_J1922, J1939DCM_J1939_NETWORK_1, J1939DCM_J1939_NETWORK_2, J1939DCM_J1939_NETWORK_3, J1939DCM_J1939_NETWORK_4, J1939DCM_OTHER, J1939DCM_PROPRIETARY_NETWORK_1, J1939DCM_PROPRIETARY_NETWORK_2}, set at pre-compile  # Identifies the communication port
        reference J1939DcmComMChannelRef: scope=ECU, post-build-variant-value=true, set at link in variant link-time / post-build in variant post-build / pre-compile in variant pre-compile, requires-symbolic-name-value=true, destination=ComMChannel  # Reference to the ComMChannel.
      choice container J1939DcmDspExternalSRDataElementClass [0..1]  # This container defines the source of data in a provided port which shall be read respectively the target of data in a required port which shall be written. | This container shall contain either one J1939DcmSubElementInDataElementInstance OR J1939DcmDataElementInstance OR J1939DcmSubElementInImplDataElementInstance reference.
        container J1939DcmDataElementInstance [0..1]  # Instance Reference to the primitive data in a port where the data element is typed with an ApplicationPrimitveDataType or an ImplementationDataType.
          instance reference J1939DcmDataElementInstanceRef: set at pre-compile, destination-context=ROOT-SW-COMPOSITION-PROTOTYPE SW-COMPONENT-PROTOTYPE PORT-PROTOTYPE, destination-type=AUTOSAR-DATA-PROTOTYPE  # Instance Reference to the primitive data which shall be read or written. | Supported are VariableDataPrototypes in SenderReceiverInterfaces and NvDataInterfaces and ParameterDataPrototypes in ParameterInterfaces (read only). This reference is applicable if the AutosarDataPrototype is typed with a ApplicationPrimitiveDataType of category VALUE or BOOLEAN or if the AutosarDataPrototype is typed with a ImplementationDataType of category VALUE or TYPE_REFERENCE that in turn boils down to VALUE
        container J1939DcmSubElementInDataElementInstance [0..1]  # Instance Reference to the primitve sub-element (at any level) of composite data in a port where the data element is typed with an ApplicationCompositeDataType.
          instance reference J1939DcmSubElementInDataElementInstanceRef: set at pre-compile, destination-context=ROOT-SW-COMPOSITION-PROTOTYPE SW-COMPONENT-PROTOTYPE PORT-PROTOTYPE AUTOSAR-DATA-PROTOTYPE APPLICATION-COMPOSITE-ELEMENT-DATA-PROTOTYPE*, destination-type=APPLICATION-COMPOSITE-ELEMENT-DATA-PROTOTYPE  # Instance Reference to the primitve sub-element (at any level) of composite data in a port which shall be read. | Supported are VariableDataPrototypes in SenderReceiverInterfaces and NvDataInterfaces and ParameterDataPrototypes in ParameterInterfaces (read only). This reference is applicable if the AutosarDataPrototype is typed with a ApplicationCompositeDataType.
        container J1939DcmSubElementInImplDataElementInstance [0..1]  # Instance Reference to the primitve sub-element (at any level) of composite data in a port where the data element is typed with an ImplementationDataType.
          instance reference J1939DcmSubElementInImplDataElementInstanceRef: set at pre-compile, destination-context=ROOT-SW-COMPOSITION-PROTOTYPE SW-COMPONENT-PROTOTYPE PORT-PROTOTYPE AUTOSAR-DATA-PROTOTYPE IMPLEMENTATION-DATA-TYPE-ELEMENT*, destination-type=IMPLEMENTATION-DATA-TYPE-ELEMENT  # Instance Reference to the primitve sub-element (at any level) of composite data in a port which shall be read. | Supported are VariableDataPrototypes in SenderReceiverInterfaces and NvDataInterfaces and ParameterDataPrototypes in ParameterInterfaces (read only). This reference is applicable if the AutosarDataPrototype is typed with a ImplementationDataType of category STRUCTURE or ARRAY. Please note that in case of ARRAY the index attribute in the target reference has to be set to select a single array element.
      container J1939DcmNode [1..*]  # Contains the parameters for the support of a logical J1939 node.
        function name J1939DcmGenericDMxCopyRxDataFunction [0..1]: multiplicity set at pre-compile, set at pre-compile  # Provides part of the data of an unsupported DMx message. Required if J1939DcmGenericDMxSupport is enabled.
        function name J1939DcmGenericDMxCopyTxDataFunction [0..1]: multiplicity set at pre-compile, set at pre-compile  # Requests to provide part of the data of an unsupported DMx message, following a call to J1939Dcm_GenericDMxTransmit. Required if J1939DcmGenericDMxSupport is enabled.
        function name J1939DcmGenericDMxRequestFunction [0..1]: multiplicity set at pre-compile, set at pre-compile  # Indicates the reception of a request for an unsupported DMx message. Required if J1939DcmGenericDMxSupport is enabled.
        function name J1939DcmGenericDMxRxIndicationFunction [0..1]: multiplicity set at pre-compile, set at pre-compile  # Confirms complete reception of an unsupported DMx message. Required if J1939DcmGenericDMxSupport is enabled.
        function name J1939DcmGenericDMxStartOfReceptionFunction [0..1]: multiplicity set at pre-compile, set at pre-compile  # Indicates reception of an unsupported DMx message. Required if J1939DcmGenericDMxSupport is enabled.
        function name J1939DcmGenericDMxTxConfirmationFunction [0..1]: multiplicity set at pre-compile, set at pre-compile  # Confirms transmission of an unsupported DMx message. Required if J1939DcmGenericDMxSupport is enabled.
        integer J1939DcmSPNsInDataStream [0..*]: 0..524287, multiplicity set at pre-compile, set at pre-compile  # Defines the SPNs available in data stream for use in DM24.
        reference J1939DcmDemClientRef: set at link in variant link-time+post-build / pre-compile in variant pre-compile, requires-symbolic-name-value=true, destination=DemClient  # Reference to the corresponding Dem Client.
        reference J1939DcmNmNodeRef: set at link in variant link-time+post-build / pre-compile in variant pre-compile, requires-symbolic-name-value=true, destination=J1939NmNode  # Reference to the corresponding J1939Nm node.
        reference J1939DcmNodeRmUserRef: post-build-variant-value=true, set at link in variant link-time / post-build in variant post-build / pre-compile in variant pre-compile, requires-symbolic-name-value=true, destination=J1939RmDcmUser  # Reference to the J1939RmUser used by J1939Dcm.
        reference J1939DcmServiceOnlyDTCsMemoryDestinationRef [0..1]: set at pre-compile, requires-symbolic-name-value=true, destination=DemUserDefinedMemory  # Reference to the user defined memory used for the Service Only DTCs handled by DM53, DM54, and DM55.
        container J1939DcmDiagnosticMessageSupport [1..*]  # Contains parameters to configure the diagnostic message support
          enumeration J1939DcmDmxSupport: {J1939DCM_DM01_SUPPORT, J1939DCM_DM02_SUPPORT, J1939DCM_DM03_SUPPORT, J1939DCM_DM04_SUPPORT, J1939DCM_DM05_SUPPORT, J1939DCM_DM06_SUPPORT, J1939DCM_DM07_SUPPORT, J1939DCM_DM08_SUPPORT, J1939DCM_DM09_SUPPORT, J1939DCM_DM10_SUPPORT, J1939DCM_DM11_SUPPORT, J1939DCM_DM12_SUPPORT, J1939DCM_DM13_SUPPORT, J1939DCM_DM14_SUPPORT, J1939DCM_DM15_SUPPORT, J1939DCM_DM16_SUPPORT, J1939DCM_DM17_SUPPORT, J1939DCM_DM18_SUPPORT, J1939DCM_DM19_SUPPORT, J1939DCM_DM20_SUPPORT, J1939DCM_DM21_SUPPORT, J1939DCM_DM22_SUPPORT, J1939DCM_DM23_SUPPORT, J1939DCM_DM24_SUPPORT, J1939DCM_DM25_SUPPORT, J1939DCM_DM26_SUPPORT, J1939DCM_DM27_SUPPORT, J1939DCM_DM28_SUPPORT, J1939DCM_DM29_SUPPORT, J1939DCM_DM30_SUPPORT, J1939DCM_DM31_SUPPORT, J1939DCM_DM32_SUPPORT, J1939DCM_DM33_SUPPORT, J1939DCM_DM34_SUPPORT, J1939DCM_DM35_SUPPORT, J1939DCM_DM36_SUPPORT, J1939DCM_DM37_SUPPORT, J1939DCM_DM38_SUPPORT, J1939DCM_DM39_SUPPORT, J1939DCM_DM40_SUPPORT, J1939DCM_DM41_SUPPORT, J1939DCM_DM42_SUPPORT, J1939DCM_DM43_SUPPORT, J1939DCM_DM44_SUPPORT, J1939DCM_DM45_SUPPORT, J1939DCM_DM46_SUPPORT, J1939DCM_DM47_SUPPORT, J1939DCM_DM48_SUPPORT, J1939DCM_DM49_SUPPORT, J1939DCM_DM50_SUPPORT, J1939DCM_DM51_SUPPORT, J1939DCM_DM52_SUPPORT, J1939DCM_DM53_SUPPORT, J1939DCM_DM54_SUPPORT, J1939DCM_DM55_SUPPORT, J1939DCM_DM56_SUPPORT, J1939DCM_DM57_SUPPORT}, set at pre-compile  # This parameter is used to identify the actual DMx message.
          reference J1939DcmDiagnosticMessageModeRuleRef [0..1]: scope=ECU, multiplicity set at link in variant link-time / pre-compile in variant post-build+pre-compile, set at link in variant link-time / pre-compile in variant post-build+pre-compile, destination=J1939DcmModeRule  # Reference to a J1939DcmModeRule which controls the execution of a DiagnosticMessage.
          reference J1939DcmDiagnosticMessageSupportChannelRef: set at link in variant link-time+post-build / pre-compile in variant pre-compile, destination=J1939DcmChannel  # Reference to J1939DcmChannel for which this diagnostic message is supported.
          container J1939DcmRxPdu [0..1]  # Contains parameters to configure the J1939DcmRxPdu. | This PDU consumes meta data items of type CAN_ID_32 for PDUs received from CanIf, and of type SOURCE_ADDRESS_16, TARGET_ADDRESS_16, and PRIORITY_8 for PDUs received from J1939Tp.
            integer J1939DcmRxPduId: 0..65535, scope=ECU, set at pre-compile, symbolic-name-value=true  # The I-PDU identifier used for communication with PduR.
            reference J1939DcmRxPduRef: post-build-variant-value=true, set at link in variant link-time / post-build in variant post-build / pre-compile in variant pre-compile, destination=Pdu  # Reference to the global Pdu element in the Ecuc module.
          container J1939DcmTxPdu [0..1]  # Contains parameters to configure the J1939DcmTxPdu. | This PDU produces meta data items of type CAN_ID_32 for PDUs transmitted via CanIf, and of type SOURCE_ADDRESS_16, TARGET_ADDRESS_16, and PRIORITY_8 for PDUs transmitted via J1939Tp.
            integer J1939DcmTxPduId: 0..65535, scope=ECU, set at pre-compile, symbolic-name-value=true  # The I-PDU identifier used to identify the Tx message.
            reference J1939DcmTxPduRef: post-build-variant-value=true, set at link in variant link-time / post-build in variant post-build / pre-compile in variant pre-compile, destination=Pdu  # Reference to the global Pdu element in the Ecuc module.
      container J1939DcmProcessingConditions [0..1]  # This container contains the configuration for mode arbitration functionality of the J1939Dcm
        container J1939DcmModeCondition [1..*]  # This container contains the configuration of a mode condition or an environmental conditions which can be used as argument in J1939DcmModeRules. | One J1939DcmModeCondition shall contain either one J1939DcmSwcModeRef or one J1939DcmBswModeRef or one J1939DcmSwcSRDataElementRef. Please note that the J1939Dcm acts as well as mode manager. Therefore the references J1939DcmSwcModeRef or one J1939DcmBswModeRef might point to provided ModeDeclarationGroupPrototypes of the J1939Dcm itself as well as to provided ModeDeclarationGroupPrototypes of other Bsw Modules or software components. In case of a configured J1939DcmSwcModeRef or J1939DcmBswModeRef only the J1939DcmConditionType J1939DCM_EQUALS or J1939DCM_EQUALS_NOT are applicable. In case of J1939DcmSwcSRDataElementRef all literals of J1939DcmConditionType are possible.
          enumeration J1939DcmConditionType: {J1939DCM_EQUALS, J1939DCM_EQUALS_NOT, J1939DCM_GREATER_OR_EQUAL, J1939DCM_GREATER_THAN, J1939DCM_LESS_OR_EQUAL, J1939DCM_LESS_THAN}, set at pre-compile  # This parameter specifies what kind of comparison that is made for the evaluation of the mode condition.
          instance reference J1939DcmBswModeRef [0..1]: multiplicity set at pre-compile, set at pre-compile, destination-context=MODE-DECLARATION-GROUP-PROTOTYPE, destination-type=MODE-DECLARATION  # This parameter references a mode of a ModeDeclarationGroupPrototype provided by a Basic Software Module used for the condition. | Please note that such ModeDeclarationGroupPrototype are owned by a Basic Software Module Description in the role providedModeGroup.
          instance reference J1939DcmSwcModeRef [0..1]: multiplicity set at pre-compile, set at pre-compile, destination-context=ROOT-SW-COMPOSITION-PROTOTYPE SW-COMPONENT-PROTOTYPE P-PORT-PROTOTYPE MODE-DECLARATION-GROUP-PROTOTYPE, destination-type=MODE-DECLARATION  # This parameter references a mode in a particular mode request port of a software component that is used for the condition.
          reference J1939DcmSwcSRDataElementRef [0..1]: multiplicity set at pre-compile, set at pre-compile, destination=J1939DcmDspExternalSRDataElementClass  # Reference to environmental conditions. | It is possible to reference a S/R Receiver-Port to read physical values and compare (equal, greater, less,...) them with a configured value that is defined by J1939DcmSwcSRDataElementValue.
          choice container J1939DcmSwcSRDataElementValue  # This container contains the configuration of a S/R compare value.
            container J1939DcmSwcSRDataElementArray [0..1]  # This container contains the configuration of a array SR data element compare value.
              container J1939DcmSwcSRDataElementArrayElement [0..*]  # This container contains the configuration of a array element SR data element compare value.
                integer J1939DcmSwcSRDataElementArrayElementIndex: 0..18446744073709551615, set at pre-compile  # Index to an array SR data element.
                integer J1939DcmSwcSRDataElementArrayElementValue: 0..18446744073709551615, set at pre-compile  # Value of an array SR data element compare value.
            container J1939DcmSwcSRDataElementPrimitive [0..1]  # This container contains the configuration of a primitive SR data element compare value.
              integer J1939DcmSwcSRDataElementPrimitiveValue: 0..18446744073709551615, set at pre-compile  # Reference to a primitive SR data element compare value.
        container J1939DcmModeRule [1..*]  # This container contains the configuration of a mode rule which represents a logical expression with J1939DcmModeConditions or other J1939DcmModeRules as arguments. | All arguments are processed with the operator defined by DcmLogicalOperator, for instance: Argument_A AND Argument_B AND Argument_C
          enumeration J1939DcmLogicalOperator [0..1]: {J1939DCM_AND, J1939DCM_OR}, multiplicity set at pre-compile, set at pre-compile  # This parameter specifies the logical operator to be used in the logical expression. If the expression only consists of a single condition this parameter shall not be used.
          integer J1939DcmModeRuleNrcValue [0..1]: 1..255, scope=ECU, multiplicity set at link in variant link-time / pre-compile in variant pre-compile, set at link in variant link-time / pre-compile in variant pre-compile  # Optional parameter which defines the NRC to be sent in case the mode rule condition is not valid.
          choice reference J1939DcmArgumentRef [1..*]: multiplicity set at pre-compile, requires-index=true, set at pre-compile, destination=[J1939DcmModeCondition, J1939DcmModeRule]  # This is a choice reference either to a mode condition or a an other mode rule serving as sub-expression.
    container J1939DcmGeneral  # Contains the general configuration parameters of the module.
      integer J1939DcmCommonBufferSize: 1..65535, set at pre-compile  # Size of common buffer (in Bytes). The buffer size should be as large as the longest command or response message.
      boolean J1939DcmDevErrorDetect: set at pre-compile, default-value=false  # Switches the development error detection and notification on or off. | * true: detection and notification is enabled. * false: detection and notification is disabled.
      integer J1939DcmDM01BufferSize [0..1]: 1..65535, multiplicity set at pre-compile, set at pre-compile  # Size of DM01 buffer (in Bytes). The buffer size should be as large as the longest DM01 response message.
      integer J1939DcmDM01MaxDTCs: 1..255, set at pre-compile, default-value=20  # Configuration value of limitation of maximum DTCs to be reported in the DM01 message.
      integer J1939DcmDM35BufferSize [0..1]: 1..65535, multiplicity set at pre-compile, set at pre-compile  # Size of DM35 buffer (in Bytes). The buffer size should be as large as the longest DM35 response message.
      boolean J1939DcmGenericDMxSupport: set at pre-compile, default-value=false  # Switches the support for all DMx messages that are not directly implemented in J1939Dcm. True: Unsupported DMx messages are handled by a CDD. False: Unsupported DMx messages are ignored/rejected.
      float J1939DcmMainFunctionPeriod: 0..INF, scope=ECU, set at link in variant link-time+post-build / pre-compile in variant pre-compile  # Call cycle in seconds of J1939Dcm_MainFunction.
      integer J1939DcmMaxDTCsPerMainFunction [0..1]: 1..255, multiplicity set at pre-compile, set at pre-compile  # Maximum threshold of DTCs filtered in a single MainFunction cycle.
      integer J1939DcmMaxFreezeFramesPerMainFunction [0..1]: 1..255, multiplicity set at pre-compile, set at pre-compile  # Maximum threshold of FreezeFrames filtered in a single MainFunction cycle.
      integer J1939DcmMaxRatiosPerMainFunction [0..1]: 1..255, multiplicity set at pre-compile, set at pre-compile  # Maximum threshold of Ratios filtered in a single MainFunction cycle.
      boolean J1939DcmVersionInfoApi: set at pre-compile, default-value=false  # Pre-processor switch for enabling version info API support.
  module definition J1939Nm [0..1]: post-build-variant-support=true, variants link-time/post-build/pre-compile  # Configuration of the J1939 Network Management module.
    container J1939NmConfigSet  # This container contains the configuration parameters and sub containers of the AUTOSAR J1939Nm module.
      container J1939NmChannel [1..*]: multiplicity set at link in variant link-time / post-build in variant post-build / pre-compile in variant pre-compile, post-build-variant-multiplicity=true  # Physical CAN channel handled by J1939Nm.
        boolean J1939NmChannelUsesAddressArbitration: post-build-variant-value=true, set at link in variant link-time / post-build in variant post-build / pre-compile in variant pre-compile, default-value=true  # Defines whether the nodes attached to this channel use an initial address claim, and whether they react to contending address claims of other nodes. | True: The initial address claim is sent, and the node reacts to address claims of other nodes. False: The node only sends an address claim upon request, and does not react to other address claims.
        reference J1939NmComMNetworkHandleRef: set at link in variant link-time+post-build / pre-compile in variant pre-compile, requires-symbolic-name-value=true, destination=ComMChannel  # Reference to the channel defined by the ComMChannel providing access to the unique channel index ComMChannelId.
        container J1939NmNodeSpecificDemEventParameterRefs [0..*]: multiplicity set at link in variant link-time / post-build in variant post-build / pre-compile in variant pre-compile, post-build-variant-multiplicity=true  # Container for the references to DemEventParameter elements related to one J1939NmNode which shall be invoked using the API Dem_SetEventStatus in case the corresponding error occurs. The EventId is taken from the referenced DemEventParameter's DemEventId symbolic value. The standardized errors are provided in this container and can be extended by vendor-specific error references.
          reference J1939NM_E_ADDRESS_LOST: set at pre-compile, requires-symbolic-name-value=true, destination=DemEventParameter  # Reference to the DemEventParameter which shall be issued when the ECU failed to claim one of its addresses.
          reference J1939NmNodeRef: post-build-variant-value=true, set at link in variant link-time / post-build in variant post-build / pre-compile in variant pre-compile, destination=J1939NmNode  # Reference to J1939NmNode.
        container J1939NmRxPdu  # Contains the configuration of the PDU used to receive the AddressClaimed PG. This PDU consumes a meta data item of type CAN_ID_32.
          integer J1939NmRxPduId: 0..65535, scope=ECU, set at pre-compile, symbolic-name-value=true  # The PDU identifier used for RxIndication from CanIf.
          reference J1939NmRxPduRef: set at link in variant link-time+post-build / pre-compile in variant pre-compile, destination=Pdu  # Reference to the Pdu object representing the PDU.
        container J1939NmTxPdu  # Contains the configuration of the PDU used to transmit the AddressClaimed PG. This PDU produces a meta data item of type CAN_ID_32.
          integer J1939NmTxPduId: 0..65535, scope=ECU, set at pre-compile, symbolic-name-value=true  # The PDU identifier used for TxConfirmation from CanIf.
          reference J1939NmTxPduRef: set at link in variant link-time+post-build / pre-compile in variant pre-compile, destination=Pdu  # Reference to the Pdu object representing the PDU.
      container J1939NmExternalNode [0..*]: multiplicity set at pre-compile  # Logical node implemented in another ECU. Configures potential communication partners. If this container is connected to more than one channel, the external ECU is linked to the local ECU by each of these channels.
        integer J1939NmExternalNodeId: 0..65535, scope=ECU, set at pre-compile, symbolic-name-value=true  # Unique identifier of this external node.
        boolean J1939NmExternalNodeNameArbitraryAddressCapable: post-build-variant-value=true, set at link in variant link-time / post-build in variant post-build / pre-compile in variant pre-compile  # Arbitrary Address Capable field of the NAME of this external node.
        integer J1939NmExternalNodeNameECUInstance: 0..7, post-build-variant-value=true, set at link in variant link-time / post-build in variant post-build / pre-compile in variant pre-compile  # ECU Instance field of the NAME of this external node.
        integer J1939NmExternalNodeNameFunction: 0..255, post-build-variant-value=true, set at link in variant link-time / post-build in variant post-build / pre-compile in variant pre-compile  # Function field of the NAME of this external node.
        integer J1939NmExternalNodeNameFunctionInstance: 0..31, post-build-variant-value=true, set at link in variant link-time / post-build in variant post-build / pre-compile in variant pre-compile  # Function Instance field of the NAME of this external node.
        integer J1939NmExternalNodeNameIdentityNumber: 0..2097151, post-build-variant-value=true, set at link in variant link-time / post-build in variant post-build / pre-compile in variant pre-compile  # Identity Number field of the NAME of this external node.
        integer J1939NmExternalNodeNameIndustryGroup: 0..7, post-build-variant-value=true, set at link in variant link-time / post-build in variant post-build / pre-compile in variant pre-compile  # Industry Group field of the NAME of this external node.
        integer J1939NmExternalNodeNameManufacturerCode: 0..2047, post-build-variant-value=true, set at link in variant link-time / post-build in variant post-build / pre-compile in variant pre-compile  # Manufacturer Code field of the NAME of this external node.
        integer J1939NmExternalNodeNameVehicleSystem: 0..127, post-build-variant-value=true, set at link in variant link-time / post-build in variant post-build / pre-compile in variant pre-compile  # Vehicle System field of the NAME of this external node.
        integer J1939NmExternalNodeNameVehicleSystemInstance: 0..15, post-build-variant-value=true, set at link in variant link-time / post-build in variant post-build / pre-compile in variant pre-compile  # Vehicle System Instance field of the NAME of this external node.
        integer J1939NmExternalNodePreferredAddress: 0..253, scope=ECU, post-build-variant-value=true, set at link in variant link-time / post-build in variant post-build / pre-compile in variant pre-compile  # Source address of this external node.
        reference J1939NmExternalNodeChannelRef [1..*]: multiplicity set at link in variant link-time / post-build in variant post-build / pre-compile in variant pre-compile, post-build-variant-multiplicity=true, post-build-variant-value=true, set at link in variant link-time / post-build in variant post-build / pre-compile in variant pre-compile, destination=J1939NmChannel  # Reference to the channels of the local ECU this external node has access to.
        reference J1939NmExternalNodeGatewayedChannelRef [0..*]: multiplicity set at link in variant link-time / post-build in variant post-build / pre-compile in variant pre-compile, post-build-variant-multiplicity=true, post-build-variant-value=true, set at link in variant link-time / post-build in variant post-build / pre-compile in variant pre-compile, destination=J1939NmChannel  # Reference to the channels on which messages to/from this external node shall be gatewayed. The address claim from the external node will be replicated on these channels.
      container J1939NmNode [1..*]: multiplicity set at link in variant link-time / post-build in variant post-build / pre-compile in variant pre-compile, post-build-variant-multiplicity=true  # Logical node representing one function handled by J1939Nm.
        integer J1939NmNodeId: 0..255, scope=ECU, set at pre-compile, symbolic-name-value=true  # Unique identifier of this node.
        boolean J1939NmNodeNameArbitraryAddressCapable: set at pre-compile  # Arbitrary Address Capable field of the NAME of this node.
        integer J1939NmNodeNameECUInstance: 0..7, post-build-variant-value=true, set at link in variant link-time / post-build in variant post-build / pre-compile in variant pre-compile  # ECU Instance field of the NAME of this node.
        integer J1939NmNodeNameFunction: 0..255, post-build-variant-value=true, set at link in variant link-time / post-build in variant post-build / pre-compile in variant pre-compile  # Function field of the NAME of this node.
        integer J1939NmNodeNameFunctionInstance: 0..31, post-build-variant-value=true, set at link in variant link-time / post-build in variant post-build / pre-compile in variant pre-compile  # Function Instance field of the NAME of this node.
        integer J1939NmNodeNameIdentityNumber: 0..2097151, post-build-variant-value=true, set at link in variant link-time / post-build in variant post-build / pre-compile in variant pre-compile  # Identity Number field of the NAME of this node.
        integer J1939NmNodeNameIndustryGroup: 0..7, post-build-variant-value=true, set at link in variant link-time / post-build in variant post-build / pre-compile in variant pre-compile  # Industry Group field of the NAME of this node.
        integer J1939NmNodeNameManufacturerCode: 0..2047, post-build-variant-value=true, set at link in variant link-time / post-build in variant post-build / pre-compile in variant pre-compile  # Manufacturer Code field of the NAME of this node.
        integer J1939NmNodeNameVehicleSystem: 0..127, post-build-variant-value=true, set at link in variant link-time / post-build in variant post-build / pre-compile in variant pre-compile  # Vehicle System field of the NAME of this node.
        integer J1939NmNodeNameVehicleSystemInstance: 0..15, post-build-variant-value=true, set at link in variant link-time / post-build in variant post-build / pre-compile in variant pre-compile  # Vehicle System Instance field of the NAME of this node.
        integer J1939NmNodePreferredAddress: 0..253, scope=ECU, post-build-variant-value=true, set at link in variant link-time / post-build in variant post-build / pre-compile in variant pre-compile  # Source address of this node used for address claiming.
        boolean J1939NmNodeStartUpDelay: set at pre-compile, default-value=true  # If enabled, the node will start communication after a delay of 250ms after transmission of the initial AddressClaimed, depending on the configured J1939NmNodePreferredAddress. If disabled, the node will start communication immediately at network start-up. | Please note: According to J1939/81, the 250ms delay is not required for single address CAs with desired source addresses in the ranges 0..127 or 248..253.
        reference J1939NmNodeChannelRef [1..*]: multiplicity set at link in variant link-time+post-build / pre-compile in variant pre-compile, set at link in variant link-time+post-build / pre-compile in variant pre-compile, destination=J1939NmChannel  # Reference to the channels this node has access to.
      container J1939NmSharedAddressSpace [0..*]: multiplicity set at link in variant link-time / post-build in variant post-build / pre-compile in variant pre-compile, post-build-variant-multiplicity=true  # Set of J1939NmChannels that share a common address space. Address claims will be routed between these channels.
        reference J1939NmSharedChannelRef [2..*]: multiplicity set at link in variant link-time / post-build in variant post-build / pre-compile in variant pre-compile, post-build-variant-multiplicity=true, post-build-variant-value=true, set at link in variant link-time / post-build in variant post-build / pre-compile in variant pre-compile, destination=J1939NmChannel  # Reference to a channel that belongs to the shared address space.
    container J1939NmGeneral  # Contains the general configuration parameters of the module.
      float J1939NmBusOffDelayTickPeriod [0..1]: 0..INF, multiplicity set at link in variant link-time+post-build / pre-compile in variant pre-compile, set at link in variant link-time+post-build / pre-compile in variant pre-compile, default-value=0.02  # Duration of ticks that are used to time BusOff delays after conflicting address claims. This parameter must be synchronized with the main function period of the CAN State Manager.
      boolean J1939NmDevErrorDetect: set at pre-compile, default-value=false  # Switches the development error detection and notification on or off. | * true: detection and notification is enabled. * false: detection and notification is disabled.
      boolean J1939NmGatewaySupport: set at pre-compile  # Enables/disables support for claiming the addresses of routed messages.
      float J1939NmMainFunctionPeriod: 0..INF, scope=ECU, set at link in variant link-time+post-build / pre-compile in variant pre-compile, default-value=0.01  # Call cycle in seconds of J1939Nm_MainFunction.
      function name J1939NmUserCallout [0..1]: multiplicity set at pre-compile, set at pre-compile  # Pre-processor switch for enabling the <User_AddressClaimedIndication> and defining the name of the callout function.
      boolean J1939NmVersionInfoApi: set at pre-compile, default-value=false  # Pre-processor switch for enabling version info API support.
  module definition J1939Rm [0..1]: post-build-variant-support=true, variants link-time/post-build/pre-compile  # Configuration of the J1939 Request Manager.
    container J1939RmConfigSet  # This container contains the configuration parameters and sub containers of the AUTOSAR J1939Rm module.
      container J1939RmChannel [1..*]: multiplicity set at link in variant link-time / post-build in variant post-build / pre-compile in variant pre-compile, post-build-variant-multiplicity=true  # Contains the parameters for a CAN channel supported by the J1939 Request Manager.
        integer J1939RmAckQueueSize: 0..255, set at link in variant link-time+post-build / pre-compile in variant pre-compile  # Number of transmitted Acknowledgement messages that can be stored.
        integer J1939RmRequestQueue2Size: 0..255, set at link in variant link-time+post-build / pre-compile in variant pre-compile  # Number of transmitted Request2 messages that can be stored.
        integer J1939RmRequestQueueSize: 0..255, set at link in variant link-time+post-build / pre-compile in variant pre-compile  # Number of transmitted Request messages that can be stored.
        integer J1939RmRequestTimeoutMonitors: 0..255, set at link in variant link-time+post-build / pre-compile in variant pre-compile  # Number of transmitted requests that can be monitored for timeout.
        reference J1939RmComMNetworkHandleRef: set at link in variant link-time+post-build / pre-compile in variant pre-compile, requires-symbolic-name-value=true, destination=ComMChannel  # Reference to the channel defined by the ComMChannel providing access to the unique channel index ComMChannelId.
        container J1939RmAckmRxPdu [0..1]  # Contains the configuration of the I-PDU used to receive the Acknowledgement PG. This PDU consumes a meta data item of type CAN_ID_32.
          integer J1939RmAckmRxPduId: 0..65535, scope=ECU, set at pre-compile, symbolic-name-value=true  # The I-PDU identifier used for RxIndication from PduR.
          reference J1939RmAckmRxPduRef: set at link in variant link-time+post-build / pre-compile in variant pre-compile, destination=Pdu  # Reference to the Pdu object representing the I-PDU.
        container J1939RmAckmTxPdu [0..1]  # Contains the configuration of the I-PDU used to transmit the Acknowledgement PG. This PDU produces a meta data item of type CAN_ID_32.
          integer J1939RmAckmTxPduId: 0..65535, scope=ECU, set at pre-compile, symbolic-name-value=true  # The I-PDU identifier used for TxConfirmation from PduR.
          reference J1939RmAckmTxPduRef: set at link in variant link-time+post-build / pre-compile in variant pre-compile, destination=Pdu  # Reference to the Pdu object representing the I-PDU.
        container J1939RmRqst2RxPdu [0..1]  # Contains the configuration of the I-PDU used to receive the Request2 PG. This PDU consumes a meta data item of type CAN_ID_32.
          integer J1939RmRqst2RxPduId: 0..65535, scope=ECU, set at pre-compile, symbolic-name-value=true  # The I-PDU identifier used for RxIndication from PduR.
          reference J1939RmRqst2RxPduRef: set at link in variant link-time+post-build / pre-compile in variant pre-compile, destination=Pdu  # Reference to the Pdu object representing the I-PDU.
        container J1939RmRqst2TxPdu [0..1]  # Contains the configuration of the I-PDU used to transmit the Request2 PG. This PDU produces a meta data item of type CAN_ID_32.
          integer J1939RmRqst2TxPduId: 0..65535, scope=ECU, set at pre-compile, symbolic-name-value=true  # The I-PDU identifier used for TxConfirmation from PduR.
          reference J1939RmRqst2TxPduRef: set at link in variant link-time+post-build / pre-compile in variant pre-compile, destination=Pdu  # Reference to the Pdu object representing the I-PDU.
        container J1939RmRqstRxPdu [0..1]  # Contains the configuration of the I-PDU used to receive the Request PG. This PDU consumes a meta data item of type CAN_ID_32.
          integer J1939RmRqstRxPduId: 0..65535, scope=ECU, set at pre-compile, symbolic-name-value=true  # The I-PDU identifier used for RxIndication from PduR.
          reference J1939RmRqstRxPduRef: set at link in variant link-time+post-build / pre-compile in variant pre-compile, destination=Pdu  # Reference to the Pdu object representing the I-PDU.
        container J1939RmRqstTxPdu [0..1]  # Contains the configuration of the I-PDU used to transmit the Request PG. This PDU produces a meta data item of type CAN_ID_32.
          integer J1939RmRqstTxPduId: 0..65535, scope=ECU, set at pre-compile, symbolic-name-value=true  # The I-PDU identifier used for TxConfirmation from PduR.
          reference J1939RmRqstTxPduRef: set at link in variant link-time+post-build / pre-compile in variant pre-compile, destination=Pdu  # Reference to the Pdu object representing the I-PDU.
      container J1939RmNode [1..*]: multiplicity set at link in variant link-time / post-build in variant post-build / pre-compile in variant pre-compile, post-build-variant-multiplicity=true  # Contains the parameters for the support of a logical J1939 node (identified by an ECU address).
        reference J1939RmNmNodeRef: set at link in variant link-time+post-build / pre-compile in variant pre-compile, requires-symbolic-name-value=true, destination=J1939NmNode  # Reference to the corresponding J1939Nm node.
        reference J1939RmNodeChannelRef [1..*]: multiplicity set at link in variant link-time+post-build / pre-compile in variant pre-compile, set at link in variant link-time+post-build / pre-compile in variant pre-compile, destination=J1939RmChannel  # Reference to the channels this node has access to.
        choice container J1939RmUser [1..*]: multiplicity set at link in variant link-time / post-build in variant post-build / pre-compile in variant pre-compile, post-build-variant-multiplicity=true  # Contains the configuration of a module that uses the request and acknowledgement interfaces of J1939Rm.
          container J1939RmCddUser [0..1]: multiplicity set at pre-compile  # J1939Rm User representing a complex driver (CDD). CDDs may use all services provided by J1939Rm.
            boolean J1939RmUserAckIndication: set at pre-compile  # Enable AckIndication for this module. In case of CDD, the name is <apiServicePrefix>_AckIndication. In case of RTE, the operation AckIndication of the required port J1939Rm_AckIndication_{user} is called.
            integer J1939RmUserAckPGN [0..*]: 0..262143, multiplicity set at pre-compile, set at pre-compile  # PGN supported to be acknowledged to this module. The PGNs supported by different modules should usually be disjunctive.
            integer J1939RmUserId [0..1]: 0..65535, scope=ECU, multiplicity set at pre-compile, set at pre-compile, symbolic-name-value=true  # Identifier used by a module using J1939Rm. This parameter is only required when the module uses transmission of requests or acknowledgements.
            boolean J1939RmUserRequestIndication: set at pre-compile  # Enable RequestIndication for this module. In case of J1939Nm or J1939Dcm, the name is fixed. In case of CDD, the name is <apiServicePrefix>_RequestIndication. In case of RTE, J1939Rm will call the operation RequestIndication of the required port J1939Rm_RequestIndication_{user}.
            integer J1939RmUserRequestPGN [0..*]: 0..262143, multiplicity set at pre-compile, set at pre-compile  # PGN supported to be requested from this module. The PGNs supported by different modules should usually be disjunctive.
            boolean J1939RmUserSendAck: set at pre-compile  # Enable the SendAck API for this module. In case of RTE, the operation SendAck of the provided port J1939Rm_SendAck_{user} is called.
            boolean J1939RmUserSendRequest: set at pre-compile  # Enable the SendRequest API for this module. In case of RTE, the operation SendRequest of the provided port J1939Rm_SendRequest_{user} is called.
            boolean J1939RmUserTimeoutSupervision: set at pre-compile  # Enable RequestTimeoutIndication and CancelRequestTimeout for this module. | RequestTimeoutIndication: In case of CDD, the name is <apiServicePrefix>_RequestTimeoutIndication. In case of RTE, the operation RequestTimeoutIndication of the required port J1939Rm_RequestTimeoutIndication_{user} is called. CancelRequestTimeout: In case of RTE, the operation CancelRequestTimeout of the provided port J1939Rm_CancelRequestTimeout_{user} is called.
            foreign reference J1939RmUserCddRef: set at pre-compile, destination-type=ECUC-MODULE-CONFIGURATION-VALUES  # Reference to the CDD module description.
          container J1939RmComUser [0..1]: multiplicity set at link in variant link-time / post-build in variant post-build / pre-compile in variant pre-compile, post-build-variant-multiplicity=true  # J1939Rm User representing AUTOSAR COM. Supports requests for COM I-PDUs.
            container J1939RmComIPdu [0..*]: multiplicity set at link in variant link-time / post-build in variant post-build / pre-compile in variant pre-compile, post-build-variant-multiplicity=true  # Contains the configuration of an I-PDU that is to be transmitted on request by COM.
              integer J1939RmComIPduExtId1 [0..1]: 0..255, multiplicity set at link in variant link-time / post-build in variant post-build / pre-compile in variant pre-compile, post-build-variant-multiplicity=true, post-build-variant-value=true, set at link in variant link-time / post-build in variant post-build / pre-compile in variant pre-compile  # First extended identifier byte of the COM I-PDU.
              integer J1939RmComIPduExtId2 [0..1]: 0..255, multiplicity set at link in variant link-time / post-build in variant post-build / pre-compile in variant pre-compile, post-build-variant-multiplicity=true, post-build-variant-value=true, set at link in variant link-time / post-build in variant post-build / pre-compile in variant pre-compile  # Second extended identifier byte of the COM I-PDU.
              integer J1939RmComIPduExtId3 [0..1]: 0..255, multiplicity set at link in variant link-time / post-build in variant post-build / pre-compile in variant pre-compile, post-build-variant-multiplicity=true, post-build-variant-value=true, set at link in variant link-time / post-build in variant post-build / pre-compile in variant pre-compile  # Third extended identifier byte of the COM I-PDU.
              integer J1939RmComIPduPGN: 0..262143, post-build-variant-value=true, set at link in variant link-time / post-build in variant post-build / pre-compile in variant pre-compile  # PGN of the COM I-PDU.
              reference J1939RmComIPduRef: set at link in variant link-time / post-build in variant post-build / pre-compile in variant pre-compile, destination=Pdu  # Reference to the Pdu object representing the I-PDU.
          container J1939RmDcmUser [0..1]: multiplicity set at link in variant link-time / post-build in variant post-build / pre-compile in variant pre-compile, post-build-variant-multiplicity=true  # J1939Rm User representing the J1939Dcm. Requires request indication and transmission of acknowledgement.
            integer J1939RmUserId: 0..65535, scope=ECU, set at pre-compile, symbolic-name-value=true  # Identifier used by J1939Dcm when calling J1939Rm_SendAck.
            integer J1939RmUserRequestPGN [0..*]: 0..262143, multiplicity set at link in variant link-time / post-build in variant post-build / pre-compile in variant pre-compile, post-build-variant-multiplicity=true, post-build-variant-value=true, set at link in variant link-time / post-build in variant post-build / pre-compile in variant pre-compile  # PGN of DMx PG supported by J1939Dcm.
          container J1939RmNmUser [0..1]: multiplicity set at link in variant link-time / post-build in variant post-build / pre-compile in variant pre-compile, post-build-variant-multiplicity=true  # J1939Rm User representing the J1939Nm. Requires request indication.
          container J1939RmRteUser [0..1]: multiplicity set at pre-compile  # J1939Rm User representing an application software component (SW-C). SW-Cs may use all services provided by the J1939Rm via service ports.
            boolean J1939RmUserAckIndication: set at pre-compile  # Enable AckIndication for this module. In case of CDD, the name is <apiServicePrefix>_AckIndication. In case of RTE, the operation AckIndication of the required port J1939Rm_AckIndication_{user} is called.
            integer J1939RmUserAckPGN [0..*]: 0..262143, multiplicity set at pre-compile, set at pre-compile  # PGN supported to be acknowledged to this module. The PGNs supported by different modules should usually be disjunctive.
            integer J1939RmUserId [0..1]: 0..65535, scope=ECU, multiplicity set at pre-compile, set at pre-compile, symbolic-name-value=true  # Identifier used by a module using J1939Rm. This parameter is only required when the module uses transmission of requests or acknowledgements.
            boolean J1939RmUserRequestIndication: set at pre-compile  # Enable RequestIndication for this module. In case of J1939Nm or J1939Dcm, the name is fixed. In case of CDD, the name is <apiServicePrefix>_RequestIndication. In case of RTE, J1939Rm will call the operation RequestIndication of the required port J1939Rm_RequestIndication_{user}.
            integer J1939RmUserRequestPGN [0..*]: 0..262143, multiplicity set at pre-compile, set at pre-compile  # PGN supported to be requested from this module. The PGNs supported by different modules should usually be disjunctive.
            boolean J1939RmUserSendAck: set at pre-compile  # Enable the SendAck API for this module. In case of RTE, the operation SendAck of the provided port J1939Rm_SendAck_{user} is called.
            boolean J1939RmUserSendRequest: set at pre-compile  # Enable the SendRequest API for this module. In case of RTE, the operation SendRequest of the provided port J1939Rm_SendRequest_{user} is called.
            boolean J1939RmUserTimeoutSupervision: set at pre-compile  # Enable RequestTimeoutIndication and CancelRequestTimeout for this module. | RequestTimeoutIndication: In case of CDD, the name is <apiServicePrefix>_RequestTimeoutIndication. In case of RTE, the operation RequestTimeoutIndication of the required port J1939Rm_RequestTimeoutIndication_{user} is called. CancelRequestTimeout: In case of RTE, the operation CancelRequestTimeout of the provided port J1939Rm_CancelRequestTimeout_{user} is called.
    container J1939RmGeneral  # Contains the general configuration parameters of the module.
      boolean J1939RmDevErrorDetect: set at pre-compile, default-value=false  # Switches the development error detection and notification on or off. | * true: detection and notification is enabled. * false: detection and notification is disabled.
      boolean J1939RmGatewaySupport: set at pre-compile  # Enables/disables support for routing Request and Acknowledgement messages.
      float J1939RmMainFunctionPeriod: 0..INF, scope=ECU, set at link in variant link-time+post-build / pre-compile in variant pre-compile  # Execution cycle of J1939Rm_MainFunction in seconds.
      boolean J1939RmSupportAckIndication: set at pre-compile  # Pre-processor switch for enabling support of acknowledgement indications.
      boolean J1939RmSupportAckTransmission: set at pre-compile  # Pre-processor switch for enabling support of acknowledgement transmission.
      boolean J1939RmSupportRequest2: set at pre-compile  # Pre-processor switch for enabling support of the Request2 PG. | Please note: Transfer is not supported.
      boolean J1939RmSupportRequestIndication: set at pre-compile  # Pre-processor switch for enabling support of request indications.
      boolean J1939RmSupportRequestTransmission: set at pre-compile  # Pre-processor switch for enabling support of request transmission.
      boolean J1939RmSupportTimeoutSupervision: set at pre-compile  # Pre-processor switch for enabling support of request timeout supervision.
      boolean J1939RmVersionInfoApi: set at pre-compile, default-value=false  # Pre-processor switch for enabling version info API support.
  module definition J1939Tp [0..1]: post-build-variant-support=true, variants link-time/post-build/pre-compile  # Configuration of the J1939Tp (J1939 Transport Protocol) module.
    container J1939TpConfiguration  # This container contains the configuration parameters and sub containers of the J1939Tp module that define the communication paths.
      container J1939TpRxChannel [0..*]  # This container describes a reception channel of the J1939Tp module. A channel referencing N-PDUs without MetaData is used for all N-SDUs that share the same source address (SA) and the same destination address (BAM: DA = 0xFF, CMDT: DA != 0xFF). A channel with N-PDUs with MetaData is used for all possible source and destination addresses.
        boolean J1939TpRxCancellationSupport [0..1]: multiplicity set at pre-compile, set at pre-compile, default-value=false  # Enable receive cancellation using the API J1939Tp_CancelReceive() for this channel.
        integer J1939TpRxDa [0..1]: 0..253, multiplicity set at link in variant link-time / post-build in variant post-build / pre-compile in variant pre-compile, post-build-variant-multiplicity=true, post-build-variant-value=true, set at link in variant link-time / post-build in variant post-build / pre-compile in variant pre-compile  # Destination address (DA) of this channel. This parameter is only required for channels with fixed DA which use N-PDUs with MetaData containing the DA.
        boolean J1939TpRxDynamicBlockCalculation [0..1]: multiplicity set at pre-compile, set at pre-compile, default-value=false  # Enable dynamic calculation of "number of packets that can be sent" value in TP.CM_CTS, based on the size of buffers in upper layers reported via StartOfReception and PduR_J1939TpCopyRxData.
        integer J1939TpRxDynamicBufferRatio [0..1]: 0..100, multiplicity set at pre-compile, set at pre-compile, default-value=80  # Percentage of available buffer that shall be used for retry. | This parameter is only applicable when "J1939TpRxRetrySupport" and "J1939TpRxDynamicBlockCalculation" are enabled.
        integer J1939TpRxPacketsPerBlock [0..1]: 1..255, multiplicity set at pre-compile, set at pre-compile, default-value=16  # Number of TP.DT frames the receiving J1939Tp module allows the sender to send before waiting for another TP.CM_CTS. This parameter is transmitted in the TP.CM_CTS frame, and is thus only relevant for reception of messages via CMDT. When J1939TpRxDynamicBlockCalculation is enabled, this parameter specifies a maximum for the calculated value. For further details on this parameter value see SAE J1939/21.
        enumeration J1939TpRxProtocolType [0..1]: {J1939TP_PROTOCOL_BAM, J1939TP_PROTOCOL_CMDT}, multiplicity set at pre-compile, set at pre-compile  # Protocol type used by this channel. This parameter is only required for channels with fixed destination address.
        boolean J1939TpRxRetrySupport [0..1]: multiplicity set at pre-compile, set at pre-compile, default-value=false  # Enable support for triggering repetition of failed transmission using TP.CM_CTS with a packet number that has already been sent. Retransmission is triggered when a sequence number is missing or a timeout occurs during reception.
        integer J1939TpRxSa [0..1]: 0..253, multiplicity set at link in variant link-time / post-build in variant post-build / pre-compile in variant pre-compile, post-build-variant-multiplicity=true, post-build-variant-value=true, set at link in variant link-time / post-build in variant post-build / pre-compile in variant pre-compile  # Source address (SA) of this channel. This parameter is only required for channels with fixed SA which use N-PDUs with MetaData containing the SA.
        container J1939TpRxCmNPdu  # This N-PDU represents the TP.CM frame of a J1939 transport protocol session. TP.CM is used both by BAM and CMDT to initialize the connection. For CMDT, it is also used to abort the connection. This N-PDU consumes a meta data item of type CAN_ID_32.
          integer J1939TpRxCmNPduId: 0..65535, scope=ECU, set at pre-compile, symbolic-name-value=true  # The N-PDU identifier used for communication with CanIf.
          reference J1939TpRxCmNPduRef: post-build-variant-value=true, set at link in variant link-time / post-build in variant post-build / pre-compile in variant pre-compile, destination=Pdu  # Reference to the Pdu object representing the N-PDU.
        container J1939TpRxDtNPdu  # This N-PDU represents the TP.DT frame of a J1939 transport protocol session. TP.DT is used both by BAM and CMDT to transfer the contents of an N-SDU. This N-PDU consumes a meta data item of type CAN_ID_32.
          integer J1939TpRxDtNPduId: 0..65535, scope=ECU, set at pre-compile, symbolic-name-value=true  # The N-PDU identifier used for communication with CanIf.
          reference J1939TpRxDtNPduRef: post-build-variant-value=true, set at link in variant link-time / post-build in variant post-build / pre-compile in variant pre-compile, destination=Pdu  # Reference to the Pdu object representing the N-PDU.
        container J1939TpRxPg [1..*]  # Parameter group received by the J1939 transport layer.
          boolean J1939TpRxPgDynLength: set at pre-compile  # This flag is set to TRUE when the N-SDU refers to a PGN with variable length. | Please note: When this attribute is TRUE, the sub container J1939TpRxDirectNPdu is required.
          integer J1939TpRxPgPGN: 0..262143, set at pre-compile  # PGN of the referenced N-SDUs.
          container J1939TpRxDirectNPdu [0..1]  # This N-PDU represents the short frame that is used for a dynamic length PGN when it has a length of less that 8 bytes. This N-PDU consumes a meta data item of type CAN_ID_32. | Please note: This sub container is only necessary when J1939TpRxPgDynLength is TRUE.
            integer J1939TpRxDirectNPduId: 0..65535, scope=ECU, set at pre-compile, symbolic-name-value=true  # The N-PDU identifier used for communication with CanIf.
            reference J1939TpRxDirectNPduRef: post-build-variant-value=true, set at link in variant link-time / post-build in variant post-build / pre-compile in variant pre-compile, destination=Pdu  # Reference to the Pdu object representing the N-PDU.
          container J1939TpRxNSdu [1..*]  # This container describes the parameters that are relevant for the reception of a specific N-SDU. This N-SDU produces meta data items of type SOURCE_ADDRESS_16, TARGET_ADDRESS_16, and PRIORITY_8.
            integer J1939TpRxNSduId: 0..65535, scope=ECU, set at pre-compile, symbolic-name-value=true  # This is a unique identifier for a received N-SDU. This Id is used in the CancelReceive and ChangeParameter API call.
            reference J1939TpRxNSduRef: post-build-variant-value=true, set at link in variant link-time / post-build in variant post-build / pre-compile in variant pre-compile, destination=Pdu  # Reference to the Pdu object representing the N-SDU.
        container J1939TpTxFcNPdu [0..1]  # This N-PDU represents the TP.CM frame that is used in reverse direction for a J1939 transport protocol session using the CMDT protocol type. TP.CM in reverse direction is used for intermediate and final acknowledgement of received data and to abort the connection. This N-PDU produces a meta data item of type CAN_ID_32. | Please note: This sub container is only required when J1939TpRxProtocolType is J1939TP_PROTOCOL_CMDT or when it is not configured at all.
          integer J1939TpTxFcNPduTxConfId: 0..65535, scope=ECU, set at pre-compile, symbolic-name-value=true  # The N-PDU identifier used for Tx confirmation from CanIf.
          reference J1939TpTxFcNPduRef: post-build-variant-value=true, set at link in variant link-time / post-build in variant post-build / pre-compile in variant pre-compile, destination=Pdu  # Reference to the Pdu object representing the N-PDU. | Please note: When two channels have identical but exchanged source and destination addresses, the Pdu referenced by this parameter is shared with J1939TpTxCmNPduRef of the corresponding J1939TpTxChannel.
      container J1939TpTxChannel [0..*]  # This container describes a transmission channel of the J1939Tp module. A channel referencing N-PDUs without MetaData is used for all N-SDUs that share the same source address (SA) and the same destination address (BAM: DA = 0xFF, CMDT: DA != 0xFF). A channel with N-PDUs with MetaData is used for all possible source and destination addresses.
        boolean J1939TpTxCancellationSupport [0..1]: multiplicity set at pre-compile, set at pre-compile, default-value=false  # Enable transmit cancellation using the API J1939Tp_CancelTransmit() for this channel.
        integer J1939TpTxDa [0..1]: 0..253, multiplicity set at link in variant link-time / post-build in variant post-build / pre-compile in variant pre-compile, post-build-variant-multiplicity=true, post-build-variant-value=true, set at link in variant link-time / post-build in variant post-build / pre-compile in variant pre-compile  # Destination address (DA) of this channel. This parameter is only required for channels with fixed DA which use N-PDUs with MetaData containing the DA.
        boolean J1939TpTxDynamicBlockCalculation [0..1]: multiplicity set at pre-compile, set at pre-compile, default-value=false  # Enable dynamic calculation of "maximum number of packets that can be sent" value in TP.CM_RTS, based on the available amount of data in upper layers reported via PduR_J1939TpCopyTxData.
        integer J1939TpTxMaxPacketsPerBlock [0..1]: 1..255, multiplicity set at pre-compile, set at pre-compile, default-value=255  # Maximum number of TP.DT frames the transmitting J1939Tp module is ready to send before waiting for another TP.CM_CTS. This parameter is transmitted in the TP.CM_RTS frame, and is thus only relevant for transmission of messages via CMDT. When J1939TpTxDynamicBlockCalculation is enabled, this parameter specifies a maximum for the calculated value. For further details on this parameter value see SAE J1939/21.
        enumeration J1939TpTxProtocolType [0..1]: {J1939TP_PROTOCOL_BAM, J1939TP_PROTOCOL_CMDT}, multiplicity set at pre-compile, set at pre-compile  # Protocol type used by this channel. This parameter is only required for channels with fixed destination address.
        boolean J1939TpTxRetrySupport [0..1]: multiplicity set at pre-compile, set at pre-compile, default-value=false  # Enable support for repetition of failed transmission using TP.CM_CTS with a packet number that has already been sent. Retransmission is handled via the retry feature of PduR_J1939TpCopyTxData.
        integer J1939TpTxSa [0..1]: 0..253, multiplicity set at link in variant link-time / post-build in variant post-build / pre-compile in variant pre-compile, post-build-variant-multiplicity=true, post-build-variant-value=true, set at link in variant link-time / post-build in variant post-build / pre-compile in variant pre-compile  # Source address (SA) of this channel. This parameter is only required for channels with fixed SA which use N-PDUs with MetaData containing the SA.
        container J1939TpRxFcNPdu [0..1]  # This N-PDU represents the TP.CM frame that is used in reverse direction for a J1939 transport protocol session using the CMDT protocol type. TP.CM in reverse direction is used for intermediate and final acknowledgement of received data and to abort the connection. This N-PDU consumes a meta data item of type CAN_ID_32. | Please note: This sub container is only required when J1939TpTxProtocolType is J1939TP_PROTOCOL_CMDT or when it is not configured at all.
          integer J1939TpRxFcNPduId: 0..65535, scope=ECU, set at pre-compile, symbolic-name-value=true  # The N-PDU identifier used for communication with CanIf.
          reference J1939TpRxFcNPduRef: post-build-variant-value=true, set at link in variant link-time / post-build in variant post-build / pre-compile in variant pre-compile, destination=Pdu  # Reference to the Pdu object representing the N-PDU. | Please note: When two channels have identical but exchanged source and destination addresses, the Pdu referenced by this parameter is shared with J1939TpRxCmNPduRef of the corresponding J1939TpRxChannel.
        container J1939TpTxCmNPdu  # This N-PDU represents the TP.CM frame of a J1939 transport protocol session. TP.CM is used both by BAM and CMDT to initialize the connection. For CMDT, it is also used to abort the connection. This N-PDU produces a meta data item of type CAN_ID_32.
          integer J1939TpTxCmNPduTxConfId: 0..65535, scope=ECU, set at pre-compile, symbolic-name-value=true  # The N-PDU identifier used for Tx confirmation from CanIf.
          reference J1939TpTxCmNPduRef: post-build-variant-value=true, set at link in variant link-time / post-build in variant post-build / pre-compile in variant pre-compile, destination=Pdu  # Reference to the Pdu object representing the N-PDU.
        container J1939TpTxDtNPdu  # This N-PDU represents the TP.DT frame of a J1939 transport protocol session. TP.DT is used both by BAM and CMDT to transfer the contents of an N-SDU. This N-PDU produces a meta data item of type CAN_ID_32.
          integer J1939TpTxDtNPduTxConfId: 0..65535, scope=ECU, set at pre-compile, symbolic-name-value=true  # The N-PDU identifier used for Tx confirmation from CanIf.
          reference J1939TpTxDtNPduRef: post-build-variant-value=true, set at link in variant link-time / post-build in variant post-build / pre-compile in variant pre-compile, destination=Pdu  # Reference to the Pdu object representing the N-PDU.
        container J1939TpTxPg [1..*]  # Parameter group transmitted by the J1939 transport layer.
          boolean J1939TpTxPgDynLength: set at pre-compile  # This flag is set to TRUE when the N-SDU refers to a PGN with variable length. | Please note: When this attribute is TRUE, the sub container J1939TpTxDirectNPdu is required.
          integer J1939TpTxPgPGN: 0..262143, set at pre-compile  # PGN of the referenced N-SDUs.
          container J1939TpTxDirectNPdu [0..1]  # This N-PDU represents the short frame that is used for a dynamic length PGN when it has a length of less that 8 bytes. This N-PDU produces a meta data item of type CAN_ID_32. | Please note: This sub container is only necessary when J1939TpTxPgDynLength is TRUE.
            integer J1939TpTxDirectNPduTxConfId: 0..65535, scope=ECU, set at pre-compile, symbolic-name-value=true  # The N-PDU identifier used for Tx confirmation from CanIf.
            reference J1939TpTxDirectNPduRef: post-build-variant-value=true, set at link in variant link-time / post-build in variant post-build / pre-compile in variant pre-compile, destination=Pdu  # Reference to the Pdu object representing the N-PDU.
          container J1939TpTxNSdu [1..*]  # This container describes the parameters that are relevant for the transmission of a specific N-SDU. This N-SDU consumes meta data items of type SOURCE_ADDRESS_16, TARGET_ADDRESS_16, and PRIORITY_8.
            integer J1939TpTxNSduId: 0..65535, scope=ECU, set at pre-compile, symbolic-name-value=true  # The N-SDU identifier used for communication with PduR.
            reference J1939TpTxNSduRef: post-build-variant-value=true, set at link in variant link-time / post-build in variant post-build / pre-compile in variant pre-compile, destination=Pdu  # Reference to the Pdu object representing the N-SDU.
    container J1939TpGeneral  # This container describes the general configuration parameters of the J1939Tp module.
      boolean J1939TpCancellationSupport [0..1]: multiplicity set at pre-compile, set at pre-compile, default-value=false  # Enable transmit and receive cancellation. | The APIs J1939Tp_CancelTransmit() and J1939Tp_CancelReceive() will only be available when this parameter is enabled.
      boolean J1939TpDevErrorDetect: set at pre-compile, default-value=false  # Switches the development error detection and notification on or off. | * true: detection and notification is enabled. * false: detection and notification is disabled.
      float J1939TpMainFunctionPeriod: 0..INF, scope=ECU, set at pre-compile  # Allow to configure the time for the MainFunction (in seconds). | Please note: This configuration value shall be equal to the value in the ScheduleManager module.
      boolean J1939TpVersionInfoApi: set at pre-compile, default-value=false  # The function J1939Tp_GetVersionInfo is configurable (On/Off) by this configuration parameter.
