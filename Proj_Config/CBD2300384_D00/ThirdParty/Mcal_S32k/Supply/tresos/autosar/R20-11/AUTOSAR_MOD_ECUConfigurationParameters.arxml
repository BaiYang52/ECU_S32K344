[part 1 of 11: package /AUTOSAR/EcucDefs]
AUTOSAR XML (schema 00049)
package /AUTOSAR/EcucDefs
  ecuc definition collection AUTOSARParameterDefinition: module=[Adc, Arti, BndM, BswM, Can, CanIf, CanNm, CanSM, CanTSyn, CanTp, CanTrcv, Cdd, Com, ComM, CorTst, Crc, CryIf, Crypto, Csm, Dcm, Dem, Det, Dio, Dlt, DoIP, Ea, EcuC, EcuM, Eep, Eth, EthIf, EthSM, EthSwt, EthTSyn, EthTrcv, Fee, FiM, Fls, FlsTst, Fr, FrArTp, FrIf, FrNm, FrSM, FrTSyn, FrTp, FrTrcv, Gpt, HTTMS, IKE, Icu, IdsM, IpduM, J1939Dcm, J1939Nm, J1939Rm, J1939Tp, KeyM, LdCom, Lin, LinIf, LinSM, LinTp, LinTrcv, Mcu, MemIf, MemMap, Mirror, Nm, NvM, Ocu, Os, PduR, Port, Pwm, RamTst, Rte, Sd, SecOC, SoAd, SomeIpTp, Spi, StbM, SwCluC, TcpIp, Tm, UdpNm, V2xBtp, V2xFac, V2xGn, V2xM, WEth, WEthTrcv, Wdg, WdgIf, WdgM, Xcp, Xfrm]
  module definition Adc [0..1]: post-build-variant-support=true, variants post-build/pre-compile  # Configuration of the Adc (Analog Digital Conversion) module.
    container AdcConfigSet  # This container contains the configuration parameters and sub containers of the AUTOSAR Adc module.
      container AdcHwUnit [1..*]  # This container contains the Driver configuration (parameters) depending on grouping of channels | This container could contain HW specific parameters which are not defined in the Standardized Module Definition. They must be added in the Vendor Specific Module Definition.
        enumeration AdcClockSource [0..1]: multiplicity set at post-build in variant post-build / pre-compile in variant pre-compile, post-build-variant-multiplicity=true, post-build-variant-value=true, set at post-build in variant post-build / pre-compile in variant pre-compile  # The ADC module specific clock input for the conversion unit can | statically be configured to select different clock sources if provided by hardware. Enumeration literals are defined vendor specific.
        enumeration AdcHwUnitId: post-build-variant-value=true, set at post-build in variant post-build / pre-compile in variant pre-compile  # Description: Numeric ID of the HW Unit. This symbolic name allows accessing Hw Unit data. Enumeration literals are defined vendor specific.
        integer AdcPrescale [0..1]: 0..65535, multiplicity set at post-build in variant post-build / pre-compile in variant pre-compile, post-build-variant-multiplicity=true, post-build-variant-value=true, set at post-build in variant post-build / pre-compile in variant pre-compile  # Optional ADC module specific clock prescale factor, if supported by hardware. | ImplementationType: Adc_PrescaleType
        container AdcChannel [1..*]  # This container contains the channel configuration (parameters) depending on the hardware capability. | The organization of this data structure could contain dependencies to the microcontroller so this is left up to the implementer and its location is left up to the configuration. Note: Since a AdcChannel can be part of several AdcGroups, this container is not realized as a subcontainer of AdcGroup but instead as a subcontainer of AdcHwUnit.
          integer AdcChannelConvTime [0..1]: 0..18446744073709551615, multiplicity set at post-build in variant post-build / pre-compile in variant pre-compile, post-build-variant-multiplicity=true, post-build-variant-value=true, set at post-build in variant post-build / pre-compile in variant pre-compile  # Configuration of conversion time, i.e. the time during which the analogue value is converted into digital representation, (in clock cycles) for each channel, if supported by hardware. | ImplementationType: Adc_ConversionTimeType
          integer AdcChannelHighLimit [0..1]: 0..18446744073709551615, multiplicity set at pre-compile, set at pre-compile  # High limit - used for limit checking.
          integer AdcChannelId: 0..1024, post-build-variant-value=true, set at post-build in variant post-build / pre-compile in variant pre-compile  # This parameter defines the assignment of the channel to the physical ADC hardware channel. | ImplementationType: Adc_ChannelType
          boolean AdcChannelLimitCheck [0..1]: multiplicity set at pre-compile, set at pre-compile  # Enables or disables limit checking for an ADC channel.
          integer AdcChannelLowLimit [0..1]: 0..18446744073709551615, multiplicity set at pre-compile, set at pre-compile  # Low limit - used for limit checking.
          enumeration AdcChannelRangeSelect [0..1]: {ADC_RANGE_ALWAYS, ADC_RANGE_BETWEEN, ADC_RANGE_NOT_BETWEEN, ADC_RANGE_NOT_OVER_HIGH, ADC_RANGE_NOT_UNDER_LOW, ADC_RANGE_OVER_HIGH, ADC_RANGE_UNDER_LOW}, multiplicity set at pre-compile, set at pre-compile  # In case of active limit checking: defines which conversion values are taken into account related to the boarders defined with AdcChannelLowLimit and AdcChannelHighLimit. | Implementation Type: Adc_ChannelRangeSelectType
          enumeration AdcChannelRefVoltsrcHigh [0..1]: multiplicity set at post-build in variant post-build / pre-compile in variant pre-compile, post-build-variant-multiplicity=true, post-build-variant-value=true, set at post-build in variant post-build / pre-compile in variant pre-compile  # Upper reference voltage source for each channel. | Enumeration literals are defined vendor specific.
          enumeration AdcChannelRefVoltsrcLow [0..1]: multiplicity set at post-build in variant post-build / pre-compile in variant pre-compile, post-build-variant-multiplicity=true, post-build-variant-value=true, set at post-build in variant post-build / pre-compile in variant pre-compile  # Lower reference voltage source for each channel. | Enumeration literals are defined vendor specific.
          integer AdcChannelResolution [0..1]: 1..63, multiplicity set at post-build in variant post-build / pre-compile in variant pre-compile, post-build-variant-multiplicity=true, post-build-variant-value=true, set at post-build in variant post-build / pre-compile in variant pre-compile  # Channel resolution in bits. | ImplementationType: Adc_ResolutionType
          integer AdcChannelSampTime [0..1]: 0..18446744073709551615, multiplicity set at post-build in variant post-build / pre-compile in variant pre-compile, post-build-variant-multiplicity=true, post-build-variant-value=true, set at post-build in variant post-build / pre-compile in variant pre-compile  # Configuration of sampling time, i.e. the time during which the value is sampled, (in clock cycles) for each channel, if supported by hardware. | ImplementationType: Adc_SamplingTimeType
        container AdcGroup [1..*]  # This container contains the Group configuration (parameters).
          enumeration AdcGroupAccessMode: {ADC_ACCESS_MODE_SINGLE, ADC_ACCESS_MODE_STREAMING}, post-build-variant-value=true, set at post-build in variant post-build / pre-compile in variant pre-compile  # Type of access mode to group conversion results. | ImplementationType: Adc_GroupAccessModeType
          enumeration AdcGroupConversionMode: {ADC_CONV_MODE_CONTINUOUS, ADC_CONV_MODE_ONESHOT}, post-build-variant-value=true, set at post-build in variant post-build / pre-compile in variant pre-compile  # Type of conversion mode supported by the driver. | ImplementationType: Adc_GroupConvModeType
          integer AdcGroupId: 0..1023, set at pre-compile, symbolic-name-value=true  # Numeric ID of the group. This parameter is the symbolic name to be used on the API. This symbolic name allows accessing Channel Group data. This value will be assigned to the symbolic name derived of the AdcGroup container shortName. | ImplementationType: Adc_GroupType
          integer AdcGroupPriority [0..1]: 0..255, multiplicity set at post-build in variant post-build / pre-compile in variant pre-compile, post-build-variant-multiplicity=true, post-build-variant-value=true, set at post-build in variant post-build / pre-compile in variant pre-compile  # Priority level of the AdcGroup. | ImplementationType: Adc_GroupPriorityType
          enumeration AdcGroupReplacement [0..1]: {ADC_GROUP_REPL_ABORT_RESTART, ADC_GROUP_REPL_SUSPEND_RESUME}, multiplicity set at post-build in variant post-build / pre-compile in variant pre-compile, post-build-variant-multiplicity=true, post-build-variant-value=true, set at post-build in variant post-build / pre-compile in variant pre-compile  # Replacement mechanism, which is used on ADC group level, if a group conversion is interrupted by a group which has a higher priority. | ImplementationType: Adc_GroupReplacementType
          enumeration AdcGroupTriggSrc: {ADC_TRIGG_SRC_HW, ADC_TRIGG_SRC_SW}, post-build-variant-value=true, set at post-build in variant post-build / pre-compile in variant pre-compile  # Type of source event that starts a group conversion. | ImplementationType: Adc_TriggerSourceType
          enumeration AdcHwTrigSignal [0..1]: {ADC_HW_TRIG_BOTH_EDGES, ADC_HW_TRIG_FALLING_EDGE, ADC_HW_TRIG_RISING_EDGE}, multiplicity set at post-build in variant post-build / pre-compile in variant pre-compile, post-build-variant-multiplicity=true, post-build-variant-value=true, set at post-build in variant post-build / pre-compile in variant pre-compile  # Configures on which edge of the hardware trigger signal the driver should react, i.e. start the conversion (only if supported by the ADC hardware). | ImplementationType: Adc_HwTriggerSignalType
          integer AdcHwTrigTimer [0..1]: 0..18446744073709551615, multiplicity set at post-build in variant post-build / pre-compile in variant pre-compile, post-build-variant-multiplicity=true, post-build-variant-value=true, set at post-build in variant post-build / pre-compile in variant pre-compile  # Reload value of the ADC module embedded timer (only if supported by ADC hardware). | ImplementationType: Adc_HwTriggerTimerType
          function name AdcNotification [0..1]: multiplicity set at post-build in variant post-build / pre-compile in variant pre-compile, post-build-variant-multiplicity=true, post-build-variant-value=true, set at post-build in variant post-build / pre-compile in variant pre-compile  # Callback function for each group
          enumeration AdcStreamingBufferMode: {ADC_STREAM_BUFFER_CIRCULAR, ADC_STREAM_BUFFER_LINEAR}, post-build-variant-value=true, set at post-build in variant post-build / pre-compile in variant pre-compile  # Configure streaming buffer as "linear buffer" (i.e. the ADC Driver stops the conversion as soon as the stream buffer is full) or as "ring buffer" (wraps around if the end of the stream buffer is reached). | ImplementationType: Adc_StreamBufferModeType
          integer AdcStreamingNumSamples: 1..255, post-build-variant-value=true, set at post-build in variant post-build / pre-compile in variant pre-compile, default-value=1  # Number of ADC values to be acquired per channel in streaming access mode. | Note: in single access mode this parameter assumes value 1, since only one sample per channel is processed. ImplementationType: Adc_StreamNumSampleType
          reference AdcGroupDefinition [1..*]: multiplicity set at post-build in variant post-build / pre-compile in variant pre-compile, post-build-variant-multiplicity=true, post-build-variant-value=true, set at post-build in variant post-build / pre-compile in variant pre-compile, destination=AdcChannel  # Assignment of AdcChannels to a AdcGroups. | ImplementationType: Adc_GroupDefType
          reference AdcGroupEcucPartitionRef [0..*]: scope=ECU, multiplicity set at pre-compile, post-build-variant-multiplicity=true, post-build-variant-value=true, set at pre-compile, destination=EcucPartition  # Maps an ADC channel group to zero or multiple ECUC partitions to limit the access to this channel group. The ECUC partitions referenced are a subset of the ECUC partitions where the ADC driver is mapped to.
    container AdcGeneral  # General configuration (parameters) of the ADC Driver software module.
      boolean AdcDeInitApi: set at pre-compile  # Adds / removes the service Adc_DeInit() from the code. | true: Adc_DeInit() can be used. false: Adc_DeInit() can not be used.
      boolean AdcDevErrorDetect: set at pre-compile, default-value=false  # Switches the development error detection and notification on or off. | * true: detection and notification is enabled. * false: detection and notification is disabled.
      boolean AdcEnableLimitCheck: set at pre-compile  # Enables or disables limit checking feature in the ADC driver.
      boolean AdcEnableQueuing: set at pre-compile  # Determines, if the queuing mechanism is active in case of priority mechanism disabled. | Note: If priority mechanism is enabled, queuing mechanism is always active and the parameter ADC_ENABLE_QUEUING is not evaluated. true: Enabled. false: Disabled.
      boolean AdcEnableStartStopGroupApi: set at pre-compile  # Adds / removes the services Adc_StartGroupConversion() and Adc_StopGroupConversion() from the code. | true: Adc_StartGroupConversion() and Adc_StopGroupConversion() can be used. false: Adc_StartGroupConversion() and Adc_StopGroupConversion() can not be used.
      boolean AdcGrpNotifCapability: set at pre-compile  # Determines, if the group notification mechanism (the functions to enable and disable the notifications) is available at runtime. | true: Enabled. false: Disabled.
      boolean AdcHwTriggerApi: set at pre-compile  # Adds / removes the services Adc_EnableHardwareTrigger() and Adc_DisableHardwareTrigger() from the code. | true: Adc_EnableHardwareTrigger() and Adc_DisableHardwareTrigger() can be used. false: Adc_EnableHardwareTrigger() and Adc_DisableHardwareTrigger() can not be used.
      boolean AdcLowPowerStatesSupport [0..1]: multiplicity set at pre-compile, set at pre-compile, default-value=false  # Adds / removes all power state management related APIs (ADC_SetPowerState, ADC_GetCurrentPowerState, ADC_GetTargetPowerState, ADC_PreparePowerState, ADC_Main_PowerTransitionManager), indicating if the HW offers low power state management.
      boolean AdcPowerStateAsynchTransitionMode [0..1]: multiplicity set at pre-compile, set at pre-compile, default-value=false  # Enables / disables support of the ADCDriver to the asynchronous power state transition.
      enumeration AdcPriorityImplementation: {ADC_PRIORITY_HW, ADC_PRIORITY_HW_SW, ADC_PRIORITY_NONE}, set at pre-compile  # Determines whether a priority mechanism is available for prioritization of the conversion requests and if available, the type of prioritization mechanism. The selection applies for groups with trigger source software and trigger source hardware. Two | types of prioritization mechanism can be selected. The hardware prioritization mechanism (AdcPriorityHw) uses the ADC hardware features for prioritization of the software conversion requests and hardware trigger signals for groups with trigger source hardware. The mixed hardware and software prioritization mechanism (AdcPriorityHwSw) uses the ADC hardware features for prioritization of ADC hardware trigger for groups with trigger source hardware and a software implemented prioritization mechanism for groups with trigger source software. The group priorities for software triggered groups are typically configured with lower priority levels than the group priorities for hardware triggered groups. ImplementationType: Adc_PriorityImplementationType
      boolean AdcReadGroupApi: set at pre-compile  # Adds / removes the service Adc_ReadGroup() and from the code. | true: Adc_ReadGroup() can be used. false: Adc_ReadGroup() can not be used.
      enumeration AdcResultAlignment: {ADC_ALIGN_LEFT, ADC_ALIGN_RIGHT}, set at pre-compile  # Alignment of ADC raw results in ADC result buffer (left/right alignment). | Implementation Type: Adc_ResultAlignmentType
      boolean AdcVersionInfoApi: set at pre-compile, default-value=false  # Adds / removes the service Adc_GetVersionInfo() from the code. | true: Adc_GetVersionInfo() can be used. false: Adc_GetVersionInfor() can not be used.
      reference AdcEcucPartitionRef [0..*]: scope=ECU, multiplicity set at pre-compile, post-build-variant-multiplicity=true, post-build-variant-value=true, set at pre-compile, destination=EcucPartition  # Maps the ADC driver to zero or multiple ECUC partitions to make the driver API available in the according partition.
      reference AdcKernelEcucPartitionRef [0..1]: scope=ECU, multiplicity set at pre-compile, post-build-variant-multiplicity=true, post-build-variant-value=true, set at pre-compile, destination=EcucPartition  # Maps the ADC kernel to zero or one ECUC partitions to assign the driver kernel to a certain core. The ECUC partition referenced is a subset of the ECUC partitions where the ADC driver is mapped to.
      container AdcPowerStateConfig [0..*]  # Each instance of this parameter defines a power state and the callback to be called when this power state is reached.
        integer AdcPowerState: 0..18446744073709551615, set at pre-compile, symbolic-name-value=true  # Each instance of this parameter describes a different power state supported by the ADC HW. It should be defined by the HW supplier and used by the ADCDriver to reference specific HW configurations which set the ADC HW module in the referenced power state. | At least the power mode corresponding to full power state shall be always configured.
        function name AdcPowerStateReadyCbkRef: set at pre-compile  # Each instance of this parameter contains a reference to a power mode callback defined in a CDD or IoHwAbs component.
    container AdcPublishedInformation  # Additional published parameters not covered by "Common" Published Information. Note that these parameters have "PUBLISHED-INFORMATION" configuration class setting, since they are published information.
      boolean AdcChannelValueSigned: set at published-information  # Information whether the result value of the ADC driver has sign information (true) or not (false). If the result shall be interpreted as signed value it shall apply to C-language rules.
      boolean AdcGroupFirstChannelFixed: set at published-information  # Information whether the first channel of an ADC Channel group can be configured (false) or is fixed (true) to a value determined by the ADC HW Unit.
      integer AdcMaxChannelResolution: 1..63, set at published-information  # Maximum Channel resolution in bits (does not specify accuracy).
  module definition Arti [0..1]: post-build-variant-support=true, variants link-time/post-build/pre-compile  # The Arti Module serves as a superordinate container collecting all information and parameters concerning ARTI.
    container ArtiGeneric [0..1]: multiplicity set at pre-compile  # The ArtiGeneric container contains definitions for generic objects, i.e. not belonging to a standard AUTOSAR module.
      container ArtiGenericComponentClass [0..*]: multiplicity set at pre-compile  # The class definition describes the layout of the object (similar to a "class" definition in C).
        string ArtiGenericComponentClassName: scope=ECU, set at pre-compile  # Name of the class.
        container ArtiGenericComponentClassParameter [0..*]: multiplicity set at pre-compile  # Parameter definition of a class.
          string ArtiGenericComponentClassParameterName: scope=ECU, set at pre-compile  # Name of the parameter.
          reference ArtiGenericComponentClassParameterTypeMapRef [0..1]: scope=ECU, multiplicity set at pre-compile, set at pre-compile, destination=ArtiParameterTypeMap  # Refers to a parameter type to interpret the parameter value.
      container ArtiGenericComponentInstance [0..*]: multiplicity set at pre-compile  # The instance definition describes a specific instantiated object.
        string ArtiGenericComponentInstanceName: scope=ECU, set at pre-compile  # Name of the instance.
        reference ArtiGenericComponentInstanceClassRef: scope=ECU, set at pre-compile, destination=ArtiGenericComponentClass  # Refers to a ArtGenericClass of which this object is instantiated.
        container ArtiGenericComponentInstanceParameter [0..*]: multiplicity set at pre-compile  # Parameter definition of an instance.
          reference ArtiGenericComponentInstanceParameterClassParameterRef [0..*]: multiplicity set at pre-compile, set at pre-compile, destination=ArtiGenericComponentClassParameter  # Refers to an ArtiGenericComponentClassParameter that defines this parameter.
          reference ArtiGenericComponentInstanceParameterConstantRef [0..1]: multiplicity set at pre-compile, set at pre-compile, destination=ArtiConstant  # Refers to an ArtiConstant that represents the value of this parameter.
          reference ArtiGenericComponentInstanceParameterExpressionRef [0..1]: multiplicity set at pre-compile, set at pre-compile, destination=ArtiExpression  # Refers to an ArtiExpression that evaluates the value of this parameter.
          reference ArtiGenericComponentInstanceParameterHookRef [0..1]: multiplicity set at pre-compile, set at pre-compile, destination=ArtiHook  # Refers to a hook that records this parameter.
    container ArtiHardware [0..1]: multiplicity set at post-build in variant post-build / pre-compile in variant pre-compile, post-build-variant-multiplicity=true  # The ArtiHardware container contains ARTI extensions to the EcucHardware module.
      container ArtiHardwareCoreClass [0..1]: multiplicity set at post-build in variant post-build / pre-compile in variant pre-compile, post-build-variant-multiplicity=true  # Contains the layout of an ARTI "Core" object, extending the EcucCoreDefinition.
        reference ArtiHardwareCoreClassCurrentApplicationRef: scope=ECU, post-build-variant-value=true, set at post-build in variant post-build / pre-compile in variant pre-compile, destination=ArtiObjectClassParameter  # Refers to the ArtiObjectClassParameter that defines the ArtiCurrentApplicationInstance parameter.
        reference ArtiHardwareCoreClassCurrentIsrRef [0..1]: scope=ECU, post-build-variant-value=true, set at post-build in variant post-build / pre-compile in variant pre-compile, destination=ArtiObjectClassParameter  # Refers to the ArtiObjectClassParameter that defines the ArtiCurrentIsrInstance parameter.
        reference ArtiHardwareCoreClassCurrentTaskRef: scope=ECU, post-build-variant-value=true, set at post-build in variant post-build / pre-compile in variant pre-compile, destination=ArtiObjectClassParameter  # Refers to the ArtiObjectClassParameter that defines the ArtiCurrentTaskInstance parameter.
        reference ArtiHardwareCoreClassGenericComponentRef [0..1]: scope=ECU, multiplicity set at post-build in variant post-build / pre-compile in variant pre-compile, post-build-variant-multiplicity=true, post-build-variant-value=true, set at post-build in variant post-build / pre-compile in variant pre-compile, destination=ArtiGenericComponentClass  # Refers to an ArtiGenericComponentClass that extends the core description.
        reference ArtiHardwareCoreClassLastErrorRef [0..1]: scope=ECU, multiplicity set at post-build in variant post-build / pre-compile in variant pre-compile, post-build-variant-multiplicity=true, post-build-variant-value=true, set at post-build in variant post-build / pre-compile in variant pre-compile, destination=ArtiObjectClassParameter  # Refers to the ArtiObjectClassParameter that defines the ArtiLastErrorInstance parameter.
        reference ArtiHardwareCoreClassRunningTaskPriorityRef [0..1]: scope=ECU, multiplicity set at post-build in variant post-build / pre-compile in variant pre-compile, post-build-variant-multiplicity=true, post-build-variant-value=true, set at post-build in variant post-build / pre-compile in variant pre-compile, destination=ArtiObjectClassParameter  # Refers to the ArtiObjectClassParameter that defines the ArtiHwCoreInstanceRunningTaskPriority parameter. This attribute specifies how to evaluate the current priority of the task referred by RUNNINGTASK. The current priority can be different from the static task priority as a result of priority ceiling protocol. This attribute differs from ArtiCurrentTask->ArtiOsTaskClassPriority as here is a single variable while in multiple tasks there is a single variable per task.
      container ArtiHardwareCoreInstance [0..*]: multiplicity set at post-build in variant post-build / pre-compile in variant pre-compile, post-build-variant-multiplicity=true  # Description: Represents an instance of an ARTI "Core" object, extending the EcucCoreDefinition. When using ARTI for debugging or hardware based tracing, this is mandatory (i.e. multiplicity 1..*), else optional.
        integer ArtiHardwareCoreInstanceCoreId: 0..18446744073709551615, scope=ECU, post-build-variant-value=true, set at post-build in variant post-build / pre-compile in variant pre-compile  # This parameter represents the "CoreID" as given by the OS, returned by GetCoreID().
        reference ArtiHardwareCoreInstanceCurrentApplicationRef: scope=ECU, post-build-variant-value=true, set at post-build in variant post-build / pre-compile in variant pre-compile, destination=ArtiObjectInstanceParameter  # Refers to the ArtiObjectInstanceParameter that contains the evaluation for the "current application" that is running on this core.
        reference ArtiHardwareCoreInstanceCurrentIsrRef [0..1]: scope=ECU, multiplicity set at post-build in variant post-build / pre-compile in variant pre-compile, post-build-variant-multiplicity=true, post-build-variant-value=true, set at post-build in variant post-build / pre-compile in variant pre-compile, destination=ArtiObjectInstanceParameter  # Refers to the ArtiObjectInstanceParameter that contains the evaluation for the "current ISR" that is running on this core.
        reference ArtiHardwareCoreInstanceCurrentTaskRef: scope=ECU, post-build-variant-value=true, set at post-build in variant post-build / pre-compile in variant pre-compile, destination=ArtiObjectInstanceParameter  # Refers to the ArtiObjectInstanceParameter that contains the evaluation for the "current task" that is running on this core.
        reference ArtiHardwareCoreInstanceEcucCoreRef: scope=ECU, post-build-variant-value=true, set at post-build in variant post-build / pre-compile in variant pre-compile, destination=EcucCoreDefinition  # Refers to the EcucCoreDefinition of this core.
        reference ArtiHardwareCoreInstanceGenericComponentRef [0..1]: scope=ECU, multiplicity set at post-build in variant post-build / pre-compile in variant pre-compile, post-build-variant-multiplicity=true, post-build-variant-value=true, set at post-build in variant post-build / pre-compile in variant pre-compile, destination=ArtiGenericComponentInstance  # Refers to an ArtiGenericComponentInstance that extends a core.
        reference ArtiHardwareCoreInstanceLastErrorRef [0..1]: scope=ECU, multiplicity set at post-build in variant post-build / pre-compile in variant pre-compile, post-build-variant-multiplicity=true, post-build-variant-value=true, set at post-build in variant post-build / pre-compile in variant pre-compile, destination=ArtiObjectInstanceParameter  # Refers to the ArtiObjectInstanceParameter that contains the evaluation for the "last error" that happened on this core.
        reference ArtiHardwareCoreInstanceRunningTaskPriorityRef [0..1]: scope=ECU, multiplicity set at post-build in variant post-build / pre-compile in variant pre-compile, post-build-variant-multiplicity=true, post-build-variant-value=true, set at post-build in variant post-build / pre-compile in variant pre-compile, destination=ArtiObjectInstanceParameter  # Refers to the ArtiObjectInstanceParameter that contains the evaluation for the "running task priority" that is on this core.
        reference ArtiHardwareCoreInstanceValidRef [0..1]: scope=ECU, multiplicity set at link in variant link-time / pre-compile in variant pre-compile, set at link in variant link-time / pre-compile in variant pre-compile, destination=ArtiObjectInstanceParameter  # Refers to the ArtiObjectInstanceParameter that contains the evaluation for the "validity" of this ArtiHwCoreInstance. Every object declaration may contain a VALID attribute telling the debugger whether the object's attributes are currently valid. It may have an integer type of any size. Its possible values are 0 (invalid) and non zero (object is valid).
    container ArtiOs [0..1]: multiplicity set at link in variant link-time / pre-compile in variant pre-compile, post-build-variant-multiplicity=true  # The ArtiOs container contains ARTI extensions to the EcucDefs/Os module.
      container ArtiOsAlarmClass [0..1]: multiplicity set at link in variant link-time / pre-compile in variant pre-compile  # Contains the layout of an ArtiOsAlarm object.
        reference ArtiOsAlarmClassGenericComponentClassRef [0..1]: scope=ECU, multiplicity set at link in variant link-time / pre-compile in variant pre-compile, set at link in variant link-time / pre-compile in variant pre-compile, destination=ArtiGenericComponentClass  # Refers to an ArtiGenericComponentClass that extends the ArtiOsAlarmClass.
        reference ArtiOsAlarmClassStateRef [0..1]: scope=ECU, multiplicity set at link in variant link-time / pre-compile in variant pre-compile, set at link in variant link-time / pre-compile in variant pre-compile, destination=ArtiObjectClassParameter  # Refers to the ArtiObjectClassParameter that declares the attribute ArtiOsAlarmStateRef in ArtiOsAlarmInstances. This attribute specifies if an alarm is "RUNNING" or "STOPPED". The refered ArtiObjectClassParameter does include the mapping from integer to human readable "RUNNING" or "STOPPED".
      container ArtiOsAlarmInstance [0..*]: multiplicity set at link in variant link-time / pre-compile in variant pre-compile  # Represents an instance of an ArtiOsAlarm object, extending the EcuC OsTaskAlarm.
        string ArtiOsAlarmInstanceAction [0..1]: scope=ECU, multiplicity set at link in variant link-time / pre-compile in variant pre-compile, set at link in variant link-time / pre-compile in variant pre-compile  # This attribute provides a string with a description of the action when the alarm expires, e.g. "ActivateTask TaskA".
        string ArtiOsAlarmInstanceCounter [0..1]: scope=ECU, multiplicity set at link in variant link-time / pre-compile in variant pre-compile, set at link in variant link-time / pre-compile in variant pre-compile  # This attribute provides a string containing the name of the counter used by this alarm.
        reference ArtiOsAlarmInstanceAlarmTimeRef [0..1]: scope=ECU, multiplicity set at link in variant link-time / pre-compile in variant pre-compile, set at link in variant link-time / pre-compile in variant pre-compile, destination=ArtiObjectInstanceParameter  # This attribute specifies how to evaluate the time until the alarm expires next. The time should be represented in seconds.
        reference ArtiOsAlarmInstanceCycleTimeRef [0..1]: scope=ECU, multiplicity set at link in variant link-time / pre-compile in variant pre-compile, set at link in variant link-time / pre-compile in variant pre-compile, destination=ArtiObjectInstanceParameter  # This attribute specifies how to evaluate the cycle time for cyclic alarms. The value of "cycle time" is 0 for non-cyclic alarms. The time should be represendet in seconds.
        reference ArtiOsAlarmInstanceEcuCRef [0..1]: scope=ECU, multiplicity set at link in variant link-time / pre-compile in variant pre-compile, set at link in variant link-time / pre-compile in variant pre-compile, destination=OsAlarm  # Refers to an EcuC OsAlarm that is beeing extended.
        reference ArtiOsAlarmInstanceGenericComponentInstanceRef [0..1]: scope=ECU, multiplicity set at link in variant link-time / pre-compile in variant pre-compile, set at link in variant link-time / pre-compile in variant pre-compile, destination=ArtiGenericComponentInstance  # Refers to an ArtiGenericComponentInstance that extends the ArtiOsAlarmInstance.
        reference ArtiOsAlarmInstanceStateRef [0..1]: scope=ECU, multiplicity set at link in variant link-time / pre-compile in variant pre-compile, set at link in variant link-time / pre-compile in variant pre-compile, destination=ArtiObjectInstanceParameter  # Refers to the ArtiObjectInstanceParameter that contains the evaluation for the "state" of this alarm. The result then is mapped with the typemap of the ArtiOsAlarmStateRef of the ArtiOsAlarmClass.
        reference ArtiOsAlarmInstanceValidRef [0..1]: scope=ECU, multiplicity set at link in variant link-time / pre-compile in variant pre-compile, set at link in variant link-time / pre-compile in variant pre-compile, destination=ArtiObjectInstanceParameter  # Refers to the ArtiObjectInstanceParameter that contains the evaluation for the "validity" of this alarm. Every object declaration may contain a VALID attribute telling the debugger whether the object's attributes are currently valid. It may have an integer type of any size. Its possible values are 0 (invalid) and non zero (object is valid).
      container ArtiOsClass [0..1]: multiplicity set at link in variant link-time / pre-compile in variant pre-compile  # Contains the layout of an ARTI "Os" object, extending the EcuC OsOS.
        reference ArtiOsClassAppModeRef: scope=ECU, set at link in variant link-time / pre-compile in variant pre-compile, destination=ArtiObjectClassParameter  # Refers to the ArtiObjectClassParameter that defines the ArtiOsAppModeInstance parameter.
        reference ArtiOsClassGenericComponentRef [0..1]: scope=ECU, multiplicity set at link in variant link-time / pre-compile in variant pre-compile, set at link in variant link-time / pre-compile in variant pre-compile, destination=ArtiGenericComponentClass  # Refers to an ArtiGenericComponentClass that extends the OS description.
        reference ArtiOsClassServiceTraceRef [0..1]: scope=ECU, multiplicity set at link in variant link-time / pre-compile in variant pre-compile, set at link in variant link-time / pre-compile in variant pre-compile, destination=ArtiObjectClassParameter  # Refers to the ArtiObjectClassParameter that defines the ArtiOsInstanceServiceTrace parameter. This attribute indicates the entry or exit of a service routine and the ID of this service routine. The value of this attribute must be evaluated from one single memory location.
      container ArtiOsContextClass [0..1]: multiplicity set at link in variant link-time / pre-compile in variant pre-compile  # Contains the layout of an ARTI "OsContext" object.
        reference ArtiOsContextClassGenericComponentClassRef [0..1]: scope=ECU, multiplicity set at link in variant link-time / pre-compile in variant pre-compile, set at link in variant link-time / pre-compile in variant pre-compile, destination=ArtiGenericComponentClass  # Refers to an ArtiGenericComponentClass that extends the ArtiOsContextClass.
      container ArtiOsContextInstance [0..*]: multiplicity set at link in variant link-time / pre-compile in variant pre-compile  # Represents an instance of an "ArtiContext" object.
        reference ArtiOsContextInstanceAddressRef [0..1]: scope=ECU, multiplicity set at link in variant link-time / pre-compile in variant pre-compile, set at link in variant link-time / pre-compile in variant pre-compile, destination=ArtiObjectInstanceParameter  # Refers to the ArtiObjectInstanceParameter that contains the evaluation for the "address" of this context.
        reference ArtiOsContextInstanceGenericComponentInstanceRef [0..1]: scope=ECU, multiplicity set at link in variant link-time / pre-compile in variant pre-compile, set at link in variant link-time / pre-compile in variant pre-compile, destination=ArtiGenericComponentInstance  # Refers to an ArtiGenericComponentInstance that extends the ArtiOsContext.
        reference ArtiOsContextInstanceSizeRef [0..1]: scope=ECU, multiplicity set at link in variant link-time / pre-compile in variant pre-compile, set at link in variant link-time / pre-compile in variant pre-compile, destination=ArtiObjectInstanceParameter  # Refers to the ArtiObjectInstanceParameter that contains the evaluation for the "size" of this context.
        reference ArtiOsContextInstanceValidRef [0..1]: scope=ECU, multiplicity set at link in variant link-time / pre-compile in variant pre-compile, set at link in variant link-time / pre-compile in variant pre-compile, destination=ArtiObjectInstanceParameter  # Refers to the ArtiObjectInstanceParameter that contains the evaluation for the "validity" of this context. Every object declaration may contain a VALID attribute telling the debugger whether the object's attributes are currently valid. It may have an integer type of any size. Its possible values are 0 (invalid) and non zero (object is valid).
      container ArtiOsInstance [0..1]: multiplicity set at link in variant link-time / pre-compile in variant pre-compile  # Represents an instance of an ARTI "Os" object, extending the EcuC OsOS.
        reference ArtiOsInstanceAppModeRef: scope=ECU, set at link in variant link-time / pre-compile in variant pre-compile, destination=ArtiObjectInstanceParameter  # Refers to the ArtiObjectInstanceParameter that contains the evaluation for the "application mode" of this OS.
        reference ArtiOsInstanceEcucRef: scope=ECU, set at link in variant link-time / pre-compile in variant pre-compile, destination=OsOS  # Refers to the EcucDefs/Os/OsOS of this OS.
        reference ArtiOsInstanceGenericComponentRef [0..1]: scope=ECU, multiplicity set at link in variant link-time / pre-compile in variant pre-compile, set at link in variant link-time / pre-compile in variant pre-compile, destination=ArtiGenericComponentInstance  # Refers to an ArtiGenericComponentInstance that extends the OS.
        reference ArtiOsInstanceHookRef [0..*]: scope=ECU, multiplicity set at link in variant link-time / pre-compile in variant pre-compile, set at link in variant link-time / pre-compile in variant pre-compile, destination=ArtiHook  # Refers to a hook defined in the OS.
        reference ArtiOsInstanceServiceTraceRef [0..1]: scope=ECU, multiplicity set at link in variant link-time / pre-compile in variant pre-compile, set at link in variant link-time / pre-compile in variant pre-compile, destination=ArtiObjectInstanceParameter  # Refers to a hook defined in the OS.
        reference ArtiOsInstanceValidRef [0..1]: scope=ECU, multiplicity set at link in variant link-time / pre-compile in variant pre-compile, set at link in variant link-time / pre-compile in variant pre-compile, destination=ArtiObjectInstanceParameter  # Refers to the ArtiObjectInstanceParameter that contains the evaluation for the "validity" of this ArtiOsInstance. Every object declaration may contain a VALID attribute telling the debugger whether the object's attributes are currently valid. It may have an integer type of any size. Its possible values are 0 (invalid) and non zero (object is valid).
      container ArtiOsIsrClass [0..1]: multiplicity set at link in variant link-time / pre-compile in variant pre-compile  # Contains the layout of an ARTI "OsIsr" object, extending the EcuC OsIsr.
        reference ArtiOsIsrClassGenericComponentRef [0..1]: scope=ECU, multiplicity set at link in variant link-time / pre-compile in variant pre-compile, set at link in variant link-time / pre-compile in variant pre-compile, destination=ArtiGenericComponentClass  # Refers to an optional ArtiGenericComponentClass that extends the OsIsr with additional parameters.
      container ArtiOsIsrInstance [0..*]: multiplicity set at link in variant link-time / pre-compile in variant pre-compile  # Represents an instance of an ARTI "OsIsr" object, extending the EcuC OsIsr.
        enumeration ArtiOsIsrInstanceCategory [0..1]: {CATEGORY_1, CATEGORY_2}, scope=ECU, multiplicity set at pre-compile, set at pre-compile  # Specifies category of this ISR. If omitted the instance is related to a CATEGORY_2.
        function name ArtiOsIsrInstanceFunction [0..1]: scope=ECU, multiplicity set at link in variant link-time / pre-compile in variant pre-compile, set at link in variant link-time / pre-compile in variant pre-compile  # This parameter represents the C function name of the ISR routine.
        integer ArtiOsIsrInstanceId: 0..18446744073709551615, scope=ECU, set at link in variant link-time / pre-compile in variant pre-compile  # This parameter represents the "ISRID" as given by the OS, returned by GetISRID().
        reference ArtiOsIsrInstanceEcucRef [0..1]: scope=ECU, multiplicity set at pre-compile, set at link in variant link-time / pre-compile in variant pre-compile, destination=OsIsr  # Refers to the EcucDefs/Os/OsIsr of this ISR.
        reference ArtiOsIsrInstanceGenericComponentRef [0..1]: scope=ECU, multiplicity set at link in variant link-time / pre-compile in variant pre-compile, set at link in variant link-time / pre-compile in variant pre-compile, destination=ArtiGenericComponentInstance  # Refers to an optional ArtiGenericComponentInstance that extends this OsIsr with additional parameters.
        reference ArtiOsIsrInstanceValidRef [0..1]: scope=ECU, multiplicity set at link in variant link-time / pre-compile in variant pre-compile, set at link in variant link-time / pre-compile in variant pre-compile, destination=ArtiObjectInstanceParameter  # Refers to the ArtiObjectInstanceParameter that contains the evaluation for the "validity" of this ArtiOsIsrInstance. Every object declaration may contain a VALID attribute telling the debugger whether the object's attributes are currently valid. It may have an integer type of any size. Its possible values are 0 (invalid) and non zero (object is valid).
      container ArtiOsMessageContainerClass [0..1]: multiplicity set at link in variant link-time / pre-compile in variant pre-compile  # Contains the layout of an ARTI "OsMessageContainer" object. The "OsMessageContainer" object represents an existing combination of OSEK messages.
        reference ArtiOsMessageContainerClassGenericComponentClassRef [0..1]: scope=ECU, multiplicity set at link in variant link-time / pre-compile in variant pre-compile, set at link in variant link-time / pre-compile in variant pre-compile, destination=ArtiGenericComponentClass  # Refers to an ArtiGenericComponentClass that extends the ArtiOsMessageContainerClass.
      container ArtiOsMessageContainerInstance [0..*]: multiplicity set at link in variant link-time / pre-compile in variant pre-compile  # Represents an instance of an "ArtiMessageContainer" object.
        string ArtiOsMessageContainerInstanceMsgName [0..1]: scope=ECU, multiplicity set at link in variant link-time / pre-compile in variant pre-compile, set at link in variant link-time / pre-compile in variant pre-compile  # This attribute provides the name of the message as defined in OIL file.
        string ArtiOsMessageContainerInstanceMsgType [0..1]: scope=ECU, multiplicity set at link in variant link-time / pre-compile in variant pre-compile, set at link in variant link-time / pre-compile in variant pre-compile  # This attribute provides the type of the message.
        reference ArtiOsMessageContainerInstanceFirstElementRef [0..1]: scope=ECU, multiplicity set at link in variant link-time / pre-compile in variant pre-compile, set at link in variant link-time / pre-compile in variant pre-compile, destination=ArtiObjectInstanceParameter  # Refers to the ArtiObjectInstanceParameter that contains the evaluation for the "firstelement" of this "ArtiOsMessageContainer". This attribute provides the formula for evaluation of address of first valid message. This message will be received next. If no message is in the queue the value is zero.
        reference ArtiOsMessageContainerInstanceGenericComponentInstanceRef [0..1]: scope=ECU, multiplicity set at link in variant link-time / pre-compile in variant pre-compile, set at link in variant link-time / pre-compile in variant pre-compile, destination=ArtiGenericComponentInstance  # Refers to an ArtiGenericComponentInstance that extends the ArtiOsMessageContainerInstance.
        reference ArtiOsMessageContainerInstanceQueueCountRef [0..1]: scope=ECU, multiplicity set at link in variant link-time / pre-compile in variant pre-compile, set at link in variant link-time / pre-compile in variant pre-compile, destination=ArtiObjectInstanceParameter  # Refers to the ArtiObjectInstanceParameter that contains the evaluation for the "queuecount" of this "ArtiOsMessageContainer". This attribute provides the number of valid messages in the queue and "1" for unqueued messages.
        reference ArtiOsMessageContainerInstanceQueueSizeRef [0..1]: scope=ECU, multiplicity set at link in variant link-time / pre-compile in variant pre-compile, set at link in variant link-time / pre-compile in variant pre-compile, destination=ArtiObjectInstanceParameter  # Refers to the ArtiObjectInstanceParameter that contains the evaluation for the "queuesize" of this "ArtiOsMessageContainer". This attribute provides the size of the queue for queued messages and "1" for unqueued messages.
        reference ArtiOsMessageContainerInstanceValidRef [0..1]: scope=ECU, multiplicity set at link in variant link-time / pre-compile in variant pre-compile, set at link in variant link-time / pre-compile in variant pre-compile, destination=ArtiObjectInstanceParameter  # Refers to the ArtiObjectInstanceParameter that contains the evaluation for the "validity" of this ArtiOsMessageContainerInstance. Every object declaration may contain a VALID attribute telling the debugger whether the object's attributes are currently valid. It may have an integer type of any size. Its possible values are 0 (invalid) and non zero (object is valid).
      container ArtiOsResourceClass [0..1]: multiplicity set at link in variant link-time / pre-compile in variant pre-compile  # Contains the layout of an ArtiOsResource object. The ArtiOsResource object represents an OSEK resource.
        reference ArtiOsResourceClassGenericComponentClassRef [0..1]: scope=ECU, multiplicity set at link in variant link-time / pre-compile in variant pre-compile, set at link in variant link-time / pre-compile in variant pre-compile, destination=ArtiGenericComponentClass  # Refers to an ArtiGenericComponentClass that extends the ArtiOsResourceClass.
        reference ArtiOsResourceClassLockerRef [0..1]: scope=ECU, multiplicity set at link in variant link-time / pre-compile in variant pre-compile, set at link in variant link-time / pre-compile in variant pre-compile, destination=ArtiObjectClassParameter  # Refers to the ArtiObjectClassParameter that declares the attribute ArtiOsResourceLockerRef in ArtiOsResourceInstances. This attribute indicates the locking ArtiOsTaskInstance or ArtiOsIsrInstance.
        reference ArtiOsResourceClassStateRef [0..1]: scope=ECU, multiplicity set at link in variant link-time / pre-compile in variant pre-compile, set at link in variant link-time / pre-compile in variant pre-compile, destination=ArtiObjectClassParameter  # Refers to the ArtiObjectClassParameter that declares the attribute ArtiOsResourceStateRef in ArtiOsResourceInstances. This attribute represents the state of a resource ("LOCKED"/"UNLOCKED"). The ArtiObjectClassParameter does include the mapping from integer to human readable "LOCKED" or "UNLOCKED".
      container ArtiOsResourceInstance [0..*]: multiplicity set at link in variant link-time / pre-compile in variant pre-compile  # Represents an instance of an ArtiOsResource object.
        string ArtiOsResourceInstancePriority [0..1]: scope=ECU, multiplicity set at link in variant link-time / pre-compile in variant pre-compile, set at link in variant link-time / pre-compile in variant pre-compile  # This attribute has two components that state: that the RESOURCE is used by TASKs only or by TASKs and ISRs, and the priority that will be used when locking the RESOURCE.
        reference ArtiOsResourceInstanceEcuCRef [0..1]: scope=ECU, multiplicity set at link in variant link-time / pre-compile in variant pre-compile, set at link in variant link-time / pre-compile in variant pre-compile, destination=OsResource  # Refers to an EcuC OsResource that is beeing extended.
        reference ArtiOsResourceInstanceGenericComponentInstanceRef [0..1]: scope=ECU, multiplicity set at link in variant link-time / pre-compile in variant pre-compile, set at link in variant link-time / pre-compile in variant pre-compile, destination=ArtiGenericComponentInstance  # Refers to an ArtiGenericComponentInstance that extends the ArtiOsResourceInstance.
        reference ArtiOsResourceInstanceLockerRef [0..1]: scope=ECU, multiplicity set at link in variant link-time / pre-compile in variant pre-compile, set at link in variant link-time / pre-compile in variant pre-compile, destination=ArtiObjectInstanceParameter  # Refers to the ArtiObjectInstanceParameter that contains the evaluation for the "locker" of this ArtiOsResource.
        reference ArtiOsResourceInstanceStateRef [0..1]: scope=ECU, multiplicity set at link in variant link-time / pre-compile in variant pre-compile, set at link in variant link-time / pre-compile in variant pre-compile, destination=ArtiObjectInstanceParameter  # Refers to the ArtiObjectInstanceParameter that contains the evaluation for the "state" of this ArtiOsResource.
        reference ArtiOsResourceInstanceValidRef [0..1]: scope=ECU, multiplicity set at link in variant link-time / pre-compile in variant pre-compile, set at link in variant link-time / pre-compile in variant pre-compile, destination=ArtiObjectInstanceParameter  # Refers to the ArtiObjectInstanceParameter that contains the evaluation for the "validity" of this ArtiOsResourceInstance. Every object declaration may contain a VALID attribute telling the debugger whether the object's attributes are currently valid. It may have an integer type of any size. Its possible values are 0 (invalid) and non zero (object is valid).
      container ArtiOsStackClass [0..1]: multiplicity set at link in variant link-time / pre-compile in variant pre-compile  # Contains the layout of an ArtiOsStack object. The ArtiOsStack object defines the memory area of any stack in the system.
        reference ArtiOsStackClassGenericComponentClassRef [0..1]: scope=ECU, multiplicity set at link in variant link-time / pre-compile in variant pre-compile, set at link in variant link-time / pre-compile in variant pre-compile, destination=ArtiGenericComponentClass  # Refers to an ArtiGenericComponentClass that extends the ArtiOsStackClass.
      container ArtiOsStackInstance [0..*]: multiplicity set at link in variant link-time / pre-compile in variant pre-compile  # Represents an instance of an ArtiOsStack object.
        string ArtiOsStackInstanceDirection [0..1]: scope=ECU, multiplicity set at link in variant link-time / pre-compile in variant pre-compile, set at link in variant link-time / pre-compile in variant pre-compile  # This attribute specifies the direction of stack growth and may have either "UP" or "DOWN" as its value. UP means growing from lower to higher addresses. DOWN means growing from higher addresses to lower addresses.
        reference ArtiOsStackInstanceBaseAddressRef [0..1]: scope=ECU, multiplicity set at link in variant link-time / pre-compile in variant pre-compile, set at link in variant link-time / pre-compile in variant pre-compile, destination=ArtiObjectInstanceParameter  # Refers to the ArtiObjectInstanceParameter that contains the evaluation for the "baseaddress" of this ArtiOsStack. This attribute specifies the lowest address of stack memory area, regardless of the stack direction.
        reference ArtiOsStackInstanceFillPatternRef [0..1]: scope=ECU, multiplicity set at link in variant link-time / pre-compile in variant pre-compile, set at link in variant link-time / pre-compile in variant pre-compile, destination=ArtiObjectInstanceParameter  # Refers to the ArtiObjectInstanceParameter that contains the evaluation for the "fillpattern" of this ArtiOsStack. If the operating system fills the stack during initialisation, this attribute specifies with which pattern the stack area is initialised. This allows the debugger to evaluate the maximum stack usage. For "stackdirection" "DOWN" the pattern starts at "baseaddress". For "stackdirection" "UP" the pattern starts at "baseaddress" + "size". If no pattern is used, this attribute must be omitted.
        reference ArtiOsStackInstanceGenericComponentInstanceRef [0..1]: scope=ECU, multiplicity set at link in variant link-time / pre-compile in variant pre-compile, set at link in variant link-time / pre-compile in variant pre-compile, destination=ArtiGenericComponentInstance  # Refers to an ArtiGenericComponentInstance that extends the ArtiOsStackInstance.
        reference ArtiOsStackInstanceSizeRef [0..1]: scope=ECU, multiplicity set at link in variant link-time / pre-compile in variant pre-compile, set at link in variant link-time / pre-compile in variant pre-compile, destination=ArtiObjectInstanceParameter  # Refers to the ArtiObjectInstanceParameter that contains the evaluation for the "size" of this ArtiOsStack. This attribute represents the size (in bytes) of the memory area allocated for stack.
        reference ArtiOsStackInstanceValidRef [0..1]: scope=ECU, multiplicity set at link in variant link-time / pre-compile in variant pre-compile, set at link in variant link-time / pre-compile in variant pre-compile, destination=ArtiObjectInstanceParameter  # Refers to the ArtiObjectInstanceParameter that contains the evaluation for the "validity" of this ArtiOsStackInstance. Every object declaration may contain a VALID attribute telling the debugger whether the object's attributes are currently valid. It may have an integer type of any size. Its possible values are 0 (invalid) and non zero (object is valid).
      container ArtiOsTaskClass [0..1]: multiplicity set at link in variant link-time / pre-compile in variant pre-compile  # Contains the layout of an ARTI "OsTask" object, extending the EcuC OsTask.
        reference ArtiOsTaskClassClassGenericComponentRef [0..1]: scope=ECU, multiplicity set at link in variant link-time / pre-compile in variant pre-compile, set at link in variant link-time / pre-compile in variant pre-compile, destination=ArtiGenericComponentClass  # Refers to an ArtiGenericComponentClass that extends the OsTask.
        reference ArtiOsTaskClassContextRef [0..1]: scope=ECU, multiplicity set at link in variant link-time / pre-compile in variant pre-compile, set at link in variant link-time / pre-compile in variant pre-compile, destination=ArtiObjectClassParameter  # ArtiOsTaskContextRef in ArtiOsTaskInstances. This attribute contains a reference to the context object that the task is currently using.
        reference ArtiOsTaskClassCurrentTaskStateRef [0..1]: scope=ECU, multiplicity set at link in variant link-time / pre-compile in variant pre-compile, set at link in variant link-time / pre-compile in variant pre-compile, destination=ArtiObjectClassParameter  # Refers to the ArtiObjectClassParameter that defines the ArtiCurrentTaskStateInstance parameter including the task state mapping.
        reference ArtiOsTaskClassPriorityRef [0..1]: scope=ECU, multiplicity set at link in variant link-time / pre-compile in variant pre-compile, set at link in variant link-time / pre-compile in variant pre-compile, destination=ArtiObjectClassParameter  # Refers to the ArtiObjectClassParameter that declares the attribute ArtiOsTaskPriorityRef in ArtiOsTaskInstances. This attribute represents the current priority of the TASK object. The current priority can be different from the static task priority as a result of priority ceiling protocol. The priority displayed is the priority as defined in the OsTask.
        reference ArtiOsTaskClassStackRef [0..1]: scope=ECU, multiplicity set at link in variant link-time / pre-compile in variant pre-compile, set at link in variant link-time / pre-compile in variant pre-compile, destination=ArtiObjectClassParameter  # Refers to the ArtiObjectClassParameter that declares the attribute ArtiOsTaskStackRef in ArtiOsTaskInstances. This attribute contains a reference to the stack object that the task is currently using.
      container ArtiOsTaskInstance [0..*]: multiplicity set at link in variant link-time / pre-compile in variant pre-compile  # Represents an instance of an ARTI "OsTask" object, extending the EcuC OsTask.
        function name ArtiOsTaskInstanceFunction [0..1]: scope=ECU, multiplicity set at link in variant link-time / pre-compile in variant pre-compile, set at link in variant link-time / pre-compile in variant pre-compile  # This parameter represents the C function name of the task body.
        integer ArtiOsTaskInstanceId: 0..18446744073709551615, scope=ECU, set at link in variant link-time / pre-compile in variant pre-compile  # This parameter represents the "TaskID" as given by the OSEK OS, returned by GetTaskID().
        reference ArtiOsTaskInstanceContextRef [0..1]: scope=ECU, multiplicity set at link in variant link-time / pre-compile in variant pre-compile, set at link in variant link-time / pre-compile in variant pre-compile, destination=ArtiObjectInstanceParameter  # Refers to the ArtiObjectInstanceParameter that contains the evaluation for the ArtiOsContext of this ArtiOsTask.
        reference ArtiOsTaskInstanceCurrentActivationsRef [0..1]: scope=ECU, multiplicity set at link in variant link-time / pre-compile in variant pre-compile, set at link in variant link-time / pre-compile in variant pre-compile, destination=ArtiObjectInstanceParameter  # Refers to the ArtiObjectInstanceParameter that contains the evaluation for the "current activations" of this task. This attribute specifies the number of current activations for the task.
        reference ArtiOsTaskInstanceCurrentTaskStateRef [0..1]: scope=ECU, multiplicity set at link in variant link-time / pre-compile in variant pre-compile, set at link in variant link-time / pre-compile in variant pre-compile, destination=ArtiObjectInstanceParameter  # Refers to the ArtiObjectInstanceParameter that contains the evaluation for the "current state" of this task.
        reference ArtiOsTaskInstanceEcucRef: scope=ECU, set at link in variant link-time / pre-compile in variant pre-compile, destination=OsTask  # Refers to an ArtiGenericComponentInstance that extends the OsTask.
        reference ArtiOsTaskInstanceGenericComponentRef [0..1]: scope=ECU, multiplicity set at link in variant link-time / pre-compile in variant pre-compile, set at link in variant link-time / pre-compile in variant pre-compile, destination=ArtiGenericComponentInstance  # Refers to an ArtiGenericComponentInstance that extends the OsTask.
        reference ArtiOsTaskInstancePriorityRef [0..1]: scope=ECU, multiplicity set at link in variant link-time / pre-compile in variant pre-compile, set at link in variant link-time / pre-compile in variant pre-compile, destination=ArtiObjectInstanceParameter  # Refers to the ArtiObjectInstanceParameter that contains the evaluation for the "task priority" of this task.
        reference ArtiOsTaskInstanceStackRef [0..1]: scope=ECU, multiplicity set at link in variant link-time / pre-compile in variant pre-compile, set at link in variant link-time / pre-compile in variant pre-compile, destination=ArtiObjectInstanceParameter  # Refers to the ArtiObjectInstanceParameter that contains the evaluation for the ArtiOsStack of this ArtiOsTask.
        reference ArtiOsTaskInstanceValidRef [0..1]: scope=ECU, multiplicity set at link in variant link-time / pre-compile in variant pre-compile, set at link in variant link-time / pre-compile in variant pre-compile, destination=ArtiObjectInstanceParameter  # Refers to the ArtiObjectInstanceParameter that contains the evaluation for the "validity" of this ArtiOsTaskInstance. Every object declaration may contain a VALID attribute telling the debugger whether the object's attributes are currently valid. It may have an integer type of any size. Its possible values are 0 (invalid) and non zero (object is valid).
    container ArtiRte [0..1]: multiplicity set at link in variant link-time / pre-compile in variant pre-compile  # The ArtiRte Container contains all parameters for ARTI that are filled by the generators RTE. Tags: atp.Status=draft
      reference ArtiRteHookRef [0..*]: multiplicity set at link in variant link-time / pre-compile in variant pre-compile, set at link in variant link-time / pre-compile in variant pre-compile, destination=ArtiHook  # Refers to an arti hook which is called by the RTE. Tags: atp.Status=draft
      container ArtiRteRunnableClass [0..1]: multiplicity set at link in variant link-time / pre-compile in variant pre-compile  # Contains the layout of an ArtiRteRunnable object. Tags: atp.Status=draft
        reference ArtiRteRunnableClassGenericComponentClassRef [0..1]: multiplicity set at link in variant link-time / pre-compile in variant pre-compile, set at link in variant link-time / pre-compile in variant pre-compile, destination=ArtiGenericComponentClass  # Refers to an ArtiGenericComponentClass that extends the ArtiRteRunnableClass. Tags: atp.Status=draft
        reference ArtiRteRunnableIdRef: set at link in variant link-time / pre-compile in variant pre-compile, destination=ArtiObjectClassParameter  # Refers to the ArtiObjectClassParameter that declares the attribute ArtiRteRunnableIdRef in ArtiRteRunnableEntityInstances. This attribute specifies the idOf(reName) mapping. Tags: atp.Status=draft
      container ArtiRteRunnableInstance [0..1]: multiplicity set at link in variant link-time / pre-compile in variant pre-compile  # Represents an instance of an ArtiRteRunnable object, extending the BswM RunnableEntity. Tags: atp.Status=draft
        string ArtiRteRunnableInstanceSymbol [0..1]: scope=ECU, multiplicity set at link in variant link-time / pre-compile in variant pre-compile, set at link in variant link-time / pre-compile in variant pre-compile  # Specifies the symbol / function name that implements the runnable. Tags: atp.Status=draft
        foreign reference ArtiRteRunnableInstanceBswRef [0..1]: multiplicity set at link in variant link-time / pre-compile in variant pre-compile, set at link in variant link-time / pre-compile in variant pre-compile, destination-type=RUNNABLE-ENTITY  # Refers to an Rte Runnable that is beeing extended. Tags: atp.Status=draft
        reference ArtiRteRunnableInstanceGenericComponentInstanceRef [0..1]: multiplicity set at link in variant link-time / pre-compile in variant pre-compile, set at link in variant link-time / pre-compile in variant pre-compile, destination=ArtiGenericComponentInstance  # Refers to an ArtiGenericComponentInstance that extends the ArtiRteRunnableInstance. Tags: atp.Status=draft
      container ArtiRteSchedulableClass [0..1]: multiplicity set at link in variant link-time / pre-compile in variant pre-compile  # Contains the layout of an ArtiRteSchedulable object. Tags: atp.Status=draft
        reference ArtiRteSchedulableClassGenericComponentClassRef [0..1]: multiplicity set at link in variant link-time / pre-compile in variant pre-compile, set at link in variant link-time / pre-compile in variant pre-compile, destination=ArtiGenericComponentClass  # Refers to an ArtiGenericComponentClass that extends the ArtiRteSchedulableClass. Tags: atp.Status=draft
        reference ArtiRteSchedulableIdRef: set at link in variant link-time / pre-compile in variant pre-compile, destination=ArtiObjectClassParameter  # Refers to the ArtiObjectClassParameter that declares the attribute ArtiRteSchmEntityIdRef in ArtiRteSchedulableInstances. This attribute specifies the idOf(entityName) mapping. Tags: atp.Status=draft
      container ArtiRteSchedulableInstance [0..1]: multiplicity set at link in variant link-time / pre-compile in variant pre-compile  # Represents an instance of an ArtiRteSchedulable object, extending the Rte Schedulable Entity. Tags: atp.Status=draft
        string ArtiRteSchedulableInstanceSymbol [0..1]: scope=ECU, multiplicity set at link in variant link-time / pre-compile in variant pre-compile, set at link in variant link-time / pre-compile in variant pre-compile  # Specifies the symbol / function name that implements the schedulable. Tags: atp.Status=draft
        foreign reference ArtiRteSchedulableInstanceBswRef [0..1]: multiplicity set at link in variant link-time / pre-compile in variant pre-compile, set at link in variant link-time / pre-compile in variant pre-compile, destination-type=BSW-SCHEDULABLE-ENITIY  # Refers to an Rte Schedulable that is beeing extended. Tags: atp.Status=draft
        reference ArtiRteSchedulableInstanceGenericComponentInstanceRef [0..1]: multiplicity set at link in variant link-time / pre-compile in variant pre-compile, set at link in variant link-time / pre-compile in variant pre-compile, destination=ArtiGenericComponentInstance  # Refers to an ArtiGenericComponentInstance that extends the ArtiRteSchedulableInstance. Tags: atp.Status=draft
    container ArtiValues [0..*]: multiplicity set at pre-compile  # The ArtiValues container collects all parameter values for ARTI that are filled by the generators (OS, RTE, ...)
      container ArtiConstant [0..*]: multiplicity set at pre-compile  # This container holds a constant value.
        string ArtiConstantString: scope=ECU, set at pre-compile  # This is the constant value for a specific parameter.
      container ArtiExpression [0..*]: multiplicity set at pre-compile  # This container holds a C like expression that a debugger can evaluate. This is similar to what is already done in ORTI.
        string ArtiExpressionString: scope=ECU, post-build-variant-value=true, set at pre-compile  # This string represents a C like expression that a debugger can evaluate.
      container ArtiHook [0..*]: multiplicity set at pre-compile  # This container represents an ARTI hook that is present in the module.
        string ArtiHookClass: scope=ECU, set at pre-compile  # Name of the (schedule) class of macros. Classes can be one of the predefined classes or user defined.
        string ArtiHookContext: scope=ECU, set at pre-compile  # Name of the execution context. One of NOSUSP, SPRVSR, or USER. | See also chapter "ARTI Tracing Macro".
        string ArtiHookEventName: scope=ECU, set at pre-compile  # The name of the event as defined for a particular class, or an arbitrary name for generic classes.
        string ArtiHookInstance: scope=ECU, set at pre-compile  # Name of an instance of the (schedule) class.
        reference ArtiHookEventParameterTypeRef [0..1]: scope=ECU, multiplicity set at pre-compile, set at pre-compile, destination=ArtiParameterTypeMap  # Refers to a parameter type to interpret the hook event number.
        reference ArtiHookInstanceParameterTypeRef [0..1]: scope=ECU, multiplicity set at pre-compile, set at pre-compile, destination=ArtiParameterTypeMap  # Refers to a parameter type to interpret the hook instance number.
      container ArtiObjectClassParameter [0..*]: multiplicity set at pre-compile  # This container represents a parameter of an Arti object class definition.
        reference ArtiObjectClassParameterTypeMapRef [0..1]: scope=ECU, multiplicity set at pre-compile, set at pre-compile, destination=ArtiParameterTypeMap  # Refers to a parameter type to interpret the instance parameter value.
      container ArtiObjectInstanceParameter [0..*]: multiplicity set at pre-compile  # This container represents a parameter of an Arti object instance.
        reference ArtiObjectInstanceParameterConstantRef [0..1]: scope=ECU, multiplicity set at pre-compile, set at pre-compile, destination=ArtiConstant  # Refers to a constant representing the value of this parameter.
        reference ArtiObjectInstanceParameterExpressionRef [0..1]: scope=ECU, multiplicity set at pre-compile, set at pre-compile, destination=ArtiExpression  # Refers to an expression that evaluates the value of this parameter.
        reference ArtiObjectInstanceParameterHookRef [0..1]: scope=ECU, multiplicity set at pre-compile, set at pre-compile, destination=ArtiHook  # Refers to a hook that records this parameter.
      container ArtiParameterTypeMap [0..*]: multiplicity set at pre-compile  # A map of key/value pairs to map a parameter value to a display string and/or an Arti or EcuC object.
        container ArtiParameterTypeMapPair [1..*]: multiplicity set at pre-compile  # A key/value pair to map a parameter value to a display string and/or an Arti or EcuC object.
          integer ArtiParameterTypeMapPairInput [0..1]: 0..65535, scope=ECU, multiplicity set at pre-compile, set at pre-compile  # The numerical value given by a parameter to translate. | When used with Hooks (ArtiHooks), this parameter is mandatory (multiplicity 1) and its value is limited to the range of 0..65535. When used with Hooks, this parameter may be used to map the values given by "instanceParameter" and/or the "eventParameter" of the ARTI_TRACE macro.
          string ArtiParameterTypeMapPairOutput [0..1]: scope=ECU, multiplicity set at pre-compile, set at pre-compile  # The string to display for the Input value.
          reference ArtiParameterTypeMapPairInputExpressionRef [0..1]: scope=ECU, multiplicity set at pre-compile, set at pre-compile, destination=ArtiExpression  # Refers to an expression that evaluates to a numerical value to translate.
          choice reference ArtiParameterTypeMapPairOutputRef [0..1]: scope=ECU, multiplicity set at pre-compile, set at pre-compile, destination=[ArtiOsContextInstance, ArtiOsIsrInstance, ArtiOsStackInstance, ArtiOsTaskInstance, ArtiStatesTaskState, OsAppMode]  # Choice Reference to ArtiOsTaskInstance, ArtiOsIsrInstance, ArtiStatesTaskState, OsAppMode, ArtiOsContextInstance, or ArtiOsStackInstance.
      container ArtiStates [0..*]: multiplicity set at pre-compile  # This container contains all states of tasks, isrs... that the EcuC uses.
        container ArtiStatesTaskState [0..*]: multiplicity set at pre-compile  # Each state used by the OS has to be listed as ArtiStatesTaskState Parameter with a choice of the states.
          boolean ArtiStatesTaskStateEnhanced: set at pre-compile  # Set to true, if the OS provides an "enhanced" state model with "READY" split to "Activated", "Preempted", "Released".
          enumeration ArtiStatesTaskStateEnum: {ArtiTaskStateActivated, ArtiTaskStatePreempted, ArtiTaskStateReady, ArtiTaskStateReleased, ArtiTaskStateRunning, ArtiTaskStateSuspended, ArtiTaskStateWaiting}, set at pre-compile  # ArtiStatesTaskState choice of the states.
  module definition BndM [0..1]: variants pre-compile  # Configuration of the BulkNvDataManager module.
    container BndMBlockDescriptor [0..*]  # Each container defines a Bulk NV Block which can be individually accessed.
      integer BndMBlockIdentifier: 0..65535, set at pre-compile, symbolic-name-value=true  # Unique identification of the block.
      foreign reference BndMBlockDescriptor: set at pre-compile, destination-type=IMPLEMENTATION-DATA-TYPE  # This parameter defines the data structure of the block.
      reference BndMCallbackRef [0..1]: multiplicity set at pre-compile, set at pre-compile, destination=BndMCallbackBlock  # Reference to the block-specific callback function.
      reference BndMDeviceIndex [0..1]: multiplicity set at pre-compile, set at pre-compile, requires-symbolic-name-value=true, destination=FlsGeneral  # Reference to the FLS device this block is stored in.
    container BndMCallbackBlock [0..*]  # This container contains the block-specific callbacks.
      function name BndMWriteBlockFinishFnc: set at pre-compile  # Callback function for the WriteBlockFinish callback.
    container BndMCallbackGeneral [0..1]  # This container contains the general callbacks
      function name BndMWriteFinalizeFinishFnc: set at pre-compile  # Callback function for the WriteFinalizeFinish callback.
      function name BndMWriteStartFinishFnc: set at pre-compile  # Callback function for the WriteStartFinish callback.
    container BndMGeneral  # Container for common configuration options.
      boolean BndMDevErrorDetect: set at pre-compile, default-value=false  # Switches the development error detection and notification on or off. | * true: detection and notification is enabled. * false: detection and notification is disabled.
      float BndMMainFunctionPeriod: 0..INF, scope=ECU, set at pre-compile  # The period between successive calls to the main function in seconds.
      boolean BndMVersionInfoApi: set at pre-compile, default-value=false  # Pre-processor switch to enable / disable the API to read out the modules version information. | true: Version info API enabled. false: Version info API disabled.
  module definition BswM [0..1]: post-build-variant-support=true, variants link-time/post-build/pre-compile  # Configuration of the BswM (Basic SW Mode Manager) module.
    container BswMConfig [1..*]  # This container contains the configuration parameters and sub containers of the AUTOSAR BswM module. This container exists once per partition.
      reference BswMPartitionRef [0..1]: multiplicity set at pre-compile, set at pre-compile, destination=EcucPartition  # This references the partition the BswM shall run inside.
      container BswMArbitration  # This container includes all configuration sub-containers and parameters related to the mode arbitration functionality of the BswM.
        container BswMEventRequestPort [0..*]: multiplicity set at pre-compile  # Each instance of this container defines an event which can be sent to the BswM. Basic Software Modules may send these events to the BswM by calling the corresponding BswM C-API (for example: BswM_ComM_InitiateReset()).
          enumeration BswMEventRequestProcessing: {BSWM_DEFERRED, BSWM_IMMEDIATE}, set at link in variant link-time+post-build / pre-compile in variant pre-compile  # This parameter defines if the processing of the mode arbitration shall be done immediately when an event request is received or if it shall be deferred to the processing of the main function of BswM.
          choice container BswMEventRequestSource  # This choice container specifies the source of the event request. The sender of the event can be another BSW Module, such as ComM.
            container BswMComMInitiateReset [0..1]  # This is an indication from the ComM to signal a shutdown.
            container BswMDcmApplicationUpdatedIndication [0..1]  # This is a request to update application data from the DCM. This container does not contain any parameters since there are no further configuration needed for this type of request.
            container BswMModeSwitchErrorEvent [0..1]  # This is a notification that an error occurred because the partition containing mode users of the referenced PPort was restarted by the RTE. Because the Mode Machine Instance holding the current mode can reside on that terminated partition, the Mode Manager has to be informed about | the loss of this partition.
              reference BswMRteSwitchPortRef: set at link in variant link-time+post-build / pre-compile in variant pre-compile, destination=BswMSwitchPort  # This is a reference to the BswMSwitchPort.
            container BswMNmCarWakeUpIndication [0..1]  # This is an indication of a CarWakeup from the Nm.
              reference BswMNmChannelRef: set at link in variant link-time+post-build / pre-compile in variant pre-compile, requires-symbolic-name-value=true, destination=ComMChannel  # This is a reference to the channel handle that the indication corresponds to.
            container BswMPartitionRestarted [0..1]  # This is a notification that an error occured because the partition containing the BswM was restarted by the RTE. The Mode Users may lie in another (still running) partition. So the BswM has to be informed that the start of its partition is no normal startup but a restart of a single partition. This information can be used inside the Rules. This notification has to be used by the Restart Task of the particular partition.
            container BswMSwitchAckNotification [0..1]  # This is a notification that a mode transition has been completed.
              reference BswMSwitchPortRef: set at link in variant link-time+post-build / pre-compile in variant pre-compile, destination=BswMSwitchPort  # References the switch port which will receive the notification.
            container BswMWdgMRequestPartitionReset [0..1]  # This is a Partition Reset request from from the WdgM. This port | corresponds to a call of the BswM_WdgM_RequestPartitionReset API.
              reference BswMWdgMRequestPartitionResetRef: set at link in variant link-time+post-build / pre-compile in variant pre-compile, destination=EcucPartition  # This is a reference to the partition that shall be reset.
        container BswMLogicalExpression [0..*]: multiplicity set at pre-compile  # This container describes the logical expressions that can be used for the mode arbitration. The logical expressions are built of a set of arguments and a logical operator. | Each argument can either be a mode condition or a sub-expression to allow definition of more complex logical expressions. There may be an unlimited number of arguments in each logical expression. Note that the order of evaluation of the expressions is not defined.
          enumeration BswMLogicalOperator [0..1]: {BSWM_AND, BSWM_NAND, BSWM_NOT, BSWM_OR, BSWM_XOR}, multiplicity set at link in variant link-time+post-build / pre-compile in variant pre-compile, set at link in variant link-time+post-build / pre-compile in variant pre-compile  # This parameter specifies the logical operator to be used in the logical expression. If the logical operator is set to something other than BSWM_NOT, and the expression only consists of a single condition, then this parameter will have no effect.
          choice reference BswMArgumentRef [1..*]: multiplicity set at link in variant link-time+post-build / pre-compile in variant pre-compile, set at link in variant link-time+post-build / pre-compile in variant pre-compile, destination=[BswMLogicalExpression, BswMModeCondition]  # This is a choice reference either to a mode condition or a sub-expression. | In case the BswMLogicalExpression.BswMLogicalOperator equals BSWM_NAND only two operands are supported. In case the BswMLogicalExpression.BswMLogicalOperator equals BSWM_NOT only one operand is supported.
        container BswMModeCondition [0..*]: multiplicity set at pre-compile  # This container describes the BswM mode conditions that can be used either by itself to form a rule or as a part of a logical expression.
          enumeration BswMConditionType: {BSWM_EQUALS, BSWM_EQUALS_NOT, BSWM_EVENT_IS_CLEARED, BSWM_EVENT_IS_SET}, set at link in variant link-time+post-build / pre-compile in variant pre-compile  # This parameter specifies what kind of comparison that is made for the evaluation of the mode condition. | For BSWM_EQUALS and BSWM_EQUALS_NOT, the BswMModeRequestPort port referenced by BswMConditionMode is compared with the value configured in BswMConditionValue for equality or not-equality. For BSWM_EVENT_IS_SET and BSWM_EVENT_IS_CLEARED, the BswMEventRequestPort port referenced by BswMConditionMode is checked for being set or cleared (not-set).
          choice reference BswMConditionMode: set at link in variant link-time+post-build / pre-compile in variant pre-compile, destination=[BswMEventRequestPort, BswMModeRequestPort]  # This parameter references either a mode request port or an event request port.
          choice container BswMConditionValue [0..1]  # This container holds the parameters and references necessary to identify the mode type and the value that the mode request is compared to.
            container BswMBswMode [0..1]  # This container defines the value of a mode in the BSW.
              string BswMBswRequestedMode: multiplicity set at pre-compile, set at pre-compile  # This parameter contains the symbolic name (as a string) of a certain mode/state that can be requested/indicated by the BSW modules.
            container BswMCompuScaleModeValue [0..1]  # This container contains parameters used to define a mode value.
              string BswMCompuConstText: set at pre-compile  # The value of this parameter shall match the VT member of a CompuConst defined within the referenced CompuMethod (BswMCompuMethodRef). The interval value of the corresponding CompuScale shall be used as the mode request value.
              foreign reference BswMCompuMethodRef: set at pre-compile, destination-type=COMPU-METHOD  # This is a foreign reference to the CompuMethod used for mode requests.
            container BswMModeDeclaration [0..1]  # When the mode corresponds to a mode request or mode indication interface the mode is defined by a mode declaration. The mode declarations are defined in the SW-C Template and hence a foreign reference to the corresponding Mode Declaration is used.
              foreign reference BswMModeValueRef: set at link in variant link-time+post-build / pre-compile in variant pre-compile, destination-type=MODE-DECLARATION  # This is a foreign reference to the Mode Declaration used for the mode requests corresponding to this condition.
        container BswMModeRequestPort [0..*]: multiplicity set at pre-compile  # Each instance of this container defines a mode request interface that is used to requests or indicate modes from/to the BswM. These interfaces are implemented as ports or as ordinary C-functions based upon if the request is made by an SW-C or a BSW module. | There are different types of mode requests: 1. Mode requests from the SW-C:s 2. Mode Requests from other BSW modules such as the DCM. 3. State/mode indications from the RTE or other BSW modules such as the bus specific State Managers. Note that the BswM treats all request and indications in the exact same way.
          enumeration BswMRequestProcessing: {BSWM_DEFERRED, BSWM_IMMEDIATE}, set at link in variant link-time+post-build / pre-compile in variant pre-compile  # This parameter defines if the processing of the mode arbitration shall be done immediately when a mode request is received or if it shall be deferred to the processing of the main function of BswM.
          container BswMModeInitValue [0..1]  # This container defines the initial mode value that is used by BswM for the corresponding mode request after initialization. The initial mode value is defined by configuring either BswMBswModeInitValue or BswMCompuScaleModeValue. This container is optional.
            string BswMBswModeInitValue [0..1]: multiplicity set at pre-compile, set at pre-compile  # This parameter defines the initial mode value that is used by BswM for the corresponding mode request after initialization.
            container BswMCompuScaleModeValue [0..1]  # This container contains parameters used to define a mode value.
              string BswMCompuConstText: set at pre-compile  # The value of this parameter shall match the VT member of a CompuConst defined within the referenced CompuMethod (BswMCompuMethodRef). The interval value of the corresponding CompuScale shall be used as the mode request value.
              foreign reference BswMCompuMethodRef: set at pre-compile, destination-type=COMPU-METHOD  # This is a foreign reference to the CompuMethod used for mode requests.
          choice container BswMModeRequestSource  # This choice container specifies the source of the mode request or state/mode indication. The requester of a mode can be both SW-C:s and other BSW Modules, such as the bus specific State Managers.
            container BswMBswModeNotification [0..1]  # This is a mode request source emanating from another BSW Module.
              foreign reference BswMBswModeDeclarationGroupPrototypeRef: set at link in variant link-time+post-build / pre-compile in variant pre-compile, destination-type=MODE-DECLARATION-GROUP-PROTOTYPE  # This is a foreign reference to the Mode Declaration Group Prototype.
            container BswMCanSMIndication [0..1]  # This is an indication of the current state of the CAN State Manager.
              reference BswMCanSMChannelRef: set at link in variant link-time+post-build / pre-compile in variant pre-compile, requires-symbolic-name-value=true, destination=ComMChannel  # This is a reference to the CAN channel handle that the mode request corresponds to.
            container BswMComMIndication [0..1]  # This is an indication of the current communication mode of a channel in the Communication Manager.
              reference BswMComMChannelRef: set at link in variant link-time+post-build / pre-compile in variant pre-compile, requires-symbolic-name-value=true, destination=ComMChannel  # This is a reference to the Communication Manager channel handle that the indication corresponds to.
            container BswMComMPncRequest [0..1]  # This is a request of the current communication mode of a Partial Network Cluster in the Communication Manager.
              reference BswMComMPncRef: set at link in variant link-time+post-build / pre-compile in variant pre-compile, requires-symbolic-name-value=true, destination=ComMPnc  # This is a reference to the Communication Manager PNC handle of the Partial Network Cluster that the request corresponds to.
            container BswMDcmComModeRequest [0..1]  # The source of the mode request is the Diagnostic Communication Manager.
              reference BswMDcmComMChannelRef: set at link in variant link-time+post-build / pre-compile in variant pre-compile, requires-symbolic-name-value=true, destination=ComMChannel  # This is a reference from DcmModeRequest to the ComM channel that the indication corresponds to.
            container BswMEcuMIndication [0..1]  # This is a notification of the current operation mode of the ECU State Manager. This container does not contain any parameters since there are no further configuration needed for this type of request.
            container BswMEcuMRUNRequestIndication [0..1]  # This is an indication of the current State of the RUN Request Protocol.
              enumeration BswMEcuMRUNRequestProtocolPort: {BSWM_ECUM_STATE_POST_RUN, BSWM_ECUM_STATE_RUN}, set at link in variant link-time+post-build / pre-compile in variant pre-compile  # Identifies the EcuM State which is related to the mode request.
            container BswMEcuMWakeupSource [0..1]  # This is a notification of the current state of an ECU State Manager wakeup source.
              reference BswMEcuMWakeupSrcRef: set at link in variant link-time+post-build / pre-compile in variant pre-compile, requires-symbolic-name-value=true, destination=EcuMWakeupSource  # This is a reference to the ECU State Manager Wakeup Source that the indication corresponds to.
            container BswMEthIfPortGroupLinkStateChg [0..1]  # This is an indication from the EthIf if the link state of a Ethernet interface switch port group has changed.
              reference BswMEthIfSwitchPortGroupRef: post-build-variant-value=true, set at link in variant link-time+post-build / pre-compile in variant pre-compile, requires-symbolic-name-value=true, destination=EthIfSwitchPortGroup  # This is a reference to the Ethernet Interface Switch Port Group that the indication corresponds to.
            container BswMEthSMIndication [0..1]  # This is an indication of the current state of the Ethernet State Manager.
              reference BswMEthSMChannelRef: set at link in variant link-time+post-build / pre-compile in variant pre-compile, requires-symbolic-name-value=true, destination=ComMChannel  # This is a reference to the Ethernet channel handle that the mode request corresponds to.
            container BswMFrSMIndication [0..1]  # This is an indication of the current state of the FlexRay State Manager.
              reference BswMFrSMChannelRef: set at link in variant link-time+post-build / pre-compile in variant pre-compile, requires-symbolic-name-value=true, destination=ComMChannel  # This is a reference to the FlexRay Cluster handle that the mode request corresponds to.
            container BswMGenericRequest [0..1]  # This mode request originates from a requester that is not among the list of standardized mode requesters (i.e. the different resource managers).
              integer BswMModeRequesterId: 0..65535, set at pre-compile, symbolic-name-value=true  # This parameters identifies the different users of the generic mode request interface.
            container BswMJ1939DcmBroadcastStatus [0..1]  # This is a notification of the desired broadcast status per network, triggered via DM13.
              reference BswMJ1939DcmChannelRef: set at link in variant link-time+post-build / pre-compile in variant pre-compile, requires-symbolic-name-value=true, destination=ComMChannel  # Reference to the communication channel which is affected by this mode request.
            container BswMJ1939NmIndication [0..1]  # This is an indication of the current state of the J1939 network management module.
              reference BswMJ1939NmChannelRef: set at link in variant link-time+post-build / pre-compile in variant pre-compile, requires-symbolic-name-value=true, destination=ComMChannel  # This is a reference to the J1939Nm channel handle that the mode request corresponds to.
              reference BswMJ1939NmNodeRef: set at link in variant link-time+post-build / pre-compile in variant pre-compile, requires-symbolic-name-value=true, destination=J1939NmNode  # This is a reference to the node that the mode request corresponds to.
            container BswMLinSMIndication [0..1]  # This is an indication of the current state of the LIN State Manager.
              reference BswMLinSMChannelRef: set at link in variant link-time+post-build / pre-compile in variant pre-compile, requires-symbolic-name-value=true, destination=ComMChannel  # This is a reference to the LIN channel handle that the mode request corresponds to.
            container BswMLinScheduleIndication [0..1]  # This is an indication of the currently active LIN Schedule Table for a specific LIN Interface.
              reference BswMLinScheduleRef: post-build-variant-value=true, set at link in variant link-time / post-build in variant post-build / pre-compile in variant pre-compile, requires-symbolic-name-value=true, destination=LinSMSchedule  # This is a reference to the LIN Schedule Table handle that the mode request corresponds to.
              reference BswMLinSMChannelRef: post-build-variant-value=true, set at link in variant link-time / post-build in variant post-build / pre-compile in variant pre-compile, requires-symbolic-name-value=true, destination=ComMChannel  # This is a reference to the LIN channel handle that the mode request corresponds to.
            container BswMLinTpModeRequest [0..1]  # This is a LinTp mode request from the LinIf. This port corresponds to a call of the BswM_LinTp_RequestMode API.
              reference BswMLinTpChannelRef: set at link in variant link-time+post-build / pre-compile in variant pre-compile, requires-symbolic-name-value=true, destination=ComMChannel  # This is a reference to the LIN Interface Channel that the mode | request corresponds to.
            container BswMNmStateChangeNotification [0..1]  # This is a notification from the Nm module that its state has changed.
              reference BswMNmChannelRef: set at link in variant link-time+post-build / pre-compile in variant pre-compile, requires-symbolic-name-value=true, destination=ComMChannel  # This is a reference to the channel handle that this notification corresponds to.
            container BswMNvMJobModeIndication [0..1]  # Indicates the current status of the multiblock job. The job is identified via BswMNvmService. Possible values for this indication are the possible values of NvM_RequestResultType.
              enumeration BswMNvmService: {NvmCancelWriteAll, NvmFirstInitAll, NvmReadAll, NvmValidateAll, NvmWriteAll}, set at link in variant link-time+post-build / pre-compile in variant pre-compile  # Identifies the Nvm job which is related to the mode request.
            container BswMNvMRequest [0..1]  # Via this Mode Request Source the NvM indicates the current status of the specified block. Possible Values are: | NvM_RequestResultType NVM_REQ_OK NVM_REQ_NOT_OK NVM_REQ_PENDING NVM_REQ_INTEGRITY_FAILED NVM_REQ_BLOCK_SKIPPED NVM_REQ_NV_INVALIDATED NVM_REQ_CANCELED NVM_REQ_REDUNDANCY_FAILED NVM_REQ_RESTORED_FROM_ROM
              reference BswMNvMBlockRef: set at link in variant link-time+post-build / pre-compile in variant pre-compile, requires-symbolic-name-value=true, destination=NvMBlockDescriptor  # This is a reference to the NvM Block Descriptor that the request corresponds to.
            container BswMSdClientServiceCurrentState [0..1]  # Used by Service Discovery module to indicate current state of the Client Service (available/down).
              reference BswMSdClientMethodsRef: set at link in variant link-time+post-build / pre-compile in variant pre-compile, requires-symbolic-name-value=true, destination=SdClientService  # This is a reference to a client service in the Sd module.
            container BswMSdConsumedEventGroupCurrentState [0..1]  # Used by Service Discovery to indicate current status of the EventHandler (requested/released).
              reference BswMSdConsumedEventGroupRef: set at link in variant link-time+post-build / pre-compile in variant pre-compile, requires-symbolic-name-value=true, destination=SdConsumedEventGroup  # This is a reference to an eventGroup that is defined within a client service in the Sd module.
            container BswMSdEventHandlerCurrentState [0..1]  # Used by Service Discovery to indicate current status of the EventHandler (requested/released).
              reference BswMSdEventHandlerRef: set at link in variant link-time+post-build / pre-compile in variant pre-compile, requires-symbolic-name-value=true, destination=SdEventHandler  # This is a reference to an event handler that is defined within a server service in the Sd module.
            container BswMSwcModeNotification [0..1]  # This is a mode switch notification associated with a RTE switch interface.
              foreign reference BswMSwcModeNotificationModeDeclarationGroupPrototypeRef: set at link in variant link-time+post-build / pre-compile in variant pre-compile, destination-type=MODE-DECLARATION-GROUP-PROTOTYPE  # This is a foreign reference to the ModeDeclarationGroupPrototype.
            container BswMSwcModeRequest [0..1]  # The source of the mode request is a SW Component.
              foreign reference BswMSwcModeRequestVariableDataPrototypeRef: post-build-variant-value=true, set at link in variant link-time / post-build in variant post-build / pre-compile in variant pre-compile, destination-type=VARIABLE-DATA-PROTOTYPE  # This is a reference to the VariableDataPrototype.
            container BswMTimer [0..1]  # This is a timer which can be used for time dependent rules. This mode request port can be in one of three modes (depending on the state of the timer): | * BSWM_TIMER_STOPPED (intial) (The timer has been stopped by an action) * BSWM_TIMER_STARTED (The timer has been started by an action) * BSWM_TIMER_EXPIRED (The timer has expired)
        container BswMRule [0..*]: multiplicity set at link in variant link-time / post-build in variant post-build / pre-compile in variant pre-compile, post-build-variant-multiplicity=true  # Each instance of this container describes a BswM arbitration rule. The rule either consists of a simple mode condition or a more complex logical expression. This container also references the action lists that shall be invoked when the rule is evaluated to True or False.
          boolean BswMNestedExecutionOnly: set at link in variant link-time+post-build / pre-compile in variant pre-compile, default-value=false  # This parameter defines for its related Rule if the Rule is an Independent rule or a Subordinate rule; | false: an Independent rule, i.e. to be evaluated each time applicable (both as standalone Rule driven by its own BswMModeRequestSource and when referenced by another Rule). true: a Subordinated rule, to be evaluated ONLY as a result of being referenced in one or more Action Lists.
          enumeration BswMRuleInitState: {BSWM_FALSE, BSWM_TRUE, BSWM_UNDEFINED}, set at link in variant link-time+post-build / pre-compile in variant pre-compile  # This parameter is a part of the reset/initialization behavior of BswM. | Action lists are executed when the result of a rule evaluation have changed since the last evaluation. This parameter defines the "previous evaluation result" of a rule to be used after initialization of the BswM. If this parameter is set to BSWM_UNDEFINED, the evaluation result is always treated as changed at the first evaluation of the rule after initialization. If this parameter is set to BSWM_TRUE, the evaluation result is treated as changed if the rule is evaluated to false. If this parameter is set to BSWM_FALSE, the evaluation result is treated as changed if the rule is evaluated to true.
          reference BswMRuleExpressionRef: set at link in variant link-time+post-build / pre-compile in variant pre-compile, destination=BswMLogicalExpression  # This is a reference to the logical expression that is evaluated for each rule.
          reference BswMRuleFalseActionList [0..1]: multiplicity set at link in variant link-time / post-build in variant post-build / pre-compile in variant pre-compile, post-build-variant-multiplicity=true, post-build-variant-value=true, set at link in variant link-time / post-build in variant post-build / pre-compile in variant pre-compile, destination=BswMActionList  # This is a reference to the action list that shall be executed when the rule is evaluated to False
          reference BswMRuleTrueActionList [0..1]: multiplicity set at link in variant link-time / post-build in variant post-build / pre-compile in variant pre-compile, post-build-variant-multiplicity=true, post-build-variant-value=true, set at link in variant link-time / post-build in variant post-build / pre-compile in variant pre-compile, destination=BswMActionList  # This is a reference to the action list that shall be executed when the rule is evaluated to True
      container BswMDataTypeMappingSets [0..1]  # Collection of references to DataTypeMappingSet.
        foreign reference BswMDataTypeMappingSetRef [1..*]: multiplicity set at link in variant link-time+post-build / pre-compile in variant pre-compile, set at link in variant link-time+post-build / pre-compile in variant pre-compile, destination-type=DATA-TYPE-MAPPING-SET  # Reference to DataTypeMappingSet.
      container BswMModeControl  # This container includes all configuration sub-containers and parameters related to the mode control functionality of the BswM.
        container BswMAction [0..*]: multiplicity set at pre-compile  # Each container of this type defines an action. These actions can be part of one or several action lists.
          choice container BswMAvailableActions  # Choice container including the available actions to be used in the action lists.
            container BswMClearEventRequest [0..1]  # This container contains a reference to a BswMEventRequestPort which will be cleared (i.e. set to CLEAR state) when this action is executed.
              reference BswMClearEventRequestPortRef: set at link in variant link-time+post-build / pre-compile in variant pre-compile, destination=BswMEventRequestPort  # This parameter references the BswMEventRequestPort which will be cleared.
            container BswMComMAllowCom [0..1]  # This container includes all parameters for the action to allow or to block communication for a ComM Channel. ComM_CommunicationAllowed is called when this action is configured.
              boolean BswMComAllowed: set at link in variant link-time+post-build / pre-compile in variant pre-compile  # The parameter BswMComMAllowChannelRef refers to a channel which will allow or block communication using the function ComM_CommunicationAllowed(). | This parameter corresponds to the parameter "Allowed" of the function ComM_CommunicationAllowed().
              reference BswMComMAllowChannelRef: set at link in variant link-time+post-build / pre-compile in variant pre-compile, requires-symbolic-name-value=true, destination=ComMChannel  # This is a reference to the ComM Channel for which communication shall be allowed or blocked. | This reference corresponds to the parameter "Channel" of the function ComM_CommunicationAllowed().
            container BswMComMModeLimitation [0..1]  # This container includes all parameters related to a limitation of communication mode for a ComM Channel. ComM_LimitChannelToNoComMode is called when this action is configured.
              boolean BswMComMLimitMode: set at link in variant link-time+post-build / pre-compile in variant pre-compile  # The function ComM_LimitChannelToNoComMode() takes in this boolean parameter to limit the channel's com mode to no-com mode. | This parameter corresponds to the parameter "Status" of the function ComM_LimitChannelToNoComMode.
              reference BswMComMLimitChannelRef: set at link in variant link-time+post-build / pre-compile in variant pre-compile, requires-symbolic-name-value=true, destination=ComMChannel  # This is a reference to the ComM channel for which the communication mode should be limited. | This reference corresponds to the parameter "Channel" of the function ComM_LimitChannelToNoComMode.
            container BswMComMModeSwitch [0..1]  # This container includes all parameters related to a switch of communication mode for a ComM User. ComM_RequestComMode is called when this action is configured.
              enumeration BswMComMRequestedMode: {BSWM_COMM_FULL_COMMUNICATION, BSWM_COMM_NO_COMMUNICATION}, set at link in variant link-time+post-build / pre-compile in variant pre-compile  # This parameter specifies if the requested communication mode. | This parameter corresponds to the parameter "ComMode" of the function ComM_RequestComMode.
              reference BswMComMUserRef: set at link in variant link-time+post-build / pre-compile in variant pre-compile, requires-symbolic-name-value=true, destination=ComMUser  # This is a reference to the ComM User that is associated to the Communication channel for which the communication mode should be requested. | This reference corresponds to the parameter "User" of the function ComM_RequestComMode.
            container BswMCoreHaltMode [0..1]  # This container includes all parameters related to a switch of the activation state of core Halt.
              string BswMCoreHaltActivationState: set at pre-compile  # Different possibilities are offered depending on the OS implementation and the CPU HW. The HALT modes addressed by this parameter are defined as names (strings) in the OS implementation. Different implementation may implement different HALT modes and subsequently different names.
              reference BswMTargetCoreRef: set at link in variant link-time+post-build / pre-compile in variant pre-compile, destination=EcucCoreDefinition  # This is a reference to the core on which the Core Halt process must be influenced.
            container BswMDeadlineMonitoringControl [0..1]  # This container includes all parameters related to enabling and disabling of deadline monitoring for one or several PDUs in COM.
              reference BswMDisabledDMPduGroupRef [0..*]: multiplicity set at link in variant link-time / post-build in variant post-build / pre-compile in variant pre-compile, post-build-variant-multiplicity=true, post-build-variant-value=true, set at link in variant link-time / post-build in variant post-build / pre-compile in variant pre-compile, requires-symbolic-name-value=true, destination=ComIPduGroup  # This is a reference to a PDU Group for which the Deadline Monitoring should be disabled. | This reference corresponds to the parameter "IpduGroupId" of the function Com_DisableReceptionDM.
              reference BswMEnabledDMPduGroupRef [0..*]: multiplicity set at link in variant link-time / post-build in variant post-build / pre-compile in variant pre-compile, post-build-variant-multiplicity=true, post-build-variant-value=true, set at link in variant link-time / post-build in variant post-build / pre-compile in variant pre-compile, requires-symbolic-name-value=true, destination=ComIPduGroup  # This is a reference to a PDU Group for which the Deadline Monitoring should be enabled. | This reference corresponds to the parameter "IpduGroupId" of the function Com_EnableReceptionDM.
            container BswMEcuMDriverInitListBswM [0..1]  # This container defines the action to trigger an EcuM driver initialization list.
              reference BswMEcuMDriverInitListBswMRef: set at link in variant link-time+post-build / pre-compile in variant pre-compile, destination=EcuMDriverInitListBswM  # This is a reference to the EcuM EcuMDriverInitListBswM container which represents the driver init list to be triggered.
            container BswMEcuMGoDownHaltPoll [0..1]  # This container defines the action to trigger the EcuM_GoDownHaltPoll from BswM.
              reference BswMEcuMUserIdRef: set at link in variant link-time+post-build / pre-compile in variant pre-compile, requires-symbolic-name-value=true, destination=EcuMFlexUserConfig  # This is a reference to a EcuM UserId.
            container BswMEcuMSelectShutdownTarget [0..1]  # This container defines the shutdown target.
              enumeration BswMEcuMShutdownTarget: {BSWM_ECUM_SHUTDOWN_TARGET_OFF, BSWM_ECUM_SHUTDOWN_TARGET_RESET, BSWM_ECUM_SHUTDOWN_TARGET_SLEEP}, set at link in variant link-time+post-build / pre-compile in variant pre-compile  # This parameter contains the shutdown target that the BswM selects at the EcuM.
              reference BswMEcuMResetModeRef [0..1]: multiplicity set at link in variant link-time+post-build / pre-compile in variant pre-compile, set at link in variant link-time+post-build / pre-compile in variant pre-compile, requires-symbolic-name-value=true, destination=EcuMResetMode  # This is a reference to a reset mode.
              reference BswMEcuMSleepModeRef [0..1]: multiplicity set at link in variant link-time+post-build / pre-compile in variant pre-compile, set at link in variant link-time+post-build / pre-compile in variant pre-compile, requires-symbolic-name-value=true, destination=EcuMSleepMode  # This is a reference to a sleep mode.
            container BswMEcuMStateSwitch [0..1]  # This container defines the action to switch a State of the ECU State Manager.
              enumeration BswMEcuMState: {BSWM_ECUM_STATE_APP_POST_RUN, BSWM_ECUM_STATE_APP_RUN, BSWM_ECUM_STATE_SHUTDOWN, BSWM_ECUM_STATE_SLEEP, BSWM_ECUM_STATE_STARTUP}, set at link in variant link-time+post-build / pre-compile in variant pre-compile  # This parameter corresponds to the parameter "State" of the function EcuM_ SetState ().
            container BswMEthIfStartAllPorts [0..1]  # This container defines the action to call EthIf_StartAllPorts from BswM and thus to start all affected EthSwtPorts.
            container BswMEthIfSwitchPortGroupRequestMode [0..1]  # This container includes all parameters related to requesting a mode for the EthIfSwtPortGroup. | The EthIf_SwitchPortGroupRequestMode API is called when this action is executed.
              enumeration BswMEthTrcvMode: {BSWM_ETH_MODE_ACTIVE, BSWM_ETH_MODE_ACTIVE_WITH_WAKEUP_REQUEST, BSWM_ETH_MODE_DOWN}, post-build-variant-value=true, set at link in variant link-time+post-build / pre-compile in variant pre-compile  # This parameter contains the mode which will be requested.
              reference BswMEthIfSwitchPortGroupRef: post-build-variant-value=true, set at link in variant link-time+post-build / pre-compile in variant pre-compile, requires-symbolic-name-value=true, destination=EthIfSwitchPortGroup  # This is a reference to the Ethernet Interface Switch Port Group which will receive the request.
            container BswMFrSMAllSlots [0..1]  # This container includes all parameter(s) for the action to request an exit from Flexray KeySlotOnlyMode. FrSM_AllSlots is called when this action is executed.
              reference BswMFrSMAllSlotsNetworkHandleRef: set at link in variant link-time+post-build / pre-compile in variant pre-compile, requires-symbolic-name-value=true, destination=ComMChannel  # This references the FlexRay cluster. The reference corresponds to the parameter "NetworkHandle" of the function FrSM_AllSlots.
            container BswMIdsMBlockStateChangeRequest [0..1]  # This container defines the action to switch a BlockState of the IdsM. Tags: atp.Status=draft
              reference BswMIdsMBlockStateChangeRequestRef: set at link in variant link-time+post-build / pre-compile in variant pre-compile, requires-symbolic-name-value=true, destination=IdsMBlockState  # This is a reference to a BlockState of the IdsM. Tags: atp.Status=draft
            container BswMJ1939DcmStateSwitch [0..1]  # This container includes all parameters related to a switch of the J1939 Diagnostic Communication Managers network state for a J1939 node. J1939Dcm_SetState is called when this action is configured.
              enumeration BswMJ1939DcmRequestedState: {BSWM_J1939DCM_STATE_OFFLINE, BSWM_J1939DCM_STATE_ONLINE}, set at link in variant link-time+post-build / pre-compile in variant pre-compile  # This parameter describes the communication state of the J1939 Diagnostic Communication Manager and corresponds to the parameter "newState" of the function J1939Dcm_SetState.
              reference BswMJ1939DcmChannelRef: set at link in variant link-time+post-build / pre-compile in variant pre-compile, requires-symbolic-name-value=true, destination=ComMChannel  # This reference points to the unique channel defined by the ComMChannel and provides access to the unique channel index value in ComMChannelId. | This reference corresponds to the parameter "channel" of the function J1939Dcm_SetState.
              reference BswMJ1939DcmNodeRef: set at link in variant link-time+post-build / pre-compile in variant pre-compile, requires-symbolic-name-value=true, destination=J1939NmNode  # This reference points to a J1939NmNode and provides access to the unique J1939NmNodeId.This reference corresponds to the parameter "node" of the function J1939Dcm_SetState.
            container BswMJ1939RmStateSwitch [0..1]  # This container includes all parameters related to a switch of the J1939 Request Managers network state for a J1939 node. J1939Rm_SetState is called when this action is configured.
              enumeration BswMJ1939RmRequestedState: {BSWM_J1939RM_STATE_OFFLINE, BSWM_J1939RM_STATE_ONLINE}, set at link in variant link-time+post-build / pre-compile in variant pre-compile  # This parameter describes the communication state of the J1939 Request Manager and corresponds to the parameter "new state" of the function J1939Rm_SetState.
              reference BswMJ1939RmChannelRef: set at link in variant link-time+post-build / pre-compile in variant pre-compile, requires-symbolic-name-value=true, destination=ComMChannel  # This reference points to the unique channel defined by the ComMChannel and provides access to the unique channel index value in ComMChannelId. | This reference corresponds to the parameter "channel" of the function J1939Rm_SetState.
              reference BswMJ1939RmNodeRef: set at link in variant link-time+post-build / pre-compile in variant pre-compile, requires-symbolic-name-value=true, destination=J1939NmNode  # This reference points to a J1939NmNode and provides access to the unique J1939NmNodeId. | This reference corresponds to the parameter "node" of the function J1939Rm_SetState.
            container BswMLinScheduleSwitch [0..1]  # This container includes all parameters related to a switch of LIN schedule table. LinSM_ScheduleRequest is called when this action is configured. | The configuration for the "network" parameter can be accessed via the reference LinSMComMNetworkHandleRef contained in the parent container LinSMChannel of the container referenced by BswMLinScheduleRef.
              reference BswMLinScheduleRef: post-build-variant-value=true, set at link in variant link-time / post-build in variant post-build / pre-compile in variant pre-compile, requires-symbolic-name-value=true, destination=LinSMSchedule  # This is a reference to the LIN schedule table that the LIN SM shall change to. | This reference corresponds to the parameter "schedule" of the function LinSM_ScheduleRequest.
            container BswMNMControl [0..1]  # This container includes all parameters related to enabling and disabling of Network Management communication. Disabling of NM communication can be requested by DCM. | Nm_EnableCommunication or Nm_DisableCommunication is called when this action is configured.
              enumeration BswMNMAction: {BSWM_NM_DISABLE, BSWM_NM_ENABLE}, set at link in variant link-time+post-build / pre-compile in variant pre-compile  # This parameter specifies if the communication of the corresponding NM channel should be enabled or disabled.
              reference BswMComMNetworkHandleRef: set at link in variant link-time+post-build / pre-compile in variant pre-compile, requires-symbolic-name-value=true, destination=ComMChannel  # This reference points to the unique channel defined by the ComMChannel and provides access to the unique channel index value in ComMChannelId. | This reference corresponds to the parameter "NetworkHandle" of the function Nm_EnableCommunication and Nm_DisableCommunication.
            container BswMPduGroupSwitch [0..1]  # This container includes references to the PDU groups that shall be enabled and disabled.
              boolean BswMPduGroupSwitchReinit [0..1]: multiplicity set at link in variant link-time / post-build in variant post-build / pre-compile in variant pre-compile, post-build-variant-multiplicity=true, post-build-variant-value=true, set at link in variant link-time / post-build in variant post-build / pre-compile in variant pre-compile, default-value=false  # This parameter defines if the data of the I-PDU, the shadow buffers of included signal groups, etc. are reinitialized when a PDU Group is started. | This parameter corresponds to the parameter "initialize" of the function Com_IpduGroupStart.
              reference BswMDisabledPduGroupRef [0..*]: multiplicity set at link in variant link-time / post-build in variant post-build / pre-compile in variant pre-compile, post-build-variant-multiplicity=true, post-build-variant-value=true, set at link in variant link-time / post-build in variant post-build / pre-compile in variant pre-compile, requires-symbolic-name-value=true, destination=ComIPduGroup  # This is a reference to a PDU Group that should be disabled. | This reference corresponds to the parameter "IpduGroupId" of the function Com_IpduGroupStop.
              reference BswMEnabledPduGroupRef [0..*]: multiplicity set at link in variant link-time / post-build in variant post-build / pre-compile in variant pre-compile, post-build-variant-multiplicity=true, post-build-variant-value=true, set at link in variant link-time / post-build in variant post-build / pre-compile in variant pre-compile, requires-symbolic-name-value=true, destination=ComIPduGroup  # This is a reference to a PDU Group that should be enabled. | This reference corresponds to the parameter "IpduGroupId" of the function Com_IpduGroupStart.
            container BswMPduRouterControl [0..1]  # This container includes all parameters related to enabling and disabling of routing of Routing Path Groups in the PDU Router. PduR_EnableRouting or PduR_DisableRouting is called when this action is configured.
              enumeration BswMPduRouterAction: {BSWM_PDUR_DISABLE, BSWM_PDUR_ENABLE}, post-build-variant-value=true, set at link in variant link-time / post-build in variant post-build / pre-compile in variant pre-compile  # This parameter specifies if the routing of the corresponding PDU should be enabled or disabled.
              boolean BswMPduRouterDisableInitBuffer [0..1]: multiplicity set at link in variant link-time / post-build in variant post-build / pre-compile in variant pre-compile, post-build-variant-multiplicity=true, post-build-variant-value=true, set at link in variant link-time / post-build in variant post-build / pre-compile in variant pre-compile  # When BswPduRouterAction is set to BSWM_PDUR_DISABLE and this parameter is set to true, then the call to PduR_DisableRouting will be invoked with parameter "initialize" set to true, otherwise false.
              reference BswMPduRoutingPathGroupRef [1..*]: multiplicity set at link in variant link-time / post-build in variant post-build / pre-compile in variant pre-compile, post-build-variant-multiplicity=true, post-build-variant-value=true, set at link in variant link-time / post-build in variant post-build / pre-compile in variant pre-compile, requires-symbolic-name-value=true, destination=PduRRoutingPathGroup  # This is a reference to the PDU Routing Path Group for which the routing in the PDU Router should be enabled or disabled. | This reference corresponds to the parameter "id" of the function PduR_EnableRouting and PduR_DisableRouting.
            container BswMRteModeRequest [0..1]  # This container defines a mode request that the BswM may send to a SW-C which is acting as a mode-manager. RTE_Write is called when this action is configured.
              foreign reference BswMRequestedModeRef: set at link in variant link-time+post-build / pre-compile in variant pre-compile, destination-type=MODE-DECLARATION  # This is a foreign reference to the Mode Declaration used for the mode request
              reference BswMRteModeRequestPortRef: set at link in variant link-time+post-build / pre-compile in variant pre-compile, destination=BswMRteModeRequestPort  # This is a reference to a BswMRteModeRequestPort.
            container BswMRteStart [0..1]  # This container defines the action to start the Rte from BswM.
            container BswMRteStop [0..1]  # This container defines the action to stop the Rte from BswM
            container BswMRteSwitch [0..1]  # This container defines a mode switch indication that the BswM provides to the SW-C that need to be notified about the mode switch. RTE_Switch is called when this action is configured.
              reference BswMRteSwitchPortRef: set at link in variant link-time+post-build / pre-compile in variant pre-compile, destination=BswMSwitchPort  # This is a reference to the BswMSwitchPort.
              foreign reference BswMSwitchedMode: set at link in variant link-time+post-build / pre-compile in variant pre-compile, destination-type=MODE-DECLARATION  # This parameter contains the integer value that corresponds to a certain mode in a Mode Declaration Group.
            container BswMSchMSwitch [0..1]  # This container defines a mode switch indication that the BswM provides to the SW-C that need to be notified about the mode switch. SchM_Switch is called when this action is configured.
              foreign reference BswMSchMSwitchedMode: set at link in variant link-time+post-build / pre-compile in variant pre-compile, destination-type=MODE-DECLARATION  # This parameter contains the integer value that corresponds to a certain mode in a Mode Declaration Group.
              reference BswMSchMSwitchPortRef: set at link in variant link-time+post-build / pre-compile in variant pre-compile, destination=BswMSwitchPort  # This is a reference to the BswMSwitchPort.
            container BswMSdClientServiceModeRequest [0..1]  # This container includes all parameters related to the selection of an client service of Sd. Sd_ClientServiceSetState is called when this action is configured.
              enumeration BswMSdClientServiceState: {BSWM_SD_CLIENT_SERVICE_RELEASED, BSWM_SD_CLIENT_SERVICE_REQUESTED}, set at link in variant link-time+post-build / pre-compile in variant pre-compile  # This parameter specifies if the corresponding client service shall be released or requested.
              reference BswMSdClientMethodsRef: set at link in variant link-time+post-build / pre-compile in variant pre-compile, requires-symbolic-name-value=true, destination=SdClientService  # This is a reference to a client service in the Sd module.
            container BswMSdConsumedEventGroupModeRequest [0..1]  # This container includes all parameters related to the selection of a consumed EventGroup of Sd. Sd_ConsumedEventGroupSetState is called when this action is configured.
              enumeration BswMSdConsumedEventGroupState: {BSWM_SD_CONSUMED_EVENTGROUP_RELEASED, BSWM_SD_CONSUMED_EVENTGROUP_REQUESTED}, set at link in variant link-time+post-build / pre-compile in variant pre-compile  # This parameter specifies if the corresponding consumed event group shall be released or requested.
              reference BswMSdConsumedEventGroupRef: set at link in variant link-time+post-build / pre-compile in variant pre-compile, requires-symbolic-name-value=true, destination=SdConsumedEventGroup  # This is a reference to an eventGroup that is defined within a client service in the Sd module.
            container BswMSdServerServiceModeRequest [0..1]  # This container includes all parameters related to the selection of a server service of Sd. Sd_ServerServiceSetState is called when this action is configured.
              enumeration BswMSdServerServiceState: {BSWM_SD_SERVER_SERVICE_AVAILABLE, BSWM_SD_SERVER_SERVICE_DOWN}, set at link in variant link-time+post-build / pre-compile in variant pre-compile  # This parameter specifies if the corresponding server service shall be down or available.
              reference BswMSdServerMethodsRef: set at link in variant link-time+post-build / pre-compile in variant pre-compile, requires-symbolic-name-value=true, destination=SdServerService  # This is a reference to a server service in the Sd module.
              container BswMSdServiceGroupSwitch [0..1]  # This container includes references to the SdServiceGroups that shall be enabled and disabled.
                reference BswMDisabledSdServiceGroupRef [0..*]: multiplicity set at link in variant link-time / post-build in variant post-build / pre-compile in variant pre-compile, post-build-variant-multiplicity=true, post-build-variant-value=true, set at link in variant link-time / post-build in variant post-build / pre-compile in variant pre-compile, requires-symbolic-name-value=true, destination=SdServiceGroup  # This is a reference to a SdServiceGroup that should be disabled. This reference corresponds to the parameter "ServiceGroupId" of the function Sd_ServiceGroupStop.
                reference BswMEnabledSdServiceGroupRef [0..*]: multiplicity set at link in variant link-time / post-build in variant post-build / pre-compile in variant pre-compile, post-build-variant-multiplicity=true, post-build-variant-value=true, set at link in variant link-time / post-build in variant post-build / pre-compile in variant pre-compile, requires-symbolic-name-value=true, destination=SdServiceGroup  # This is a reference to a SdServiceGroup that should be enabled. This reference corresponds to the parameter "ServiceGroupId" of the function Sd_ServiceGroupStart.
            container BswMSwitchIPduMode [0..1]  # This container includes all parameters related to the selection of the transmission mode an I-PDU to be sent by COM. Com_SwitchIpduTxMode is called when this action is configured.
              boolean BswMSwitchIPduModeValue: post-build-variant-value=true, set at link in variant link-time / post-build in variant post-build / pre-compile in variant pre-compile  # This parameter defines which transmission mode shall be selected during this call. | This parameter corresponds to the parameter "Mode" of the function Com_SwitchIpduTxMode.
              reference BswMSwitchIPduModeRef: post-build-variant-value=true, set at link in variant link-time / post-build in variant post-build / pre-compile in variant pre-compile, requires-symbolic-name-value=true, destination=ComIPdu  # This is a reference to an I-PDU for which the transmission mode shall be set. | This reference corresponds to the parameter "PduId" of the function Com_SwitchIpduTxMode.
            container BswMTimerControl [0..1]  # This container includes all parameters for the action to start or to stop a timer.
              enumeration BswMTimerAction: {BSWM_TIMER_START, BSWM_TIMER_STOP}, set at link in variant link-time+post-build / pre-compile in variant pre-compile, default-value=BSWM_TIMER_START  # Specify the action for the timer. The timer can be started or stopped.
              float BswMTimerValue: 0..INF, set at link in variant link-time+post-build / pre-compile in variant pre-compile  # Specify the timer value (in seconds) that is used when the timer is started.
              reference BswMTimerRef: set at link in variant link-time+post-build / pre-compile in variant pre-compile, destination=BswMTimer  # Specify the Timer for which the timer action shall be executed.
            container BswMTriggerIPduSend [0..1]  # This container includes all parameters related to the triggering of an I-PDU to be sent by COM. Com_TriggerIPDUSend is called when this action is configured.
              reference BswMTriggeredIPduRef [1..*]: multiplicity set at link in variant link-time / post-build in variant post-build / pre-compile in variant pre-compile, post-build-variant-multiplicity=true, post-build-variant-value=true, set at link in variant link-time / post-build in variant post-build / pre-compile in variant pre-compile, requires-symbolic-name-value=true, destination=ComIPdu  # This is a reference to an I-PDU that should be triggered for transmission. | This reference corresponds to the parameter "PduId" of the function Com_TriggerIPDUSend.
            container BswMUserCallout [0..1]  # This container includes all details needed for a user defined function call.
              string BswMUserCalloutFunction: set at pre-compile  # This parameter specifies the complete function call including all parameters. The parameters are specified during configuration time, and cannot be changed during run time. Any return values passed by the callout will be ignored. | Example usage can be: Actions to initialize other BSW modules Action to call NvM_ReadAll() Action to call NvM_WriteAll()
        container BswMActionList [0..*]: multiplicity set at link in variant link-time / post-build in variant post-build / pre-compile in variant pre-compile, post-build-variant-multiplicity=true  # Each instance of this container defines an action list that is invoked based on the BswM Rules. An action list contains a list of numbered action items to be processed. An action list can also include other action lists.
          enumeration BswMActionListExecution: {BSWM_CONDITION, BSWM_TRIGGER}, set at link in variant link-time+post-build / pre-compile in variant pre-compile  # This parameter controls if the corresponding action list shall be executed every time the rule is evaluated or only when the result of the evaluation changes. This parameter does not have an effect when this action list is executed within another action list.
          integer BswMActionListPriority [0..1]: 0..255, set at link in variant link-time+post-build / pre-compile in variant pre-compile, default-value=0  # This controls the order of execution, in the case when multiple action lists are executed during a single mode control cycle. | Highest priority action list will be executed first. Zero (0) is lowest priority, and 255 is highest priority.
          container BswMActionListItem [1..*]: multiplicity set at link in variant link-time / post-build in variant post-build / pre-compile in variant pre-compile, post-build-variant-multiplicity=true  # This container defines an item in an action list.
            boolean BswMAbortOnFail: post-build-variant-value=true, set at link in variant link-time / post-build in variant post-build / pre-compile in variant pre-compile, default-value=false  # This parameter defines if the execution of the action list shall be aborted if this specific action returns E_NOT_OK. Note that this is only applicable for actions that have E_NOT_OK as a possible return value.
            integer BswMActionListItemIndex: 0..255, post-build-variant-value=true, set at link in variant link-time / post-build in variant post-build / pre-compile in variant pre-compile  # This parameter defines the index of the action in the action list. It is used define in which order the actions shall be performed.
            integer BswMReportFailRuntimeErrorId [0..1]: 128..255, multiplicity set at link in variant link-time / post-build in variant post-build / pre-compile in variant pre-compile, post-build-variant-multiplicity=true, post-build-variant-value=true, set at link in variant link-time / post-build in variant post-build / pre-compile in variant pre-compile, default-value=128  # If this parameter is configured, and this specific action returns E_NOT_OK, the BswM will report a Det Runtime Error. The ErrorId reported in the Runtime Error is given by the value configured in this parameter.
            choice reference BswMActionListItemRef: post-build-variant-value=true, set at link in variant link-time / post-build in variant post-build / pre-compile in variant pre-compile, destination=[BswMAction, BswMActionList, BswMRule]  # The action item can either be an atomic action or a reference to another action list or rule.
        container BswMRteModeRequestPort [0..*]: multiplicity set at pre-compile  # This container defines a mode request port which the BswM may utilize to send a mode request to a SW-C which is acting as a mode-manager. If this container is referenced by a BswMRteModeRequest, the BswM shall create a corresponding PPort in its service description.
          instance reference BswMRteModeRequestPortInterfaceRef [0..1]: set at pre-compile, destination-context=SW-COMPONENT-PROTOTYPE*PORT-PROTOTYPE, destination-type=VARIABLE-DATA-PROTOTYPE  # This is an instance reference to the variable data prototype used for the mode request.
          foreign reference BswMRteModeRequestVariableDataPrototypeSRRef [0..1]: set at pre-compile, destination-type=VARIABLE-DATA-PROTOTYPE  # This is a foreign reference to a VariableDataPrototype used for the mode request.
        container BswMSwitchPort [0..*]: multiplicity set at pre-compile  # Represents an output mode-switch port to be generated by the BswM. If BswMModeSwitchInterfaceRef is configured then a PPortPrototype is generated in the SWCD. If BswMSchMModeDeclarationGroupRef is configured then a ModeDeclarationGroupPrototype is generated in the ProvidedModeGroups of the BSWMD. If both BswMModeSwitchInterfaceRef and BswMSchMModeDeclarationGroupRef are configured then an SwcBswSynchronizedModeGroupPrototype is also generated in the BSWMD (see Chapter 6.11 of the BSW Module Description Template SWS and EXP ModemanagementGuide)..
          foreign reference BswMModeSwitchInterfaceRef [0..1]: set at link in variant link-time+post-build / pre-compile in variant pre-compile  # Reference to the ModeSwitchInterface from which the BswM will generate a PPortPrototype.
          foreign reference BswMSchMModeDeclarationGroupRef [0..1]: set at link in variant link-time+post-build / pre-compile in variant pre-compile, destination-type=MODE-DECLARATION-GROUP  # Reference to the ModeDeclarationGroup from which the BswM will generate a ModeDeclarationGroupPrototype.
    container BswMGeneral  # General configuration parameters of the Basic SW Mode Manager.
      boolean BswMCanSMEnabled: set at pre-compile, default-value=false  # enable/disable CanSM module related BswM API: | true: Enabled false: Disabled
      boolean BswMComMEnabled: set at pre-compile, default-value=false  # enable/disable ComM module related BswM API: | true: Enabled false: Disabled
      boolean BswMDcmEnabled: set at pre-compile, default-value=false  # enable/disable Dcm module related BswM API: | true: Enabled false: Disabled
      boolean BswMDevErrorDetect: set at pre-compile, default-value=false  # Switches the development error detection and notification on or off. | * true: detection and notification is enabled. * false: detection and notification is disabled.
      boolean BswMEcuMEnabled: set at pre-compile, default-value=false  # enable/disable EcuM module related BswM API: | true: Enabled false: Disabled
      boolean BswMEthIfEnabled: set at pre-compile, default-value=false  # enable/disable EthIf module related BswM API: | true: Enabled false: Disabled
      boolean BswMEthSMEnabled: set at pre-compile, default-value=false  # enable/disable EthSM module related BswM API: | true: Enabled false: Disabled
      boolean BswMFrSMEnabled: set at pre-compile, default-value=false  # enable/disable FrSM module related BswM API: | true: Enabled false: Disabled
      boolean BswMGenericRequestEnabled: set at pre-compile, default-value=false  # enable/disable Generic Request related BswM API: | true: Enabled false: Disabled
      boolean BswMJ1939DcmEnabled: set at pre-compile, default-value=false  # Enable/disable J1939Dcm module related BswM API: | true: Enabled false: Disabled
      boolean BswMJ1939NmEnabled: set at pre-compile, default-value=false  # Enable/disable J1939Nm module related BswM API. | true: Enabled false: Disabled
      boolean BswMLinSMEnabled: set at pre-compile, default-value=false  # enable/disable LinSM module related BswM API: | true: Enabled false: Disabled
      boolean BswMLinTPEnabled: set at pre-compile, default-value=false  # enable/disable LinTP module related BswM API: | true: Enabled false: Disabled
      float BswMMainFunctionPeriod [0..1]: 0..INF, multiplicity set at link in variant link-time+post-build / pre-compile in variant pre-compile, set at link in variant link-time+post-build / pre-compile in variant pre-compile  # The cycle time of the periodic main function of BswM. Defined in seconds .
      boolean BswMNmEnabled: set at pre-compile, default-value=false  # enable/disable Nm module related BswM API: | true: Enabled false: Disabled
      boolean BswMNvMEnabled: set at pre-compile, default-value=false  # enable/disable NvM module related BswM API: | true: Enabled false: Disabled
      boolean BswMSchMEnabled: set at pre-compile, default-value=false  # enable/disable SchM module related BswM API: | true: Enabled false: Disabled
      boolean BswMSdEnabled: set at pre-compile, default-value=false  # enable/disable Sd module related BswM API. | true: Enabled false: Disabled
      boolean BswMVersionInfoApi: set at pre-compile, default-value=false  # Switches the possibility to read the version information with the service BswM_GetVersionInfo(). | true: Enabled false: Disabled
      boolean BswMWdgMEnabled: set at pre-compile, default-value=false  # enable/disable WdgM module related BswM API: | true: Enabled false: Disabled
      container BswMUserIncludeFiles [0..1]  # Collection of header file names which shall be included by the BswM.
        string BswMUserIncludeFile [1..*]: multiplicity set at pre-compile, set at pre-compile  # Header file name which shall be included by the BswM. | The value of this parameter shall be used as h-char-sequence or q-char-sequence according to ISO C90 section 6.10.2 "source file inclusion". The parameter value MUST NOT represent a path, since ISO C90 does not specify how such a path is treated (i.e., this is implementation defined (and additionally depends on the operating system and the underlying file system)).
  module definition Can [0..*]: post-build-variant-support=true, variants post-build/pre-compile  # This container holds the configuration of a single CAN Driver.
    container CanConfigSet  # This container contains the configuration parameters and sub containers of the AUTOSAR Can module.
      container CanController [1..*]  # This container contains the configuration parameters of the CAN controller(s).
        enumeration CanBusoffProcessing: {INTERRUPT, POLLING}, set at pre-compile  # Enables / disables API Can_MainFunction_BusOff() for handling busoff events in polling mode.
        boolean CanControllerActivation: set at pre-compile  # Defines if a CAN controller is used in the configuration.
        integer CanControllerBaseAddress: 0..4294967295, set at pre-compile  # Specifies the CAN controller base address.
        integer CanControllerId: 0..255, scope=ECU, set at pre-compile, symbolic-name-value=true  # This parameter provides the controller ID which is unique in a given CAN Driver. The value for this parameter starts with 0 and continue without any gaps.
        enumeration CanRxProcessing: {INTERRUPT, MIXED, POLLING}, set at pre-compile  # Enables / disables API Can_MainFunction_Read() for handling PDU reception events in polling mode.
        enumeration CanTxProcessing: {INTERRUPT, MIXED, POLLING}, set at pre-compile  # Enables / disables API Can_MainFunction_Write() for handling PDU transmission events in polling mode.
        boolean CanWakeupFunctionalityAPI: set at pre-compile, default-value=false  # Adds / removes the service Can_CheckWakeup() from the code. | True: Can_CheckWakeup can be used. False: Can_CheckWakeup cannot be used.
        enumeration CanWakeupProcessing: {INTERRUPT, POLLING}, set at pre-compile  # Enables / disables API Can_MainFunction_Wakeup() for handling wakeup events in polling mode.
        boolean CanWakeupSupport: set at pre-compile  # CAN driver support for wakeup over CAN Bus.
        reference CanControllerDefaultBaudrate: post-build-variant-value=true, set at post-build in variant post-build / pre-compile in variant pre-compile, destination=CanControllerBaudrateConfig  # Reference to baudrate configuration container configured for the Can Controller.
        reference CanControllerEcucPartitionRef [0..1]: scope=ECU, multiplicity set at pre-compile, post-build-variant-multiplicity=true, post-build-variant-value=true, set at pre-compile, destination=EcucPartition  # Maps the CAN controller to zero or one ECUC partitions. The ECUC partition referenced is a subset of the ECUC partitions where the CAN driver is mapped to.
        reference CanCpuClockRef: set at pre-compile, destination=McuClockReferencePoint  # Reference to the CPU clock configuration, which is set in the MCU driver configuration
        reference CanWakeupSourceRef [0..1]: multiplicity set at pre-compile, set at pre-compile, requires-symbolic-name-value=true, destination=EcuMWakeupSource  # This parameter contains a reference to the Wakeup Source for this controller as defined in the ECU State Manager. | Implementation Type: reference to EcuM_WakeupSourceType
        container CanControllerBaudrateConfig [1..*]  # This container contains bit timing related configuration parameters of the CAN controller(s).
          float CanControllerBaudRate: 0..2000, post-build-variant-value=true, set at post-build in variant post-build / pre-compile in variant pre-compile  # Specifies the baudrate of the controller in kbps.
          integer CanControllerBaudRateConfigID: 0..65535, scope=ECU, post-build-variant-value=true, set at post-build in variant post-build / pre-compile in variant pre-compile, default-value=0  # This ID is used by SetBaudrate API and uniquely identifies a specific baud rate configuration within a controller configuration.
          integer CanControllerPropSeg: 0..255, post-build-variant-value=true, set at post-build in variant post-build / pre-compile in variant pre-compile  # Specifies propagation delay in time quantas.
          integer CanControllerSeg1: 0..255, post-build-variant-value=true, set at post-build in variant post-build / pre-compile in variant pre-compile  # Specifies phase segment 1 in time quantas.
          integer CanControllerSeg2: 0..255, post-build-variant-value=true, set at post-build in variant post-build / pre-compile in variant pre-compile  # Specifies phase segment 2 in time quantas.
          integer CanControllerSyncJumpWidth: 0..255, post-build-variant-value=true, set at post-build in variant post-build / pre-compile in variant pre-compile  # Specifies the synchronization jump width for the controller in time quantas.
          container CanControllerFdBaudrateConfig [0..1]  # This optional container contains bit timing related configuration parameters of the CAN controller(s) for payload and CRC of a CAN FD frame. If this container exists the controller supports CAN FD frames.
            float CanControllerFdBaudRate: 0..16000, post-build-variant-value=true, set at post-build in variant post-build / pre-compile in variant pre-compile  # Specifies the data segment baud rate of the controller in kbps.
            integer CanControllerPropSeg: 0..255, post-build-variant-value=true, set at post-build in variant post-build / pre-compile in variant pre-compile  # Specifies propagation delay in time quantas.
            integer CanControllerSeg1: 0..255, post-build-variant-value=true, set at post-build in variant post-build / pre-compile in variant pre-compile  # Specifies phase segment 1 in time quantas.
            integer CanControllerSeg2: 0..255, post-build-variant-value=true, set at post-build in variant post-build / pre-compile in variant pre-compile  # Specifies phase segment 2 in time quantas.
            integer CanControllerSspOffset [0..1]: 0..255, multiplicity set at post-build in variant post-build / pre-compile in variant pre-compile, post-build-variant-multiplicity=true, post-build-variant-value=true, set at post-build in variant post-build / pre-compile in variant pre-compile  # Specifies the Transmitter Delay Compensation Offset in minimum time quanta (see [17]). Transmitter Delay Compensation Offset is used to adjust the position of the Secondary Sample Point (SSP), relative to the beginning of the received bit. If this parameter is configured, the Transmitter Delay Compensation is done by measurement of the CAN controller. If not specified, Transmitter Delay Compensation is disabled. | Note: MTQ == Minimum Time Quanta in seconds == 1/(frequency of the CAN controller clock) Secondary Sample Point Offset in seconds = CanControllerSspOffset * MTQ Example: CAN controller clock frequency = 20MHz => MTQ = 1/20 * 10^(-6) s = 0,05 us = 50ns Baud rate = 1MBit/s => BitTime = 1/(1 * 10^6) s/Bit = 1 * 10^(-6) = 1us/Bit SSP = 75% => SSP in seconds = 0,75 * 1us = 750 ns CanControllerSspOffset in MTQ = 750ns / 50ns = 15 Note: Please consider the minimum range (0..63) stated in [17] and the range definition (0..127) used as per [19].
            integer CanControllerSyncJumpWidth: 0..255, post-build-variant-value=true, set at post-build in variant post-build / pre-compile in variant pre-compile  # Specifies the synchronization jump width for the controller in time quantas.
            boolean CanControllerTxBitRateSwitch: post-build-variant-value=true, set at post-build in variant post-build / pre-compile in variant pre-compile, default-value=true  # Specifies if the bit rate switching shall be used for transmissions. | If FALSE: CAN FD frames shall be sent without bit rate switching.
        container CanTTController [0..1]  # CanTTController is specified in the SWS TTCAN and contains the configuration parameters of the TTCAN controller(s) (which are needed in addition to the configuration parameters of the CAN controller(s)). | This container is only included and valid if TTCAN is supported by the controller, enabled (see CanSupportTTCANRef, ECUC_Can_00430), and used.
          integer CanTTControllerApplWatchdogLimit: 0..255, scope=ECU, post-build-variant-value=true, set at post-build in variant post-build / pre-compile in variant pre-compile  # Defines the maximum time period (unit is 256 times NTU) after which the application has to serve the watchdog.
          integer CanTTControllerCycleCountMax: 0..63, scope=ECU, post-build-variant-value=true, set at post-build in variant post-build / pre-compile in variant pre-compile  # Defines the value for cycle_count_max. | Allowed values: 0x00: 1 basic cycle 0x01: 2 basic cycles 0x03: 4 basic cycles 0x07: 8 basic cycles 0x0F: 16 basic cycles 0x1F: 32 basic cycles 0x3F: 64 basic cycles
          integer CanTTControllerExpectedTxTrigger: 0..255, post-build-variant-value=true, set at post-build in variant post-build / pre-compile in variant pre-compile  # Number of expected_tx_trigger.
          boolean CanTTControllerExternalClockSynchronisation: scope=ECU, post-build-variant-value=true, set at post-build in variant post-build / pre-compile in variant pre-compile  # Enables/disables the external clock synchronization. | TRUE: External clock synchronization enabled. FALSE: External clock synchronization disabled. This parameter shall only be configurable if parameter CanTTControllerLevel2 equals TRUE.
          boolean CanTTControllerGlobalTimeFiltering: post-build-variant-value=true, set at post-build in variant post-build / pre-compile in variant pre-compile  # Enables/disables the global time filtering. | TRUE: Global time filtering enabled. FALSE: Global time filtering disabled. This parameter shall only be configurable if parameter CanTTControllerLevel2 equals TRUE.
          integer CanTTControllerInitialRefOffset: 0..127, scope=ECU, post-build-variant-value=true, set at post-build in variant post-build / pre-compile in variant pre-compile  # Defines the initial value for ref trigger offset.
          integer CanTTControllerInterruptEnable: 0..1023, post-build-variant-value=true, set at post-build in variant post-build / pre-compile in variant pre-compile  # Enables/disables the respective interrupts. | Bit Position set to 1: Enable respective interrupt. Bit Position set to 0: Disable respective interrupt. Bit Position / Interrupt Source: 10: Application Watchdog. 9: Watch Trigger reached. 8: Initialization Watch Trigger reached. 7: Change of Error Level. 6: Tx Overflow. 5: Tx Underflow. 4: Global Time Error. 3: Gap. 2: Start of Cycle. 1: Time Discontinuity. 0: Master State Change. Bit position "1: Time Discontinuity" and "4: Global Time Error" shall only be configurable if parameter CanTTControllerLevel2 equals TRUE.
          boolean CanTTControllerLevel2: post-build-variant-value=true, set at post-build in variant post-build / pre-compile in variant pre-compile  # Defines whether Level 2 or Level 1 is used. | TRUE: Level 2. FALSE: Level 1. If this parameter is set to FALSE then all parameters with dependency to CanTTControllerLevel2 need not be configured.
          float CanTTControllerNTUConfig: 0..100, scope=ECU, post-build-variant-value=true, set at post-build in variant post-build / pre-compile in variant pre-compile  # Defines the config value for NTU (network time unit). | Value given in microseconds. The value configured shall be greater than 0. Together with the local oscillator period, the TUR (time unit ratio) can be derived from the NTU. This parameter shall only be configurable if parameter CanTTControllerLevel2 equals TRUE.
          enumeration CanTTControllerOperationMode: {CAN_TT_EVENT_SYNC_TIME_TRIGGERED, CAN_TT_EVENT_TRIGGERED, CAN_TT_TIME_TRIGGERED}, scope=ECU, post-build-variant-value=true, set at post-build in variant post-build / pre-compile in variant pre-compile  # Defines the operation mode.
          float CanTTControllerSyncDeviation: 0..100, post-build-variant-value=true, set at post-build in variant post-build / pre-compile in variant pre-compile  # Defines the maximum synchronization deviation: | Given as a percentage value of the NTU (network time unit). The value configured shall be greater than 0. This parameter shall only be configurable if parameter CanTTControllerLevel2 equals TRUE.
          boolean CanTTControllerTimeMaster: scope=ECU, post-build-variant-value=true, set at post-build in variant post-build / pre-compile in variant pre-compile  # Defines whether the controller acts as a potential time master. | TRUE: Potential time master. FALSE: Time slave.
          integer CanTTControllerTimeMasterPriority: 0..7, scope=ECU, post-build-variant-value=true, set at post-build in variant post-build / pre-compile in variant pre-compile  # Defines the time master priority.
          boolean CanTTControllerTURRestore: post-build-variant-value=true, set at post-build in variant post-build / pre-compile in variant pre-compile  # Enables/disables the TUR restore. | Note that the value configured for TUR can be derived from the value configured for NTU and the local oscillator preriod. TRUE: TUR restore enabled. FALSE: TUR restore disabled. This parameter shall only be configurable if parameter CanTTControllerLevel2 equals TRUE.
          integer CanTTControllerTxEnableWindowLength: 1..16, scope=ECU, post-build-variant-value=true, set at post-build in variant post-build / pre-compile in variant pre-compile  # Length of the tx enable window given in CAN bit times. | Definition parameter "CanTTControllerTxEnableWindowlength" is used such that: Length of enable window = CanTTControllerTxEnableWindowLength + 1
          integer CanTTControllerWatchTriggerGapTimeMark: 0..65535, post-build-variant-value=true, set at post-build in variant post-build / pre-compile in variant pre-compile  # watch trigger time mark after a gap
          integer CanTTControllerWatchTriggerTimeMark: 0..65535, post-build-variant-value=true, set at post-build in variant post-build / pre-compile in variant pre-compile  # watch trigger time mark
          enumeration CanTTIRQProcessing: {INTERRUPT, POLLING}, scope=ECU, post-build-variant-value=true, set at post-build in variant post-build / pre-compile in variant pre-compile  # Enables / disables API Can_MainFunction_BusOff() for handling busoff events in polling mode.
          reference CanTTControllerEcucPartitionRef [0..1]: scope=ECU, multiplicity set at pre-compile, post-build-variant-value=true, set at pre-compile, destination=EcucPartition  # Maps the Time triggered CAN controller to zero or one ECUC partitions. The ECUC partition referenced is a subset of the ECUC partitions where the CAN driver is mapped to.
      container CanHardwareObject [1..*]  # This container contains the configuration (parameters) of CAN Hardware Objects.
        integer CanFdPaddingValue [0..1]: 0..255, scope=ECU, multiplicity set at post-build in variant post-build / pre-compile in variant pre-compile, post-build-variant-multiplicity=true, post-build-variant-value=true, set at post-build in variant post-build / pre-compile in variant pre-compile, default-value=0  # Specifies the value which is used to pad unspecified data in CAN FD frames > 8 bytes for transmission. This is necessary due to the discrete possible values of the DLC if > 8 bytes. | If the length of a PDU which was requested to be sent does not match the allowed DLC values, the remaining bytes up to the next possible value shall be padded with this value.
        enumeration CanHandleType: {BASIC, FULL}, scope=ECU, post-build-variant-value=true, set at post-build in variant post-build / pre-compile in variant pre-compile  # Specifies the type (Full-CAN or Basic-CAN) of a hardware object.
        boolean CanHardwareObjectUsesPolling [0..1]: default-value=false  # Enables polling of this hardware object.
        integer CanHwObjectCount: 1..65535, scope=ECU, multiplicity set at post-build in variant post-build / pre-compile in variant pre-compile, post-build-variant-multiplicity=true, post-build-variant-value=true, set at post-build in variant post-build / pre-compile in variant pre-compile, default-value=1  # Number of hardware objects used to implement one HOH. In case of a HRH this parameter defines the number of elements in the hardware FIFO or the number of shadow buffers, in case of a HTH it defines the number of hardware objects used for multiplexed transmission or for a hardware FIFO used by a FullCAN HTH.
        enumeration CanIdType: {EXTENDED, MIXED, STANDARD}, scope=ECU, post-build-variant-value=true, set at post-build in variant post-build / pre-compile in variant pre-compile  # Specifies whether the IdValue is of type | * standard identifier * extended identifier * mixed mode ImplementationType: Can_IdType
        integer CanObjectId: 0..65535, scope=ECU, set at pre-compile, symbolic-name-value=true  # Holds the handle ID of HRH or HTH. The value of this parameter is unique in a given CAN Driver, and it should start with 0 and continue without any gaps. | The HRH and HTH Ids share a common ID range. Example: HRH0-0, HRH1-1, HTH0-2, HTH1-3
        enumeration CanObjectPayloadLength [0..1]: {CAN_OBJECT_PL_12, CAN_OBJECT_PL_16, CAN_OBJECT_PL_20, CAN_OBJECT_PL_24, CAN_OBJECT_PL_32, CAN_OBJECT_PL_48, CAN_OBJECT_PL_64, CAN_OBJECT_PL_8}, scope=ECU, post-build-variant-value=true, set at post-build in variant post-build / pre-compile in variant pre-compile  # Specifies the maximum L-PDU payload length in bytes the hardware object can store. | If the parameter is not provided, Can driver configuration generators have to assume the maximum length of the underlying CAN derivate, e.g. 8 bytes for CAN, 64 bytes for CAN-FD.
        enumeration CanObjectType: {RECEIVE, TRANSMIT}, scope=ECU, post-build-variant-value=true, set at post-build in variant post-build / pre-compile in variant pre-compile  # Specifies if the HardwareObject is used as Transmit or as Receive object
        boolean CanTriggerTransmitEnable [0..1]: scope=ECU, set at pre-compile, default-value=false  # This parameter defines if or if not Can supports the trigger-transmit API for this handle.
        reference CanControllerRef: post-build-variant-value=true, set at post-build in variant post-build / pre-compile in variant pre-compile, destination=CanController  # Reference to CAN Controller to which the HOH is associated to.
        reference CanMainFunctionRWPeriodRef [0..1]: multiplicity set at post-build in variant post-build / pre-compile in variant pre-compile, post-build-variant-multiplicity=true, post-build-variant-value=true, set at post-build in variant post-build / pre-compile in variant pre-compile, destination=CanMainFunctionRWPeriods  # Reference to CanMainFunctionPeriod
        container CanHwFilter [0..*]  # This container is only valid for HRHs and contains the configuration (parameters) of one hardware filter.
          integer CanHwFilterCode: 0..4294967295, post-build-variant-value=true, set at post-build in variant post-build / pre-compile in variant pre-compile  # Specifies (together with the filter mask) the identifiers range that passes the hardware filter.
          integer CanHwFilterMask: 0..4294967295, post-build-variant-value=true, set at post-build in variant post-build / pre-compile in variant pre-compile  # Describes a mask for hardware-based filtering of CAN identifiers. The CAN identifiers of incoming messages are masked with the appropriate CanFilterMaskValue. Bits holding a 0 mean don't care, i.e. do not compare the message's identifier in the respective bit position. | The mask shall be build by filling with leading 0. In case of CanIdType EXTENDED or MIXED a 29 bit mask shall be build. In case of CanIdType STANDARD a 11 bit mask shall be build
        container CanTTHardwareObjectTrigger [0..*]  # CanTTHardwareObjectTrigger is specified in the SWS TTCAN and contains the configuration (parameters) of TTCAN triggers for Hardware Objects, which are additional to the configuration (parameters) of CAN Hardware Objects. | This container is only included and valid if TTCAN is supported by the controller and, enabled (see CanSupportTTCANRef, ECUC_Can_00430), and used.
          integer CanTTHardwareObjectBaseCycle: 0..63, scope=ECU, post-build-variant-value=true, set at post-build in variant post-build / pre-compile in variant pre-compile  # Defines the cycle_offset. | CanTTHardwareObjectBaseCycle must be not greater than cycle_count_max.
          integer CanTTHardwareObjectCycleRepetition: 1..64, scope=ECU, post-build-variant-value=true, set at post-build in variant post-build / pre-compile in variant pre-compile  # Defines the repeat_factor. | CanTTHardwareObjectCycleRepetition shall be a power of two (2), greater than cycle_offset but not greater than cycle_count_max + 1.
          integer CanTTHardwareObjectTimeMark: 0..65535, post-build-variant-value=true, set at post-build in variant post-build / pre-compile in variant pre-compile  # Defines the point in time, when the trigger will be activated. | Value is given in cycle time.
          integer CanTTHardwareObjectTriggerId: 0..63, set at pre-compile, symbolic-name-value=true  # Sequential number which allows separation of different TTCAN triggers configured for one and the same hardware object.
          enumeration CanTTHardwareObjectTriggerType: {CAN_TT_RX_TRIGGER, CAN_TT_TX_REF_TRIGGER, CAN_TT_TX_REF_TRIGGER_GAP, CAN_TT_TX_TRIGGER_EXCLUSIVE, CAN_TT_TX_TRIGGER_MERGED, CAN_TT_TX_TRIGGER_SINGLE}, post-build-variant-value=true, set at post-build in variant post-build / pre-compile in variant pre-compile  # Defines the type of the trigger associated with the hardware object. This parameter depends on plain CAN parameter CAN_OBJECT_TYPE. | If CAN_OBJECT_TYPE equals RECEIVE than this parameter is fixed to CAN_TT_RX_TRIGGER. If CAN_OBJECT_TYPE equals TRANSMIT than one of the following literals is configurable: CAN_TT_TX_REF_TRIGGER, CAN_TT_TX_REF_TRIGGER_GAP, CAN_TT_TX_TRIGGER_MERGED, CAN_TT_TX_TRIGGER_SINGLE, CAN_TT_TX_TRIGGER_EXCLUSIVE.
    container CanGeneral  # This container contains the parameters related each CAN Driver Unit.
      boolean CanDevErrorDetect: set at pre-compile, default-value=false  # Switches the development error detection and notification on or off. | * true: detection and notification is enabled. * false: detection and notification is disabled.
      boolean CanEnableSecurityEventReporting: scope=ECU, set at pre-compile, default-value=false  # Switches the reporting of security events to the IdsM: Tags: atp.Status=draft | - true: reporting is enabled. - false: reporting is disabled.
      integer CanIndex: 0..255, set at pre-compile  # Specifies the InstanceId of this module instance. If only one instance is present it shall have the Id 0.
      function name CanLPduReceiveCalloutFunction [0..1]: multiplicity set at pre-compile, set at pre-compile  # This parameter defines the existence and the name of a callout function that is called after a successful | reception of a received CAN Rx L-PDU. If this parameter is omitted no callout shall take place.
      float CanMainFunctionBusoffPeriod [0..1]: 0..INF, multiplicity set at pre-compile, set at pre-compile  # This parameter describes the period for cyclic call to Can_MainFunction_Busoff. Unit is seconds.
      float CanMainFunctionModePeriod: 0..INF, set at pre-compile  # This parameter describes the period for cyclic call to Can_MainFunction_Mode. Unit is seconds.
      float CanMainFunctionWakeupPeriod [0..1]: 0..INF, multiplicity set at pre-compile, set at pre-compile  # This parameter describes the period for cyclic call to Can_MainFunction_Wakeup. Unit is seconds.
      boolean CanMultiplexedTransmission: scope=ECU, set at pre-compile  # Specifies if multiplexed transmission shall be supported.ON or OFF
      boolean CanSetBaudrateApi [0..1]: scope=ECU, multiplicity set at pre-compile, set at pre-compile, default-value=false  # The support of the Can_SetBaudrate API is optional. | If this parameter is set to true the Can_SetBaudrate API shall be supported. Otherwise the API is not supported.
      float CanTimeoutDuration: 1E-6..65.535, set at pre-compile  # Specifies the maximum time for blocking function until a timeout is detected. Unit is seconds.
      boolean CanVersionInfoApi: set at pre-compile, default-value=false  # Switches the Can_GetVersionInfo() API ON or OFF.
      reference CanEcucPartitionRef [0..*]: scope=ECU, multiplicity set at pre-compile, post-build-variant-multiplicity=true, post-build-variant-value=true, set at pre-compile, destination=EcucPartition  # Maps the CAN driver to zero or multiple ECUC partitions to make the modules API available in this partition. The CAN driver will operate as an independent instance in each of the partitions.
      reference CanOsCounterRef [0..1]: multiplicity set at pre-compile, set at pre-compile, destination=OsCounter  # This parameter contains a reference to the OsCounter, which is used by the CAN driver.
      reference CanSupportTTCANRef: scope=ECU, set at pre-compile, destination=CanIfPrivateCfg  # The parameter refers to CanIfSupportTTCAN parameter in the CAN Interface Module configuration. | The CanIfSupportTTCAN parameter defines whether TTCAN is supported.
      container CanMainFunctionRWPeriods [0..*]  # This container contains the parameter for configuring the period for cyclic call to Can_MainFunction_Read or Can_MainFunction_Write depending on the referring item.
        float CanMainFunctionPeriod: 0..INF, set at pre-compile  # This parameter describes the period for cyclic call to Can_MainFunction_Read or Can_MainFunction_Write depending on the referring item. Unit is seconds. Different poll-cycles will be configurable if more than one CanMainFunctionPeriod is configured. In this case multiple Can_MainFunction_Read() or Can_MainFunction_Write() will be provided by the CAN Driver module.
