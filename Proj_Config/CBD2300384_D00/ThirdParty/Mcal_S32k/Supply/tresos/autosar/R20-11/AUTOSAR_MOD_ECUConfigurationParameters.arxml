[part 8 of 11: package /AUTOSAR/EcucDefs]
AUTOSAR XML (schema 00049)
package /AUTOSAR/EcucDefs  (continued)
  module definition J1939Dcm [0..1]: post-build-variant-support=true, variants link-time/post-build/pre-compile  # The SAE J1939 Dcm module
    container J1939DcmConfigSet  # This container contains the configuration parameters and sub containers of the AUTOSAR J1939Dcm module.
      container J1939DcmChannel [1..*]  # Contains the J1939DcmChannel parameters.
        enumeration J1939DcmBusType: {J1939DCM_ISO9141, J1939DCM_J1587, J1939DCM_J1850, J1939DCM_J1922, J1939DCM_J1939_NETWORK_1, J1939DCM_J1939_NETWORK_2, J1939DCM_J1939_NETWORK_3, J1939DCM_J1939_NETWORK_4, J1939DCM_OTHER, J1939DCM_PROPRIETARY_NETWORK_1, J1939DCM_PROPRIETARY_NETWORK_2}, set at pre-compile  # Identifies the communication port
        reference J1939DcmComMChannelRef: scope=ECU, post-build-variant-value=true, set at link in variant link-time / post-build in variant post-build / pre-compile in variant pre-compile, requires-symbolic-name-value=true, destination=ComMChannel  # Reference to the ComMChannel.
      choice container J1939DcmDspExternalSRDataElementClass [0..1]  # This container defines the source of data in a provided port which shall be read respectively the target of data in a required port which shall be written. | This container shall contain either one J1939DcmSubElementInDataElementInstance OR J1939DcmDataElementInstance OR J1939DcmSubElementInImplDataElementInstance reference.
        container J1939DcmDataElementInstance [0..1]  # Instance Reference to the primitive data in a port where the data element is typed with an ApplicationPrimitveDataType or an ImplementationDataType.
          instance reference J1939DcmDataElementInstanceRef: set at pre-compile, destination-context=ROOT-SW-COMPOSITION-PROTOTYPE SW-COMPONENT-PROTOTYPE PORT-PROTOTYPE, destination-type=AUTOSAR-DATA-PROTOTYPE  # Instance Reference to the primitive data which shall be read or written. | Supported are VariableDataPrototypes in SenderReceiverInterfaces and NvDataInterfaces and ParameterDataPrototypes in ParameterInterfaces (read only). This reference is applicable if the AutosarDataPrototype is typed with a ApplicationPrimitiveDataType of category VALUE or BOOLEAN or if the AutosarDataPrototype is typed with a ImplementationDataType of category VALUE or TYPE_REFERENCE that in turn boils down to VALUE
        container J1939DcmSubElementInDataElementInstance [0..1]  # Instance Reference to the primitve sub-element (at any level) of composite data in a port where the data element is typed with an ApplicationCompositeDataType.
          instance reference J1939DcmSubElementInDataElementInstanceRef: set at pre-compile, destination-context=ROOT-SW-COMPOSITION-PROTOTYPE SW-COMPONENT-PROTOTYPE PORT-PROTOTYPE AUTOSAR-DATA-PROTOTYPE APPLICATION-COMPOSITE-ELEMENT-DATA-PROTOTYPE*, destination-type=APPLICATION-COMPOSITE-ELEMENT-DATA-PROTOTYPE  # Instance Reference to the primitve sub-element (at any level) of composite data in a port which shall be read. | Supported are VariableDataPrototypes in SenderReceiverInterfaces and NvDataInterfaces and ParameterDataPrototypes in ParameterInterfaces (read only). This reference is applicable if the AutosarDataPrototype is typed with a ApplicationCompositeDataType.
        container J1939DcmSubElementInImplDataElementInstance [0..1]  # Instance Reference to the primitve sub-element (at any level) of composite data in a port where the data element is typed with an ImplementationDataType.
          instance reference J1939DcmSubElementInImplDataElementInstanceRef: set at pre-compile, destination-context=ROOT-SW-COMPOSITION-PROTOTYPE SW-COMPONENT-PROTOTYPE PORT-PROTOTYPE AUTOSAR-DATA-PROTOTYPE IMPLEMENTATION-DATA-TYPE-ELEMENT*, destination-type=IMPLEMENTATION-DATA-TYPE-ELEMENT  # Instance Reference to the primitve sub-element (at any level) of composite data in a port which shall be read. | Supported are VariableDataPrototypes in SenderReceiverInterfaces and NvDataInterfaces and ParameterDataPrototypes in ParameterInterfaces (read only). This reference is applicable if the AutosarDataPrototype is typed with a ImplementationDataType of category STRUCTURE or ARRAY. Please note that in case of ARRAY the index attribute in the target reference has to be set to select a single array element.
      container J1939DcmNode [1..*]  # Contains the parameters for the support of a logical J1939 node.
        function name J1939DcmGenericDMxCopyRxDataFunction [0..1]: multiplicity set at pre-compile, set at pre-compile  # Provides part of the data of an unsupported DMx message. Required if J1939DcmGenericDMxSupport is enabled.
        function name J1939DcmGenericDMxCopyTxDataFunction [0..1]: multiplicity set at pre-compile, set at pre-compile  # Requests to provide part of the data of an unsupported DMx message, following a call to J1939Dcm_GenericDMxTransmit. Required if J1939DcmGenericDMxSupport is enabled.
        function name J1939DcmGenericDMxRequestFunction [0..1]: multiplicity set at pre-compile, set at pre-compile  # Indicates the reception of a request for an unsupported DMx message. Required if J1939DcmGenericDMxSupport is enabled.
        function name J1939DcmGenericDMxRxIndicationFunction [0..1]: multiplicity set at pre-compile, set at pre-compile  # Confirms complete reception of an unsupported DMx message. Required if J1939DcmGenericDMxSupport is enabled.
        function name J1939DcmGenericDMxStartOfReceptionFunction [0..1]: multiplicity set at pre-compile, set at pre-compile  # Indicates reception of an unsupported DMx message. Required if J1939DcmGenericDMxSupport is enabled.
        function name J1939DcmGenericDMxTxConfirmationFunction [0..1]: multiplicity set at pre-compile, set at pre-compile  # Confirms transmission of an unsupported DMx message. Required if J1939DcmGenericDMxSupport is enabled.
        integer J1939DcmSPNsInDataStream [0..*]: 0..524287, multiplicity set at pre-compile, set at pre-compile  # Defines the SPNs available in data stream for use in DM24.
        reference J1939DcmDemClientRef: set at link in variant link-time+post-build / pre-compile in variant pre-compile, requires-symbolic-name-value=true, destination=DemClient  # Reference to the corresponding Dem Client.
        reference J1939DcmNmNodeRef: set at link in variant link-time+post-build / pre-compile in variant pre-compile, requires-symbolic-name-value=true, destination=J1939NmNode  # Reference to the corresponding J1939Nm node.
        reference J1939DcmNodeRmUserRef: post-build-variant-value=true, set at link in variant link-time / post-build in variant post-build / pre-compile in variant pre-compile, requires-symbolic-name-value=true, destination=J1939RmDcmUser  # Reference to the J1939RmUser used by J1939Dcm.
        reference J1939DcmServiceOnlyDTCsMemoryDestinationRef [0..1]: set at pre-compile, requires-symbolic-name-value=true, destination=DemUserDefinedMemory  # Reference to the user defined memory used for the Service Only DTCs handled by DM53, DM54, and DM55.
        container J1939DcmDiagnosticMessageSupport [1..*]  # Contains parameters to configure the diagnostic message support
          enumeration J1939DcmDmxSupport: {J1939DCM_DM01_SUPPORT, J1939DCM_DM02_SUPPORT, J1939DCM_DM03_SUPPORT, J1939DCM_DM04_SUPPORT, J1939DCM_DM05_SUPPORT, J1939DCM_DM06_SUPPORT, J1939DCM_DM07_SUPPORT, J1939DCM_DM08_SUPPORT, J1939DCM_DM09_SUPPORT, J1939DCM_DM10_SUPPORT, J1939DCM_DM11_SUPPORT, J1939DCM_DM12_SUPPORT, J1939DCM_DM13_SUPPORT, J1939DCM_DM14_SUPPORT, J1939DCM_DM15_SUPPORT, J1939DCM_DM16_SUPPORT, J1939DCM_DM17_SUPPORT, J1939DCM_DM18_SUPPORT, J1939DCM_DM19_SUPPORT, J1939DCM_DM20_SUPPORT, J1939DCM_DM21_SUPPORT, J1939DCM_DM22_SUPPORT, J1939DCM_DM23_SUPPORT, J1939DCM_DM24_SUPPORT, J1939DCM_DM25_SUPPORT, J1939DCM_DM26_SUPPORT, J1939DCM_DM27_SUPPORT, J1939DCM_DM28_SUPPORT, J1939DCM_DM29_SUPPORT, J1939DCM_DM30_SUPPORT, J1939DCM_DM31_SUPPORT, J1939DCM_DM32_SUPPORT, J1939DCM_DM33_SUPPORT, J1939DCM_DM34_SUPPORT, J1939DCM_DM35_SUPPORT, J1939DCM_DM36_SUPPORT, J1939DCM_DM37_SUPPORT, J1939DCM_DM38_SUPPORT, J1939DCM_DM39_SUPPORT, J1939DCM_DM40_SUPPORT, J1939DCM_DM41_SUPPORT, J1939DCM_DM42_SUPPORT, J1939DCM_DM43_SUPPORT, J1939DCM_DM44_SUPPORT, J1939DCM_DM45_SUPPORT, J1939DCM_DM46_SUPPORT, J1939DCM_DM47_SUPPORT, J1939DCM_DM48_SUPPORT, J1939DCM_DM49_SUPPORT, J1939DCM_DM50_SUPPORT, J1939DCM_DM51_SUPPORT, J1939DCM_DM52_SUPPORT, J1939DCM_DM53_SUPPORT, J1939DCM_DM54_SUPPORT, J1939DCM_DM55_SUPPORT, J1939DCM_DM56_SUPPORT, J1939DCM_DM57_SUPPORT}, set at pre-compile  # This parameter is used to identify the actual DMx message.
          reference J1939DcmDiagnosticMessageModeRuleRef [0..1]: scope=ECU, multiplicity set at link in variant link-time / pre-compile in variant post-build+pre-compile, set at link in variant link-time / pre-compile in variant post-build+pre-compile, destination=J1939DcmModeRule  # Reference to a J1939DcmModeRule which controls the execution of a DiagnosticMessage.
          reference J1939DcmDiagnosticMessageSupportChannelRef: set at link in variant link-time+post-build / pre-compile in variant pre-compile, destination=J1939DcmChannel  # Reference to J1939DcmChannel for which this diagnostic message is supported.
          container J1939DcmRxPdu [0..1]  # Contains parameters to configure the J1939DcmRxPdu. | This PDU consumes meta data items of type CAN_ID_32 for PDUs received from CanIf, and of type SOURCE_ADDRESS_16, TARGET_ADDRESS_16, and PRIORITY_8 for PDUs received from J1939Tp.
            integer J1939DcmRxPduId: 0..65535, scope=ECU, set at pre-compile, symbolic-name-value=true  # The I-PDU identifier used for communication with PduR.
            reference J1939DcmRxPduRef: post-build-variant-value=true, set at link in variant link-time / post-build in variant post-build / pre-compile in variant pre-compile, destination=Pdu  # Reference to the global Pdu element in the Ecuc module.
          container J1939DcmTxPdu [0..1]  # Contains parameters to configure the J1939DcmTxPdu. | This PDU produces meta data items of type CAN_ID_32 for PDUs transmitted via CanIf, and of type SOURCE_ADDRESS_16, TARGET_ADDRESS_16, and PRIORITY_8 for PDUs transmitted via J1939Tp.
            integer J1939DcmTxPduId: 0..65535, scope=ECU, set at pre-compile, symbolic-name-value=true  # The I-PDU identifier used to identify the Tx message.
            reference J1939DcmTxPduRef: post-build-variant-value=true, set at link in variant link-time / post-build in variant post-build / pre-compile in variant pre-compile, destination=Pdu  # Reference to the global Pdu element in the Ecuc module.
      container J1939DcmProcessingConditions [0..1]  # This container contains the configuration for mode arbitration functionality of the J1939Dcm
        container J1939DcmModeCondition [1..*]  # This container contains the configuration of a mode condition or an environmental conditions which can be used as argument in J1939DcmModeRules. | One J1939DcmModeCondition shall contain either one J1939DcmSwcModeRef or one J1939DcmBswModeRef or one J1939DcmSwcSRDataElementRef. Please note that the J1939Dcm acts as well as mode manager. Therefore the references J1939DcmSwcModeRef or one J1939DcmBswModeRef might point to provided ModeDeclarationGroupPrototypes of the J1939Dcm itself as well as to provided ModeDeclarationGroupPrototypes of other Bsw Modules or software components. In case of a configured J1939DcmSwcModeRef or J1939DcmBswModeRef only the J1939DcmConditionType J1939DCM_EQUALS or J1939DCM_EQUALS_NOT are applicable. In case of J1939DcmSwcSRDataElementRef all literals of J1939DcmConditionType are possible.
          enumeration J1939DcmConditionType: {J1939DCM_EQUALS, J1939DCM_EQUALS_NOT, J1939DCM_GREATER_OR_EQUAL, J1939DCM_GREATER_THAN, J1939DCM_LESS_OR_EQUAL, J1939DCM_LESS_THAN}, set at pre-compile  # This parameter specifies what kind of comparison that is made for the evaluation of the mode condition.
          instance reference J1939DcmBswModeRef [0..1]: multiplicity set at pre-compile, set at pre-compile, destination-context=MODE-DECLARATION-GROUP-PROTOTYPE, destination-type=MODE-DECLARATION  # This parameter references a mode of a ModeDeclarationGroupPrototype provided by a Basic Software Module used for the condition. | Please note that such ModeDeclarationGroupPrototype are owned by a Basic Software Module Description in the role providedModeGroup.
          instance reference J1939DcmSwcModeRef [0..1]: multiplicity set at pre-compile, set at pre-compile, destination-context=ROOT-SW-COMPOSITION-PROTOTYPE SW-COMPONENT-PROTOTYPE P-PORT-PROTOTYPE MODE-DECLARATION-GROUP-PROTOTYPE, destination-type=MODE-DECLARATION  # This parameter references a mode in a particular mode request port of a software component that is used for the condition.
          reference J1939DcmSwcSRDataElementRef [0..1]: multiplicity set at pre-compile, set at pre-compile, destination=J1939DcmDspExternalSRDataElementClass  # Reference to environmental conditions. | It is possible to reference a S/R Receiver-Port to read physical values and compare (equal, greater, less,...) them with a configured value that is defined by J1939DcmSwcSRDataElementValue.
          choice container J1939DcmSwcSRDataElementValue  # This container contains the configuration of a S/R compare value.
            container J1939DcmSwcSRDataElementArray [0..1]  # This container contains the configuration of a array SR data element compare value.
              container J1939DcmSwcSRDataElementArrayElement [0..*]  # This container contains the configuration of a array element SR data element compare value.
                integer J1939DcmSwcSRDataElementArrayElementIndex: 0..18446744073709551615, set at pre-compile  # Index to an array SR data element.
                integer J1939DcmSwcSRDataElementArrayElementValue: 0..18446744073709551615, set at pre-compile  # Value of an array SR data element compare value.
            container J1939DcmSwcSRDataElementPrimitive [0..1]  # This container contains the configuration of a primitive SR data element compare value.
              integer J1939DcmSwcSRDataElementPrimitiveValue: 0..18446744073709551615, set at pre-compile  # Reference to a primitive SR data element compare value.
        container J1939DcmModeRule [1..*]  # This container contains the configuration of a mode rule which represents a logical expression with J1939DcmModeConditions or other J1939DcmModeRules as arguments. | All arguments are processed with the operator defined by DcmLogicalOperator, for instance: Argument_A AND Argument_B AND Argument_C
          enumeration J1939DcmLogicalOperator [0..1]: {J1939DCM_AND, J1939DCM_OR}, multiplicity set at pre-compile, set at pre-compile  # This parameter specifies the logical operator to be used in the logical expression. If the expression only consists of a single condition this parameter shall not be used.
          integer J1939DcmModeRuleNrcValue [0..1]: 1..255, scope=ECU, multiplicity set at link in variant link-time / pre-compile in variant pre-compile, set at link in variant link-time / pre-compile in variant pre-compile  # Optional parameter which defines the NRC to be sent in case the mode rule condition is not valid.
          choice reference J1939DcmArgumentRef [1..*]: multiplicity set at pre-compile, requires-index=true, set at pre-compile, destination=[J1939DcmModeCondition, J1939DcmModeRule]  # This is a choice reference either to a mode condition or a an other mode rule serving as sub-expression.
    container J1939DcmGeneral  # Contains the general configuration parameters of the module.
      integer J1939DcmCommonBufferSize: 1..65535, set at pre-compile  # Size of common buffer (in Bytes). The buffer size should be as large as the longest command or response message.
      boolean J1939DcmDevErrorDetect: set at pre-compile, default-value=false  # Switches the development error detection and notification on or off. | * true: detection and notification is enabled. * false: detection and notification is disabled.
      integer J1939DcmDM01BufferSize [0..1]: 1..65535, multiplicity set at pre-compile, set at pre-compile  # Size of DM01 buffer (in Bytes). The buffer size should be as large as the longest DM01 response message.
      integer J1939DcmDM01MaxDTCs [0..1]: 1..255, set at pre-compile, default-value=20  # Configuration value of limitation of maximum DTCs to be reported in the DM01 message.
      integer J1939DcmDM35BufferSize [0..1]: 1..65535, multiplicity set at pre-compile, set at pre-compile  # Size of DM35 buffer (in Bytes). The buffer size should be as large as the longest DM35 response message.
      boolean J1939DcmGenericDMxSupport: set at pre-compile, default-value=false  # Switches the support for all DMx messages that are not directly implemented in J1939Dcm. True: Unsupported DMx messages are handled by a CDD. False: Unsupported DMx messages are ignored/rejected.
      float J1939DcmMainFunctionPeriod: 0..INF, scope=ECU, set at link in variant link-time+post-build / pre-compile in variant pre-compile  # Call cycle in seconds of J1939Dcm_MainFunction.
      integer J1939DcmMaxDTCsPerMainFunction [0..1]: 1..255, multiplicity set at pre-compile, set at pre-compile  # Maximum threshold of DTCs filtered in a single MainFunction cycle.
      integer J1939DcmMaxFreezeFramesPerMainFunction [0..1]: 1..255, multiplicity set at pre-compile, set at pre-compile  # Maximum threshold of FreezeFrames filtered in a single MainFunction cycle.
      integer J1939DcmMaxRatiosPerMainFunction [0..1]: 1..255, multiplicity set at pre-compile, set at pre-compile  # Maximum threshold of Ratios filtered in a single MainFunction cycle.
      boolean J1939DcmVersionInfoApi: set at pre-compile, default-value=false  # Pre-processor switch for enabling version info API support.
  module definition J1939Nm [0..1]: post-build-variant-support=true, variants link-time/post-build/pre-compile  # Configuration of the J1939 Network Management module.
    container J1939NmConfigSet  # This container contains the configuration parameters and sub containers of the AUTOSAR J1939Nm module.
      container J1939NmChannel [1..*]: multiplicity set at link in variant link-time / post-build in variant post-build / pre-compile in variant pre-compile, post-build-variant-multiplicity=true  # Physical CAN channel handled by J1939Nm.
        boolean J1939NmChannelUsesAddressArbitration: post-build-variant-value=true, set at link in variant link-time / post-build in variant post-build / pre-compile in variant pre-compile, default-value=true  # Defines whether the nodes attached to this channel use an initial address claim, and whether they react to contending address claims of other nodes. | True: The initial address claim is sent, and the node reacts to address claims of other nodes. False: The node only sends an address claim upon request, and does not react to other address claims.
        reference J1939NmComMNetworkHandleRef: set at link in variant link-time+post-build / pre-compile in variant pre-compile, requires-symbolic-name-value=true, destination=ComMChannel  # Reference to the channel defined by the ComMChannel providing access to the unique channel index ComMChannelId.
        container J1939NmNodeSpecificDemEventParameterRefs [0..*]: multiplicity set at link in variant link-time / post-build in variant post-build / pre-compile in variant pre-compile, post-build-variant-multiplicity=true  # Container for the references to DemEventParameter elements related to one J1939NmNode which shall be invoked using the API Dem_SetEventStatus in case the corresponding error occurs. The EventId is taken from the referenced DemEventParameter's DemEventId symbolic value. The standardized errors are provided in this container and can be extended by vendor-specific error references.
          reference J1939NM_E_ADDRESS_LOST: set at pre-compile, requires-symbolic-name-value=true, destination=DemEventParameter  # Reference to the DemEventParameter which shall be issued when the ECU failed to claim one of its addresses.
          reference J1939NmNodeRef: post-build-variant-value=true, set at link in variant link-time / post-build in variant post-build / pre-compile in variant pre-compile, destination=J1939NmNode  # Reference to J1939NmNode.
        container J1939NmRxPdu  # Contains the configuration of the PDU used to receive the AddressClaimed PG. This PDU consumes a meta data item of type CAN_ID_32.
          integer J1939NmRxPduId: 0..65535, scope=ECU, set at pre-compile, symbolic-name-value=true  # The PDU identifier used for RxIndication from CanIf.
          reference J1939NmRxPduRef: set at link in variant link-time+post-build / pre-compile in variant pre-compile, destination=Pdu  # Reference to the Pdu object representing the PDU.
        container J1939NmTxPdu  # Contains the configuration of the PDU used to transmit the AddressClaimed PG. This PDU produces a meta data item of type CAN_ID_32.
          integer J1939NmTxPduId: 0..65535, scope=ECU, set at pre-compile, symbolic-name-value=true  # The PDU identifier used for TxConfirmation from CanIf.
          reference J1939NmTxPduRef: set at link in variant link-time+post-build / pre-compile in variant pre-compile, destination=Pdu  # Reference to the Pdu object representing the PDU.
      container J1939NmExternalNode [0..*]: multiplicity set at pre-compile  # Logical node implemented in another ECU. Configures potential communication partners. If this container is connected to more than one channel, the external ECU is linked to the local ECU by each of these channels.
        integer J1939NmExternalNodeId: 0..65535, scope=ECU, set at pre-compile, symbolic-name-value=true  # Unique identifier of this external node.
        boolean J1939NmExternalNodeNameArbitraryAddressCapable: post-build-variant-value=true, set at link in variant link-time / post-build in variant post-build / pre-compile in variant pre-compile  # Arbitrary Address Capable field of the NAME of this external node.
        integer J1939NmExternalNodeNameECUInstance: 0..7, post-build-variant-value=true, set at link in variant link-time / post-build in variant post-build / pre-compile in variant pre-compile  # ECU Instance field of the NAME of this external node.
        integer J1939NmExternalNodeNameFunction: 0..255, post-build-variant-value=true, set at link in variant link-time / post-build in variant post-build / pre-compile in variant pre-compile  # Function field of the NAME of this external node.
        integer J1939NmExternalNodeNameFunctionInstance: 0..31, post-build-variant-value=true, set at link in variant link-time / post-build in variant post-build / pre-compile in variant pre-compile  # Function Instance field of the NAME of this external node.
        integer J1939NmExternalNodeNameIdentityNumber: 0..2097151, post-build-variant-value=true, set at link in variant link-time / post-build in variant post-build / pre-compile in variant pre-compile  # Identity Number field of the NAME of this external node.
        integer J1939NmExternalNodeNameIndustryGroup: 0..7, post-build-variant-value=true, set at link in variant link-time / post-build in variant post-build / pre-compile in variant pre-compile  # Industry Group field of the NAME of this external node.
        integer J1939NmExternalNodeNameManufacturerCode: 0..2047, post-build-variant-value=true, set at link in variant link-time / post-build in variant post-build / pre-compile in variant pre-compile  # Manufacturer Code field of the NAME of this external node.
        integer J1939NmExternalNodeNameVehicleSystem: 0..127, post-build-variant-value=true, set at link in variant link-time / post-build in variant post-build / pre-compile in variant pre-compile  # Vehicle System field of the NAME of this external node.
        integer J1939NmExternalNodeNameVehicleSystemInstance: 0..15, post-build-variant-value=true, set at link in variant link-time / post-build in variant post-build / pre-compile in variant pre-compile  # Vehicle System Instance field of the NAME of this external node.
        integer J1939NmExternalNodePreferredAddress: 0..253, scope=ECU, post-build-variant-value=true, set at link in variant link-time / post-build in variant post-build / pre-compile in variant pre-compile  # Source address of this external node.
        reference J1939NmExternalNodeChannelRef [1..*]: multiplicity set at link in variant link-time / post-build in variant post-build / pre-compile in variant pre-compile, post-build-variant-multiplicity=true, post-build-variant-value=true, set at link in variant link-time / post-build in variant post-build / pre-compile in variant pre-compile, destination=J1939NmChannel  # Reference to the channels of the local ECU this external node has access to.
        reference J1939NmExternalNodeGatewayedChannelRef [0..*]: multiplicity set at link in variant link-time / post-build in variant post-build / pre-compile in variant pre-compile, post-build-variant-multiplicity=true, post-build-variant-value=true, set at link in variant link-time / post-build in variant post-build / pre-compile in variant pre-compile, destination=J1939NmChannel  # Reference to the channels on which messages to/from this external node shall be gatewayed. The address claim from the external node will be replicated on these channels.
      container J1939NmNode [1..*]: multiplicity set at link in variant link-time / post-build in variant post-build / pre-compile in variant pre-compile, post-build-variant-multiplicity=true  # Logical node representing one function handled by J1939Nm.
        integer J1939NmNodeId: 0..255, scope=ECU, set at pre-compile, symbolic-name-value=true  # Unique identifier of this node.
        boolean J1939NmNodeNameArbitraryAddressCapable: set at pre-compile  # Arbitrary Address Capable field of the NAME of this node.
        integer J1939NmNodeNameECUInstance: 0..7, post-build-variant-value=true, set at link in variant link-time / post-build in variant post-build / pre-compile in variant pre-compile  # ECU Instance field of the NAME of this node.
        integer J1939NmNodeNameFunction: 0..255, post-build-variant-value=true, set at link in variant link-time / post-build in variant post-build / pre-compile in variant pre-compile  # Function field of the NAME of this node.
        integer J1939NmNodeNameFunctionInstance: 0..31, post-build-variant-value=true, set at link in variant link-time / post-build in variant post-build / pre-compile in variant pre-compile  # Function Instance field of the NAME of this node.
        integer J1939NmNodeNameIdentityNumber: 0..2097151, post-build-variant-value=true, set at link in variant link-time / post-build in variant post-build / pre-compile in variant pre-compile  # Identity Number field of the NAME of this node.
        integer J1939NmNodeNameIndustryGroup: 0..7, post-build-variant-value=true, set at link in variant link-time / post-build in variant post-build / pre-compile in variant pre-compile  # Industry Group field of the NAME of this node.
        integer J1939NmNodeNameManufacturerCode: 0..2047, post-build-variant-value=true, set at link in variant link-time / post-build in variant post-build / pre-compile in variant pre-compile  # Manufacturer Code field of the NAME of this node.
        integer J1939NmNodeNameVehicleSystem: 0..127, post-build-variant-value=true, set at link in variant link-time / post-build in variant post-build / pre-compile in variant pre-compile  # Vehicle System field of the NAME of this node.
        integer J1939NmNodeNameVehicleSystemInstance: 0..15, post-build-variant-value=true, set at link in variant link-time / post-build in variant post-build / pre-compile in variant pre-compile  # Vehicle System Instance field of the NAME of this node.
        integer J1939NmNodePreferredAddress: 0..253, scope=ECU, post-build-variant-value=true, set at link in variant link-time / post-build in variant post-build / pre-compile in variant pre-compile  # Source address of this node used for address claiming.
        boolean J1939NmNodeStartUpDelay: set at pre-compile, default-value=true  # If enabled, the node will start communication after a delay of 250ms after transmission of the initial AddressClaimed, depending on the configured J1939NmNodePreferredAddress. If disabled, the node will start communication immediately at network start-up. | Please note: According to J1939/81, the 250ms delay is not required for single address CAs with desired source addresses in the ranges 0..127 or 248..253.
        reference J1939NmNodeChannelRef [1..*]: multiplicity set at link in variant link-time+post-build / pre-compile in variant pre-compile, set at link in variant link-time+post-build / pre-compile in variant pre-compile, destination=J1939NmChannel  # Reference to the channels this node has access to.
      container J1939NmSharedAddressSpace [0..*]: multiplicity set at link in variant link-time / post-build in variant post-build / pre-compile in variant pre-compile, post-build-variant-multiplicity=true  # Set of J1939NmChannels that share a common address space. Address claims will be routed between these channels.
        reference J1939NmSharedChannelRef [2..*]: multiplicity set at link in variant link-time / post-build in variant post-build / pre-compile in variant pre-compile, post-build-variant-multiplicity=true, post-build-variant-value=true, set at link in variant link-time / post-build in variant post-build / pre-compile in variant pre-compile, destination=J1939NmChannel  # Reference to a channel that belongs to the shared address space.
    container J1939NmGeneral  # Contains the general configuration parameters of the module.
      float J1939NmBusOffDelayTickPeriod [0..1]: 0..INF, multiplicity set at link in variant link-time+post-build / pre-compile in variant pre-compile, set at link in variant link-time+post-build / pre-compile in variant pre-compile, default-value=0.02  # Duration of ticks that are used to time BusOff delays after conflicting address claims. This parameter must be synchronized with the main function period of the CAN State Manager.
      boolean J1939NmDevErrorDetect: set at pre-compile, default-value=false  # Switches the development error detection and notification on or off. | * true: detection and notification is enabled. * false: detection and notification is disabled.
      boolean J1939NmGatewaySupport: set at pre-compile  # Enables/disables support for claiming the addresses of routed messages.
      float J1939NmMainFunctionPeriod: 0..INF, scope=ECU, set at link in variant link-time+post-build / pre-compile in variant pre-compile, default-value=0.01  # Call cycle in seconds of J1939Nm_MainFunction.
      function name J1939NmUserCallout [0..1]: multiplicity set at pre-compile, set at pre-compile  # Pre-processor switch for enabling the <User_AddressClaimedIndication> and defining the name of the callout function.
      boolean J1939NmVersionInfoApi: set at pre-compile, default-value=false  # Pre-processor switch for enabling version info API support.
  module definition J1939Rm [0..1]: post-build-variant-support=true, variants link-time/post-build/pre-compile  # Configuration of the J1939 Request Manager.
    container J1939RmConfigSet  # This container contains the configuration parameters and sub containers of the AUTOSAR J1939Rm module.
      container J1939RmChannel [1..*]: multiplicity set at link in variant link-time / post-build in variant post-build / pre-compile in variant pre-compile, post-build-variant-multiplicity=true  # Contains the parameters for a CAN channel supported by the J1939 Request Manager.
        integer J1939RmAckQueueSize: 0..255, set at link in variant link-time+post-build / pre-compile in variant pre-compile  # Number of transmitted Acknowledgement messages that can be stored.
        integer J1939RmRequestQueue2Size: 0..255, set at link in variant link-time+post-build / pre-compile in variant pre-compile  # Number of transmitted Request2 messages that can be stored.
        integer J1939RmRequestQueueSize: 0..255, set at link in variant link-time+post-build / pre-compile in variant pre-compile  # Number of transmitted Request messages that can be stored.
        integer J1939RmRequestTimeoutMonitors: 0..255, set at link in variant link-time+post-build / pre-compile in variant pre-compile  # Number of transmitted requests that can be monitored for timeout.
        reference J1939RmComMNetworkHandleRef: set at link in variant link-time+post-build / pre-compile in variant pre-compile, requires-symbolic-name-value=true, destination=ComMChannel  # Reference to the channel defined by the ComMChannel providing access to the unique channel index ComMChannelId.
        container J1939RmAckmRxPdu [0..1]  # Contains the configuration of the I-PDU used to receive the Acknowledgement PG. This PDU consumes a meta data item of type CAN_ID_32.
          integer J1939RmAckmRxPduId: 0..65535, scope=ECU, set at pre-compile, symbolic-name-value=true  # The I-PDU identifier used for RxIndication from PduR.
          reference J1939RmAckmRxPduRef: set at link in variant link-time+post-build / pre-compile in variant pre-compile, destination=Pdu  # Reference to the Pdu object representing the I-PDU.
        container J1939RmAckmTxPdu [0..1]  # Contains the configuration of the I-PDU used to transmit the Acknowledgement PG. This PDU produces a meta data item of type CAN_ID_32.
          integer J1939RmAckmTxPduId: 0..65535, scope=ECU, set at pre-compile, symbolic-name-value=true  # The I-PDU identifier used for TxConfirmation from PduR.
          reference J1939RmAckmTxPduRef: set at link in variant link-time+post-build / pre-compile in variant pre-compile, destination=Pdu  # Reference to the Pdu object representing the I-PDU.
        container J1939RmRqst2RxPdu [0..1]  # Contains the configuration of the I-PDU used to receive the Request2 PG. This PDU consumes a meta data item of type CAN_ID_32.
          integer J1939RmRqst2RxPduId: 0..65535, scope=ECU, set at pre-compile, symbolic-name-value=true  # The I-PDU identifier used for RxIndication from PduR.
          reference J1939RmRqst2RxPduRef: set at link in variant link-time+post-build / pre-compile in variant pre-compile, destination=Pdu  # Reference to the Pdu object representing the I-PDU.
        container J1939RmRqst2TxPdu [0..1]  # Contains the configuration of the I-PDU used to transmit the Request2 PG. This PDU produces a meta data item of type CAN_ID_32.
          integer J1939RmRqst2TxPduId: 0..65535, scope=ECU, set at pre-compile, symbolic-name-value=true  # The I-PDU identifier used for TxConfirmation from PduR.
          reference J1939RmRqst2TxPduRef: set at link in variant link-time+post-build / pre-compile in variant pre-compile, destination=Pdu  # Reference to the Pdu object representing the I-PDU.
        container J1939RmRqstRxPdu [0..1]  # Contains the configuration of the I-PDU used to receive the Request PG. This PDU consumes a meta data item of type CAN_ID_32.
          integer J1939RmRqstRxPduId: 0..65535, scope=ECU, set at pre-compile, symbolic-name-value=true  # The I-PDU identifier used for RxIndication from PduR.
          reference J1939RmRqstRxPduRef: set at link in variant link-time+post-build / pre-compile in variant pre-compile, destination=Pdu  # Reference to the Pdu object representing the I-PDU.
        container J1939RmRqstTxPdu [0..1]  # Contains the configuration of the I-PDU used to transmit the Request PG. This PDU produces a meta data item of type CAN_ID_32.
          integer J1939RmRqstTxPduId: 0..65535, scope=ECU, set at pre-compile, symbolic-name-value=true  # The I-PDU identifier used for TxConfirmation from PduR.
          reference J1939RmRqstTxPduRef: set at link in variant link-time+post-build / pre-compile in variant pre-compile, destination=Pdu  # Reference to the Pdu object representing the I-PDU.
      container J1939RmNode [1..*]: multiplicity set at link in variant link-time / post-build in variant post-build / pre-compile in variant pre-compile, post-build-variant-multiplicity=true  # Contains the parameters for the support of a logical J1939 node (identified by an ECU address).
        reference J1939RmNmNodeRef: set at link in variant link-time+post-build / pre-compile in variant pre-compile, requires-symbolic-name-value=true, destination=J1939NmNode  # Reference to the corresponding J1939Nm node.
        reference J1939RmNodeChannelRef [1..*]: multiplicity set at link in variant link-time+post-build / pre-compile in variant pre-compile, set at link in variant link-time+post-build / pre-compile in variant pre-compile, destination=J1939RmChannel  # Reference to the channels this node has access to.
        choice container J1939RmUser [1..*]: multiplicity set at link in variant link-time / post-build in variant post-build / pre-compile in variant pre-compile, post-build-variant-multiplicity=true  # Contains the configuration of a module that uses the request and acknowledgement interfaces of J1939Rm.
          container J1939RmCddUser [0..1]: multiplicity set at pre-compile  # J1939Rm User representing a complex driver (CDD). CDDs may use all services provided by J1939Rm.
            boolean J1939RmUserAckIndication: set at pre-compile  # Enable AckIndication for this module. In case of CDD, the name is <apiServicePrefix>_AckIndication. In case of RTE, the operation AckIndication of the required port J1939Rm_AckIndication_{user} is called.
            integer J1939RmUserAckPGN [0..*]: 0..262143, multiplicity set at pre-compile, set at pre-compile  # PGN supported to be acknowledged to this module. The PGNs supported by different modules should usually be disjunctive.
            integer J1939RmUserId [0..1]: 0..65535, scope=ECU, multiplicity set at pre-compile, set at pre-compile, symbolic-name-value=true  # Identifier used by a module using J1939Rm. This parameter is only required when the module uses transmission of requests or acknowledgements.
            boolean J1939RmUserRequestIndication: set at pre-compile  # Enable RequestIndication for this module. In case of J1939Nm or J1939Dcm, the name is fixed. In case of CDD, the name is <apiServicePrefix>_RequestIndication. In case of RTE, J1939Rm will call the operation RequestIndication of the required port J1939Rm_RequestIndication_{user}.
            integer J1939RmUserRequestPGN [0..*]: 0..262143, multiplicity set at pre-compile, set at pre-compile  # PGN supported to be requested from this module. The PGNs supported by different modules should usually be disjunctive.
            boolean J1939RmUserSendAck: set at pre-compile  # Enable the SendAck API for this module. In case of RTE, the operation SendAck of the provided port J1939Rm_SendAck_{user} is called.
            boolean J1939RmUserSendRequest: set at pre-compile  # Enable the SendRequest API for this module. In case of RTE, the operation SendRequest of the provided port J1939Rm_SendRequest_{user} is called.
            boolean J1939RmUserTimeoutSupervision: set at pre-compile  # Enable RequestTimeoutIndication and CancelRequestTimeout for this module. | RequestTimeoutIndication: In case of CDD, the name is <apiServicePrefix>_RequestTimeoutIndication. In case of RTE, the operation RequestTimeoutIndication of the required port J1939Rm_RequestTimeoutIndication_{user} is called. CancelRequestTimeout: In case of RTE, the operation CancelRequestTimeout of the provided port J1939Rm_CancelRequestTimeout_{user} is called.
            foreign reference J1939RmUserCddRef: set at pre-compile, destination-type=ECUC-MODULE-CONFIGURATION-VALUES  # Reference to the CDD module description.
          container J1939RmComUser [0..1]: multiplicity set at link in variant link-time / post-build in variant post-build / pre-compile in variant pre-compile, post-build-variant-multiplicity=true  # J1939Rm User representing AUTOSAR COM. Supports requests for COM I-PDUs.
            container J1939RmComIPdu [0..*]: multiplicity set at link in variant link-time / post-build in variant post-build / pre-compile in variant pre-compile, post-build-variant-multiplicity=true  # Contains the configuration of an I-PDU that is to be transmitted on request by COM.
              integer J1939RmComIPduExtId1 [0..1]: 0..255, multiplicity set at link in variant link-time / post-build in variant post-build / pre-compile in variant pre-compile, post-build-variant-multiplicity=true, post-build-variant-value=true, set at link in variant link-time / post-build in variant post-build / pre-compile in variant pre-compile  # First extended identifier byte of the COM I-PDU.
              integer J1939RmComIPduExtId2 [0..1]: 0..255, multiplicity set at link in variant link-time / post-build in variant post-build / pre-compile in variant pre-compile, post-build-variant-multiplicity=true, post-build-variant-value=true, set at link in variant link-time / post-build in variant post-build / pre-compile in variant pre-compile  # Second extended identifier byte of the COM I-PDU.
              integer J1939RmComIPduExtId3 [0..1]: 0..255, multiplicity set at link in variant link-time / post-build in variant post-build / pre-compile in variant pre-compile, post-build-variant-multiplicity=true, post-build-variant-value=true, set at link in variant link-time / post-build in variant post-build / pre-compile in variant pre-compile  # Third extended identifier byte of the COM I-PDU.
              integer J1939RmComIPduPGN: 0..262143, post-build-variant-value=true, set at link in variant link-time / post-build in variant post-build / pre-compile in variant pre-compile  # PGN of the COM I-PDU.
              reference J1939RmComIPduRef: set at link in variant link-time / post-build in variant post-build / pre-compile in variant pre-compile, destination=Pdu  # Reference to the Pdu object representing the I-PDU.
          container J1939RmDcmUser [0..1]: multiplicity set at link in variant link-time / post-build in variant post-build / pre-compile in variant pre-compile, post-build-variant-multiplicity=true  # J1939Rm User representing the J1939Dcm. Requires request indication and transmission of acknowledgement.
            integer J1939RmUserId: 0..65535, scope=ECU, set at pre-compile, symbolic-name-value=true  # Identifier used by J1939Dcm when calling J1939Rm_SendAck.
            integer J1939RmUserRequestPGN [0..*]: 0..262143, multiplicity set at link in variant link-time / post-build in variant post-build / pre-compile in variant pre-compile, post-build-variant-multiplicity=true, post-build-variant-value=true, set at link in variant link-time / post-build in variant post-build / pre-compile in variant pre-compile  # PGN of DMx PG supported by J1939Dcm.
          container J1939RmNmUser [0..1]: multiplicity set at link in variant link-time / post-build in variant post-build / pre-compile in variant pre-compile, post-build-variant-multiplicity=true  # J1939Rm User representing the J1939Nm. Requires request indication.
          container J1939RmRteUser [0..1]: multiplicity set at pre-compile  # J1939Rm User representing an application software component (SW-C). SW-Cs may use all services provided by the J1939Rm via service ports.
            boolean J1939RmUserAckIndication: set at pre-compile  # Enable AckIndication for this module. In case of CDD, the name is <apiServicePrefix>_AckIndication. In case of RTE, the operation AckIndication of the required port J1939Rm_AckIndication_{user} is called.
            integer J1939RmUserAckPGN [0..*]: 0..262143, multiplicity set at pre-compile, set at pre-compile  # PGN supported to be acknowledged to this module. The PGNs supported by different modules should usually be disjunctive.
            integer J1939RmUserId [0..1]: 0..65535, scope=ECU, multiplicity set at pre-compile, set at pre-compile, symbolic-name-value=true  # Identifier used by a module using J1939Rm. This parameter is only required when the module uses transmission of requests or acknowledgements.
            boolean J1939RmUserRequestIndication: set at pre-compile  # Enable RequestIndication for this module. In case of J1939Nm or J1939Dcm, the name is fixed. In case of CDD, the name is <apiServicePrefix>_RequestIndication. In case of RTE, J1939Rm will call the operation RequestIndication of the required port J1939Rm_RequestIndication_{user}.
            integer J1939RmUserRequestPGN [0..*]: 0..262143, multiplicity set at pre-compile, set at pre-compile  # PGN supported to be requested from this module. The PGNs supported by different modules should usually be disjunctive.
            boolean J1939RmUserSendAck: set at pre-compile  # Enable the SendAck API for this module. In case of RTE, the operation SendAck of the provided port J1939Rm_SendAck_{user} is called.
            boolean J1939RmUserSendRequest: set at pre-compile  # Enable the SendRequest API for this module. In case of RTE, the operation SendRequest of the provided port J1939Rm_SendRequest_{user} is called.
            boolean J1939RmUserTimeoutSupervision: set at pre-compile  # Enable RequestTimeoutIndication and CancelRequestTimeout for this module. | RequestTimeoutIndication: In case of CDD, the name is <apiServicePrefix>_RequestTimeoutIndication. In case of RTE, the operation RequestTimeoutIndication of the required port J1939Rm_RequestTimeoutIndication_{user} is called. CancelRequestTimeout: In case of RTE, the operation CancelRequestTimeout of the provided port J1939Rm_CancelRequestTimeout_{user} is called.
    container J1939RmGeneral  # Contains the general configuration parameters of the module.
      boolean J1939RmDevErrorDetect: set at pre-compile, default-value=false  # Switches the development error detection and notification on or off. | * true: detection and notification is enabled. * false: detection and notification is disabled.
      boolean J1939RmGatewaySupport: set at pre-compile  # Enables/disables support for routing Request and Acknowledgement messages.
      float J1939RmMainFunctionPeriod: 0..INF, scope=ECU, set at link in variant link-time+post-build / pre-compile in variant pre-compile  # Execution cycle of J1939Rm_MainFunction in seconds.
      boolean J1939RmSupportAckIndication: set at pre-compile  # Pre-processor switch for enabling support of acknowledgement indications.
      boolean J1939RmSupportAckTransmission: set at pre-compile  # Pre-processor switch for enabling support of acknowledgement transmission.
      boolean J1939RmSupportRequest2: set at pre-compile  # Pre-processor switch for enabling support of the Request2 PG. | Please note: Transfer is not supported.
      boolean J1939RmSupportRequestIndication: set at pre-compile  # Pre-processor switch for enabling support of request indications.
      boolean J1939RmSupportRequestTransmission: set at pre-compile  # Pre-processor switch for enabling support of request transmission.
      boolean J1939RmSupportTimeoutSupervision: set at pre-compile  # Pre-processor switch for enabling support of request timeout supervision.
      boolean J1939RmVersionInfoApi: set at pre-compile, default-value=false  # Pre-processor switch for enabling version info API support.
  module definition J1939Tp [0..1]: post-build-variant-support=true, variants link-time/post-build/pre-compile  # Configuration of the J1939Tp (J1939 Transport Protocol) module.
    container J1939TpConfiguration  # This container contains the configuration parameters and sub containers of the J1939Tp module that define the communication paths.
      container J1939TpRxChannel [0..*]  # This container describes a reception channel of the J1939Tp module. A channel referencing N-PDUs without MetaData is used for all N-SDUs that share the same source address (SA) and the same destination address (BAM: DA = 0xFF, CMDT: DA != 0xFF). A channel with N-PDUs with MetaData is used for all possible source and destination addresses.
        boolean J1939TpRxCancellationSupport [0..1]: multiplicity set at pre-compile, set at pre-compile, default-value=false  # Enable receive cancellation using the API J1939Tp_CancelReceive() for this channel.
        integer J1939TpRxDa [0..1]: 0..253, multiplicity set at link in variant link-time / post-build in variant post-build / pre-compile in variant pre-compile, post-build-variant-multiplicity=true, post-build-variant-value=true, set at link in variant link-time / post-build in variant post-build / pre-compile in variant pre-compile  # Destination address (DA) of this channel. This parameter is only required for channels with fixed DA which use N-PDUs with MetaData containing the DA.
        boolean J1939TpRxDynamicBlockCalculation [0..1]: multiplicity set at pre-compile, set at pre-compile, default-value=false  # Enable dynamic calculation of "number of packets that can be sent" value in TP.CM_CTS, based on the size of buffers in upper layers reported via StartOfReception and PduR_J1939TpCopyRxData.
        integer J1939TpRxDynamicBufferRatio [0..1]: 0..100, multiplicity set at pre-compile, set at pre-compile, default-value=80  # Percentage of available buffer that shall be used for retry. | This parameter is only applicable when "J1939TpRxRetrySupport" and "J1939TpRxDynamicBlockCalculation" are enabled.
        integer J1939TpRxPacketsPerBlock [0..1]: 1..255, multiplicity set at pre-compile, set at pre-compile, default-value=16  # Number of TP.DT frames the receiving J1939Tp module allows the sender to send before waiting for another TP.CM_CTS. This parameter is transmitted in the TP.CM_CTS frame, and is thus only relevant for reception of messages via CMDT. When J1939TpRxDynamicBlockCalculation is enabled, this parameter specifies a maximum for the calculated value. For further details on this parameter value see SAE J1939/21.
        enumeration J1939TpRxProtocolType [0..1]: {J1939TP_PROTOCOL_BAM, J1939TP_PROTOCOL_CMDT}, multiplicity set at pre-compile, set at pre-compile  # Protocol type used by this channel. This parameter is only required for channels with fixed destination address.
        boolean J1939TpRxRetrySupport [0..1]: multiplicity set at pre-compile, set at pre-compile, default-value=false  # Enable support for triggering repetition of failed transmission using TP.CM_CTS with a packet number that has already been sent. Retransmission is triggered when a sequence number is missing or a timeout occurs during reception.
        integer J1939TpRxSa [0..1]: 0..253, multiplicity set at link in variant link-time / post-build in variant post-build / pre-compile in variant pre-compile, post-build-variant-multiplicity=true, post-build-variant-value=true, set at link in variant link-time / post-build in variant post-build / pre-compile in variant pre-compile  # Source address (SA) of this channel. This parameter is only required for channels with fixed SA which use N-PDUs with MetaData containing the SA.
        container J1939TpRxCmNPdu  # This N-PDU represents the TP.CM frame of a J1939 transport protocol session. TP.CM is used both by BAM and CMDT to initialize the connection. For CMDT, it is also used to abort the connection. This N-PDU consumes a meta data item of type CAN_ID_32.
          integer J1939TpRxCmNPduId: 0..65535, scope=ECU, set at pre-compile, symbolic-name-value=true  # The N-PDU identifier used for communication with CanIf.
          reference J1939TpRxCmNPduRef: post-build-variant-value=true, set at link in variant link-time / post-build in variant post-build / pre-compile in variant pre-compile, destination=Pdu  # Reference to the Pdu object representing the N-PDU.
        container J1939TpRxDtNPdu  # This N-PDU represents the TP.DT frame of a J1939 transport protocol session. TP.DT is used both by BAM and CMDT to transfer the contents of an N-SDU. This N-PDU consumes a meta data item of type CAN_ID_32.
          integer J1939TpRxDtNPduId: 0..65535, scope=ECU, set at pre-compile, symbolic-name-value=true  # The N-PDU identifier used for communication with CanIf.
          reference J1939TpRxDtNPduRef: post-build-variant-value=true, set at link in variant link-time / post-build in variant post-build / pre-compile in variant pre-compile, destination=Pdu  # Reference to the Pdu object representing the N-PDU.
        container J1939TpRxPg [1..*]  # Parameter group received by the J1939 transport layer.
          boolean J1939TpRxPgDynLength: set at pre-compile  # This flag is set to TRUE when the N-SDU refers to a PGN with variable length. | Please note: When this attribute is TRUE, the sub container J1939TpRxDirectNPdu is required.
          integer J1939TpRxPgPGN: 0..262143, set at pre-compile  # PGN of the referenced N-SDUs.
          container J1939TpRxDirectNPdu [0..1]  # This N-PDU represents the short frame that is used for a dynamic length PGN when it has a length of less that 8 bytes. This N-PDU consumes a meta data item of type CAN_ID_32. | Please note: This sub container is only necessary when J1939TpRxPgDynLength is TRUE.
            integer J1939TpRxDirectNPduId: 0..65535, scope=ECU, set at pre-compile, symbolic-name-value=true  # The N-PDU identifier used for communication with CanIf.
            reference J1939TpRxDirectNPduRef: post-build-variant-value=true, set at link in variant link-time / post-build in variant post-build / pre-compile in variant pre-compile, destination=Pdu  # Reference to the Pdu object representing the N-PDU.
          container J1939TpRxNSdu [1..*]  # This container describes the parameters that are relevant for the reception of a specific N-SDU. This N-SDU produces meta data items of type SOURCE_ADDRESS_16, TARGET_ADDRESS_16, and PRIORITY_8.
            integer J1939TpRxNSduId: 0..65535, scope=ECU, set at pre-compile, symbolic-name-value=true  # This is a unique identifier for a received N-SDU. This Id is used in the CancelReceive and ChangeParameter API call.
            reference J1939TpRxNSduRef: post-build-variant-value=true, set at link in variant link-time / post-build in variant post-build / pre-compile in variant pre-compile, destination=Pdu  # Reference to the Pdu object representing the N-SDU.
        container J1939TpTxFcNPdu [0..1]  # This N-PDU represents the TP.CM frame that is used in reverse direction for a J1939 transport protocol session using the CMDT protocol type. TP.CM in reverse direction is used for intermediate and final acknowledgement of received data and to abort the connection. This N-PDU produces a meta data item of type CAN_ID_32. | Please note: This sub container is only required when J1939TpRxProtocolType is J1939TP_PROTOCOL_CMDT or when it is not configured at all.
          integer J1939TpTxFcNPduTxConfId: 0..65535, scope=ECU, set at pre-compile, symbolic-name-value=true  # The N-PDU identifier used for Tx confirmation from CanIf.
          reference J1939TpTxFcNPduRef: post-build-variant-value=true, set at link in variant link-time / post-build in variant post-build / pre-compile in variant pre-compile, destination=Pdu  # Reference to the Pdu object representing the N-PDU. | Please note: When two channels have identical but exchanged source and destination addresses, the Pdu referenced by this parameter is shared with J1939TpTxCmNPduRef of the corresponding J1939TpTxChannel.
      container J1939TpTxChannel [0..*]  # This container describes a transmission channel of the J1939Tp module. A channel referencing N-PDUs without MetaData is used for all N-SDUs that share the same source address (SA) and the same destination address (BAM: DA = 0xFF, CMDT: DA != 0xFF). A channel with N-PDUs with MetaData is used for all possible source and destination addresses.
        boolean J1939TpTxCancellationSupport [0..1]: multiplicity set at pre-compile, set at pre-compile, default-value=false  # Enable transmit cancellation using the API J1939Tp_CancelTransmit() for this channel.
        integer J1939TpTxDa [0..1]: 0..253, multiplicity set at link in variant link-time / post-build in variant post-build / pre-compile in variant pre-compile, post-build-variant-multiplicity=true, post-build-variant-value=true, set at link in variant link-time / post-build in variant post-build / pre-compile in variant pre-compile  # Destination address (DA) of this channel. This parameter is only required for channels with fixed DA which use N-PDUs with MetaData containing the DA.
        boolean J1939TpTxDynamicBlockCalculation [0..1]: multiplicity set at pre-compile, set at pre-compile, default-value=false  # Enable dynamic calculation of "maximum number of packets that can be sent" value in TP.CM_RTS, based on the available amount of data in upper layers reported via PduR_J1939TpCopyTxData.
        integer J1939TpTxMaxPacketsPerBlock [0..1]: 1..255, multiplicity set at pre-compile, set at pre-compile, default-value=255  # Maximum number of TP.DT frames the transmitting J1939Tp module is ready to send before waiting for another TP.CM_CTS. This parameter is transmitted in the TP.CM_RTS frame, and is thus only relevant for transmission of messages via CMDT. When J1939TpTxDynamicBlockCalculation is enabled, this parameter specifies a maximum for the calculated value. For further details on this parameter value see SAE J1939/21.
        enumeration J1939TpTxProtocolType [0..1]: {J1939TP_PROTOCOL_BAM, J1939TP_PROTOCOL_CMDT}, multiplicity set at pre-compile, set at pre-compile  # Protocol type used by this channel. This parameter is only required for channels with fixed destination address.
        boolean J1939TpTxRetrySupport [0..1]: multiplicity set at pre-compile, set at pre-compile, default-value=false  # Enable support for repetition of failed transmission using TP.CM_CTS with a packet number that has already been sent. Retransmission is handled via the retry feature of PduR_J1939TpCopyTxData.
        integer J1939TpTxSa [0..1]: 0..253, multiplicity set at link in variant link-time / post-build in variant post-build / pre-compile in variant pre-compile, post-build-variant-multiplicity=true, post-build-variant-value=true, set at link in variant link-time / post-build in variant post-build / pre-compile in variant pre-compile  # Source address (SA) of this channel. This parameter is only required for channels with fixed SA which use N-PDUs with MetaData containing the SA.
        container J1939TpRxFcNPdu [0..1]  # This N-PDU represents the TP.CM frame that is used in reverse direction for a J1939 transport protocol session using the CMDT protocol type. TP.CM in reverse direction is used for intermediate and final acknowledgement of received data and to abort the connection. This N-PDU consumes a meta data item of type CAN_ID_32. | Please note: This sub container is only required when J1939TpTxProtocolType is J1939TP_PROTOCOL_CMDT or when it is not configured at all.
          integer J1939TpRxFcNPduId: 0..65535, scope=ECU, set at pre-compile, symbolic-name-value=true  # The N-PDU identifier used for communication with CanIf.
          reference J1939TpRxFcNPduRef: post-build-variant-value=true, set at link in variant link-time / post-build in variant post-build / pre-compile in variant pre-compile, destination=Pdu  # Reference to the Pdu object representing the N-PDU. | Please note: When two channels have identical but exchanged source and destination addresses, the Pdu referenced by this parameter is shared with J1939TpRxCmNPduRef of the corresponding J1939TpRxChannel.
        container J1939TpTxCmNPdu  # This N-PDU represents the TP.CM frame of a J1939 transport protocol session. TP.CM is used both by BAM and CMDT to initialize the connection. For CMDT, it is also used to abort the connection. This N-PDU produces a meta data item of type CAN_ID_32.
          integer J1939TpTxCmNPduTxConfId: 0..65535, scope=ECU, set at pre-compile, symbolic-name-value=true  # The N-PDU identifier used for Tx confirmation from CanIf.
          reference J1939TpTxCmNPduRef: post-build-variant-value=true, set at link in variant link-time / post-build in variant post-build / pre-compile in variant pre-compile, destination=Pdu  # Reference to the Pdu object representing the N-PDU.
        container J1939TpTxDtNPdu  # This N-PDU represents the TP.DT frame of a J1939 transport protocol session. TP.DT is used both by BAM and CMDT to transfer the contents of an N-SDU. This N-PDU produces a meta data item of type CAN_ID_32.
          integer J1939TpTxDtNPduTxConfId: 0..65535, scope=ECU, set at pre-compile, symbolic-name-value=true  # The N-PDU identifier used for Tx confirmation from CanIf.
          reference J1939TpTxDtNPduRef: post-build-variant-value=true, set at link in variant link-time / post-build in variant post-build / pre-compile in variant pre-compile, destination=Pdu  # Reference to the Pdu object representing the N-PDU.
        container J1939TpTxPg [1..*]  # Parameter group transmitted by the J1939 transport layer.
          boolean J1939TpTxPgDynLength: set at pre-compile  # This flag is set to TRUE when the N-SDU refers to a PGN with variable length. | Please note: When this attribute is TRUE, the sub container J1939TpTxDirectNPdu is required.
          integer J1939TpTxPgPGN: 0..262143, set at pre-compile  # PGN of the referenced N-SDUs.
          container J1939TpTxDirectNPdu [0..1]  # This N-PDU represents the short frame that is used for a dynamic length PGN when it has a length of less that 8 bytes. This N-PDU produces a meta data item of type CAN_ID_32. | Please note: This sub container is only necessary when J1939TpTxPgDynLength is TRUE.
            integer J1939TpTxDirectNPduTxConfId: 0..65535, scope=ECU, set at pre-compile, symbolic-name-value=true  # The N-PDU identifier used for Tx confirmation from CanIf.
            reference J1939TpTxDirectNPduRef: post-build-variant-value=true, set at link in variant link-time / post-build in variant post-build / pre-compile in variant pre-compile, destination=Pdu  # Reference to the Pdu object representing the N-PDU.
          container J1939TpTxNSdu [1..*]  # This container describes the parameters that are relevant for the transmission of a specific N-SDU. This N-SDU consumes meta data items of type SOURCE_ADDRESS_16, TARGET_ADDRESS_16, and PRIORITY_8.
            integer J1939TpTxNSduId: 0..65535, scope=ECU, set at pre-compile, symbolic-name-value=true  # The N-SDU identifier used for communication with PduR.
            reference J1939TpTxNSduRef: post-build-variant-value=true, set at link in variant link-time / post-build in variant post-build / pre-compile in variant pre-compile, destination=Pdu  # Reference to the Pdu object representing the N-SDU.
    container J1939TpGeneral  # This container describes the general configuration parameters of the J1939Tp module.
      boolean J1939TpCancellationSupport [0..1]: multiplicity set at pre-compile, set at pre-compile, default-value=false  # Enable transmit and receive cancellation. | The APIs J1939Tp_CancelTransmit() and J1939Tp_CancelReceive() will only be available when this parameter is enabled.
      boolean J1939TpDevErrorDetect: set at pre-compile, default-value=false  # Switches the development error detection and notification on or off. | * true: detection and notification is enabled. * false: detection and notification is disabled.
      float J1939TpMainFunctionPeriod: 0..INF, scope=ECU, set at pre-compile  # Allow to configure the time for the MainFunction (in seconds). | Please note: This configuration value shall be equal to the value in the ScheduleManager module.
      boolean J1939TpVersionInfoApi: set at pre-compile, default-value=false  # The function J1939Tp_GetVersionInfo is configurable (On/Off) by this configuration parameter.
  module definition KeyM [0..1]: post-build-variant-support=true, variants post-build/pre-compile  # Configuration of the Mcu (Microcontroller Unit) module.
    container KeyMCertificate [0..65535]  # This container contains the certificate configuration.
      enumeration KeyMCertAlgorithmType: {ECC, RSA}, set at pre-compile  # Specify in which format the certificate will be provided.
      enumeration KeyMCertFormatType: {CRL, CVC, X509}, set at pre-compile  # Specify in which format the certificate will be provided.
      integer KeyMCertificateId: 0..65535, set at pre-compile, symbolic-name-value=true  # Identifier of the certificate. The set of configured identifiers shall be consecutive and gapless.
      integer KeyMCertificateMaxLength: 1..65535, set at pre-compile  # Specify the maximum length in bytes of the certificate.
      string KeyMCertificateName: set at pre-compile  # Provides a unique name of the certificate for identification. The certificate provisional will reference certificates by this unique name.
      enumeration KeyMCertificateStorage: {KEYM_STORAGE_IN_CSM, KEYM_STORAGE_IN_NVM, KEYM_STORAGE_IN_RAM}, multiplicity set at pre-compile, set at pre-compile  # Specify the storage location of the certificate.
      function name KeyMCertificateVerifyCallbackNotificationFunc [0..1]: multiplicity set at pre-compile, set at pre-compile  # This parameter provides the function name for the callback <KeyM_CertificateVerifyCallbackNotification>. It indicates if a certificate verification operation was finished and provides its status. If this parameter is omitted, no callback will be provided.
      function name KeyMServiceCertificateCallbackNotificationFunc [0..1]: multiplicity set at pre-compile, set at pre-compile  # This parameter provides the function name for the service certificate callback <KeyM_ServiceCertificateCallbackNotification>. It indicates if a certificate service operation was finished and provides its status. If this parameter is not set, no callback will be provided.
      reference KeyMCertCertificateElementRuleRef [0..65535]: multiplicity set at pre-compile, set at pre-compile, destination=KeyMCertificateElementRule  # Reference to certificate element rules which should be verified within the certification validation step.
      reference KeyMCertCsmSignatureGenerateJobRef [0..1]: set at pre-compile, requires-symbolic-name-value=true, destination=CsmJob  # Reference to a CSM job to calculate a signature
      reference KeyMCertCsmSignatureVerifyJobRef: set at pre-compile, requires-symbolic-name-value=true, destination=CsmJob  # Reference to the CSM job that is used to verify the signature
      reference KeyMCertCsmSignatureVerifyKeyRef: multiplicity set at pre-compile, set at pre-compile, requires-symbolic-name-value=true, destination=CsmKey  # Reference to the CSM key associated to the CSM signature verify job. | The Public Key of this certificate shall be set to the key element (CRYPTO_KE_SIGNATURE_KEY) where the key references to.
      reference KeyMCertificateCsmKeyTargetRef [0..1]: multiplicity set at pre-compile, set at pre-compile, requires-symbolic-name-value=true, destination=CsmKey  # Defines a reference to the associated CSM key where the certificate shall be stored to.
      reference KeyMCertificateNvmBlockRef [0..1]: multiplicity set at pre-compile, set at pre-compile, destination=KeyMNvmBlock  # Defines a reference to the NvMblock where the certificate is going to be stored.
      reference KeyMCertPrivateKeyStorageCryptoKeyRef [0..1]: multiplicity set at pre-compile, set at pre-compile, destination=KeyMCryptoKey  # Defines a storage location of the private key of a certificate.
      reference KeyMCertTimebaseRef: set at pre-compile, requires-symbolic-name-value=true, destination=StbMSynchronizedTimeBase  # This is a reference to an StbM time base to validate the validity period. Alternatively, KeyMCertificateElementVerification with the KeyMCertificateElement of CertificateValidityPeriodNotBefore or CertificateValidityPeriodNotAfter could be used.
      reference KeyMCertUpperHierarchicalCertRef: set at pre-compile, destination=KeyMCertificate  # Identifier of the certificate that is the next higher in the PKI hierarchical structure. The reference points to itself for root certificates.
      container KeyMCertificateElement [0..65535]  # This container contains the certificate element configuration.
        boolean KeyMCertificateElementHasIteration: set at pre-compile, default-value=false  # Defines if the certificate element can occur more than one time. If so, the iterator can be used to retrieve the individual data values of this certificate element.
        integer KeyMCertificateElementId: 0..65535, set at pre-compile, symbolic-name-value=true  # Identifier of a certificate element.
        integer KeyMCertificateElementMaxLength: 1..65535, set at pre-compile  # Maximum length in bytes
        string KeyMCertificateElementObjectId [0..1]: multiplicity set at pre-compile, set at pre-compile  # This is the object identifier (OID) that is used to identify the certificate element within its element structure.
        integer KeyMCertificateElementObjectType [0..1]: 0..255, set at pre-compile  # Certificate elements are stored in ASN.1 format. In this item the type of ASN.1 TLV can be specified (e.g. INTEGER has the value '2'). This can be used to identify only such certificate elements. If the type is different, the element is not included in the search. | If KeyMCertificateElementObjectType is not specified, any ASN.1 encoding datatype is used to read the value.
        enumeration KeyMCertificateElementOfStructure: {CertificateExtension, CertificateIssuerName, CertificateIssuerUniqueIdentifier, CertificateSerialNumber, CertificateSignature, CertificateSignatureAlgorithm, CertificateSignatureAlgorithmID, CertificateSubjectAuthorization, CertificateSubjectName, CertificateSubjectPublicKeyInfo_PublicKeyAlgorithm, CertificateSubjectPublicKeyInfo_SubjectPublicKey, CertificateSubjectUniqueIdentifier, CertificateValidityPeriodNotAfter, CertificateValidityPeriodNotBefore, CertificateVersionNumber, RevokedCertificates}, set at pre-compile  # This defines in which structure the certificate element is located.
    container KeyMCertificateElementVerification [0..65535]  # This container defines if and how certificate elements are to be verified.
      container KeyMCertificateElementCondition [1..*]  # This container contains the configuration of KeyElement compare conditions which can be used as arguments for a KeyMCertificateElementRule. | One KeyMCertificateElementCondition shall contain either one KeyMCertificateElementSwcCallback or one KeyMCertificateElementSwcSRDataElementRef or one KeyMCertificateElementSwcSRDataElementValueRef.
        enumeration KeyMCertElementConditionType: {KEYM_EQUALS, KEYM_EQUALS_NOT, KEYM_GREATER_OR_EQUAL, KEYM_LESS_OR_EQUAL, KEYM_LESS_THAN}, set at pre-compile  # This parameter specifies what kind of comparison that is made for the evaluation of the mode condition.
        reference KeyMCertificateElementRef [0..1]: multiplicity set at pre-compile, set at pre-compile, destination=KeyMCertificateElement  # Reference to a certificate element used for the condition.
        container KeyMCertificateElementConditionValue  # This container contains the configuration of a compare value.
          container KeyMCertificateElementConditionArray [0..1]  # This container contains the configuration of a array compare value.
            container KeyMCertificateElementConditionArrayElement [0..*]  # This container contains the configuration of a array compare value.
              integer KeyMCertificateElementConditionArrayElementIndex: 0..65535, set at pre-compile  # Index to an element of the compare value array.
              integer KeyMCertificateElementConditionArrayElementValue: 0..18446744073709551615, set at pre-compile  # Value of an array element compare value.
          container KeyMCertificateElementConditionCerificateElement [0..1]  # This container contains the configuration of a certificate element as a compare value.
            reference KeyMCertificateElementRef: set at pre-compile, destination=KeyMCertificateElement  # Reference to another certificate element.
          container KeyMCertificateElementConditionPrimitive [0..1]  # This container contains the configuration of a primitive compare value.
            integer KeyMCertificateElementConditionPrimitiveValue: 0..18446744073709551615, set at pre-compile  # Primitive compare value
          container KeyMCertificateElementConditionSenderReceiver [0..1]  # This container contains the configuration of a dynamic compare value in a sender-/receiver interface.
            instance reference KeyMCertificateElementConditionSenderReceiver: set at pre-compile, destination-context=ROOT-SW-COMPOSITION-PROTOTYPE SW-COMPONENT-PROTOTYPE PORT-PROTOTYPE, destination-type=AUTOSAR-DATA-PROTOTYPE  # This parameter references a mode in a particular mode request port of a software component that is used for the condition.
      container KeyMCertificateElementRule [1..*]  # This container contains the configuration of a mode rule which represents a logical expression with KeyMCertificateElementCondition or other KeyMCertificateElementRule as arguments. | All arguments are processed with the operator defined by KeyMLogicalOperator, for instance: Argument_A AND Argument_B AND Argument_C.
        enumeration KeyMLogicalOperator [0..1]: {KEYM_AND, KEYM_OR}, set at pre-compile  # This parameter specifies the logical operator to be used in the logical expression. If the expression only consists of a single condition this parameter shall not be used.
        choice reference KeyMArgumentRef [1..*]: multiplicity set at pre-compile, set at pre-compile, destination=[KeyMCertificateElementCondition, KeyMCertificateElementRule]  # This is a choice reference either to a condition or another rule serving as sub-expression.
    container KeyMCryptoKey [0..65535]  # This container contains the crypto keys that can be updated.
      enumeration KeyMCryptoCsmVerifyJobType [0..1]: {KEYM_VERIFY_AEADDECRYPT, KEYM_VERIFY_AEADENCRYPT, KEYM_VERIFY_DECRYPT, KEYM_VERIFY_ENCRYPT, KEYM_VERIFY_MACGENERATE, KEYM_VERIFY_MACVERIFY}, set at pre-compile  # Specifies what type of function for key verification operation is used.
      string KeyMCryptoKeyCryptoProps [0..1]: multiplicity set at pre-compile, set at pre-compile  # If set, it will provide additional hints to the crypto key that is used by KeyM to identify the key. | Typical approach is to set the value to the SHE-Slot ID where the key was placed to. If present, the KeyM will take the information and identify the key by its slot ID. The slot information will be extracted from the corresponding field of the M1M2M3 data.
      string KeyMCryptoKeyGenerationInfo [0..1]: multiplicity set at pre-compile, set at pre-compile  # This data may contain static data for key derivation. If a key is configured to be derived from another key and this configuration item is set, the data will be added as salt.
      enumeration KeyMCryptoKeyGenerationType: {KEYM_DERIVED_KEY, KEYM_STORED_KEY}, set at pre-compile  # Specifies how the CryptoKey will be generated. If it is derived from another key or simply stored with KeyElementSet.
      integer KeyMCryptoKeyId: 0..65535, set at pre-compile, symbolic-name-value=true  # Identifier of the crypto key. The set of configured identifiers shall be consecutive and gapless.
      integer KeyMCryptoKeyMaxLength: 1..4294967295, set at pre-compile  # The maximum size in bytes of a CryptoKey.
      string KeyMCryptoKeyName: set at pre-compile  # Provides a unique name of the key for identification. The key master will reference keys by this unique key name.
      enumeration KeyMCryptoKeyStorage: {KEYM_STORAGE_IN_CSM, KEYM_STORAGE_IN_NVM, KEYM_STORAGE_IN_RAM}, set at pre-compile  # Specify the storage location of the certificate.
      reference KeyMCryptoKeyCsmKeySourceDeriveRef [0..1]: multiplicity set at pre-compile, set at pre-compile, requires-symbolic-name-value=true, destination=CsmKey  # Defines a reference to the associated CSM key that is used as source for the key derivation of this key.
      reference KeyMCryptoKeyCsmKeyTargetRef: set at pre-compile, requires-symbolic-name-value=true, destination=CsmKey  # Defines a reference to the associated CSM key that shall be generated.
      reference KeyMCryptoKeyCsmVerifyJobRef [0..1]: multiplicity set at pre-compile, set at pre-compile, requires-symbolic-name-value=true, destination=CsmJob  # Defines the crypto job that the key verify function can use for verification of a certain key.
      reference KeyMCryptoKeyNvmBlockRef [0..1]: multiplicity set at pre-compile, set at pre-compile, destination=KeyMNvmBlock  # Defines a reference to the NvM block where the key is going to be stored.
    container KeyMGeneral  # This container holds general configuration (parameters) for key manager.
      integer KeyMCertificateChainMaxDepth: 1..255, set at pre-compile  # Maximum number of certificates defined in a certificate chain.
      boolean KeyMCertificateManagerEnabled: set at pre-compile, default-value=false  # Enables (TRUE) or disables (FALSE) the part that manages certificates.
      boolean KeyMCryptoKeyHandlerPrepareEnabled: set at pre-compile, default-value=false  # Enables (TRUE) or disables (FALSE) the key handler prepare function call. If set to true, the corresponding key handler function shall be provided.
      boolean KeyMCryptoKeyHandlerServiceCertificateEnabled: set at pre-compile, default-value=false  # Enables (TRUE) or disables (FALSE) the key handler service function call. If set to true, the certificate submodule function KeyM_KH_ServiceCertificate() shall be provided.
      boolean KeyMCryptoKeyHandlerStartFinalizeEnabled: set at pre-compile, default-value=false  # Enables (TRUE) or disables (FALSE) the key handler start and finalize function call. If set to true, the key handler functions KeyM_KH_Start() and KeyM_KH_Finalize() shall be provided.
      boolean KeyMCryptoKeyHandlerUpdateEnabled: set at pre-compile, default-value=false  # Enables (TRUE) or disables (FALSE) the call to the key handler update function KeyM_KH_Update(). If set to true, the corresponding key handler function shall be provided.
      boolean KeyMCryptoKeyHandlerVerifyEnabled: set at pre-compile, default-value=false  # Enables (TRUE) or disables (FALSE) the call to the key handler verify function KeyM_KH_Verify(). If set to true, the corresponding key handler function shall be provided.
      boolean KeyMCryptoKeyManagerEnabled: set at pre-compile, default-value=false  # Enables (TRUE) or disables (FALSE) the part that manages crypto key operations.
      boolean KeyMCryptoKeyPrepareFunctionEnabled [0..1]: multiplicity set at pre-compile, set at pre-compile, default-value=false  # Enables (TRUE) or disables (FALSE) the prepare function of the key manager. If set to true, the KeyM_Prepare() function has to be called accordingly.
      boolean KeyMCryptoKeyStartFinalizeFunctionEnabled [0..1]: multiplicity set at pre-compile, set at pre-compile, default-value=false  # Enables (TRUE) or disables (FALSE) the start and Finish function of the key manager. If set to true, the KeyM_Start() and KeyM_Finalize() functions have to be called.
      boolean KeyMCryptoKeyVerifyAsyncMode [0..1]: multiplicity set at pre-compile, set at pre-compile, default-value=false  # This parameter defines if the function KeyM_Verify() runs in synchronous or asynchronous mode
      boolean KeyMCryptoKeyVerifyFunctionEnabled [0..1]: multiplicity set at pre-compile, set at pre-compile, default-value=false  # Enables (TRUE) or disables (FALSE) the verify function of the key manager. If set to true, the KeyM_Verify() function can be called.
      boolean KeyMDevErrorDetect: set at pre-compile, default-value=false  # Switches the development error detection and notification on or off. | * true: detection and notification is enabled. * false: detection and notification is disabled.
      boolean KeyMEnableSecurityEventReporting: scope=ECU, set at pre-compile, default-value=false  # Switches the reporting of security events to the IdsM: Tags: atp.Status=draft | - true: reporting is enabled. - false: reporting is disabled.
      integer KeyMKeyCertNameMaxLength: 1..255, set at pre-compile  # Maximum length in bytes of certificate or key names used for the service interface.
      float KeyMMainFunctionPeriod: 0..INF, set at pre-compile  # Specifies the period of main function KeyM_MainFunction in seconds.
      boolean KeyMServiceCertificateFunctionEnabled [0..1]: multiplicity set at pre-compile, set at pre-compile, default-value=false  # Enables (TRUE) or disables (FALSE) the certificate service function of the key manager. If set to true, the KeyM_ServiceCertificate() function has to be called accordingly.
      container KeyMSecurityEventRefs [0..1]: multiplicity set at pre-compile  # Container for the references to IdsMEvent elements representing the security events that the KeyM module shall report to the IdsM in case the coresponding security related event occurs (and if KeyMEnableSecurityEventReporting is set to "true"). The standardized security events in this container can be extended by vendor-specific security events. Tags: atp.Status=draft
        reference KEYM_SEV_CERT_VERIF_FAILED [0..1]: multiplicity set at pre-compile, set at pre-compile, requires-symbolic-name-value=true, destination=IdsMEvent  # A request to verify a certificate against a certificate chain was not successful. Tags: atp.Status=draft
        reference KEYM_SEV_INST_INTERMEDIATE_CERT_OP [0..1]: multiplicity set at pre-compile, set at pre-compile, requires-symbolic-name-value=true, destination=IdsMEvent  # Attempt to install an intermediate certificate. Tags: atp.Status=draft
        reference KEYM_SEV_INST_ROOT_CERT_OP [0..1]: multiplicity set at pre-compile, set at pre-compile, requires-symbolic-name-value=true, destination=IdsMEvent  # Attempt to install a root certificate. Tags: atp.Status=draft
        reference KEYM_SEV_UPD_INTERMEDIATE_CERT_OP [0..1]: multiplicity set at pre-compile, set at pre-compile, requires-symbolic-name-value=true, destination=IdsMEvent  # Attempt to update an existing intermediate certificate. Tags: atp.Status=draft
        reference KEYM_SEV_UPD_ROOT_CERT_OP [0..1]: multiplicity set at pre-compile, set at pre-compile, requires-symbolic-name-value=true, destination=IdsMEvent  # Attempt to update an existing root certificate. Tags: atp.Status=draft
    container KeyMNvmBlock [0..65535]  # Configuration of optional usage of Nvm in case the KeyM module requires non volatile memory in the Ecu to store information (e.g. crypto keys or certificates).
      integer KeyMNvmBlockWriteDelayed: 0..65535, multiplicity set at pre-compile, set at pre-compile  # This is the delay time in ms to write a key to NVM after it has been updated. | A value of 0 means, that the key is written immediately after it has been updated. If several keys are update that are assigned to the same container, the first delay time expiration shall be used. All keys that have been updated during that time shall be updated and its delay timer shall be stopped.
      reference KeyMNvmBlockDescriptorRef [0..1]: scope=ECU, multiplicity set at pre-compile, set at pre-compile, requires-symbolic-name-value=true, destination=NvMBlockDescriptor  # Reference to the Nvm block description in the Nvm module configuration.
  module definition LdCom [0..1]: post-build-variant-support=true, variants link-time/post-build/pre-compile  # Configuration of the AUTOSAR LdCom module.
    container LdComConfig  # This container contains the configuration parameters and sub containers of the AUTOSAR LdCom module.
      container LdComIPdu [0..*]: multiplicity set at link in variant link-time / post-build in variant post-build / pre-compile in variant pre-compile, post-build-variant-multiplicity=true  # Contains the configuration parameters of the IPdu inside LdCom.
        enumeration LdComApiType: {LDCOM_IF, LDCOM_TP}, scope=ECU, set at link in variant link-time+post-build / pre-compile in variant pre-compile  # Defines if this I-PDU is a normal I-PDU that shall be sent unfragmented or if this is a large I-PDU that shall be sent via the Transport Protocol of the underlying bus. | This setting is used by RTE to invoke the proper API.
        integer LdComHandleId: 0..65535, scope=ECU, set at pre-compile, symbolic-name-value=true  # This is the ID used by RTE to invoke LdCom. | A corresponding shortName is created, which is used for the invocations of the RTE. The same ID is used for invocations by PduR.
        enumeration LdComIPduDirection: {LDCOM_RECEIVE, LDCOM_SEND}, set at link in variant link-time+post-build / pre-compile in variant pre-compile  # The direction defines if this IPdu, and therefore the contributing signal, shall be sent or received.
        function name LdComRxCopyRxData [0..1]: scope=ECU, multiplicity set at link in variant link-time+post-build / pre-compile in variant pre-compile, set at link in variant link-time+post-build / pre-compile in variant pre-compile  # Only on receiver side: Name of Rte_LdComCbkCopyRxData callback function to be called.
        function name LdComRxIndication [0..1]: scope=ECU, multiplicity set at link in variant link-time+post-build / pre-compile in variant pre-compile, set at link in variant link-time+post-build / pre-compile in variant pre-compile  # Only on receiver side: Name of Rte_LdComCbkRxIndication callback function to be called.
        function name LdComRxStartOfReception [0..1]: scope=ECU, multiplicity set at link in variant link-time+post-build / pre-compile in variant pre-compile, set at link in variant link-time+post-build / pre-compile in variant pre-compile  # Only on receiver side: Name of Rte_LdComCbkStartOfReception callback function to be called.
        function name LdComTpRxIndication [0..1]: scope=ECU, multiplicity set at link in variant link-time+post-build / pre-compile in variant pre-compile, set at link in variant link-time+post-build / pre-compile in variant pre-compile  # Only on receiver side: Name of Rte_LdComCbkTpRxIndication callback function to be called.
        function name LdComTpTxConfirmation [0..1]: scope=ECU, multiplicity set at link in variant link-time+post-build / pre-compile in variant pre-compile, set at link in variant link-time+post-build / pre-compile in variant pre-compile  # Only on sender side: Name of Rte_LdComCbkTpTxConfirmation callback function to be called.
        function name LdComTxConfirmation [0..1]: scope=ECU, multiplicity set at link in variant link-time+post-build / pre-compile in variant pre-compile, set at link in variant link-time+post-build / pre-compile in variant pre-compile  # Only on sender side: Name of Rte_LdComCbkTxConfirmation callback function to be called.
        function name LdComTxCopyTxData [0..1]: scope=ECU, multiplicity set at link in variant link-time+post-build / pre-compile in variant pre-compile, set at link in variant link-time+post-build / pre-compile in variant pre-compile  # Only on sender side: Name of Rte_LdComCbkCopyTxData callback function to be called.
        function name LdComTxTriggerTransmit [0..1]: scope=ECU, multiplicity set at link in variant link-time+post-build / pre-compile in variant pre-compile, set at link in variant link-time+post-build / pre-compile in variant pre-compile  # Only on sender side: Name of Rte_LdComCbkTriggerTransmit callback function to be called. If defined TriggerTransmit has to be supported for this signal.
        reference LdComPduRef: scope=ECU, set at link in variant link-time+post-build / pre-compile in variant pre-compile, destination=Pdu  # Reference to the global Pdu.
        foreign reference LdComSystemTemplateSignalRef [0..1]: scope=ECU, multiplicity set at link in variant link-time / post-build in variant post-build / pre-compile in variant pre-compile, post-build-variant-multiplicity=true, post-build-variant-value=true, set at link in variant link-time / post-build in variant post-build / pre-compile in variant pre-compile, destination-type=I-SIGNAL-TO-I-PDU-MAPPING  # Reference to the ISignalToIPduMapping that contains a reference to the ISignal (System Template).
    container LdComGeneral  # Contains the general configuration parameters of the LdCom module.
      boolean LdComDevErrorDetect: set at pre-compile, default-value=false  # Switches the development error detection and notification on or off. | * true: detection and notification is enabled. * false: detection and notification is disabled.
      boolean LdComVersionInfoApi: set at pre-compile, default-value=false  # Activate/Deactivate the version information API (LdCom_GetVersionInfo). | * True: version information API activated * False: version information API deactivated
  module definition Lin [0..*]: post-build-variant-support=true, variants post-build/pre-compile  # Configuration of the Lin (LIN driver) module.
    container LinDemEventParameterRefs [0..1]  # Container for the references to DemEventParameter elements which shall be invoked using the API Dem_SetEventStatus in case the corresponding error occurs. The EventId is taken from the referenced DemEventParameter's DemEventId symbolic value. The standardized errors are provided in this container and can be extended by vendor-specific error references.
      reference LIN_E_TIMEOUT [0..1]: multiplicity set at pre-compile, set at pre-compile, requires-symbolic-name-value=true, destination=DemEventParameter  # Reference to the DemEventParameter which shall be issued when the error "Timeout caused by hardware error" has occurred. If the reference is not configured the error shall be reported as DET error.
    container LinGeneral  # This container contains the parameters related to each LIN Driver Unit.
      boolean LinDevErrorDetect: set at pre-compile, default-value=false  # Switches the development error detection and notification on or off. | * true: detection and notification is enabled. * false: detection and notification is disabled.
      integer LinIndex: 0..255, set at pre-compile  # Specifies the InstanceId of this module instance. If only one instance is present it shall have the Id 0.
      integer LinTimeoutDuration: 0..65535, set at pre-compile  # Specifies the maximum number of loops for blocking function until a timeout is raised in short term wait loops
      boolean LinVersionInfoApi: set at pre-compile, default-value=false  # Switches the Lin_GetVersionInfo function ON or OFF.
      reference LinEcucPartitionRef [0..*]: scope=ECU, multiplicity set at pre-compile, post-build-variant-multiplicity=true, post-build-variant-value=true, set at pre-compile, destination=EcucPartition  # Maps the Lin driver to zero or multiple ECUC partitions to make the modules API available in this partition. The Lin driver will operate as an independent instance in each of the partitions.
    container LinGlobalConfig  # This container contains the global configuration parameter of the Lin driver.
      container LinChannel [1..*]  # This container contains the configuration (parameters) of the LIN Controller(s).
        integer LinChannelBaudRate: 1000..20000, post-build-variant-value=true, set at post-build in variant post-build / pre-compile in variant pre-compile  # Specifies the baud rate of the LIN channel
        integer LinChannelId: 0..65535, set at pre-compile, symbolic-name-value=true  # Identifies the LIN channel. Replaces LIN_CHANNEL_INDEX_NAME from the LIN SWS.
        boolean LinChannelWakeupSupport: set at pre-compile  # Specifies if the LIN hardware channel supports wake up functionality
        enumeration LinNodeType: {MASTER, SLAVE}, set at pre-compile  # Specifies the LIN node type of this channel.
        reference LinChannelEcucPartitionRef [0..1]: scope=ECU, multiplicity set at pre-compile, post-build-variant-multiplicity=true, post-build-variant-value=true, set at pre-compile, destination=EcucPartition  # Maps one single Lin channel to zero or one ECUC partitions. The ECUC partition referenced is a subset of the ECUC partitions where the Lin driver is mapped to.
        reference LinChannelEcuMWakeupSource [0..1]: multiplicity set at pre-compile, set at pre-compile, requires-symbolic-name-value=true, destination=EcuMWakeupSource  # This parameter contains a reference to the Wakeup Source for this controller as defined in the ECU State Manager.
        reference LinClockRef: post-build-variant-value=true, set at post-build in variant post-build / pre-compile in variant pre-compile, destination=McuClockReferencePoint  # Reference to the LIN clock source configuration, which is set in the MCU driver configuration.
  module definition LinIf [0..1]: post-build-variant-support=true, variants link-time/post-build/pre-compile  # Configuration of the LinIf (LIN Interface) module.
    container LinIfGeneral  # This container contains the general parameters of LIN Interface module.
      boolean LinIfBusMirroringSupported: set at pre-compile, default-value=false  # States if Bus Mirroring is enabled in the LIN Interface or not. The reason for this parameter is to reduce the size of LIN Interface if the Bus Mirroring is not used.
      boolean LinIfDevErrorDetect: set at pre-compile, default-value=false  # Switches the development error detection and notification on or off. | * true: detection and notification is enabled. * false: detection and notification is disabled.
      boolean LinIfMultipleDriversSupported: set at pre-compile  # States if multiple drivers are supported by the LIN Interface or not. The reason for this parameter is to reduce the size of LIN Interface if multiple drivers are not used.
      boolean LinIfMultipleTrcvDriverSupported: set at pre-compile  # States if multiple transceiver drivers are supported by the LIN Interface or not. The reason for this parameter is to reduce the size of LIN Interface if multiple transceiver drivers are not used.
      boolean LinIfNcOptionalRequestSupported: set at pre-compile  # States if the node configuration commands Assign NAD and Conditional Change NAD are supported.
      string LinIfPublicCddHeaderFile [0..*]: scope=ECU, multiplicity set at pre-compile, set at pre-compile, max-length=32, min-length=1  # Defines header files for callback functions which shall be included in case of CDDs. Range of characters is 1.. 32.
      function name LinIfResponseErrorSignalChangedCallout [0..1]: set at pre-compile  # This parameter contains the name of the callout function that is called after a response error signal change. | Only applicable for LIN slave nodes.
      function name LinIfSaveConfigurationCallout [0..1]: set at pre-compile  # This parameter contains the name of the callout function that is called when a save configuration node configuration command is processed by this slave node. The service is only supported when this parameter is configured. | Only applicable for LIN slave nodes.
      boolean LinIfTpSupported: set at pre-compile  # States if the TP is included in the LIN Interface or not. The reason for this parameter is to reduce the size of LIN Interface if the TP is not used.
      boolean LinIfTrcvDriverSupported: set at pre-compile  # States if transceiver driver support is included in the LIN Interface or not. The reason for this parameter is to reduce the size of LIN Interface if transceiver drivers are not used.
      boolean LinIfVersionInfoApi: set at pre-compile, default-value=false  # Switches the LinIf_GetVersionInfo function ON or OFF.
    container LinIfGlobalConfig  # This container contains the global configuration parameters of the LinIf.
      container LinIfChannel [1..*]: multiplicity set at pre-compile  # Describes each LIN channel the LinIf is connected to.
        float LinIfBusIdleTimeoutPeriod: 0.1..INF, post-build-variant-value=true, set at link in variant link-time / post-build in variant post-build / pre-compile in variant pre-compile, default-value=4  # Bus idle timeout in seconds. | According to the LIN protocol specification, the bus idle timeout period shall be in range [4, 10] seconds.
        enumeration LinIfGotoSleepConfirmationUL: {CDD, LIN_SM}, scope=ECU, post-build-variant-value=true, set at link in variant link-time+post-build / pre-compile in variant pre-compile  # This parameter defines the upper layer (UL) module to which the confirmation of the goto-sleep command shall be sent.
        enumeration LinIfGotoSleepIndicationUL [0..1]: {CDD, LIN_SM}, scope=ECU, post-build-variant-value=true, set at link in variant link-time+post-build / pre-compile in variant pre-compile  # This parameter defines the upper layer (UL) module to which the indication of the goto-sleep command shall be sent. | Only used for LIN Slave nodes, ignored for master nodes.
        float LinIfMainFunctionPeriod: 0..INF, set at link in variant link-time+post-build / pre-compile in variant pre-compile  # Defines the interval of calls to main functions per channel in seconds.
        integer LinIfMaxFrameCnt [0..1]: 0..65535, multiplicity set at link in variant link-time+post-build / pre-compile in variant pre-compile, set at link in variant link-time+post-build / pre-compile in variant pre-compile  # Maximum number of Frames. This parameter is needed only in case of post-build loadable implementation using static memory allocation.
        boolean LinIfScheduleChangeNextTimeBase [0..1]: post-build-variant-value=true, set at link in variant link-time / post-build in variant post-build / pre-compile in variant pre-compile  # Enables/disables the switch to a new schedule table at the start of the next time base after status check. | True: LinIf selects a new schedule table in next main function. Only applicable for LIN Master nodes.
        enumeration LinIfScheduleRequestConfirmationUL [0..1]: {CDD, LIN_SM}, scope=ECU, post-build-variant-value=true, set at link in variant link-time+post-build / pre-compile in variant pre-compile  # This parameter defines the upper layer (UL) module to which the confirmation of the successfully performed schedule table change shall be sent. | Only applicable to LIN master nodes.
        enumeration LinIfWakeupConfirmationUL: {CDD, LIN_SM}, scope=ECU, post-build-variant-value=true, set at link in variant link-time+post-build / pre-compile in variant pre-compile  # This parameter defines the upper layer (UL) module to which the confirmation of the wake-up shall be sent.
        foreign reference LinIfCddRef [0..1]: multiplicity set at pre-compile, set at pre-compile, destination-type=ECUC-MODULE-CONFIGURATION-VALUES  # Reference to the CDD module description. This parameter is only required when LinIfWakeupConfirmationUL, LinIfScheduleRequestConfirmationUL, LinIfGotoSleepConfirmationUL and/or LinIfGotoSleepIndicationUL is set to CDD.
        reference LinIfChannelRef: scope=ECU, set at link in variant link-time+post-build / pre-compile in variant pre-compile, requires-symbolic-name-value=true, destination=LinChannel  # Reference to the channel definition in the LIN driver.
        reference LinIfComMNetworkHandleRef: set at link in variant link-time+post-build / pre-compile in variant pre-compile, requires-symbolic-name-value=true, destination=ComMChannel  # Unique handle to identify one LIN network. Reference to one of the network handles configured for the ComM.
        container LinIfFrame [0..*]: multiplicity set at link in variant link-time / post-build in variant post-build / pre-compile in variant pre-compile, post-build-variant-multiplicity=true  # Generic container for all types of LIN frames.
          enumeration LinIfChecksumType [0..1]: {CLASSIC, ENHANCED}, post-build-variant-value=true, set at link in variant link-time / post-build in variant post-build / pre-compile in variant pre-compile  # Type of checksum that the frame is using. | This parameter is optional because in case of sporadic frames it should not be set.
          integer LinIfFrameId [0..1]: 0..63, multiplicity set at link in variant link-time / post-build in variant post-build / pre-compile in variant pre-compile, post-build-variant-multiplicity=true, post-build-variant-value=true, set at link in variant link-time / post-build in variant post-build / pre-compile in variant pre-compile  # ID of the LIN frame. The Protected ID including parity is calculated by the generation tool.
          integer LinIfFrameIndex [0..1]: 0..63, multiplicity set at link in variant link-time / post-build in variant post-build / pre-compile in variant pre-compile, post-build-variant-multiplicity=true, post-build-variant-value=true, set at link in variant link-time / post-build in variant post-build / pre-compile in variant pre-compile  # PID index of the frame. This index is used in the AssignFrameIdentifierRange node configuration service to identify the frame(s) to which a new PID shall be assigned. | It corresponds to the order of the frames in the configurable frames list in the node attributes section of the LDF / NCF of the slave node. Only relevant for LIN slave nodes.
          enumeration LinIfFrameType: {ASSIGN, ASSIGN_FRAME_ID_RANGE, ASSIGN_NAD, CONDITIONAL, EVENT_TRIGGERED, FREE, MRF, SAVE_CONFIGURATION, SPORADIC, SRF, UNASSIGN, UNCONDITIONAL}, post-build-variant-value=true, set at link in variant link-time / post-build in variant post-build / pre-compile in variant pre-compile  # This parameter defines the type of frame (e.g. sporadic frame). | For master nodes, all frame types are permitted. A sporadic slot may be used by a set of unconditional frames in the role of substitution frames. For slave nodes, only following types are permitted: Uncondtional, MRF, SRF, Event-triggered. An event-triggered slot may be used by a set of unconditional frames in the role of substitution frames.
          container LinIfFixedFrameSdu [0..1]  # In case this is a fixed frame this is the SDU (response). | This container represents an eight byte array. The Byte order shall be MSB first. Only applicable to LIN master nodes.
            container LinIfFixedFrameSduByte [8..8]  # This container represents a byte within the 8 byte array.
              integer LinIfFixedFrameSduBytePos: 0..7, post-build-variant-value=true, set at link in variant link-time / post-build in variant post-build / pre-compile in variant pre-compile  # Index of the Byte in the SDU (response) 8 byte array.
              integer LinIfFixedFrameSduByteVal: 0..255, post-build-variant-value=true, set at link in variant link-time / post-build in variant post-build / pre-compile in variant pre-compile  # Byte value in the SDU (response) 8-byte array.
          choice container LinIfPduDirection [0..1]  # Direction of the frame
            container LinIfInternalPdu [0..1]  # Represents a Diagnostic or Configuration frame : no Message ID (no PduId). | Only applicable to LIN master nodes.
            container LinIfRxPdu [0..1]  # represents a received PDU/frame
              function name LinIfRxIndicationUL [0..1]: scope=ECU, multiplicity set at link in variant link-time+post-build / pre-compile in variant pre-compile, post-build-variant-multiplicity=true, post-build-variant-value=true, set at link in variant link-time+post-build / pre-compile in variant pre-compile  # This parameter defines the name of the <User_RxIndication>. This parameter depends on the parameter LinIfUserRxIndicationUL. | If LinIfUserRxIndicationUL equals PDUR, the name of the <User_RxIndication> is fixed. If LinIfUserRxIndicationUL equals CDD, the name of the <User_RxIndication> is selectable.
              enumeration LinIfUserRxIndicationUL: {CDD, PDUR}, scope=ECU, post-build-variant-value=true, set at link in variant link-time+post-build / pre-compile in variant pre-compile  # This parameter defines the upper layer (UL) module to which the indication of the successfully received LinIfRxPdu has to be routed via <User_RxIndication>.
              reference LinIfRxPduRef: scope=ECU, post-build-variant-value=true, set at link in variant link-time / post-build in variant post-build / pre-compile in variant pre-compile, destination=Pdu  # Reference to the PDU that is received in this frame.
            container LinIfSlaveToSlavePdu [0..1]  # Represents a slave-to-slave PDU/frame. Master does only send the header but doesn't receive the response. | Only relevant for master nodes.
            container LinIfTxPdu [0..1]  # represents a transmitted PDU/frame
              function name LinIfTxConfirmationUL [0..1]: scope=ECU, multiplicity set at link in variant link-time+post-build / pre-compile in variant pre-compile, post-build-variant-multiplicity=true, post-build-variant-value=true, set at link in variant link-time+post-build / pre-compile in variant pre-compile  # This parameter defines the name of the <User_TxConfirmation>. This parameter depends on the parameter LinIfUserTxUL. | If LinIfUserTxUL equals PDUR, the name of the <User_TxConfirmation> is fixed. If LinIfUserTxUL equals CDD, the name of the <User_TxConfirmation> is selectable.
              integer LinIfTxPduId: 0..65535, set at pre-compile, symbolic-name-value=true  # Identifier of the Pdu for the upper layer.
              function name LinIfTxTriggerTransmitUL [0..1]: scope=ECU, multiplicity set at link in variant link-time+post-build / pre-compile in variant pre-compile, post-build-variant-multiplicity=true, post-build-variant-value=true, set at link in variant link-time+post-build / pre-compile in variant pre-compile  # This parameter defines the name of the <User_TriggerTransmit>. This parameter depends on the parameter LinIfUserTxUL. If LinIfUserTxUL equals PDUR, the name of the <User_TriggerTransmit> is fixed. | If LinIfUserTxUL equals CDD, the name of the <User_TriggerTransmit> is selectable.
              enumeration LinIfUserTxUL: {CDD, PDUR}, scope=ECU, post-build-variant-value=true, set at link in variant link-time+post-build / pre-compile in variant pre-compile  # This parameter defines the upper layer (UL) module to which the trigger of the transmitted LinTxPdu (via the <User_TriggerTransmit>) or the confirmation of the successfully transmitted LinTxPdu has to be routed (via the <User_TxConfirmation>).
              reference LinIfTxPduRef: scope=ECU, post-build-variant-value=true, set at link in variant link-time / post-build in variant post-build / pre-compile in variant pre-compile, destination=Pdu  # Reference to the PDU that is transmitted in this frame.
          container LinIfSubstitutionFrames [0..*]  # List of sporadic frames that can be sent in a sporadic frame slot (master node) or list of unconditional frames that can be sent in an event-triggered frame slot (slave node).
            integer LinIfFramePriority: 0..255, post-build-variant-value=true, set at link in variant link-time / post-build in variant post-build / pre-compile in variant pre-compile  # Priority of sporadic frame in a master node or of event-triggered frame in slave node.
            reference LinIfSubstitutionFrameRef: post-build-variant-value=true, set at link in variant link-time / post-build in variant post-build / pre-compile in variant pre-compile, destination=LinIfFrame  # Reference to an unconditional Frame that is used as sporadic frame in a master node or event-triggered frame in a slave node.
        choice container LinIfNodeType  # This container defines the LIN node type of this channel.
          container LinIfMaster [0..1]  # Each Master can only be connected to one physical channel. This could be compared to the Node parameter in a LDF file.
            float LinIfJitter: 0..0.255, set at pre-compile  # The jitter specifies the differences between the maximum and minimum delay from time base tick to the header sending start point in seconds.
          container LinIfSlave [0..1]  # Describes all parameters which are only relevant for a LIN Slave node.
            enumeration LinIfLinProtocolVersion: {ISO17987, LIN13, LIN20, LIN21, LIN22}, set at pre-compile  # Defines the LIN protocol version of the slave node. | This information is relevant for the LIN conformance test execution.
            reference LinIfResponseErrorSignal [0..1]: scope=ECU, set at link in variant link-time+post-build / pre-compile in variant pre-compile, requires-symbolic-name-value=true, destination=ComSignal  # Reference to the response_error signal. | Mandatory for all LIN 2.x and ISO LIN slave nodes, not relevant for LIN 1.3 slave nodes.
            container LinIfNodeConfigurationIdentification [0..1]  # This container is mandatory for all LIN 2.x and ISO17987 LIN slave nodes, and ignored for LIN 1.3 slave nodes and all master nodes,
              integer LinIfConfiguredNAD: 1..125, post-build-variant-value=true, set at link in variant link-time / post-build in variant post-build / pre-compile in variant pre-compile  # Slave node configured NAD.
              integer LinIfFunctionId: 0..65535, post-build-variant-value=true, set at link in variant link-time / post-build in variant post-build / pre-compile in variant pre-compile  # LIN function Id.
              integer LinIfInitialNAD: 1..125, post-build-variant-value=true, set at link in variant link-time / post-build in variant post-build / pre-compile in variant pre-compile  # Slave node initial NAD.
              float LinIfNasTimeout: 0..1, post-build-variant-value=true, set at link in variant link-time / post-build in variant post-build / pre-compile in variant pre-compile  # N_As timeout in seconds.
              integer LinIfSupplierId: 0..32767, post-build-variant-value=true, set at link in variant link-time / post-build in variant post-build / pre-compile in variant pre-compile  # LIN consortium or ISO LIN supplier Id.
              integer LinIfVariantId: 0..255, post-build-variant-value=true, set at link in variant link-time / post-build in variant post-build / pre-compile in variant pre-compile  # LIN variant Id.
        container LinIfScheduleTable [0..*]: multiplicity set at link in variant link-time / post-build in variant post-build / pre-compile in variant pre-compile, post-build-variant-multiplicity=true  # Describes a schedule table. Each LinIfChannel may have several schedule tables. Each schedule table can only be connected to one channel. | Mandatory for LIN Master nodes. The SHORT-NAME of the LinIfScheduleTable container represents the symbolic name of the schedule table.
          enumeration LinIfResumePosition: {CONTINUE_AT_IT_POINT, START_FROM_BEGINNING}, post-build-variant-value=true, set at link in variant link-time / post-build in variant post-build / pre-compile in variant pre-compile  # Defines where a RUN_CONTINUOUS schedule table shall proceed in case it has been interrupted by a RUN_ONCE table.
          enumeration LinIfRunMode: {RUN_CONTINUOUS, RUN_ONCE}, post-build-variant-value=true, set at link in variant link-time / post-build in variant post-build / pre-compile in variant pre-compile  # The schedule table can be executed in two different modes.
          integer LinIfScheduleTableIndex: 0..255, set at pre-compile, symbolic-name-value=true  # This is the unique index used by upper layers to identify a schedule. Note that the NULL_SCHEDULE for each channel must have index 0.
          container LinIfEntry [0..*]: multiplicity set at link in variant link-time / post-build in variant post-build / pre-compile in variant pre-compile, post-build-variant-multiplicity=true  # Describes an entry in the schedule table (also known as Frame Slot).
            float LinIfDelay: 0..0.255, post-build-variant-value=true, set at link in variant link-time / post-build in variant post-build / pre-compile in variant pre-compile  # Delay to next entry in schedule table in seconds.
            integer LinIfEntryIndex: 0..255, post-build-variant-value=true, set at link in variant link-time / post-build in variant post-build / pre-compile in variant pre-compile  # Position of the Frame Entry in the Schedule Table. The first entry index in the schedule table is 0.
            reference LinIfCollisionResolvingRef [0..1]: post-build-variant-value=true, set at link in variant link-time / post-build in variant post-build / pre-compile in variant pre-compile, destination=LinIfScheduleTable  # Reference to the schedule table, which resolves the collision. This parameter is only used if the referenced frames are event triggered frames.
            reference LinIfFrameRef: post-build-variant-value=true, set at link in variant link-time / post-build in variant post-build / pre-compile in variant pre-compile, destination=LinIfFrame  # Reference to the frames that belong to this schedule table entry.
        container LinIfTransceiverDrvConfig [0..1]  # This container contains the configuration parameters of each underlying LIN Transceiver Driver.
          reference LinIfTrcvIdRef: scope=ECU, set at link in variant link-time+post-build / pre-compile in variant pre-compile, requires-symbolic-name-value=true, destination=LinTrcvChannel  # Logical handle of the underlying LIN transceiver to be served by the LIN Interface.
  module definition LinSM [0..1]: post-build-variant-support=true, variants link-time/post-build/pre-compile  # Configuration of the Lin State Manager module.
    container LinSMConfigSet  # This container contains the configuration parameters and sub containers of the AUTOSAR LinSm module.
      integer LinSMModeRequestRepetitionMax: 0..255, post-build-variant-value=true, set at link in variant link-time / post-build in variant post-build / pre-compile in variant pre-compile  # Specifies the maximal amount of mode request repetitions without a respective mode indication from the LinIf module until the LinSM module reports a Development Error to the Det and tries to go back to no communication.
      container LinSMChannel [1..*]  # Describes each LIN channel the LinSM is connected to.
        float LinSMConfirmationTimeout: 0..INF, set at link in variant link-time+post-build / pre-compile in variant pre-compile  # Timeout in seconds for the goto sleep, wakeup and schedule request calls to LinIf. The timeout must be longer than a goto-sleep command on the bus (i.e. it is bit rate dependent).
        enumeration LinSMNodeType: {MASTER, SLAVE}, set at pre-compile  # Specifies the LIN node type of this channel.
        float LinSMSilenceAfterWakeupTimeout [0..1]: 0..INF, set at link in variant link-time+post-build / pre-compile in variant pre-compile  # Timeout in seconds after a failed wakeup sequence until a new wakeup process is started.
        boolean LinSMTransceiverPassiveMode [0..1]: multiplicity set at link in variant link-time+post-build / pre-compile in variant pre-compile, set at link in variant link-time+post-build / pre-compile in variant pre-compile  # Selects STANDBY (true) or SLEEP (false) transceiver mode when entering LINSM_NO_COM.
        reference LinSMComMNetworkHandleRef: set at link in variant link-time+post-build / pre-compile in variant pre-compile, requires-symbolic-name-value=true, destination=ComMChannel  # Unique handle to identify one certain LIN network. Reference to one of the network handles configured in the ComM.
        container LinSMSchedule [0..*]  # The schedule references to a schedule that is located in the LinIf configuration. Moreover, the PDU groups are located in the COM configuration. Note that there are two references to PDU groups. The simple reason is that a PDU group is only allowed to contain one direction (TX or RX). | Only applicable to LIN master nodes.
          integer LinSMScheduleIndex: 0..255, set at pre-compile, symbolic-name-value=true  # This index parameter can be used by the BswM as a SymbolicNameReference target. The LinSM just forwards the request from the BswM to LinIf. Note that the value of the LinSMScheduleIndex shall be the same as the value from the LinIf.
          reference LinSMScheduleIndexRef: post-build-variant-value=true, set at link in variant link-time / post-build in variant post-build / pre-compile in variant pre-compile, requires-symbolic-name-value=true, destination=LinIfScheduleTable  # Reference to a schedule table in the LinIf configuration
    container LinSMGeneral  # This container contains general parameters of LIN State Manager module.
      boolean LinSMDevErrorDetect: set at pre-compile, default-value=false  # Switches the development error detection and notification on or off. | * true: detection and notification is enabled. * false: detection and notification is disabled.
      float LinSMMainProcessingPeriod: 0..INF, set at pre-compile  # Fixed period that the MainFunction shall be called.
      boolean LinSMVersionInfoApi: set at pre-compile, default-value=false  # Switches the LinSM_GetVersionInfo function ON or OFF.
  module definition LinTp [0..1]: post-build-variant-support=true, variants link-time/post-build/pre-compile  # Configuration of the LIN Transport Protocol.
    container LinTpGeneral  # Container that holds all LIN transport protocol general parameters.
      boolean LinTpChangeParameterApi: set at pre-compile  # This parameter, if set to true, enables the LinTp_ChangeParameter Api for this Module.
      boolean LinTpVersionInfoApi: set at pre-compile, default-value=false  # Switches the LinTp_GetVersionInfo function ON or OFF.
    container LinTpGlobalConfig  # This container contains the global configuration parameters of the LinTp.
      integer LinTpMaxRxNSduCnt [0..1]: 0..65535, set at link in variant link-time+post-build / pre-compile in variant pre-compile  # Maximum number of NSdus. This parameter is needed only in case of post-build loadable implementation using static memory allocation.
      integer LinTpMaxTxNSduCnt [0..1]: 0..65535, set at link in variant link-time+post-build / pre-compile in variant pre-compile  # Maximum number of NSdus. This parameter is needed only in case of post-build loadable implementation using static memory allocation.
      container LinTpChannelConfig [0..*]: multiplicity set at link in variant link-time / post-build in variant post-build / pre-compile in variant pre-compile, post-build-variant-multiplicity=true  # This container contains the channel specific configuration parameters of LinTp.
        boolean LinTpDropNotRequestedNad: post-build-variant-value=true, set at link in variant link-time / post-build in variant post-build / pre-compile in variant pre-compile, default-value=true  # Configures if TP Frames of not requested LIN-Slaves are dropped or not. | TRUE: Drop TP Frames of not requested LIN-Slaves FALSE: Keep TP Frames of not requested LIN-Slaves Only used for LIN Master nodes, ignored for slave nodes.
        integer LinTpMaxNumberOfRespPendingFrames: 0..65535, post-build-variant-value=true, set at link in variant link-time / post-build in variant post-build / pre-compile in variant pre-compile  # Configures the maximum number of allowed response pending frames. | Only used for LIN Master nodes, ignored for slave nodes.
        float LinTpP2Max: 0.05..2, post-build-variant-value=true, set at link in variant link-time / post-build in variant post-build / pre-compile in variant pre-compile  # P2*max timeout when a response pending frame is expected in seconds. | Note that the minimum value of LinTpP2Max shall be more than or equal to the value of LinTpP2Timing. Only used for LIN Master nodes, ignored for slave nodes.
        float LinTpP2Timing: 0.05..0.5, post-build-variant-value=true, set at link in variant link-time / post-build in variant post-build / pre-compile in variant pre-compile  # Definition of the P2max timeout observation parameter in seconds. | Only used for LIN Master nodes, ignored for slave nodes.
        boolean LinTpScheduleChangeDiag: post-build-variant-value=true, set at link in variant link-time / post-build in variant post-build / pre-compile in variant pre-compile, default-value=false  # Enables or disables the call of BswM_LinTp_RequestMode() to diagnostic request/response schedule. | false: BswM is not called true: BswM is called Only used for LIN Master nodes, ignored for slave nodes.
        reference LinTpChannelRef: post-build-variant-value=true, set at link in variant link-time / post-build in variant post-build / pre-compile in variant pre-compile, requires-symbolic-name-value=true, destination=ComMChannel  # Index of the channel this LinTp channel belongs to.
      container LinTpRxNSdu [0..*]: multiplicity set at link in variant link-time / post-build in variant post-build / pre-compile in variant pre-compile, post-build-variant-multiplicity=true  # This container exists once for each received N-SDU on any channel the node is connected to. This N-SDU produces meta data items of type LIN_NAD_8.
        float LinTpNcr [0..1]: 0..1, multiplicity set at link in variant link-time / post-build in variant post-build / pre-compile in variant pre-compile, post-build-variant-multiplicity=true, post-build-variant-value=true, set at link in variant link-time / post-build in variant post-build / pre-compile in variant pre-compile  # Value in seconds of the N_Cr timeout. N_Cr is the time until reception of the next Consecutive Frame N_PDU.
        integer LinTpRxNSduId: 0..65535, set at pre-compile, symbolic-name-value=true  # The identifier of the Transport Protocol message. This ID will be used by upper layers to call LinTp_ChangeParameter.
        integer LinTpRxNSduNad: 0..255, post-build-variant-value=true, set at link in variant link-time / post-build in variant post-build / pre-compile in variant pre-compile  # A N-SDU transported on LIN is identified using the NAD for the specific slave.
        reference LinTpRxNSduChannelRef: set at link in variant link-time+post-build / pre-compile in variant pre-compile, requires-symbolic-name-value=true, destination=ComMChannel  # Index of the channel this N-SDU belongs to.
        reference LinTpRxNSduPduRef: scope=ECU, post-build-variant-value=true, set at link in variant link-time / post-build in variant post-build / pre-compile in variant pre-compile, destination=Pdu  # Reference to the global PDU
      container LinTpTxNSdu [0..*]: multiplicity set at link in variant link-time / post-build in variant post-build / pre-compile in variant pre-compile, post-build-variant-multiplicity=true  # This container exists once for each transmitted N-SDU on any channel the node is connected to. This N-SDU consumes meta data items of type LIN_NAD_8.
        integer LinTpMaxBufReq: 0..255, post-build-variant-value=true, set at link in variant link-time / post-build in variant post-build / pre-compile in variant pre-compile  # This parameter defines the maximum number of times the LinTp should request upper layer for the Tx Buffer. It is also used to limit the number of retries for PduR_LinTpCopyTxData when no timer is active.
        float LinTpNas: 0..1, post-build-variant-value=true, set at link in variant link-time / post-build in variant post-build / pre-compile in variant pre-compile  # Value in seconds of the N_As timeout. N_As is the time for transmission of a LIN frame (any N_PDU) on the part of the sender.
        float LinTpNcs [0..1]: 0..INF, multiplicity set at link in variant link-time / post-build in variant post-build / pre-compile in variant pre-compile, post-build-variant-multiplicity=true, post-build-variant-value=true, set at link in variant link-time / post-build in variant post-build / pre-compile in variant pre-compile  # Value in seconds of the performance requirement of N_Cs. N_Cs is the time which elapses between the transmit request of a CF N-PDU until the transmit request of the next CF N-PDU.
        integer LinTpTxNSduId: 0..65535, set at pre-compile, symbolic-name-value=true  # The identifier of the Transport Protocol message. This ID will be the one that is communicated with upper layers.
        integer LinTpTxNSduNad: 0..255, post-build-variant-value=true, set at link in variant link-time / post-build in variant post-build / pre-compile in variant pre-compile  # A N-SDU transported on LIN is identified using the NAD for the specific slave.
        reference LinTpTxNSduChannelRef: set at link in variant link-time+post-build / pre-compile in variant pre-compile, requires-symbolic-name-value=true, destination=ComMChannel  # Index of the channel this N-SDU belongs to.
        reference LinTpTxNSduPduRef: scope=ECU, post-build-variant-value=true, set at link in variant link-time / post-build in variant post-build / pre-compile in variant pre-compile, destination=Pdu  # Reference to the global PDU
  module definition LinTrcv [0..*]: variants pre-compile  # Configuration of LIN Transceiver Driver module
    container LinTrcvChannel [1..*]  # Container gives LIN transceiver driver information about a single LIN transceiver channel. Any LIN transceiver driver has such LIN transceiver channels.
      integer LinTrcvChannelId: 0..255, set at pre-compile, symbolic-name-value=true  # Unique identifier of the LIN Transceiver Channel.
      boolean LinTrcvChannelUsed: set at pre-compile, default-value=true  # Shall the related LIN transceiver channel be used? | True: Is used False Is not used
      boolean LinTrcvWakeupByBusUsed: set at pre-compile, default-value=false  # Is wake up by bus supported? If LIN transceiver hardware does not support wake up by bus value is always FALSE. If LIN transceiver hardware supports wake up by bus value is TRUE or FALSE depending whether it is used or not. | TRUE = Is used. FALSE = Is not used.
      reference LinTrcvChannelEcucPartitionRef [0..1]: scope=ECU, multiplicity set at pre-compile, post-build-variant-multiplicity=true, post-build-variant-value=true, set at pre-compile, destination=EcucPartition  # Maps one single Lin transceiver channel to zero or one ECUC partitions. The ECUC partition referenced is a subset of the ECUC partitions where the Lin transceiver driver is mapped to.
      reference LinTrcvIcuChannelRef [0..1]: scope=ECU, multiplicity set at pre-compile, set at pre-compile, requires-symbolic-name-value=true, destination=IcuChannel  # Reference to the IcuChannel to enable/disable the interrupts for wakeups.
      reference LinTrcvWakeupSourceRef [0..1]: scope=ECU, multiplicity set at pre-compile, set at pre-compile, requires-symbolic-name-value=true, destination=EcuMWakeupSource  # Reference to a wakeup source in the EcuM configuration. This reference is only needed if LinTrcvWakeupByBusUsed is true. Implementation Type: reference to EcuM_WakeupSourceType.
      choice container LinTrcvAccess  # Container gives LIN transceiver driver access about a single LIN transceiver channel.
        container LinTrcvDioAccess [0..1]  # Container gives LIN transceiver driver information about accessing ports and port pins. In addition relation between LIN transceiver hardware pin names and Dio port access information is given. If a LIN transceiver hardware has no Dio interface, there is no instance of this container.
          container LinTrcvDioChannelAccess [1..*]  # Container gives DIO channel access by single Lin transceiver channel.
            string LinTrcvHardwareInterfaceName: set at pre-compile  # LIN transceiver hardware interface name. It is typically the name of a pin. From a Dio point of view it is either a port, a single channel or a channel group. Depending on this fact either LINTRCV_DIO_PORT_SYMBOLIC_NAME or LINTRCV_DIO_CHANNEL_SYMBOLIC_NAME or LINTRCV_DIO_CHANNEL_GROUP_SYMBOLIC_NAME shall reference a Dio configuration. The LIN transceiver driver implementation description shall list up this name for the appropriate LIN transceiver hardware.
            choice reference LinTrcvDioSymRefName: set at pre-compile, destination=[DioChannel, DioChannelGroup, DioPort]  # Choice Reference to a DIO Port, DIO Channel or DIO Channel Group. This reference replaces the LINTRCV_DIO_PORT_SYM_NAME, LINTRCV_DIO_CHANNEL_SYM_NAME and LINTRCV_DIO_GROUP_SYM_NAME references in the Lin Trcv SWS.
        container LinTrcvSpiSequence [0..1]  # Container gives LIN transceiver driver information about one SPI sequence. | One SPI sequence used by LIN transceiver driver is in exclusive use for it. No other driver is allowed to access this sequence. LIN transceiver driver may use one sequence to access n LIN transceiver hardwares chips of the same type or n sequences are used to access one single LIN transceiver hardware chip. If a LIN transceiver hardware has no SPI interface, there is no instance of this container.
          reference LinTrcvSpiSequenceName: set at pre-compile, requires-symbolic-name-value=true, destination=SpiSequence  # Reference to a Spi sequence configuration container.
    container LinTrcvGeneral  # Container gives LIN transceiver driver basic information.
      boolean LinTrcvDevErrorDetect: set at pre-compile, default-value=false  # Switches the development error detection and notification on or off. | * true: detection and notification is enabled. * false: detection and notification is disabled.
      integer LinTrcvIndex: 0..255, set at pre-compile  # Specifies the InstanceId of this module instance. If only one instance is present it shall have the Id 0.
      enumeration LinTrcvTimerType [0..1]: {None, Timer_1us16bit}, multiplicity set at pre-compile, set at pre-compile  # Type of the Time Service Predefined Timer.
      boolean LinTrcvVersionInfoApi: set at pre-compile, default-value=false  # Switches version information API on and off. If switched off, function need not be present in compiled code. | True: Is used False: Is not used
      float LinTrcvWaitTime [0..1]: 0..2.55E-4, multiplicity set at pre-compile, set at pre-compile  # Wait time for transceiver state changes in seconds.
      boolean LinTrcvWakeUpSupport: set at pre-compile  # Informs whether wake up is supported or not. In case wake up is not supported by LIN transceiver hardware the setting shall be false. The wake up ability may be switched on or off for each channel of one LIN transceiver by LinTrcvWakeupSourceRef. | True: Is used False: Is not used
      reference LinTrcvEcucPartitionRef [0..*]: scope=ECU, multiplicity set at pre-compile, post-build-variant-multiplicity=true, post-build-variant-value=true, set at pre-compile, destination=EcucPartition  # Maps the Lin transceiver driver to zero or multiple ECUC partitions to make the modules API available in this partition. The Lin transceiver driver will operate as an independent instance in each of the partitions.
  module definition Mcu [0..1]: post-build-variant-support=true, variants post-build/pre-compile  # Configuration of the Mcu (Microcontroller Unit) module.
    container McuGeneralConfiguration  # This container contains the configuration (parameters) of the MCU driver.
      boolean McuDevErrorDetect: set at pre-compile, default-value=false  # Switches the development error detection and notification on or off. | * true: detection and notification is enabled. * false: detection and notification is disabled.
      boolean McuGetRamStateApi: set at pre-compile  # Pre-processor switch to enable/disable the API Mcu_GetRamState. | (e.g. If the H/W does not support the functionality, this parameter can be used to disable the Api).
      boolean McuInitClock: set at pre-compile, default-value=true  # If this parameter is set to FALSE, the clock initialization has to be disabled from the MCU driver. This concept applies when there are some write once clock registers and a bootloader is present. If this parameter is set to TRUE, the MCU driver is responsible of the clock initialization.
      boolean McuNoPll: set at pre-compile, default-value=true  # This parameter shall be set True, if the H/W does not have a PLL or the PLL circuitry is enabled after the power on without S/W intervention. In this case MCU_DistributePllClock has to be disabled and MCU_GetPllStatus has to return MCU_PLL_STATUS_UNDEFINED. Otherwise this parameters has to be set False
      boolean McuPerformResetApi: set at pre-compile  # Pre-processor switch to enable / disable the use of the function Mcu_PerformReset()
      boolean McuVersionInfoApi: set at pre-compile, default-value=false  # Pre-processor switch to enable / disable the API to read out the modules version information.
      reference McuEcucPartitionRef [0..*]: scope=ECU, multiplicity set at pre-compile, post-build-variant-multiplicity=true, post-build-variant-value=true, set at pre-compile, destination=EcucPartition  # Maps the MCU driver to zero or multiple ECUC partition to make the driver API available in this partition.
    container McuModuleConfiguration  # This container contains the configuration (parameters) of the MCU driver
      enumeration McuClockSrcFailureNotification: {DISABLED, ENABLED}, post-build-variant-value=true, set at post-build in variant post-build / pre-compile in variant pre-compile  # Enables/Disables clock failure notification. In case this feature is not supported by HW the setting should be disabled.
      integer McuNumberOfMcuModes: 1..255, post-build-variant-value=true, set at post-build in variant post-build / pre-compile in variant pre-compile  # This parameter shall represent the number of Modes available for the MCU. | calculationFormula = Number of configured McuModeSettingConf
      integer McuRamSectors: 0..4294967295, post-build-variant-value=true, set at post-build in variant post-build / pre-compile in variant pre-compile  # This parameter shall represent the number of RAM sectors available for the MCU. | calculationFormula = Number of configured McuRamSectorSettingConf
      integer McuResetSetting [0..1]: 1..255, multiplicity set at pre-compile, set at pre-compile  # This parameter relates to the MCU specific reset configuration. This applies to the function Mcu_PerformReset, which performs a microcontroller reset using the hardware feature of the microcontroller.
      container McuClockSettingConfig [1..*]  # This container contains the configuration (parameters) for the Clock settings of the MCU. Please see MCU031 for more information on the MCU clock settings.
        integer McuClockSettingId: 0..255, set at pre-compile, symbolic-name-value=true  # The Id of this McuClockSettingConfig to be used as argument for the API call "Mcu_InitClock".
        container McuClockReferencePoint [1..*]  # This container defines a reference point in the Mcu Clock tree. It defines the frequency which then can be used by other modules as an input value. Lower multiplicity is 1, as even in the simplest case (only one frequency is used), there is one frequency to be defined.
          float McuClockReferencePointFrequency: 0..INF, scope=ECU, post-build-variant-value=true, set at post-build in variant post-build / pre-compile in variant pre-compile  # This is the frequency for the specific instance of the McuClockReferencePoint container. It shall be given in Hz.
      container McuDemEventParameterRefs [0..1]  # Container for the references to DemEventParameter elements which shall be invoked using the API Dem_SetEventStatus in case the corresponding error occurs. The EventId is taken from the referenced DemEventParameter's DemEventId symbolic value. The standardized errors are provided in this container and can be extended by vendor-specific error references.
        reference MCU_E_CLOCK_FAILURE [0..1]: multiplicity set at pre-compile, set at pre-compile, requires-symbolic-name-value=true, destination=DemEventParameter  # Reference to configured DEM event to report "Clock source failure".
      container McuModeSettingConf [1..*]  # This container contains the configuration (parameters) for the Mode setting of the MCU. Please see MCU035 for more information on the MCU mode settings.
        integer McuMode: 0..255, set at pre-compile, symbolic-name-value=true  # The parameter represents the MCU Mode settings.
      container McuRamSectorSettingConf [0..*]  # This container contains the configuration (parameters) for the RAM Sector setting. Please see MCU030 for more information on RAM sec-tor settings.
        integer McuRamDefaultValue: 0..255, post-build-variant-value=true, set at post-build in variant post-build / pre-compile in variant pre-compile  # This parameter shall represent the Data pre-setting to be initialized
        integer McuRamSectionBaseAddress: 0..4294967295, post-build-variant-value=true, set at post-build in variant post-build / pre-compile in variant pre-compile  # This parameter shall represent the MCU RAM section base address
        integer McuRamSectionSize: 0..4294967295, post-build-variant-value=true, set at post-build in variant post-build / pre-compile in variant pre-compile  # This parameter represents the MCU RAM Section size in bytes.
        integer McuRamSectionWriteSize: 0..4294967295, post-build-variant-value=true, set at post-build in variant post-build / pre-compile in variant pre-compile, default-value=8  # This parameter shall define the size in bytes of data which can be written into RAM at once.
    container McuPublishedInformation  # Container holding all MCU specific published information parameters
      container McuResetReasonConf [1..*]  # This container contains the configuration for the different type of reset reason that can be retrieved from Mcu_GetResetReason Api.
        integer McuResetReason: 0..255, scope=ECU, set at published-information, symbolic-name-value=true  # The parameter represents the different type of reset that a Micro supports. This parameter is referenced by the parameter EcuMResetReason in the ECU State manager module.
  module definition MemIf [0..1]: variants pre-compile  # Configuration of the MemIf (Memory Abstraction Interface) module.
    container MemIfGeneral  # Configuration of the memory abstraction interface (Memif) module.
      boolean MemIfDevErrorDetect: set at pre-compile, default-value=false  # Switches the development error detection and notification on or off. | * true: detection and notification is enabled. * false: detection and notification is disabled.
      integer MemIfNumberOfDevices: 1..2, set at pre-compile  # Concrete number of underlying memory abstraction modules. | Calculation Formula: Count number of configured EA and FEE modules.
      boolean MemIfVersionInfoApi: set at pre-compile, default-value=false  # Pre-processor switch to enable / disable the API to read out the modules version information. | true: Version info API enabled. false: Version info API disabled.
  module definition MemMap [0..1]: variants pre-compile  # Configuration of the Memory Mapping and Compiler Abstraction module.
    container MemMapAddressingModeSet [0..*]  # Defines a set of addressing modes which might apply to a SwAddrMethod.
      string MemMapCompilerMemClassSymbolImpl: scope=ECU, set at pre-compile  # Defines the implementation behind a MemClassSymbol and configures the Compiler Abstraction.
      string MemMapSupportedAddressingMethodOption [0..*]: scope=ECU, multiplicity set at pre-compile, set at pre-compile, regular-expression=[a-zA-Z]([a-zA-Z0-9]|_[a-zA-Z0-9])*_?  # This constrains the usage of this addressing mode set for Generic Mappings to swAddrMethods. | The attribute option of a swAddrMethod mapped via MemMapGenericMapping to this MemMapAddressingModeSet shall be equal to one of the configured MemMapSupportedAddressMethodOption's
      enumeration MemMapSupportedMemoryAllocationKeywordPolicy [0..*]: {MEMMAP_ALLOCATION_KEYWORD_POLICY_ADDR_METHOD_SHORT_NAME, MEMMAP_ALLOCATION_KEYWORD_POLICY_ADDR_METHOD_SHORT_NAME_AND_ALIGNMENT}, scope=ECU, multiplicity set at pre-compile, set at pre-compile  # This constrains the usage of this addressing mode set for Generic Mappings to swAddrMethods. | The attribute MemoryAllocationKeywordPolicy of a swAddrMethod mapped via MemMapGenericMapping to this MemMapAddressingModeSet shall be equal to one of the configured MemMapSupportedMemoryAllocationKeywordPolicy's
      string MemMapSupportedSectionInitializationPolicy [0..*]: scope=ECU, multiplicity set at pre-compile, set at pre-compile  # This constrains the usage of this addressing mode set for Generic Mappings to swAddrMethods. | The sectionIntializationPolicy attribute value of a swAddrMethod mapped via MemMapGenericMapping to this MemMapAddressingModeSet shall be equal to one of the configured MemMapSupportedSectionIntializationPolicy's Please note that SectionInitializationPolicyType describes the intended initialization of MemorySections. The following values are standardized in AUTOSAR Methodology: * '''NO-INIT''': No initialization and no clearing is performed. Such data elements must not be read before one has written a value into it. * '''INIT''': To be used for data that are initialized by every reset to the specified value (initValue). * '''POWER-ON-INIT''': To be used for data that are initialized by "Power On" to the specified value (initValue). Note: there might be several resets between power on resets. * '''CLEARED''': To be used for data that are initialized by every reset to zero. * '''POWER-ON-CLEARED''': To be used for data that are initialized by "Power On" to zero. Note: there might be several resets between power on resets. Please note that the values are defined similar to the representation of enumeration types in the XML schema to ensure backward compatibility.
      enumeration MemMapSupportedSectionType [0..*]: {MEMMAP_SECTION_TYPE_CAL_PRM, MEMMAP_SECTION_TYPE_CODE, MEMMAP_SECTION_TYPE_CONFIG_DATA, MEMMAP_SECTION_TYPE_CONST, MEMMAP_SECTION_TYPE_EXCLUDE_FROM_FLASH, MEMMAP_SECTION_TYPE_VAR}, scope=ECU, multiplicity set at pre-compile, set at pre-compile  # This constrains the usage of this addressing mode set for Generic Mappings to swAddrMethods. | The attribute sectionType of a swAddrMethod mapped via MemMapGenericMapping or MemMapSectionSpecificMapping to this MemMapAddressingModeSet shall be equal to one of the configured MemMapSupportedSectionType's.
      container MemMapAddressingMode [1..*]  # Defines a addressing mode with a set of #pragma statements implementing the start and the stop of a section.
        multiline string MemMapAddressingModeStart: set at pre-compile  # Defines a set of #pragma statements implementing the start of a section.
        multiline string MemMapAddressingModeStop: set at pre-compile  # Defines a set of #pragma statements implementing the start of a section.
        string MemMapAlignmentSelector [1..*]: multiplicity set at pre-compile, set at pre-compile, regular-expression=[1-9][0-9]*|0x[0-9a-f]*|0[0-7]*|0b[0-1]*|UNSPECIFIED|UNKNOWN|BOOLEAN|PTR  # Defines a the alignments for which the MemMapAddressingMode applies. | The to be used alignment is defined in the alignment attribute of the MemorySection. If the MemMapAlignmentSelector fits to alignment attribute of the MemorySection the set of #pragmas of the related MemMapAddressingMode shall be used to implement the start and the stop of a section. Please note that the same MemMapAddressingMode can be applicable for several alignments, e.g. "8" bit and "UNSPECIFIED".
    container MemMapAllocation [0..*]  # Defines which MemorySection of a BSW Module or a Software Component is implemented with which MemMapAddressingModeSet. | This can either be specified for a set of MemorySections which refer to an identical SwAddrMethod (MemMapGenericMapping) or for individual MemorySections (MemMapSectionSpecificMapping). If both are defined for the same MemorySection the MemMapSectionSpecificMapping overrules the MemMapGenericMapping.
      container MemMapGenericMapping [0..*]  # Defines which SwAddrMethod is implemented with which MemMapAddressingModeSet. | The pragmas for the implementation of the MemorySelectorKeywords are taken from the MemMapAddressingModeStart and MemMapAddressingModeStop parameters of the MemMapAddressingModeSet for the individual alignments. That this mapping becomes valid requires matching MemMapSupportedSectionType's, MemMapSupportedSectionInitializationPolicy's and MemMapSupportedAddressingMethodOption's. The MemMapGenericMapping applies only if it is not overruled by an MemMapSectionSpecificMapping
        reference MemMapAddressingModeSetRef: scope=ECU, set at pre-compile, destination=MemMapAddressingModeSet  # Reference to the MemMapAddressingModeSet which applies to the MemMapGenericMapping.
        reference MemMapMappingSelectorRef [0..1]: scope=ECU, set at pre-compile, destination=MemMapMappingSelector  # Reference to a MemMapPrefixSelector. The owning MemMapGenericMapping is only effective for those memories where the MemMapMappingSelector matches.
        foreign reference MemMapSwAddressMethodRef: scope=ECU, set at pre-compile, destination-type=SW-ADDR-METHOD  # Reference to the SwAddrMethod which applies to the MemMapGenericMapping.
      container MemMapMappingSelector [0..*]  # The container holds a section criteria reusable for MemMapGenericMappings.
        string MemMapPrefixSelector [0..1]: scope=ECU, set at pre-compile  # The parameter MemMapPrefixSelector defines a regular expression which shall be applied to the <PREFIX> part of the memory allocation keywords. | The mapping using this selector is only effective for those memories where the <PREFIX> part of the memory allocation keyword matches the regular expression. Note: This is in particular intended the restrict the usage of of a MemMapAddressingModeSet for a sub set of BSW Modules or Software Components or a subset of allocatable memory parts inside BSW Modules or Software Components.
      container MemMapSectionSpecificMapping [0..*]  # Defines which MemorySection of a BSW Module or a Software Component is implemented with which MemMapAddressingModeSet. | The pragmas for the implementation of the MemorySelectorKeywords are taken from the MemMapAddressingModeStart and MemMapAddressingModeStop parameters of the MemMapAddressingModeSet for the specific alignment of the MemorySection. The MemMapSectionSpecificMapping precedes a mapping defined by MemMapGenericMapping.
        reference MemMapAddressingModeSetRef: scope=ECU, set at pre-compile, destination=MemMapAddressingModeSet  # Reference to the MemMapAddressingModeSet which applies to the MemMapModuleSectionSpecificMapping.
        foreign reference MemMapMemorySectionRef: scope=ECU, set at pre-compile, destination-type=MEMORY-SECTION  # Reference to the MemorySection which applies to the MemMapSectionSpecificMapping.
    container MemMapGenericCompilerMemClass [0..*]  # The shortName of the container defines the name of the generic Compiler memclass which is global for all using modules, e.g. REGSPACE. | The configures the Compiler Abstraction.
      string MemMapGenericCompilerMemClassSymbolImpl: scope=ECU, set at pre-compile  # Defines the implementation behind the generic MemClassSymbol and configures the Compiler Abstraction.
  module definition Mirror [0..1]: post-build-variant-support=true, variants link-time/post-build/pre-compile  # Configuration of the Bus Mirroring module.
    container MirrorConfigSet  # Contains the configuration parameters and sub containers of the Bus Mirroring module.
      reference MirrorInitialDestNetworkRef: post-build-variant-value=true, set at link in variant link-time / post-build in variant post-build / pre-compile in variant pre-compile, destination=MirrorDestNetwork  # Reference to the destination bus that is selected after initialization of the Bus Mirroring module.
      choice container MirrorDestNetwork [1..*]: multiplicity set at link in variant link-time / post-build in variant post-build / pre-compile in variant pre-compile, post-build-variant-multiplicity=true  # Destination bus to which frames are sent by the Bus Mirroring module.
        container MirrorDestNetworkCan [0..1]: multiplicity set at link in variant link-time / post-build in variant post-build / pre-compile in variant pre-compile, post-build-variant-multiplicity=true  # Destination bus representing a CAN network.
          integer MirrorDestQueueSize: 1..65535, set at link in variant link-time+post-build / pre-compile in variant pre-compile, default-value=20  # Number of frames that can be stored in the output queue for the destination bus.
          integer MirrorNetworkId: 0..255, scope=ECU, post-build-variant-value=true, set at link in variant link-time / post-build in variant post-build / pre-compile in variant pre-compile, symbolic-name-value=true  # Network ID of the bus.
          integer MirrorStatusCanId [0..1]: 0..4294967295, post-build-variant-value=true, set at link in variant link-time / post-build in variant post-build / pre-compile in variant pre-compile  # CAN ID of the CAN status frame. | If configured, a status frame will be sent on the CAN destination bus that contains the state of all active source buses.
          reference MirrorComMNetworkHandleRef: set at link in variant link-time / post-build in variant post-build / pre-compile in variant pre-compile, requires-symbolic-name-value=true, destination=ComMChannel  # Reference to the ComMChannel that represents the bus.
          container MirrorDestPdu: multiplicity set at link in variant link-time / post-build in variant post-build / pre-compile in variant pre-compile, post-build-variant-multiplicity=true  # I-PDU used for transmission of the mirrored frames on the destination bus.
            integer MirrorDestPduId: 0..65535, scope=ECU, set at pre-compile, symbolic-name-value=true  # I-PDU identifier used for TxConfirmation from PduR.
            boolean MirrorDestPduUsesTriggerTransmit: post-build-variant-value=true, set at link in variant link-time / post-build in variant post-build / pre-compile in variant pre-compile  # Switches transmission via TriggerTransmit. | * true: The I-PDU is transmitted using TriggerTransmit. * false: The I-PDU is transmitted directly with the Transmit call.
            reference MirrorDestPduRef: set at link in variant link-time+post-build / pre-compile in variant pre-compile, destination=Pdu  # Reference to the Pdu object representing the I-PDU.
        container MirrorDestNetworkCdd [0..1]: multiplicity set at link in variant link-time / post-build in variant post-build / pre-compile in variant pre-compile, post-build-variant-multiplicity=true  # Destination bus representing a user defined network.
          integer MirrorDestQueueSize: 1..65535, set at link in variant link-time+post-build / pre-compile in variant pre-compile, default-value=20  # Number of frames that can be stored in the output queue for the destination bus.
          float MirrorDestTransmissionDeadline [0..1]: 0.001..0.655, post-build-variant-value=true, set at link in variant link-time / post-build in variant post-build / pre-compile in variant pre-compile, default-value=0.1  # Time in seconds after which the collection of source frames into the destination frame stopped and the frame is sent at the latest. | If omitted, destination frames are only sent when full or when the time stamp overflows after 655.35ms.
          integer MirrorNetworkId: 0..255, scope=ECU, post-build-variant-value=true, set at link in variant link-time / post-build in variant post-build / pre-compile in variant pre-compile, symbolic-name-value=true  # Network ID of the bus.
          reference MirrorComMNetworkHandleRef: set at link in variant link-time / post-build in variant post-build / pre-compile in variant pre-compile, requires-symbolic-name-value=true, destination=ComMChannel  # Reference to the ComMChannel that represents the bus.
          container MirrorDestPdu: multiplicity set at link in variant link-time / post-build in variant post-build / pre-compile in variant pre-compile, post-build-variant-multiplicity=true  # I-PDU used for transmission of the mirrored frames on the destination bus.
            integer MirrorDestPduId: 0..65535, scope=ECU, set at pre-compile, symbolic-name-value=true  # I-PDU identifier used for TxConfirmation from PduR.
            boolean MirrorDestPduUsesTriggerTransmit: post-build-variant-value=true, set at link in variant link-time / post-build in variant post-build / pre-compile in variant pre-compile  # Switches transmission via TriggerTransmit. | * true: The I-PDU is transmitted using TriggerTransmit. * false: The I-PDU is transmitted directly with the Transmit call.
            reference MirrorDestPduRef: set at link in variant link-time+post-build / pre-compile in variant pre-compile, destination=Pdu  # Reference to the Pdu object representing the I-PDU.
        container MirrorDestNetworkFlexRay [0..1]: multiplicity set at link in variant link-time / post-build in variant post-build / pre-compile in variant pre-compile, post-build-variant-multiplicity=true  # Destination bus representing a FlexRay network.
          integer MirrorDestQueueSize: 1..65535, set at link in variant link-time+post-build / pre-compile in variant pre-compile, default-value=20  # Number of frames that can be stored in the output queue for the destination bus.
          float MirrorDestTransmissionDeadline [0..1]: 0.001..0.655, post-build-variant-value=true, set at link in variant link-time / post-build in variant post-build / pre-compile in variant pre-compile, default-value=0.1  # Time in seconds after which the collection of source frames into the destination frame stopped and the frame is sent at the latest. | If omitted, destination frames are only sent when full or when the time stamp overflows after 655.35ms.
          integer MirrorNetworkId: 0..255, scope=ECU, post-build-variant-value=true, set at link in variant link-time / post-build in variant post-build / pre-compile in variant pre-compile, symbolic-name-value=true  # Network ID of the bus.
          reference MirrorComMNetworkHandleRef: set at link in variant link-time / post-build in variant post-build / pre-compile in variant pre-compile, requires-symbolic-name-value=true, destination=ComMChannel  # Reference to the ComMChannel that represents the bus.
          container MirrorDestPduFlexRay [1..*]: multiplicity set at link in variant link-time / post-build in variant post-build / pre-compile in variant pre-compile, post-build-variant-multiplicity=true  # I-PDU used for transmission of the mirrored frames on the destination bus. For FlexRay, an arbitrary number of I-PDUs can be configured.
            integer MirrorDestPduId: 0..65535, scope=ECU, set at pre-compile, symbolic-name-value=true  # I-PDU identifier used for TxConfirmation from PduR.
            boolean MirrorDestPduUsesTriggerTransmit: post-build-variant-value=true, set at link in variant link-time / post-build in variant post-build / pre-compile in variant pre-compile  # Switches transmission via TriggerTransmit. | * true: The I-PDU is transmitted using TriggerTransmit. * false: The I-PDU is transmitted directly with the Transmit call.
            reference MirrorDestPduRef: set at link in variant link-time+post-build / pre-compile in variant pre-compile, destination=Pdu  # Reference to the Pdu object representing the I-PDU.
        container MirrorDestNetworkIp [0..1]: multiplicity set at link in variant link-time / post-build in variant post-build / pre-compile in variant pre-compile, post-build-variant-multiplicity=true  # Destination bus representing an IP network.
          integer MirrorDestQueueSize: 1..65535, set at link in variant link-time+post-build / pre-compile in variant pre-compile, default-value=20  # Number of frames that can be stored in the output queue for the destination bus.
          float MirrorDestTransmissionDeadline [0..1]: 0.001..0.655, post-build-variant-value=true, set at link in variant link-time / post-build in variant post-build / pre-compile in variant pre-compile, default-value=0.1  # Time in seconds after which the collection of source frames into the destination frame stopped and the frame is sent at the latest. | If omitted, destination frames are only sent when full or when the time stamp overflows after 655.35ms.
          integer MirrorNetworkId: 0..255, scope=ECU, post-build-variant-value=true, set at link in variant link-time / post-build in variant post-build / pre-compile in variant pre-compile, symbolic-name-value=true  # Network ID of the bus.
          reference MirrorComMNetworkHandleRef: set at link in variant link-time / post-build in variant post-build / pre-compile in variant pre-compile, requires-symbolic-name-value=true, destination=ComMChannel  # Reference to the ComMChannel that represents the bus.
          container MirrorDestPdu: multiplicity set at link in variant link-time / post-build in variant post-build / pre-compile in variant pre-compile, post-build-variant-multiplicity=true  # I-PDU used for transmission of the mirrored frames on the destination bus.
            integer MirrorDestPduId: 0..65535, scope=ECU, set at pre-compile, symbolic-name-value=true  # I-PDU identifier used for TxConfirmation from PduR.
            boolean MirrorDestPduUsesTriggerTransmit: post-build-variant-value=true, set at link in variant link-time / post-build in variant post-build / pre-compile in variant pre-compile  # Switches transmission via TriggerTransmit. | * true: The I-PDU is transmitted using TriggerTransmit. * false: The I-PDU is transmitted directly with the Transmit call.
            reference MirrorDestPduRef: set at link in variant link-time+post-build / pre-compile in variant pre-compile, destination=Pdu  # Reference to the Pdu object representing the I-PDU.
      choice container MirrorSourceNetwork [1..*]: multiplicity set at link in variant link-time / post-build in variant post-build / pre-compile in variant pre-compile, post-build-variant-multiplicity=true  # Source bus from which frames are received by the Bus Mirroring module.
        container MirrorSourceNetworkCan [0..1]: multiplicity set at link in variant link-time / post-build in variant post-build / pre-compile in variant pre-compile, post-build-variant-multiplicity=true  # Source bus representing a CAN network.
          integer MirrorNetworkId: 0..255, scope=ECU, post-build-variant-value=true, set at link in variant link-time / post-build in variant post-build / pre-compile in variant pre-compile, symbolic-name-value=true  # Network ID of the bus.
          integer MirrorSourceMaxDynamicFilters: 0..255, set at link in variant link-time+post-build / pre-compile in variant pre-compile, default-value=5  # Maximum number of filters that can be dynamically added using Mirror_AddXxxFilter().
          reference MirrorComMNetworkHandleRef: set at link in variant link-time / post-build in variant post-build / pre-compile in variant pre-compile, requires-symbolic-name-value=true, destination=ComMChannel  # Reference to the ComMChannel that represents the bus.
          choice container MirrorSourceCanFilter [0..255]: multiplicity set at link in variant link-time / post-build in variant post-build / pre-compile in variant pre-compile, post-build-variant-multiplicity=true  # Pre-configured filter for CAN frames.
            container MirrorSourceCanFilterMask [0..1]: multiplicity set at link in variant link-time / post-build in variant post-build / pre-compile in variant pre-compile, post-build-variant-multiplicity=true  # Pre-configured mask based filter for CAN frames.
              integer MirrorSourceCanFilterCanIdCode: 0..4294967295, post-build-variant-value=true, set at link in variant link-time / post-build in variant post-build / pre-compile in variant pre-compile  # Value to match masked CAN IDs.
              integer MirrorSourceCanFilterCanIdMask: 0..4294967295, post-build-variant-value=true, set at link in variant link-time / post-build in variant post-build / pre-compile in variant pre-compile  # Mask applied to CAN IDs before comparison.
              integer MirrorSourceCanFilterId: 0..255, scope=ECU, post-build-variant-value=true, set at link in variant link-time / post-build in variant post-build / pre-compile in variant pre-compile, symbolic-name-value=true  # Unique identifier of the pre-configured CAN filter.
            container MirrorSourceCanFilterRange [0..1]: multiplicity set at link in variant link-time / post-build in variant post-build / pre-compile in variant pre-compile, post-build-variant-multiplicity=true  # Pre-configured range filter for CAN frames.
              integer MirrorSourceCanFilterId: 0..255, scope=ECU, post-build-variant-value=true, set at link in variant link-time / post-build in variant post-build / pre-compile in variant pre-compile, symbolic-name-value=true  # Unique identifier of the pre-configured CAN filter.
              integer MirrorSourceCanFilterLower: 0..4294967295, post-build-variant-value=true, set at link in variant link-time / post-build in variant post-build / pre-compile in variant pre-compile  # Lowest CAN ID that is accepted by the filter.
              integer MirrorSourceCanFilterUpper: 0..4294967295, post-build-variant-value=true, set at link in variant link-time / post-build in variant post-build / pre-compile in variant pre-compile  # Highest CAN ID that is accepted by the filter.
          container MirrorSourceCanMaskBasedIdMapping [0..*]: multiplicity set at link in variant link-time / post-build in variant post-build / pre-compile in variant pre-compile, post-build-variant-multiplicity=true  # Rule for remapping a set of CAN IDs.
            integer MirrorSourceCanMaskBasedIdMappingDestBaseId: 0..4294967295, post-build-variant-value=true, set at link in variant link-time / post-build in variant post-build / pre-compile in variant pre-compile  # Base ID merged with the masked parts of the original CAN ID to form the mapped CAN ID.
            integer MirrorSourceCanMaskBasedIdMappingSourceCanIdCode: 0..4294967295, post-build-variant-value=true, set at link in variant link-time / post-build in variant post-build / pre-compile in variant pre-compile  # Value to match masked original CAN IDs.
            integer MirrorSourceCanMaskBasedIdMappingSourceCanIdMask: 0..4294967295, post-build-variant-value=true, set at link in variant link-time / post-build in variant post-build / pre-compile in variant pre-compile  # Mask applied to original CAN IDs before comparison.
          container MirrorSourceCanSingleIdMapping [0..*]: multiplicity set at link in variant link-time / post-build in variant post-build / pre-compile in variant pre-compile, post-build-variant-multiplicity=true  # Rule for remapping a single CAN ID.
            integer MirrorSourceCanSingleIdMappingDestCanId: 0..4294967295, post-build-variant-value=true, set at link in variant link-time / post-build in variant post-build / pre-compile in variant pre-compile  # Mapped CAN ID.
            integer MirrorSourceCanSingleIdMappingSourceCanId: 0..4294967295, post-build-variant-value=true, set at link in variant link-time / post-build in variant post-build / pre-compile in variant pre-compile  # Original CAN ID.
        container MirrorSourceNetworkFlexRay [0..1]: multiplicity set at link in variant link-time / post-build in variant post-build / pre-compile in variant pre-compile, post-build-variant-multiplicity=true  # Source bus representing a FlexRay network.
          integer MirrorNetworkId: 0..255, scope=ECU, post-build-variant-value=true, set at link in variant link-time / post-build in variant post-build / pre-compile in variant pre-compile, symbolic-name-value=true  # Network ID of the bus.
          integer MirrorSourceMaxDynamicFilters: 0..255, set at link in variant link-time+post-build / pre-compile in variant pre-compile, default-value=5  # Maximum number of filters that can be dynamically added using Mirror_AddXxxFilter().
          reference MirrorComMNetworkHandleRef: set at link in variant link-time / post-build in variant post-build / pre-compile in variant pre-compile, requires-symbolic-name-value=true, destination=ComMChannel  # Reference to the ComMChannel that represents the bus.
          container MirrorSourceFlexRayFilter [0..255]: multiplicity set at link in variant link-time / post-build in variant post-build / pre-compile in variant pre-compile, post-build-variant-multiplicity=true  # Pre-configured filter for FlexRay frames.
            enumeration MirrorSourceFlexRayFilterChannelAssignment: {MIRROR_FR_CHANNEL_A, MIRROR_FR_CHANNEL_AB, MIRROR_FR_CHANNEL_B}, post-build-variant-value=true, set at link in variant link-time / post-build in variant post-build / pre-compile in variant pre-compile  # FlexRay channels accepted by the filter.
            integer MirrorSourceFlexRayFilterCycleRepetition: 1..64, post-build-variant-value=true, set at link in variant link-time / post-build in variant post-build / pre-compile in variant pre-compile  # Cycle repetition of accepted cycles.
            integer MirrorSourceFlexRayFilterId: 0..255, scope=ECU, post-build-variant-value=true, set at link in variant link-time / post-build in variant post-build / pre-compile in variant pre-compile, symbolic-name-value=true  # Unique identifier of the pre-configured FlexRay filter.
            integer MirrorSourceFlexRayFilterLowerBaseCycle: 0..63, post-build-variant-value=true, set at link in variant link-time / post-build in variant post-build / pre-compile in variant pre-compile  # Lowest base cycle number that is accepted by the filter.
            integer MirrorSourceFlexRayFilterLowerSlot: 1..2047, post-build-variant-value=true, set at link in variant link-time / post-build in variant post-build / pre-compile in variant pre-compile  # Lowest slot ID that is accepted by the filter.
            integer MirrorSourceFlexRayFilterUpperBaseCycle: 0..63, post-build-variant-value=true, set at link in variant link-time / post-build in variant post-build / pre-compile in variant pre-compile  # Highest base cycle number that is accepted by the filter.
            integer MirrorSourceFlexRayFilterUpperSlot: 1..2047, post-build-variant-value=true, set at link in variant link-time / post-build in variant post-build / pre-compile in variant pre-compile  # Highest slot ID that is accepted by the filter.
        container MirrorSourceNetworkLin [0..1]: multiplicity set at link in variant link-time / post-build in variant post-build / pre-compile in variant pre-compile, post-build-variant-multiplicity=true  # Source bus representing a LIN network.
          integer MirrorNetworkId: 0..255, scope=ECU, post-build-variant-value=true, set at link in variant link-time / post-build in variant post-build / pre-compile in variant pre-compile, symbolic-name-value=true  # Network ID of the bus.
          integer MirrorSourceLinToCanBaseId: 0..4294967295, post-build-variant-value=true, set at link in variant link-time / post-build in variant post-build / pre-compile in variant pre-compile  # Base ID merged with the LIN frame ID to form the CAN ID.
          integer MirrorSourceMaxDynamicFilters: 0..255, set at link in variant link-time+post-build / pre-compile in variant pre-compile, default-value=5  # Maximum number of filters that can be dynamically added using Mirror_AddXxxFilter().
          reference MirrorComMNetworkHandleRef: set at link in variant link-time / post-build in variant post-build / pre-compile in variant pre-compile, requires-symbolic-name-value=true, destination=ComMChannel  # Reference to the ComMChannel that represents the bus.
          choice container MirrorSourceLinFilter [0..255]: multiplicity set at link in variant link-time / post-build in variant post-build / pre-compile in variant pre-compile, post-build-variant-multiplicity=true  # Pre-configured filter for LIN frames.
            container MirrorSourceLinFilterMask [0..1]: multiplicity set at link in variant link-time / post-build in variant post-build / pre-compile in variant pre-compile, post-build-variant-multiplicity=true  # Pre-configured mask based filter for LIN frames.
              integer MirrorSourceLinFilterId: 0..255, scope=ECU, post-build-variant-value=true, set at link in variant link-time / post-build in variant post-build / pre-compile in variant pre-compile, symbolic-name-value=true  # Unique identifier of the pre-configured LIN filter.
              integer MirrorSourceLinFilterLinIdCode: 0..63, post-build-variant-value=true, set at link in variant link-time / post-build in variant post-build / pre-compile in variant pre-compile  # Value to match masked frame IDs.
              integer MirrorSourceLinFilterLinIdMask: 0..63, post-build-variant-value=true, set at link in variant link-time / post-build in variant post-build / pre-compile in variant pre-compile  # Mask applied to frame IDs before comparison.
            container MirrorSourceLinFilterRange [0..1]: multiplicity set at link in variant link-time / post-build in variant post-build / pre-compile in variant pre-compile, post-build-variant-multiplicity=true  # Pre-configured range filter for LIN frames.
              integer MirrorSourceLinFilterId: 0..255, scope=ECU, post-build-variant-value=true, set at link in variant link-time / post-build in variant post-build / pre-compile in variant pre-compile, symbolic-name-value=true  # Unique identifier of the pre-configured LIN filter.
              integer MirrorSourceLinFilterLower: 0..63, post-build-variant-value=true, set at link in variant link-time / post-build in variant post-build / pre-compile in variant pre-compile  # Lowest frame ID that is accepted by the filter.
              integer MirrorSourceLinFilterUpper: 0..63, post-build-variant-value=true, set at link in variant link-time / post-build in variant post-build / pre-compile in variant pre-compile  # Highest frame ID that is accepted by the filter.
          container MirrorSourceLinToCanIdMapping [0..*]: multiplicity set at link in variant link-time / post-build in variant post-build / pre-compile in variant pre-compile, post-build-variant-multiplicity=true  # Rule for mapping a LIN frame ID to a special CAN ID.
            integer MirrorSourceLinToCanIdMappingCanId: 0..4294967295, post-build-variant-value=true, set at link in variant link-time / post-build in variant post-build / pre-compile in variant pre-compile  # CAN ID which lies outside of the range mapping.
            integer MirrorSourceLinToCanIdMappingLinId: 0..63, post-build-variant-value=true, set at link in variant link-time / post-build in variant post-build / pre-compile in variant pre-compile  # Frame ID which is excluded from the range mapping.
    container MirrorGeneral  # Contains the general configuration parameters of the module.
      boolean MirrorDevErrorDetect: set at pre-compile, default-value=false  # Switches the development error detection and notification on or off. | * true: detection and notification is enabled. * false: detection and notification is disabled.
      boolean MirrorVersionInfoApi: set at pre-compile, default-value=false  # Pre-processor switch for enabling version info API support.
      reference MirrorEcucPartitionRef [0..1]: multiplicity set at pre-compile, set at pre-compile, destination=EcucPartition  # Reference to EcucPartition, where BusMirroring module is assigned to.
      reference MirrorStbRef [0..1]: set at pre-compile, requires-symbolic-name-value=true, destination=StbMSynchronizedTimeBase  # Reference to the StbM time base to use for acquiring the time stamps used in the mirroring protocol. | This reference is not required if all destination buses are CAN.
      container MirrorMainFunction [1..*]: multiplicity set at pre-compile  # Each element of this container defines one instance of Mirror_MainFunction.
        float MirrorMainFunctionPeriod: 0..INF, set at pre-compile, default-value=0.05  # Execution cycle of the respective Mirror_MainFunction instance in seconds.
        reference MirrorMainPartitionRef: set at pre-compile, destination=EcucPartition  # Reference to EcucPartition, where the according Mirror_MainFunction instance is assigned to.
  module definition Nm [0..1]: variants link-time/pre-compile  # The Generic Network Management Interface module
    container NmChannelConfig [1..*]  # This container contains the configuration (parameters) of the bus channel(s). The channel parameter shall be harmonized within the whole communication stack.
      boolean NmActiveCoordinator [0..1]: multiplicity set at pre-compile, set at pre-compile  # This parameter indicates whether a NM channel - part of a Nm Coordination cluster - will be coordinated actively (NmActiveCoordinator = TRUE) or passively (NmActiveCoordinator = FALSE).
      boolean NmChannelSleepMaster: set at link in variant link-time / pre-compile in variant pre-compile  # This parameter shall be set to indicate if the sleep of this network can be absolutely decided by the local node only and that no other nodes can oppose that decision. | If this parameter is set to TRUE, the Nm shall assume that the channel is always ready to go to sleep and that no calls to Nm_RemoteSleepIndication or Nm_RemoteSleepCancellation will be made from the <BusNm> representing this channel. If this parameter is set to FALSE, the Nm shall not assume that the network is ready to sleep until a call has been made to Nm_RemoteSleepCancellation.
      boolean NmComUserDataSupport [0..1]: multiplicity set at pre-compile, set at pre-compile, default-value=false  # This parameter indicates whether on a NM channel user data is accessed via Com signals or by SetUserData API.
      integer NmCoordClusterIndex [0..1]: 0..255, multiplicity set at link in variant link-time / pre-compile in variant pre-compile, set at link in variant link-time / pre-compile in variant pre-compile  # If this parameter is undefined for a channel, the corresponding bus does not belong to an NM coordination cluster.
      boolean NmDynamicPncToChannelMappingEnabled [0..1]: set at link in variant link-time / pre-compile in variant pre-compile, default-value=false  # Channel-specific parameter to enable the dynamic PNC-to-channel-mapping feature. Tags: atp.Status=draft | False: Dynamic PNC-to-channel-mapping is disabled True: Dynamic PNC-to-channel-mapping is enabled
      boolean NmPassiveModeEnabled: set at pre-compile  # This parameter indicates whether a NM channel is active,e.g. can request communication and keep the bus awake, or passive, e.g. can just be woken up and kept awake by other ECUs.
      boolean NmStateReportEnabled: set at pre-compile  # Specifies if the NMS shall be set for the corresponding network. | false: No NMS shall be set true: The NMS shall be set
      boolean NmSynchronizingNetwork: set at link in variant link-time / pre-compile in variant pre-compile  # If this parameter is true, then this network is a synchronizing network for the NM coordination cluster which it belongs to. The network is expected to call Nm_SynchronizationPoint() at regular intervals.
      reference NmComMChannelRef: set at link in variant link-time / pre-compile in variant pre-compile, requires-symbolic-name-value=true, destination=ComMChannel  # Reference to the corresponding ComM Channel.
      reference NmStateReportSignalRef [0..1]: multiplicity set at pre-compile, set at pre-compile, requires-symbolic-name-value=true, destination=ComSignal  # Reference to the signal for setting the NMS by calling Com_SendSignal for the respective channel.
      choice container NmBusType
        container NmGenericBusNmConfig [0..1]
          string NmGenericBusNmPrefix: set at link in variant link-time / pre-compile in variant pre-compile  # The prefix which identifies the generic <BusNm>. This will be used to determine the API name to be called by Nm for the provided interfaces of the <BusNm>. This string will used for the module prefix before the "_" character in the API call name.
          float NmGenericBusNmShutdownTime: 0..INF, set at link in variant link-time / pre-compile in variant pre-compile  # This parameter shall be | used to calculate shutdown delay time.
        container NmStandardBusNmConfig [0..1]
          enumeration NmStandardBusType: {NM_BUSNM_CANNM, NM_BUSNM_FRNM, NM_BUSNM_J1939NM, NM_BUSNM_LOCALNM, NM_BUSNM_UDPNM}, set at link in variant link-time / pre-compile in variant pre-compile  # Identifies the bus type of the channel for standard AUTOSAR <BusNm>s and is used to determine which set of API calls to be called by Nm for the <BusNm>s. | Note: The Ethernet bus' NM is UdpNm !
    container NmGlobalConfig  # This container contains all global configuration parameters of the Nm Interface.
      reference NmEcucPartitionRef [0..1]: multiplicity set at pre-compile, set at pre-compile, destination=EcucPartition  # Reference to EcucPartition, where Nm module is assigned to.
      container NmGlobalConstants
        integer NmNumberOfChannels: 1..255, set at pre-compile  # Number of NM channels allowed within one ECU.
      container NmGlobalFeatures
        boolean NmBusSynchronizationEnabled: set at pre-compile  # Pre-processor switch for enabling bus synchronization support of the <BusNm>s. This feature is required for NM Coordinator nodes only.
        function name NmCarWakeUpCallout [0..1]: multiplicity set at link in variant link-time / pre-compile in variant pre-compile, set at link in variant link-time / pre-compile in variant pre-compile  # Name of the callout function to be called if Nm_CarWakeUpIndication() is called. If this parameter is not configured, the Nm will call BswM_Nm_CarWakeUpIndication.
        boolean NmCarWakeUpRxEnabled: set at link in variant link-time / pre-compile in variant pre-compile, default-value=false  # Enables or disables CWU detection. | FALSE - CarWakeUp not supported TRUE - CarWakeUp supported
        boolean NmComControlEnabled: set at pre-compile  # Pre-processor switch for enabling the Communication Control support.
        boolean NmCoordinatorSupportEnabled: set at pre-compile, default-value=false  # Pre-processor switch for enabling NM Coordinator support.
        boolean NmCoordinatorSyncSupport: set at link in variant link-time / pre-compile in variant pre-compile  # Enables/disables the coordinator synchronisation support.
        boolean NmDynamicPncToChannelMappingSupport: set at pre-compile  # Precompile time switch to enable the dynamic PNC-to-channel-mapping handling. Tags: atp.Status=draft | False: Dynamic PNC-to-channel-mapping is disabled True: Dynamic PNC-to-channel-mapping is enabled
        float NmGlobalCoordinatorTime [0..1]: 0..INF, multiplicity set at pre-compile, set at pre-compile  # This parameter defines the maximum shutdown time of a connected and coordinated NM-Cluster. | Note:This includes nested connections.
        boolean NmPduRxIndicationEnabled: set at pre-compile  # Pre-processor switch for enabling the PDU Rx Indication.
        boolean NmRemoteSleepIndEnabled: set at pre-compile  # Pre-processor switch for enabling Remote Sleep Indication support. This feature is required for a Gateway or Nm Coordinator functionality. | Note that this feature should not be used if all NM channels have Passive Mode enabled.
        boolean NmStateChangeIndEnabled: set at pre-compile  # Pre-processor switch for enabling the Network Management state change notification.
        boolean NmSynchronizedPncShutdownEnabled [0..1]: multiplicity set at link in variant link-time / pre-compile in variant pre-compile, set at link in variant link-time / pre-compile in variant pre-compile, default-value=false  # Enables or disables support of synchronized PNC shutdown. Tags: atp.Status=draft | FALSE: synchronized PNC shutdown is disabled TRUE: synchronized PNC shutdown is enabled
        boolean NmUserDataEnabled: set at pre-compile  # Pre-processor switch for enabling User Data support.
      container NmGlobalProperties
        float NmCycletimeMainFunction [0..1]: 0..INF, multiplicity set at link in variant link-time / pre-compile in variant pre-compile, set at link in variant link-time / pre-compile in variant pre-compile  # The period between successive calls to the Main Function of the NM Interface in seconds.
        boolean NmDevErrorDetect: set at pre-compile, default-value=false  # Switches the development error detection and notification on or off. | * true: detection and notification is enabled. * false: detection and notification is disabled.
        boolean NmVersionInfoApi: set at pre-compile, default-value=false  # Pre-processor switch for enabling Version Info API support.
