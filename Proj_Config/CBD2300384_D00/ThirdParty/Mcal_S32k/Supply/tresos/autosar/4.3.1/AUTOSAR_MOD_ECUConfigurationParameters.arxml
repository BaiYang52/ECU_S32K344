[part 9 of 9: packages /AUTOSAR/EcucDefs to /AUTOSAR/LifeCycleInfoSets]
AUTOSAR XML (schema 00044)
package /AUTOSAR/EcucDefs  (continued)
  module definition TcpIp [0..1]: post-build-variant-support=true, variants link-time/post-build/pre-compile  # Configuration of the TcpIp (TCP/IP stack) module.
    container TcpIpConfig  # This container contains the configuration parameters and sub containers of the AUTOSAR TcpIp module.
      container TcpIpCtrl [1..*]  # Specifies the EthIf controller used for IP communication.
        integer TcpIpIpFramePrioDefault [0..1]: 0..7, multiplicity set at link in variant link-time / post-build in variant post-build / pre-compile in variant pre-compile, post-build-variant-multiplicity=true, post-build-variant-value=true, set at link in variant link-time / post-build in variant post-build / pre-compile in variant pre-compile, default-value=0  # Specifies the default value for the priority for all outgoing frames. | Note: the value can be changed for each socket individually via TcpIp_ChangeParameter() service. If this optional parameter is not available, 0 is used as default priority.
        reference TcpIpDhcpServerConfigRef [0..1]: post-build-variant-value=true, set at link in variant link-time / post-build in variant post-build / pre-compile in variant pre-compile, destination=TcpIpDhcpServerConfig  # Reference to a TcpIpDhcpServerConfig which shall be used for this controller setting (VLAN).
        symbolic name reference TcpIpEthIfCtrlRef: post-build-variant-value=true, set at link in variant link-time / post-build in variant post-build / pre-compile in variant pre-compile, destination=EthIfController  # Reference to EthIf controller where the IP address shall be assigned.
        choice container TcpIpIpVXCtrl  # Specifies whether this controller is an Internet Protocol version 4 (IPv4) or Internet Protocol version 6 (IPv4) instance.
          container TcpIpIpV4Ctrl [0..1]  # Specifies an Internet Protocol version 4 (IPv4) instance.
            reference TcpIpArpConfigRef [0..1]: multiplicity set at pre-compile, set at pre-compile, destination=TcpIpArpConfig  # Reference to ARP configuration for this IPv4 instance. | (Multiple IPv4 instances may use the same configuration container but will operate independently)
            reference TcpIpAutoIpConfigRef [0..1]: multiplicity set at pre-compile, set at pre-compile, destination=TcpIpAutoIpConfig  # Reference to AutoIp configuration for this IPv4 instance. | (Multiple IPv4 instances may use the same configuration container but will operate independently)
            reference TcpIpDhcpConfigRef [0..1]: multiplicity set at pre-compile, set at pre-compile, destination=TcpIpDhcpConfig  # Reference to DHCP configuration for this IPv4 instance. | (Multiple IPv4 instances may use the same configuration container but will operate independently)
            reference TcpIpFragmentationConfigRef [0..1]: multiplicity set at pre-compile, set at pre-compile, destination=TcpIpIpFragmentationConfig  # Reference to Fragmentation configuration for this IPv4 instance. | (Multiple IPv4 instances may use the same configuration container but will operate independently)
            container TcpIpIpV4MtuConfig  # This container specifies the Maximum Transmission Unit parameters for this IPv4 instance.
              boolean TcpIpIpV4PathMtuEnabled: set at pre-compile, default-value=false  # If enabled the IPv4 processes incoming ICMPv4 "Packet Too Big" messages and stores a MTU value for each destination address.
              float TcpIpIpV4PathMtuTimeout: 1..86400, set at pre-compile, default-value=600  # If this value is >0 the IpV4 will reset the MTU value stored for each destination after n seconds. | see [RFC1191 6.3. Purging stale PMTU information] Default: 600 seconds (10 minutes)
          container TcpIpIpV6Ctrl [0..1]  # Specifies an Internet Protocol version 6 (IPv6) instance.
            reference TcpIpIpV6DhcpConfigRef [0..1]: multiplicity set at pre-compile, set at pre-compile, destination=TcpIpDhcpV6Config  # Reference to DHCPv6 configuration. | (Multiple IPv6 instances may use the same configuration container but will operate independently)
            reference TcpIpIpV6FragmentationConfigRef [0..1]: multiplicity set at pre-compile, set at pre-compile, destination=TcpIpIpV6FragmentationConfig  # Reference to IPv6 Fragmentation Configuration. | (Multiple IPv6 instances may use the same configuration container but will operate independently)
            reference TcpIpIpV6NdpConfigRef: set at pre-compile, destination=TcpIpNdpConfig  # Reference to Neighbor Discovery Protocol Configuration. | (Multiple IPv6 instances may use the same configuration container but will operate independently)
            container TcpIpIpV6MtuConfig  # This container specifies the Maximum Transmission Unit parameters for this IPv6 instance.
              boolean TcpIpIpV6PathMtuEnabled: set at pre-compile, default-value=false  # If enabled the IPv6 processes incoming ICMPv6 "Packet Too Big" messages and stores a MTU value for each destination address. | See RFC1981 "Path MTU Discovery for IP version 6" for details about PathMTU.
              float TcpIpIpV6PathMtuTimeout: 1..86400, set at pre-compile, default-value=600  # If this value is >0 the IpV6 will reset the MTU value stored for each destination after n seconds. | see [RFC1981 5.3. Purging stale PMTU information] Default: 600 seconds (10 minutes)
      container TcpIpDhcpServerConfig [0..*]: multiplicity set at link in variant link-time / post-build in variant post-build / pre-compile in variant pre-compile, post-build-variant-multiplicity=true  # Specifies the configuration parameters of the DHCP Server sub-module.
        string TcpIpDhcpDefaultRouter [0..1]: multiplicity set at link in variant link-time / post-build in variant post-build / pre-compile in variant pre-compile, post-build-variant-multiplicity=true, post-build-variant-value=true, set at link in variant link-time / post-build in variant post-build / pre-compile in variant pre-compile  # IP address of default router (gateway).
        integer TcpIpDhcpNetmask [0..1]: 0..128, multiplicity set at link in variant link-time / post-build in variant post-build / pre-compile in variant pre-compile, post-build-variant-multiplicity=true, post-build-variant-value=true, set at link in variant link-time / post-build in variant post-build / pre-compile in variant pre-compile  # Network mask of IPv4 address or address prefix of IPv6 address in CIDR Notation, i.e. decimal value between 0 and 32 (IPv4) or 0 and 128 (IPv6) that describes the number of significant bits defining the network number or prefix of an IP address.
        symbolic name reference TcpIpDhcpEthIfSwitchRef [0..1]: scope=ECU, multiplicity set at link in variant link-time / post-build in variant post-build / pre-compile in variant pre-compile, post-build-variant-multiplicity=true, post-build-variant-value=true, set at link in variant link-time / post-build in variant post-build / pre-compile in variant pre-compile, destination=EthIfSwitch  # Reference to EthIfSwitch representation. | Optional in case the Dhcp server is operating without an Ethernet switch.
        container TcpIpDhcpAddressAssignment [0..*]: multiplicity set at link in variant link-time / post-build in variant post-build / pre-compile in variant pre-compile, post-build-variant-multiplicity=true  # Defines a Ethernet Switch port based IP address assignment.
          string TcpIpDhcpAddressLowerBound: post-build-variant-value=true, set at link in variant link-time / post-build in variant post-build / pre-compile in variant pre-compile  # The lower bound IP address which shall be assigned. | If lower bound and upper bound are identical exactly this IP address shall be assigned.
          string TcpIpDhcpAddressUpperBound: post-build-variant-value=true, set at link in variant link-time / post-build in variant post-build / pre-compile in variant pre-compile  # The upper bound IP address which shall be assigned. | If lower bound and upper bound are identical exactly this IP address shall be assigned.
          symbolic name reference TcpIpDhcpSwitchPortRef [0..1]: scope=ECU, multiplicity set at link in variant link-time / post-build in variant post-build / pre-compile in variant pre-compile, post-build-variant-multiplicity=true, post-build-variant-value=true, set at link in variant link-time / post-build in variant post-build / pre-compile in variant pre-compile, destination=EthSwtPort  # Reference to Ethernet Switch port. | Optional in case the Dhcp server is operating without an Ethernet switch.
      container TcpIpDuplicateAddressDetectionConfig [0..1]  # Specifies the DAD callout function.
        function name TcpIpDuplicateAddressDetectionCalloutName: set at pre-compile  # This parameter defines the name of the DAD callout function <Up_DADAddressConflict>.
        string TcpIpDuplicateAddressDetectionHeaderFileName: set at pre-compile  # This parameter specifies the name of the header file containing the definition of the DAD callout function.
      container TcpIpIpConfig [0..1]  # Specifies the configuration parameters of the IP (Internet Protocol) sub-module
        container TcpIpIpV4Config [0..1]  # Specifies the configuration parameters of the IPv4 (Internet Protocol version 4) sub-module.
          container TcpIpArpConfig [0..*]  # Specifies the configuration parameters of the ARP (Address Resolution Protocol) sub-module.
            integer TcpIpArpNumGratuitousARPonStartup: 0..255, post-build-variant-value=true, set at link in variant link-time / post-build in variant post-build / pre-compile in variant pre-compile  # Specifies the number of gratuitous ARP replies which shall be sent on assignment of a new IP address.
            boolean TcpIpArpPacketQueueEnabled: set at pre-compile, default-value=false  # Enables (TRUE) or disables (FALSE) support of the ARP Packet Queue according to IETF RFC 1122, section 2.3.2.2.
            float TcpIpArpTableEntryTimeout: 0..Inf, post-build-variant-value=true, set at link in variant link-time / post-build in variant post-build / pre-compile in variant pre-compile  # Timeout in seconds after which an unused ARP entry is removed.
            integer TcpIpArpTableSizeMax: 0..65535, set at link in variant link-time+post-build / pre-compile in variant pre-compile  # Maximum number of entries in the ARP table.
          container TcpIpAutoIpConfig [0..*]  # Specifies the configuration parameters of the Auto-IP (automatic private IP addressing) sub-module.
            float TcpIpAutoIpInitTimeout: 0..Inf, post-build-variant-value=true, set at link in variant link-time / post-build in variant post-build / pre-compile in variant pre-compile  # The time in seconds Auto-IP waits at startup, before beginning with ARP probing. This delay is used to give DHCP time to acquire a lease in case a DHCP server is present.
          container TcpIpDhcpConfig [0..*]  # Specifies the configuration parameters of the DHCPv4. | This container may be referenced by multiple IPv4 instances if they shall use the same configuration. This container may have multiple instances if different configurations are required for different IPv4 instances.
          container TcpIpIcmpConfig [0..1]  # Specifies the configuration parameters of the ICMP (Internet Control Message Protocol) sub-module.
            boolean TcpIpIcmpEchoReplyEnabled: set at pre-compile, default-value=false  # Enables or disables transmission of ICMP echo reply message in case of a ICMP echo reception.
            integer TcpIpIcmpTtl: 0..255, post-build-variant-value=true, set at link in variant link-time / post-build in variant post-build / pre-compile in variant pre-compile  # Default Time-to-live value of outgoing ICMP packets.
            container TcpIpIcmpMsgHandler [0..1]  # This container is a subcontainer of TcpIpIcmpConfig and specifies the configuration parameters for the ICMP message handler.
              string TcpIpIcmpMsgHandlerHeaderFileName: set at link in variant link-time+post-build / pre-compile in variant pre-compile, max-length=32, min-length=1  # This parameter specifies the name of the header file containing the definition of the ICMP message handler function.
              function name TcpIpIcmpMsgHandlerName: set at link in variant link-time+post-build / pre-compile in variant pre-compile  # This parameter defines the name of the ICMP message handler function <Up_IcmpMsgHandler>.
          container TcpIpIpFragmentationConfig [0..*]  # Specifies the configuration parameters of IPv4 packet fragmentation/reassembly. | This container may be referenced by multiple IPv4 instances if they shall use the same configuration. This container may have multiple instances if different configurations are required for different IPv4 instances.
            boolean TcpIpIpFragmentationRxEnabled: set at pre-compile, default-value=false  # Enables (TRUE) or disables (FALSE) support for reassembling of incoming datagrams that are fragmented according to IETF RFC 815 (IP Datagram Reassembly Algorithms).
            integer TcpIpIpNumFragments [0..1]: 0..255, multiplicity set at link in variant link-time / post-build in variant post-build / pre-compile in variant pre-compile, post-build-variant-multiplicity=true, post-build-variant-value=true, set at link in variant link-time / post-build in variant post-build / pre-compile in variant pre-compile, default-value=0  # Specifies the maximum number of IP fragments per datagram. | Note: this parameter is only relevant if TcpIpIpFragmentationRxEnabled is TRUE.
            integer TcpIpIpNumReassDgrams [0..1]: 0..65535, multiplicity set at link in variant link-time / post-build in variant post-build / pre-compile in variant pre-compile, post-build-variant-multiplicity=true, post-build-variant-value=true, set at link in variant link-time / post-build in variant post-build / pre-compile in variant pre-compile, default-value=3  # Specifies the maximum number of fragmented IP datagrams that can be reassembled in parallel. | Note: this parameter is only relevant if TcpIpIpFragmentationRxEnabled is TRUE.
            float TcpIpIpReassTimeout [0..1]: 0..Inf, multiplicity set at link in variant link-time / post-build in variant post-build / pre-compile in variant pre-compile, post-build-variant-multiplicity=true, post-build-variant-value=true, set at link in variant link-time / post-build in variant post-build / pre-compile in variant pre-compile, default-value=60  # Specifies the timeout in [s] after which an incomplete datagram gets discarded. | Note: this parameter is only relevant if TcpIpIpFragmentationRxEnabled is TRUE.
        container TcpIpIpV6Config [0..1]  # Specifies the configuration parameters of the IPv6 (Internet Protocol version 6) sub-module.
          container TcpIpDhcpV6Config [0..*]  # Specifies the configuration parameters of the DHCPv6. | This container may be referenced by multiple IPv6 instances if they shall use the same configuration. This container may have multiple instances if different configurations are required for different IPv6 instances.
            float TcpIpDhcpV6CnfDelayMax: 0..100, set at pre-compile, default-value=1  # Maximum delay (s) before sending the first Confirm message. If this value is bigger than the previous minimum delay value a random delay will be chosen from the interval.
            float TcpIpDhcpV6CnfDelayMin: 0..100, set at pre-compile, default-value=0  # Minimum delay (s) before the first Confirm message will be sent.
            float TcpIpDhcpV6InfDelayMax: 0..100, set at pre-compile, default-value=1  # Maximum delay (s) before sending the first Information Request message. If this value is bigger than the previous minimum delay value a random delay will be chosen from the interval.
            float TcpIpDhcpV6InfDelayMin: 0..100, set at pre-compile, default-value=0  # Minimum delay (s) before the first Information Request message will be sent.
            float TcpIpDhcpV6SolDelayMax: 0..100, set at pre-compile, default-value=1  # Maximum delay (s) before sending the first Solicit message. If this value is bigger than the previous minimum delay value a random delay will be chosen from the interval.
            float TcpIpDhcpV6SolDelayMin: 0..100, set at pre-compile, default-value=0  # Minimum delay (s) before the first Solicit message will be sent.
          container TcpIpIcmpV6Config  # Specifies the configuration parameters of the ICMPv6 (Internet Control Message Protocol for IPv6) sub-module.
            boolean TcpIpIcmpV6EchoReplyAvoidFragmentation: set at pre-compile, default-value=false  # If enabled, the stack will respond only to incoming ICMPv6 Echo Requests (Pings) that fit the MTU of the respective interface, i.e. can be transmitted without IPv6 fragmentation. Only relevant if TcpIpIcmpV6EchoReplyEnabled is enabled.
            boolean TcpIpIcmpV6EchoReplyEnabled: set at pre-compile, default-value=false  # If enabled, the stack will respond to incoming ICMPv6 Echo Requests (Pings).
            integer TcpIpIcmpV6HopLimit: 0..255, post-build-variant-value=true, set at link in variant link-time / post-build in variant post-build / pre-compile in variant pre-compile  # Default Hop-Limit value of outgoing ICMPv6 packets.
            boolean TcpIpIcmpV6MsgDestinationUnreachableEnabled: set at pre-compile  # Dis/Enables transmission of Destination Unreachable Messages
            boolean TcpIpIcmpV6MsgParameterProblemEnabled: set at pre-compile, default-value=true  # If enabled an ICMPv6 parameter problem message will be sent if a received packet has been dropped due to unknown options or headers that are found in the packet. | [RFC2460 4. IPv6 Extension Headers]
            container TcpIpIcmpV6MsgHandler [0..1]  # This container is a subcontainer of TcpIpIcmpConfig and specifies the configuration parameters for the ICMPv6 message handler.
              string TcpIpIcmpV6MsgHandlerHeaderFileName: set at link in variant link-time+post-build / pre-compile in variant pre-compile, max-length=32, min-length=1  # This parameter specifies the name of the header file containing the definition of the ICMPv6 message handler function.
              function name TcpIpIcmpV6MsgHandlerName: set at link in variant link-time+post-build / pre-compile in variant pre-compile  # This parameter defines the name of the ICMP message handler function <Up_IcmpMsgHandler>.
          container TcpIpIpV6ConfigExtHeaderFilter [0..*]  # This container describes the white list for the filtering of IPv6 extension headers, i.e. frames containing IPv6 extension headers not listed here shall be silently dropped.
            integer TcpIpIpV6ConfigExtHeaderFilterEntry [1..*]: 0..255, set at pre-compile  # IPv6 Extension Header type allowed by this filter.
          container TcpIpIpV6FragmentationConfig [0..*]  # Specifies the configuration parameters of IPv6 packet fragmentation/reassembly. | This container may be referenced by multiple IPv6 instances if they shall use the same configuration. This container may have multiple instances if different configurations are required for different IPv6 instances.
            integer TcpIpIpV6ReassemblyBufferCount: 0..255, set at pre-compile, default-value=2  # Number of buffers that can be used for fragment reassembly. In case of a reassembly error or if not all fragments are received in time this buffer will be blocked until the specified "Fragment Reassembly Timeout" has been exceeded. | A value of 0 disables fragment reassembly. [RFC2460 5. Packet Size Issues] "In order to send a packet larger than a path's MTU, a node may use the IPv6 Fragment header to fragment the packet at the source and have it reassembled at the destination(s). However, the use of such fragmentation is discouraged in any application that is able to adjust its packets to fit the measured path MTU (i.e., down to 1280 octets)."
            integer TcpIpIpV6ReassemblyBufferSize [0..1]: 1500..65535, multiplicity set at pre-compile, set at pre-compile, default-value=1500  # [RFC2460 5. Packet Size Issues] | "A node must be able to accept a fragmented packet that, after reassembly, is as large as 1500 octets. A node is permitted to accept fragmented packets that reassemble to more than 1500 octets."the measured path MTU (i.e., down to 1280 octets)."
            integer TcpIpIpV6ReassemblySegmentCount [0..1]: 1..255, multiplicity set at pre-compile, set at pre-compile, default-value=5  # Specifies the maximum number of consecutive data segments that can be managed in each reassembly buffer. If all fragments are received in order, only one segment will be needed. | To deal with fragments received out of order this value should be configured bigger than 1.
            float TcpIpIpV6ReassemblyTimeout [0..1]: 0.001..100, multiplicity set at pre-compile, set at pre-compile, default-value=60  # [RFC2460 4.5 Fragment Header] | Default: 60 seconds
            integer TcpIpIpV6TxFragmentBufferCount: 1..1000, set at pre-compile, default-value=2  # These buffers will be used if the IpV6 receives packets from the upper layer that do not fit into the MTU and thus must be fragmented. | A value of 0 disables tx fragmentation. If the upper layer transmits packets that do not fit into the link or path MTU, the IpV6 will split-up the packet into fragments. see "Enable Fragment Reassembly"
            integer TcpIpIpV6TxFragmentBufferSize [0..1]: 1500..65535, multiplicity set at pre-compile, set at pre-compile, default-value=1500  # Size of each fragment tx buffer in bytes
          container TcpIpNdpConfig [1..*]  # Specifies the configuration parameters of the Neighbor Discovery Protocol for IPv6 | This container may be referenced by multiple IPv6 instances if they shall use the same configuration. This container may have multiple instances if different configurations are required for different IPv6 instances.
            container TcpIpNdpArNudConfig [0..1]  # Specifies the configuration parameters for NDP Address Resolution and Neighbor Unreachability Detection.
              float TcpIpNdpDefaultReachableTime: 0..120, set at pre-compile, default-value=30  # Configuration of the ReachableTime (s) specified in [RFC4861 6.3.2. Host Variables]. | "The time a neighbor is considered reachable after receiving a reachability confirmation." If "TcpIpNdpDynamicReachableTimeEnabled" is checked, this value may be reconfigured based on received Router Advertisements. Default: REACHABLE_TIME = 30 seconds
              float TcpIpNdpDefaultRetransTimer: 0..60, set at pre-compile, default-value=1  # Configures the default value (s) for the RetransTimer variable specified in [RFC4861 6.3.2. Host Variables]. | "The time between retransmissions of Neighbor Solicitation messages to a neighbor when resolving the address or when probing the reachability of a neighbor." If "TcpIpNdpDynamicRetransTimeEnabled" is checked, this value may be reconfigured based on received Router Advertisements. Default: RETRANS_TIMER = 1 second
              boolean TcpIpNdpDefensiveProcessing: set at pre-compile, default-value=false  # If enabled the NDP shall only process Neighbor Advertisements which are received in reaction to a previously transmitted Neighbor Solicitation as well as skipping updates to the Neighbor Cache based on received Neighbor Solicitations. If disabled all Neighbor Advertisements and Solicitations shall be processed as specified in RFC4861. | [RFC4861 7.2.5. Receipt of Neighbor Advertisements]
              float TcpIpNdpDelayFirstProbeTime: 0..60, set at pre-compile, default-value=5  # Delay before sending the first NUD probe in (s). | [RFC4861 7.3.3. Node Behavior] Default: DELAY_FIRST_PROBE_TIME = 5 seconds
              integer TcpIpNdpMaxNeighborCacheSize: 1..254, set at pre-compile, default-value=5  # Maximum number of entries in the neighbor cache. | [RFC4861 5.1. Conceptual Data Structures]
              integer TcpIpNdpMaxRandomFactor: 0..100, set at pre-compile, default-value=15  # Maximum random factor used for randomization | [RFC4861 10. Protocol Constants] Default: 15 (MAX_RANDOM_FACTOR = 1.5)
              integer TcpIpNdpMinRandomFactor: 0..100, set at pre-compile, default-value=5  # Minimum random factor used for randomization | [RFC4861 10. Protocol Constants] Default: 5 (MIN_RANDOM_FACTOR = 0.5)
              boolean TcpIpNdpNeighborUnreachabilityDetectionEnabled: set at pre-compile, default-value=true  # Neighbor Unreachability Detection is used to remove unused entries from the neighbor cache. This feature is a basic feature of NDP and should be turned on.
              integer TcpIpNdpNumMulticastSolicitations: 0..255, set at pre-compile, default-value=3  # Maximum number of multicast solicitations that will be sent when performing address resolution. | [RFC4861 7.2.2. Sending Neighbor Solicitations] Default: MAX_MULTICAST_SOLICIT = 3
              integer TcpIpNdpNumUnicastSolicitations: 0..255, set at pre-compile, default-value=3  # Maximum number of unicast solicitations that will be sent when performig Neighbor Unreachability Detection. | [RFC4861 7.3.3. Node Behavior] Default: MAX_UNICAST_SOLICIT = 3
              boolean TcpIpNdpPacketQueueEnabled: set at pre-compile, default-value=true  # Enables (TRUE) or disables (FALSE) support of a NDP Packet Queue according to IETF RFC 4861, section 7.2.2.
              boolean TcpIpNdpRandomReachableTimeEnabled: set at pre-compile, default-value=true  # If enabled the value of ReachableTime will be multiplied with a random value between MIN_RANDOM_FACTOR and MAX_RANDOM_FACTOR in order to prevent multiple nodes from transmitting at exactly the same time | [RFC4861 6.3.2. Host Variables / ReachableTime]
            container TcpIpNdpPrefixRouterDiscoveryConfig [0..1]  # Specifies the configuration parameters for NDP Prefix and Router Discovery.
              integer TcpIpNdpDefaultRouterListSize: 2..254, set at pre-compile, default-value=2  # Maximum number of default router entries. | [RFC4861 5.1. Conceptual Data Structures]
              integer TcpIpNdpDestinationCacheSize: 1..254, set at pre-compile, default-value=5  # Maximum number of entries in the destination cache. | [RFC4861 5.1. Conceptual Data Structures]
              boolean TcpIpNdpDynamicHopLimitEnabled: set at pre-compile, default-value=true  # If enabled the default hop limit may be reconfigured based on received Router Advertisements. | [RFC4861 6.3.4. Processing Received Router Advertisements]
              boolean TcpIpNdpDynamicMtuEnabled: set at pre-compile, default-value=false  # Allow dynamic reconfiguration of link MTU via Router Advertisements. | [RFC4861 4.6.4. MTU]
              boolean TcpIpNdpDynamicReachableTimeEnabled: set at pre-compile, default-value=true  # If enabled the default Reachable Time value may be reconfigured based on received Router Advertisements. | [RFC4861 6.3.4. Processing Received Router Advertisements] Default: Enabled
              boolean TcpIpNdpDynamicRetransTimeEnabled: set at pre-compile, default-value=true  # If enabled the default Retransmit Timer value may be reconfigured based on received Router Advertisements. | [RFC4861 6.3.4. Processing Received Router Advertisements] Default: Enabled
              float TcpIpNdpMaxRtrSolicitationDelay: 0.001..60, set at pre-compile, default-value=1  # Maximum delay before the first Router Solicitation will be sent after interface initialization in (s). | [RFC4861 6.3.7. Sending Router Solicitations] Default: MAX_RTR_SOLICITATION_DELAY = 1 second
              integer TcpIpNdpMaxRtrSolicitations: 0..255, set at pre-compile, default-value=3  # Maximum number of Router Solicitations that will be sent before the first Router Advertisement has been received. | 0 = No Router Solicitations will be sent. This has no impact on handling Router Advertisements. [RFC4861 6.3.7. Sending Router Solicitations] Default: MAX_RTR_SOLICITATIONS = 3 transmissions
              integer TcpIpNdpPrefixListSize: 1..254, set at pre-compile, default-value=5  # Maximum number of entries in the on-link prefix list. | [RFC4861 5.1. Conceptual Data Structures]
              boolean TcpIpNdpRndRtrSolicitationDelayEnabled: set at pre-compile, default-value=true  # If enabled the first router solicitation will be delayed randomly from [0...MAX_RTR_SOLICITATION_DELAY]. Otherwise the first router solicitation will be sent after exactly MAX_RTR_SOLICITATION_DELAY milliseconds. | [RFC4861 6.3.7. Sending Router Solicitations] Default: Enabled
              float TcpIpNdpRtrSolicitationInterval: 0.001..60, set at pre-compile, default-value=4  # Interval between consecutive Router Solicitations in (s). | [RFC4861 6.3.7. Sending Router Solicitations] Default: RTR_SOLICITATION_INTERVAL = 4 seconds
              container TcpIpNdpPrefixList [0..1]  # Specifies a list of prefixes to be treated as "on-link" according to IETF RFC 4861 Section 5.1.
                container TcpIpNdpPrefixListEntry [1..*]  # Single entry in the prefix list.
                  string TcpIpNdpPrefixListEntryPrefixAddress: set at pre-compile  # The prefix of an IP address. This prefix can be used for on-link determination.
                  integer TcpIpNdpPrefixListEntryPrefixLength: 0..128, set at pre-compile  # The number of leading bits in the Prefix that are valid.
            container TcpIpNdpSlaacConfig [0..1]  # Specifies the configuration parameters for StateLess Address AutoConfiguration.
              integer TcpIpNdpSlaacDadNumberOfTransmissions: 0..254, set at pre-compile, default-value=1  # Number of Neighbor Solicitations that have to be unanswered in order to set an autoconfigurated address to PREFERRED (usable) state. | [RFC4861 5.1. Node Configuration Variables] Default: DupAddrDetectTransmits = 1 Setting this value to 0 turns off DAD.
              float TcpIpNdpSlaacDadRetransmissionDelay: 0..10, set at pre-compile, default-value=1  # Sets the maximum value for the address configuration delay (s). | According to [RFC4861 5.4.2. Sending Neighbor Solicitation Messages] this value should be the same as MAX_RTR_SOLICITATION_DELAY. Default: MAX_RTR_SOLICITATION_DELAY = 1 second
              boolean TcpIpNdpSlaacDelayEnabled: set at pre-compile, default-value=false  # If enabled transmission of the first DAD Neighbor Solicitation will be delayed by a random value from [0...MAX_DAD_DELAY]. | "This serves to alleviate congestion when many nodes start up on the link at the same time, such as after a power failure, and may help to avoid race conditions when more than one node is trying to solicit for the same address at the same time." "The delay will avoid similar congestion when multiple nodes are going to configure addresses by receiving the same single multicast router advertisement." [RFC4861 5.4.2. Sending Neighbor Solicitation Messages] Default: True
              boolean TcpIpNdpSlaacOptimisticDadEnabled: set at pre-compile, default-value=false  # Enable Optimistic Duplicate Address Detection (DAD) according to RFC4429.
      container TcpIpLocalAddr [1..*]  # Specifies the local IP (Internet Protocol) addresses used for IP communication.
        enumeration TcpIpAddressType: {TCPIP_ANYCAST, TCPIP_MULTICAST, TCPIP_UNICAST}, post-build-variant-value=true, set at link in variant link-time / post-build in variant post-build / pre-compile in variant pre-compile  # Address type.
        integer TcpIpAddrId: 0..65535, scope=ECU, set at pre-compile, symbolic-name-value=true  # IP address table identifier assigned by TCP/IP stack.
        enumeration TcpIpDomainType: {TCPIP_AF_INET, TCPIP_AF_INET6}, post-build-variant-value=true, set at link in variant link-time / post-build in variant post-build / pre-compile in variant pre-compile  # Address family.
        reference TcpIpCtrlRef: post-build-variant-value=true, set at link in variant link-time / post-build in variant post-build / pre-compile in variant pre-compile, destination=TcpIpCtrl  # Reference to a TcpIpCtrl specifying the EthIf Controller where the IP address shall be assigned.
        reference TcpIpLocalAddrIPv6ExtHeaderFilterRef [0..1]: multiplicity set at link in variant link-time / post-build in variant post-build / pre-compile in variant pre-compile, post-build-variant-multiplicity=true, post-build-variant-value=true, set at link in variant link-time / post-build in variant post-build / pre-compile in variant pre-compile, destination=TcpIpIpV6ConfigExtHeaderFilter  # Reference to a set of IPv6 Extension Headers which are allowed for this local IPv6 address. | Note: this parameter is only relevant if the related TcpIpDomainType is TCPIP_AF_INET6.
        container TcpIpAddrAssignment [1..*]  # This container is a subcontainer of TcpIpLocalAddr and specifies the assignment policy for the IP address.
          enumeration TcpIpAssignmentLifetime [0..1]: {TCPIP_FORGET, TCPIP_STORE}, post-build-variant-value=true, set at link in variant link-time / post-build in variant post-build / pre-compile in variant pre-compile, default-value=TCPIP_FORGET  # Defines the lifetime of a dynamically fetched IP address. | If TcpIpAssignmentMethod = TCPIP_STATIC then TcpIpAssignmentLifetime shall be omitted.
          enumeration TcpIpAssignmentMethod: {TCPIP_DHCP, TCPIP_IPV6_ROUTER, TCPIP_LINKLOCAL, TCPIP_LINKLOCAL_DOIP, TCPIP_STATIC}, post-build-variant-value=true, set at link in variant link-time / post-build in variant post-build / pre-compile in variant pre-compile  # Method of address assignment
          integer TcpIpAssignmentPriority: 1..3, post-build-variant-value=true, set at link in variant link-time / post-build in variant post-build / pre-compile in variant pre-compile  # Priority of assignment (1 is highest). If a new address from an assignment method with a higher priority is available, it overwrites the IP address previously assigned by an assignment method with a lower priority.
          enumeration TcpIpAssignmentTrigger: {TCPIP_AUTOMATIC, TCPIP_MANUAL}, post-build-variant-value=true, set at link in variant link-time / post-build in variant post-build / pre-compile in variant pre-compile  # Trigger of address assignment.
        container TcpIpStaticIpAddressConfig [0..1]  # This container is a subcontainer of TcpIpLocalAddr and specifies a static IP address including directly related parameters.
          string TcpIpDefaultRouter [0..1]: multiplicity set at link in variant link-time / post-build in variant post-build / pre-compile in variant pre-compile, post-build-variant-multiplicity=true, post-build-variant-value=true, set at link in variant link-time / post-build in variant post-build / pre-compile in variant pre-compile  # IP address of default router (gateway)
          integer TcpIpNetmask [0..1]: 0..128, multiplicity set at link in variant link-time / post-build in variant post-build / pre-compile in variant pre-compile, post-build-variant-multiplicity=true, post-build-variant-value=true, set at link in variant link-time / post-build in variant post-build / pre-compile in variant pre-compile  # Network mask of IPv4 address or address prefix of IPv6 address in CIDR Notation, i.e. decimal value between 0 and 32 (IPv4) or 0 and 128 (IPv6) that describes the number of significant bits defining the network number or prefix of an IP address.
          string TcpIpStaticIpAddress: post-build-variant-value=true, set at link in variant link-time / post-build in variant post-build / pre-compile in variant pre-compile  # Static IP Address. | To specify any IP address for a certain EthIfCtrl, "ANY" has to be set as wildcard. See TcpIp_Bind() for more details.
      container TcpIpNvmBlock [0..1]: multiplicity set at link in variant link-time+post-build / pre-compile in variant pre-compile  # Configuration of optional usage of Nvm in case the TcpIp module requires non volatile memory in the Ecu to store information (e.g. IP Address received via DHCP and shall be stored).
        symbolic name reference TcpIpNvmBlockDescriptorRef: scope=ECU, set at link in variant link-time+post-build / pre-compile in variant pre-compile, destination=NvMBlockDescriptor  # Reference to the Nvm block description in the Nvm module configuration.
      container TcpIpPhysAddrConfig [0..1]  # Specifies the physical address configuration.
        container TcpIpPhysAddrChgHandler [0..1]  # This container is a subcontainer of TcpIpPhysAddrConfig and | specifies the configuration parameters for physical address change handler.
          string TcpIpPhysAddrChgHandlerHeaderFileName: set at link in variant link-time+post-build / pre-compile in variant pre-compile, max-length=32, min-length=1  # This parameter specifies the name of the header file containing the definition of the physical address change handler function.
          function name TcpIpPhysAddrChgHandlerName: scope=ECU, set at pre-compile  # This parameter defines the name of the physical address change function <Up>_PhysAddrTableChg.
      container TcpIpSocketOwnerConfig  # Specifies the upper layer modules of TcpIp using the socket API.
        container TcpIpSocketOwner [1..*]  # This container is a subcontainer of TcpIpSocketOwnerConfig and specifies an upper layer of TcpIp that uses the socket API.
          string TcpIpSocketOwnerCopyTxDataName [0..1]: set at link in variant link-time+post-build / pre-compile in variant pre-compile  # This parameter defines the name of the <Up_CopyTxData> function of the TcpIpSocketOwner module. The function name shall only be configurable if TcpIpSocketOwnerUpperLayerType is set to CDD.
          string TcpIpSocketOwnerHeaderFileName [0..1]: set at link in variant link-time+post-build / pre-compile in variant pre-compile  # This parameter specifies the name of the header file containing the definition of the TcpIpSocketOwner module functions. The header file name shall only be configurable if TcpIpSocketOwnerUpperLayerType is set to CDD.
          string TcpIpSocketOwnerLocalIpAddrAssignmentChgName [0..1]: set at link in variant link-time+post-build / pre-compile in variant pre-compile  # This parameter defines the name of the <Up_LocalIpAddrAssignmentChg> function of the TcpIpSocketOwner module. The function name shall only be configurable if TcpIpSocketOwnerUpperLayerType is set to CDD.
          string TcpIpSocketOwnerRxIndicationName [0..1]: set at link in variant link-time+post-build / pre-compile in variant pre-compile  # This parameter defines the name of the <Up_RxIndication> function of the TcpIpSocketOwner module. The function name shall only be configurable if TcpIpSocketOwnerUpperLayerType is set to CDD.
          string TcpIpSocketOwnerTcpAcceptedName [0..1]: set at link in variant link-time+post-build / pre-compile in variant pre-compile  # This parameter defines the name of the <Up_TcpAccepted> function of the TcpIpSocketOwner module. The function name shall only be configurable if TcpIpSocketOwnerUpperLayerType is set to CDD.
          string TcpIpSocketOwnerTcpConnectedName [0..1]: set at link in variant link-time+post-build / pre-compile in variant pre-compile  # This parameter defines the name of the <Up_TcpConnected> function of the TcpIpSocketOwner module. The function name shall only be configurable if TcpIpSocketOwnerUpperLayerType is set to CDD.
          function name TcpIpSocketOwnerTcpIpEventName [0..1]: set at link in variant link-time+post-build / pre-compile in variant pre-compile  # This parameter defines the name of the <Up_TcpIpEvent> function of the TcpIpSocketOwner module. The function name shall only be configurable if TcpIpSocketOwnerUpperLayerType is set to CDD.
          string TcpIpSocketOwnerTxConfirmationName [0..1]: set at link in variant link-time+post-build / pre-compile in variant pre-compile  # This parameter defines the name of the <Up_TxConfirmation> function of the TcpIpSocketOwner module. The function name shall only be configurable if TcpIpSocketOwnerUpperLayerType is set to CDD.
          enumeration TcpIpSocketOwnerUpperLayerType: {CDD, SOAD}, post-build-variant-value=true, set at link in variant link-time / post-build in variant post-build / pre-compile in variant pre-compile  # This parameter specifies the type of the upper layer module.
      container TcpIpTcpConfig [0..1]  # Specifies the configuration parameters of the TCP (Transmission Control Protocol) sub-module.
        boolean TcpIpTcpCongestionAvoidanceEnabled: set at pre-compile  # Enables (TRUE) or disables (FALSE) support of TCP congestion avoidance algorithm according to IETF RFC 5681.
        boolean TcpIpTcpFastRecoveryEnabled: set at pre-compile  # Enables (TRUE) or disables (FALSE) support of TCP Fast Recovery according to IETF RFC 5681.
        boolean TcpIpTcpFastRetransmitEnabled: set at pre-compile  # Enables (TRUE) or disables (FALSE) support of TCP Fast Retransmission according to IETF RFC 5681.
        float TcpIpTcpFinWait2Timeout: 0..Inf, post-build-variant-value=true, set at link in variant link-time / post-build in variant post-build / pre-compile in variant pre-compile  # Timeout in [s] to receive a FIN from the remote node (after this node has initiated connection termination), i.e. maximum time waiting in FINWAIT-2 for a connection termination request from the remote TCP.
        boolean TcpIpTcpKeepAliveEnabled: set at pre-compile, default-value=false  # Enables (TRUE) or disables (FALSE) TCP Keep Alive Probes according to IETF RFC 1122 chapter 4.2.3.6
        float TcpIpTcpKeepAliveInterval: 0..Inf, post-build-variant-value=true, set at link in variant link-time / post-build in variant post-build / pre-compile in variant pre-compile  # Specifies the interval in [s] between subsequent keepalive probes.
        integer TcpIpTcpKeepAliveProbesMax: 0..65535, post-build-variant-value=true, set at link in variant link-time / post-build in variant post-build / pre-compile in variant pre-compile  # Maximum number of times that a TCP Keep Alive is retransmitted before the connection is closed.
        float TcpIpTcpKeepAliveTime: 0..Inf, post-build-variant-value=true, set at link in variant link-time / post-build in variant post-build / pre-compile in variant pre-compile, default-value=7200  # Specifies the time in [s] between the last data packet sent (simple ACKs are not considered data) and the first keepalive probe. Note: Setting this configuration parameter to a value smaller or equal to the value of TcpIpMainFunctionPeriod results in the transmission of keep alive probes within every MainFunction cycle.
        integer TcpIpTcpMaxRtx [0..1]: 0..255, post-build-variant-value=true, set at link in variant link-time / post-build in variant post-build / pre-compile in variant pre-compile  # Maximum number of times that a TCP segment is retransmitted before the TCP connection is closed. This parameter is only valid if TcpIpTcpRetransmissionTimeout is configured. | Note: This parameter also applies for FIN retransmissions.
        float TcpIpTcpMsl: 0..Inf, post-build-variant-value=true, set at link in variant link-time / post-build in variant post-build / pre-compile in variant pre-compile  # Maximum segment lifetime in [s]. | (Note: TIME-WAIT = 2 x TcpIpTcpMsl - to ensure that the remote node received the acknowledgment to its connection termination request.)
        boolean TcpIpTcpNagleEnabled: set at pre-compile  # Enables (TRUE) or disables (FALSE) support of Nagle's algorithm according to IETF RFC 896. If enabled the Nagle's algorithm is activated per default for all TCP sockets, but can be deactivated via TcpIp_ChangeParameter() API.
        integer TcpIpTcpReceiveWindowMax: 0..65535, post-build-variant-value=true, set at link in variant link-time / post-build in variant post-build / pre-compile in variant pre-compile  # Default value of maximum receive window in bytes.
        float TcpIpTcpRetransmissionTimeout [0..1]: 0.001..Inf, post-build-variant-value=true, set at link in variant link-time / post-build in variant post-build / pre-compile in variant pre-compile  # Timeout in [s] before an unacknowledged TCP segment is sent again. | If the timeout is disabled or set to INF, no TCP segments shall be retransmitted.
        boolean TcpIpTcpSlowStartEnabled: set at pre-compile  # Enables (TRUE) or disables (FALSE) support of TCP slow start algorithm according to IETF RFC 5681.
        integer TcpIpTcpSynMaxRtx: 0..255, post-build-variant-value=true, set at link in variant link-time / post-build in variant post-build / pre-compile in variant pre-compile  # Maximum number of times that a TCP SYN is retransmitted. | Note: SYN will be retried after TcpIpTcpRetransmissionTimeout. The connection will be dropped if no matching connection request has been received after the last TCP SYN has been sent and TcpIpTcpRetransmissionTimeout has been expired.
        float TcpIpTcpSynReceivedTimeout: 0..Inf, post-build-variant-value=true, set at link in variant link-time / post-build in variant post-build / pre-compile in variant pre-compile  # Timeout in [s] to complete a remotely initiated TCP connection establishment, i.e. maximum time waiting in SYN-RECEIVED for a confirming connection request acknowledgment after having both received and sent a connection request.
        integer TcpIpTcpTtl: 0..255, post-build-variant-value=true, set at link in variant link-time / post-build in variant post-build / pre-compile in variant pre-compile  # Default Time-to-live value of outgoing TCP packets.
        container TcpIpTcpConfigOptionFilter [0..*]: multiplicity set at link in variant link-time / post-build in variant post-build / pre-compile in variant pre-compile, post-build-variant-multiplicity=true  # This container describes the white list for the filtering of TCP options, i.e. segments containing TCP options not listed here shall be silently dropped.
          integer TcpIpTcpConfigOptionFilterEntry [0..*]: 0..255, multiplicity set at link in variant link-time / post-build in variant post-build / pre-compile in variant pre-compile, post-build-variant-multiplicity=true, post-build-variant-value=true, set at link in variant link-time / post-build in variant post-build / pre-compile in variant pre-compile  # TCP option kind allowed by this filter.
          integer TcpIpTcpConfigOptionFilterId: 0..255, post-build-variant-value=true, set at link in variant link-time / post-build in variant post-build / pre-compile in variant pre-compile, symbolic-name-value=true  # Identification of the TCP option filter.
      container TcpIpUdpConfig [0..1]  # Specifies the configuration parameters of the UDP (User Datagram Protocol) sub-module
        integer TcpIpUdpTtl: 0..255, post-build-variant-value=true, set at link in variant link-time / post-build in variant post-build / pre-compile in variant pre-compile  # Default Time-to-live value of outgoing UDP packets.
    container TcpIpGeneral  # This container is a subcontainer of TcpIp and specifies the general configuration parameters of the TCP/IP stack.
      integer TcpIpBufferMemory: 0..4294967295, set at link in variant link-time+post-build / pre-compile in variant pre-compile  # Memory size in bytes reserved for TCP/IP buffers.
      boolean TcpIpDevErrorDetect: set at pre-compile, default-value=false  # Switches the development error detection and notification on or off. | * true: detection and notification is enabled. * false: detection and notification is disabled.
      boolean TcpIpDhcpServerEnabled: set at pre-compile  # Enables (TRUE) or disables (FALSE) the DHCP (Dynamic Host Configuration Protocol) Server.
      boolean TcpIpGetAndResetMeasurementDataApi: set at pre-compile  # Enables / Disables the Get and Reset Measurement Data API
      float TcpIpMainFunctionPeriod: 0..Inf, set at link in variant link-time+post-build / pre-compile in variant pre-compile  # Period of TcpIp_MainFunction in [s].
      boolean TcpIpResetIpAssignmentApi: set at pre-compile  # Enables/disables the API TcpIp_ResetIpAssignment of a DHCP-client.
      enumeration TcpIpScalabilityClass: {SC1, SC2, SC3}, set at pre-compile  # In order to customize the TcpIp Stack to the specific needs of the user it can be scaled according to the scalability classes.
      boolean TcpIpTcpEnabled: set at pre-compile  # Enables (TRUE) or disabled (FALSE) support of TCP (Transmission Control Protocol).
      integer TcpIpTcpSocketMax: 0..65535, set at link in variant link-time+post-build / pre-compile in variant pre-compile  # Maximum number of TCP sockets
      boolean TcpIpUdpEnabled: set at pre-compile  # Enables (TRUE) or disabled (FALSE) support of UDP (User Datagram Protocol)
      integer TcpIpUdpSocketMax: 0..65535, set at link in variant link-time+post-build / pre-compile in variant pre-compile  # Maximum number of UDP sockets.
      boolean TcpIpVersionInfoApi: set at pre-compile, default-value=false  # If true the TcpIp_GetVersionInfo API is available.
      container TcpIpIpV4General  # This container is a subcontainer of TcpIp and specifies the general configuration parameters of the TCP/IP stack for IPv4
        boolean TcpIpArpEnabled: set at pre-compile  # Enables (TRUE) or disables (FALSE) support of ARP (Address Resolution Protocol).
        boolean TcpIpAutoIpEnabled: set at pre-compile  # Enables (TRUE) or disables (FALSE) the Auto-IP (automatic private IP addressing) sub-module.
        boolean TcpIpDhcpClientEnabled: set at pre-compile  # Enables (TRUE) or disables (FALSE) the DHCP (Dynamic Host Configuration Protocol) Client.
        boolean TcpIpIcmpEnabled: set at pre-compile  # Enables (TRUE) or disabled (FALSE) support of ICMP (Internet Control Message Protocol).
        boolean TcpIpIpV4Enabled: set at pre-compile  # Enables (TRUE) or disables (FALSE) support of IPv4 (Internet Protocol version 4).
        integer TcpIpLocalAddrIpv4EntriesMax: 0..255, set at link in variant link-time+post-build / pre-compile in variant pre-compile  # Maximum number of LocalAddr table entries for IPv4.
        boolean TcpIpPathMtuDiscoveryEnabled: set at pre-compile  # Enables (TRUE) or disables (FALSE) the discovery of the maximum transmission unit on a path according to IETF RfC 1191.
      container TcpIpIpV6General  # This container is a subcontainer of TcpIp and specifies the general configuration parameters of the TCP/IP stack for IPv6.
        boolean TcpIpDhcpV6ClientEnabled: set at pre-compile  # Enables (TRUE) or disables (FALSE) the DHCPv6 (Dynamic Host Configuration Protocol for IPv6) Client.
        boolean TcpIpIpV6Enabled: set at pre-compile  # Enables (TRUE) or disables (FALSE) support of IPv6 (Internet Protocol version 6).
        boolean TcpIpIpV6PathMtuDiscoveryEnabled: set at pre-compile  # Enables (TRUE) or disables (FALSE) Path MTU Discovery support for IPv6 according to IETF RFC 1981.
        integer TcpIpLocalAddrIpv6EntriesMax: 0..255, set at link in variant link-time+post-build / pre-compile in variant pre-compile  # Maximum number of LocalAddr table entries for IPv6.
        boolean TcpIpNdpAddressResolutionUnrechabilityDetectionEnabled: set at pre-compile  # Enables (TRUE) or disables (FALSE) support of Address Resoultion and Neighbor Unreachability Detetion via NDP.
        boolean TcpIpNdpPrefixAndRouterDiscoveryEnabled: set at pre-compile  # Enables (TRUE) or disables (FALSE) support of Prefix and Router Discovery via NDP.
  module definition Tm [0..1]: variants pre-compile  # Configuration of the Time Service module.
    container TmGeneral  # General configuration of Time Service module.
      boolean TmDevErrorDetect: set at pre-compile, default-value=false  # Switches the development error detection and notification on or off. | * true: detection and notification is enabled. * false: detection and notification is disabled.
      boolean TmEnablePredefTimer100us32bit: scope=ECU, set at pre-compile  # Specifies if the Predef Timer 100µs32bit shall be enabled (functionality and set of API services). ON or OFF.
      boolean TmEnablePredefTimer1us16bit: scope=ECU, set at pre-compile  # Specifies if the Predef Timer 1µs16bit shall be enabled (functionality and set of API services). ON or OFF.
      boolean TmEnablePredefTimer1us24bit: scope=ECU, set at pre-compile  # Specifies if the Predef Timer 1µs24bit shall be enabled (functionality and set of API services). ON or OFF.
      boolean TmEnablePredefTimer1us32bit: scope=ECU, set at pre-compile  # Specifies if the Predef Timer 1µs32bit shall be enabled (functionality and set of API services). ON or OFF.
      boolean TmVersionInfoApi: set at pre-compile, default-value=false  # Adds / removes the service Tm_GetVersionInfo() from the code. ON or OFF.
  module definition UdpNm [0..1]: post-build-variant-support=true, variants link-time/pre-compile
    container UdpNmGlobalConfig  # This container contains all global configuration parameters of UDP NM configured from the CanTrcv Module perspective.
      boolean UdpNmBusSynchronizationEnabled: set at pre-compile  # Pre-processor switch for enabling bus synchronization support. | This feature is required for gateway nodes only. It must not be defined if UdpNmPassiveModeEnabled==true. This parameter shall be derived from NmBusSynchronizationEnabled.
      boolean UdpNmComControlEnabled: set at pre-compile  # Pre-processor switch for enabling the Communication Control support.
      boolean UdpNmComUserDataSupport: set at pre-compile  # Enable/disable the user data support.
      boolean UdpNmCoordinatorEnabled: set at pre-compile  # Enable/disable the NM Coordination algorithm to being able to initiate the synchronization algorithm. | TRUE: Option is enabled FALSE: The parameter shall be FALSE by default and shall only be allowed to be TRUE if the parameter UdpNmRemoteSleepIndEnabled is TRUE.
      integer UdpNmCoordinatorId: 0..3, set at pre-compile  # Set the NM coordination ID for this gateway. | 0x00: passive coordinator only 0x01 - 0x03: coordinator priority Only valid, if UdpmCoordinatorEnabled is TRUE.
      boolean UdpNmCoordinatorSyncSupport: set at pre-compile  # Enables/disables the coordinator synchronization support.
      boolean UdpNmDevErrorDetect: set at pre-compile, default-value=false  # Switches the development error detection and notification on or off. | * true: detection and notification is enabled. * false: detection and notification is disabled.
      boolean UdpNmImmediateRestartEnabled: set at pre-compile  # Pre-processor switch for enabling the immediate transmission of a NM PACKET upon bus-communication request in Prepare-Bus-Sleep mode. | Must not be defined if UdpNmPassiveModeEnabled== true.
      boolean UdpNmNodeDetectionEnabled [0..1]: set at pre-compile  # Pre-processor switch for enabling the node detection support. Tags: atp.Status=obsolete | This parameter shall be derived from NmNodeDetectionEnabled. This parameter shall only be enabled if UdpNmNodeIdEnabled == true. If(UdpNmPduCbvPosition != UDPNM_PDU_OFF) then Equal(NmNodeDetectionEnabled) else Equal(False). This element is obsolete and will be removed in a future revision.
      boolean UdpNmNodeIdEnabled [0..1]: set at pre-compile  # Pre-processor switch for enabling the source node identifier. Tags: atp.Status=obsolete | This parameter shall be derived from NmNodeIdEnabled. This element is obsolete and will be removed in a future revision.
      integer UdpNmNumberOfChannels: 1..255, set at pre-compile  # Number of NM channels allowed within one ECU.
      boolean UdpNmPassiveModeEnabled: set at pre-compile  # Pre-processor switch for enabling support of the Passive Mode.
      boolean UdpNmPduRxIndicationEnabled: set at pre-compile  # Pre-processor switch for enabling the PDU Rx Indication. | This parameter shall be derived from NmPduRxIndicationEnabled.
      boolean UdpNmPnEiraCalcEnabled [0..1]: multiplicity set at link in variant link-time / pre-compile in variant pre-compile, set at link in variant link-time / pre-compile in variant pre-compile, default-value=false  # Specifies if UdpNm calculates the PN request information for internal and external requests. (EIRA) true: PN request are calculated | false: PN request are not calculated
      float UdpNmPnResetTime [0..1]: 0.001..65.535, multiplicity set at link in variant link-time / pre-compile in variant pre-compile, set at link in variant link-time / pre-compile in variant pre-compile  # Specifies the runtime of the reset timer in seconds. This reset time is valid for the reset of PN requests in the EIRA and in the ERA. The value shall be the same for every channel. Thus it is a global config parameter.
      boolean UdpNmRemoteSleepIndEnabled: set at pre-compile  # Pre-processor switch for enabling remote sleep indication support. | This feature is required for gateway nodes only. It must not be defined if UdpNmPassiveModeEnabled==true. This parameter shall be derived from NmRemoteSleepIndEnabled.
      boolean UdpNmRepeatMsgIndEnabled [0..1]: set at pre-compile  # Enable/disable the notification that a RepeatMessageRequest bit has been received. Tags: atp.Status=obsolete
      boolean UdpNmStateChangeIndEnabled: set at pre-compile  # Pre-processor switch for enabling the UDP NM state change notification. | This parameter shall be derived from NmStateChangeIndEnabled.
      boolean UdpNmUserDataEnabled: set at pre-compile  # Pre-processor switch for enabling user data support. | This parameter shall be derived from NmUserDataEnabled.
      boolean UdpNmVersionInfoApi: set at pre-compile, default-value=false  # Pre-processor switch for enabling version info API support.
      reference UdpNmPnEiraRxNSduRef [0..1]: multiplicity set at link in variant link-time / pre-compile in variant pre-compile, post-build-variant-value=true, set at link in variant link-time / pre-compile in variant pre-compile, destination=Pdu  # Reference to a Pdu in the COM-Stack. Only one SduRef is required for UdpNm because the EIRA is the aggregation over all Ethernet Channels.
      container UdpNmChannelConfig [1..*]  # This container contains the channel-specific configuration parameters of the UdpNm.
        boolean UdpNmActiveWakeupBitEnabled [0..1]: multiplicity set at link in variant link-time / pre-compile in variant pre-compile, set at link in variant link-time / pre-compile in variant pre-compile, default-value=false  # Enables/Disables the handling of the Active Wakeup Bit in the UdpNm module.
        boolean UdpNmAllNmMessagesKeepAwake [0..1]: multiplicity set at link in variant link-time / pre-compile in variant pre-compile, set at link in variant link-time / pre-compile in variant pre-compile, default-value=false  # Specifies if UdpNm drops irrelevant NM PDUs. | false: Only NM PDUs with a PNI bit = true and containing a PN request for this ECU triggers the standard RX indication handling true: Every NM PDU triggers the standard RX indication handling
        integer UdpNmCarWakeUpBitPosition [0..1]: 0..7, multiplicity set at link in variant link-time / pre-compile in variant pre-compile, set at link in variant link-time / pre-compile in variant pre-compile  # Specifies the Bit position of the CWU within the NM PDU.
        integer UdpNmCarWakeUpBytePosition [0..1]: 0..7, multiplicity set at link in variant link-time / pre-compile in variant pre-compile, set at link in variant link-time / pre-compile in variant pre-compile  # Specifies the Byte position of the CWU within the NM PDU.
        boolean UdpNmCarWakeUpFilterEnabled [0..1]: multiplicity set at link in variant link-time / pre-compile in variant pre-compile, set at link in variant link-time / pre-compile in variant pre-compile, default-value=false  # If CWU filtering is supported, only the CWU bit within the NM PDU with source node identifier UdpNmCarWakeUpFilterNodeId is considered as CWU request. | FALSE - CWU filtering is not supported TRUE - CWU filtering is supported.
        integer UdpNmCarWakeUpFilterNodeId [0..1]: 0..255, multiplicity set at link in variant link-time / pre-compile in variant pre-compile, set at link in variant link-time / pre-compile in variant pre-compile  # Source node identifier for CWU filtering. If CWU filtering is supported, only the CWU bit within the NM PDU with source node identifier UdpNmCarWakeUpFilterNodeId is considered as CWU request.
        boolean UdpNmCarWakeUpRxEnabled: scope=ECU, set at link in variant link-time / pre-compile in variant pre-compile, default-value=false  # Enables or disables support of CarWakeUp bit evaluation in received NM PDUs. | FALSE - CarWakeUp not supported. TRUE - CarWakeUp supported.
        float UdpNmImmediateNmCycleTime [0..1]: 0.001..65.535, multiplicity set at link in variant link-time / pre-compile in variant pre-compile, set at link in variant link-time / pre-compile in variant pre-compile  # Defines the immediate NM PDU cycle time in seconds which is used for UdpNmImmediateNmTransmissions NM PDU transmissions.
        integer UdpNmImmediateNmTransmissions: 0..255, set at link in variant link-time / pre-compile in variant pre-compile  # Defines the number of immediate NM PDUs which shall be transmitted. If the value is zero no immediate NM PDUs are transmitted. The cycle time of immeditate NM PDUs is defined by UdpNmImmediateNmCycleTime.
        float UdpNmMainFunctionPeriod: 0..Inf, set at link in variant link-time / pre-compile in variant pre-compile  # Call cycle of UdpNm_MainFunction_x for the respective instance in [s].
        float UdpNmMsgCycleOffset: 0..65.535, post-build-variant-value=true, set at link in variant link-time / pre-compile in variant pre-compile  # Time offset in the periodic transmission node. It determines the start delay of the transmission. | < UdpNmMsgCycleTime This parameter is only valid if UdpNmPassiveModeEnabled is disabled.
        float UdpNmMsgCycleTime: 0.001..65.535, set at link in variant link-time / pre-compile in variant pre-compile  # Period of a NM-message. It determines the periodic rate and is the basis for transmit scheduling. | NmTimeoutTime = n * UdpNmMsgCycleTime This parameter is only valid if UdpNmPassiveModeEnabled is disabled.
        float UdpNmMsgTimeoutTime [0..1]: 0.001..65.535, set at link in variant link-time / pre-compile in variant pre-compile  # Transmission Timout of NM-message. If there is no transmission confirmation by the UDP Interface within this timeout, the UDPNM module shall gibe an error notification. Tags: atp.Status=obsolete, atp.StatusRevisionBegin=4.3.1 | This parameter is only valid if UdpNmPassiveModeEnabled is disabled. UdpNmMsgTimeoutTime should be a multiple of UdpNmMsgCycleTime. This element is obsolete and will be removed in a future revision.
        boolean UdpNmNodeDetectionEnabled: set at link in variant link-time / pre-compile in variant pre-compile  # Pre-processor switch for enabling the node detection support. | This parameter shall be derived from NmNodeDetectionEnabled. This parameter shall only be enabled if UdpNmNodeIdEnabled == true. If(UdpNmPduCbvPosition != UDPNM_PDU_OFF) then Equal(NmNodeDetectionEnabled) else Equal(False).
        integer UdpNmNodeId: 0..255, set at link in variant link-time / pre-compile in variant pre-compile  # Node identifier of local node. | This parameter is only valid if UdpNmPassiveModeEnabled is set to OFF and UdpNmNodeDetectionEnabled is set to ON.
        boolean UdpNmNodeIdEnabled: set at link in variant link-time / pre-compile in variant pre-compile  # Pre-processor switch for enabling the source node identifier. | This parameter shall be derived from NmNodeIdEnabled.
        enumeration UdpNmPduCbvPosition: {UDPNM_PDU_BYTE_0, UDPNM_PDU_BYTE_1, UDPNM_PDU_OFF}, set at link in variant link-time / pre-compile in variant pre-compile  # Defines the position of the control bit vector within the NM PACKET. | The value of the parameter represents the location of the control bit vector in the NM PACKET (UDPNM_PDU_BYTE_0 means byte 0, UDPNM_PDU_BYTE_1 means byte 1, UDPNM_PDU_OFF means the control bit vector is not part of the NM PACKET) See also UdpNmPduNidPosition if (UdpNmPduCbvPosition != UDPNM_PDU_OFF && UdpNmPduNidPosition != UDPNM_PDU_OFF) then UdpNmPduCbvPosition != UdpNmPduNidPosition if (UdpNmPduCbvPosition != UDPNM_PDU_OFF && UdpNmPduNidPosition == UDPNM_PDU_OFF) then UdpNmPduCbvPosition = UDPNM_PDU_BYTE0
        enumeration UdpNmPduNidPosition: {UDPNM_PDU_BYTE_0, UDPNM_PDU_BYTE_1, UDPNM_PDU_OFF}, set at link in variant link-time / pre-compile in variant pre-compile  # Defines the position of the source node identifier within the NM PACKET. | ImplementationType: UdpNm_PduPositionType The value of the parameter represents the location of the source node identifier in the NM PACKET (UDPNM_PDU_BYTE_0 means byte 0, UDPNM_PDU_BYTE_1 means byte 1, UDPNM_PDU_OFF means source node identifier is not part of the NM PACKET) See also UdpNmPduCbvPosition if (UDPNM_PDU_NID_POSITION != UDPNM_PDU_OFF && UDPNM_PDU_CBV_POSITION != UDPNM_PDU_OFF) then UDPNM_PDU_NID_POSITION != UDPNM_PDU_CBV_POSITION if (UDPNM_PDU_NID_POSITION != UDPNM_PDU_OFF && UDPNM_PDU_CBV_POSITION == UDPNM_PDU_OFF) then UDPNM_PDU_IND_POSITION = UDPNM_PDU_BYTE0
        boolean UdpNmPnEnabled [0..1]: multiplicity set at link in variant link-time / pre-compile in variant pre-compile, set at link in variant link-time / pre-compile in variant pre-compile, default-value=false  # Enables or disables support of partial networking. | false: Partial networking Range not supported true: Partial networking supported
        boolean UdpNmPnEraCalcEnabled [0..1]: multiplicity set at link in variant link-time / pre-compile in variant pre-compile, set at link in variant link-time / pre-compile in variant pre-compile, default-value=false  # Specifies if UdpNm calculates the PN request information for external requests. (ERA) | false: PN request are not calculated true: PN request are calculated.
        boolean UdpNmPnHandleMultipleNetworkRequests [0..1]: multiplicity set at link in variant link-time / pre-compile in variant pre-compile, set at link in variant link-time / pre-compile in variant pre-compile, default-value=false  # false: UdpNm_NetworkRequest is ignored in NO. | true: UdpNm_NetworkRequest triggers a change from NO to RM.
        float UdpNmRemoteSleepIndTime: 0.001..65.535, set at link in variant link-time / pre-compile in variant pre-compile  # Timeout for Remote Sleep Indication. | It defines the time in [s] how long it shall take to recognize that all other nodes are ready to sleep. Typically it should be equal to: n * UdpNmMsgCycleTime, where n denotes the number of NM packets that are normally sent before Remote Sleep Indication is detected. The value of n decremented by one determines the amount of lost NM packets that can be tolerated by the Remote Sleep Indication procedure.
        float UdpNmRepeatMessageTime: 0..65.535, set at link in variant link-time / pre-compile in variant pre-compile  # Timeout for Repeat Message State. | It defines the time in seconds how long the NM shall stay in the Repeat Message State.
        boolean UdpNmRepeatMsgIndEnabled: set at link in variant link-time / pre-compile in variant pre-compile  # Enable/disable the notification that a RepeatMessageRequest bit has been received.
        boolean UdpNmRetryFirstMessageRequest [0..1]: multiplicity set at link in variant link-time / pre-compile in variant pre-compile, set at link in variant link-time / pre-compile in variant pre-compile  # Specifies if first message request in UdpNm is repeated until accepted by SoAd.
        float UdpNmTimeoutTime: 0.002..65.535, set at link in variant link-time / pre-compile in variant pre-compile  # Network Timeout for NM packets. | It denotes the time in [s] how long the NM shall stay in the Network Mode before transition into Prepare Bus-Sleep Mode shall take place. It shall be equal for all nodes in the cluster. It shall be greater than UdpNmMsgCycleTime. Typically, it should be equal to: x * UdpNmMsgCycleTime, where n denotes the number of NM PACKET cycle times in the Ready Sleep State before transition into the Bus-Sleep Mode is initiated. The value of n decremented by one determines the amount of lost NM packets that can be tolerated by the coordination algorithm.
        float UdpNmWaitBusSleepTime: 0.001..65.535, set at link in variant link-time / pre-compile in variant pre-compile  # Timeout for bus calm down phase. | It denotes the time in [s] how long the NM shall stay in the Prepare Bus-Sleep Mode before transition into Bus-Sleep Mode shall take place. It shall be equal for all nodes in the cluster. It shall be long enough to empty all Tx-buffer empty.
        symbolic name reference UdpNmComMNetworkHandleRef: scope=ECU, post-build-variant-value=true, set at link in variant link-time / pre-compile in variant pre-compile, destination=ComMChannel  # This reference points to the unique channel defined by the ComMChannel and provides access to the unique channel index value in ComMChannelId.
        reference UdpNmPnEraRxNSduRef [0..1]: multiplicity set at link in variant link-time / pre-compile in variant pre-compile, post-build-variant-value=true, set at link in variant link-time / pre-compile in variant pre-compile, destination=Pdu  # Reference to a Pdu in the COM-Stack. The SduRef is required for every UdpNm Channel, because ERA is reported per channel.
        container UdpNmRxPdu [1..*]  # This container describes the UdpNm RX PDU's.
          integer UdpNmRxPduId: 0..4294967296, post-build-variant-value=true, set at pre-compile, symbolic-name-value=true  # ID of the RxPdu that will be used by a RxIndication of the lower layer.
          reference UdpNmRxPduRef: set at link in variant link-time / pre-compile in variant pre-compile, destination=Pdu  # The reference to a PDU in the global PDU structure described in the AUTOSAR ECU Configuration Specification. This reference will be used by the UdpNm module to derive the PDU Id.
        container UdpNmTxPdu [0..1]  # This container describes the UdpNm TX PDU's.
          integer UdpNmTxConfirmationPduId: 0..4294967296, post-build-variant-value=true, set at pre-compile, symbolic-name-value=true  # Id of the TxPdu that will be used by a TxConfirmation from the lower layer.
          reference UdpNmTxPduRef: post-build-variant-value=true, set at link in variant link-time / pre-compile in variant pre-compile, destination=Pdu  # The reference to a PDU in the global PDU structure described in the AUTOSAR ECU Configuration Specification. This reference will be used by the UdpNm module to derive the PDU Id.
        container UdpNmUserDataTxPdu [0..1]  # Preprocessor switch for enabling the Tx path of Com User Data. | Use case: Setting of NMUserData via SWC.
          integer UdpNmTxUserDataPduId: 0..65535, set at pre-compile, symbolic-name-value=true  # This parameter defines the Handle ID of the NM User Data I-PDU.
          reference UdpNmTxUserDataPduRef: set at link in variant link-time / pre-compile in variant pre-compile, destination=Pdu  # Reference to the NM User Data I-PDU in the global PDU collection.
      container UdpNmPnInfo [0..1]  # PN information configuration
        integer UdpNmPnInfoLength: 1..7, set at link in variant link-time / pre-compile in variant pre-compile, default-value=1  # Specifies the length of the PN request information in the NM message.
        integer UdpNmPnInfoOffset: 1..7, set at link in variant link-time / pre-compile in variant pre-compile, default-value=1  # Specifies the offset of the PN request information in the NM message.
        container UdpNmPnFilterMaskByte [0..7]  # PN information configuration
          integer UdpNmPnFilterMaskByteIndex: 0..6, post-build-variant-value=true, set at link in variant link-time / pre-compile in variant pre-compile  # Index of the filter mask byte. Specifies the position within the filter mask byte array.
          integer UdpNmPnFilterMaskByteValue: 0..255, set at link in variant link-time / pre-compile in variant pre-compile, default-value=0  # Parameter to configure the filter mask byte.
  module definition V2xBtp [0..1]: variants pre-compile  # Configuration of the V2xBtp (Vehicle-2-X Basic Transport) module.
    container V2xBtpGeneral  # This container contains the general configuration parameters of the Vehicle-2-X Basic Transport.
      boolean V2xBtpDevErrorDetect: set at pre-compile, default-value=false  # Switches the Default Error Tracer (Det) detection and notification ON or OFF. | - true: enabled (ON) - false: disabled (OFF)
      boolean V2xBtpVersionInfoApi: set at pre-compile, default-value=false  # Enable/disables the API for reading the version information of the V2xBtp Module. | - true: enabled (ON) - false: disabled (OFF)
    container V2xBtpRxIndicationFunction [1..*]  # This container contains the RxIndication functions for V2xBtp upper layers
      string V2xBtpCddHeaderFile: set at pre-compile  # This parameter specifies the name of the header file containing the definition of the V2xBtpRxIndicationFunction module functions.
      integer V2xBtpDestinationPort: 0..65535, default-value=0  # Destination port for the <User>_RxIndication function.
      function name V2xBtpRxIndicationFunctionName: set at pre-compile  # Name of the <User>_RxIndication callback function.
  module definition V2xFac [0..1]: variants pre-compile  # Configuration of the V2xFac module.
    container V2xFacGeneral  # This container contains the general configuration parameters of the Vehicle-2-X Basic Transport.
      float V2xFacCaBsMainFunctionPeriod: 0..Inf, set at pre-compile, default-value=0.1  # This parameter defines the schedule period of V2xFac_CaBs_MainFunction.Unit: [s]
      float V2xFacDenBsMainFunctionPeriod: 0..Inf, set at pre-compile, default-value=0.1  # This parameter defines the schedule period of V2xFac_DenBs_MainFunction.Unit: [s]
      boolean V2xFacDevErrorDetect: set at pre-compile, default-value=false  # Switches the Default Error Tracer (Det) detection and notification ON or OFF. | - true: enabled (ON) - false: disabled (OFF)
      enumeration V2xFacStationType: {V2XFAC_ST_BUS, V2XFAC_ST_CYCLIST, V2XFAC_ST_HEAVYTRUCK, V2XFAC_ST_LIGHTTRUCK, V2XFAC_ST_MOPED, V2XFAC_ST_MOTORCYCLE, V2XFAC_ST_PASSENGERCAR, V2XFAC_ST_PEDESTRIAN, V2XFAC_ST_SPECIALVEHICLES, V2XFAC_ST_TRAILER, V2XFAC_ST_TRAM, V2XFAC_ST_UNKNOWN}, set at pre-compile, default-value=V2XFAC_ST_UNKNOWN  # This configuration value defines the station type information of the originating ITS-S, RoadSideUnit (15) not supported by AUTOSAR.
      boolean V2xFacVersionInfoApi: set at pre-compile, default-value=false  # Enable/disables the API for reading the version information of the V2xFac Module. | - true: enabled (ON) - false: disabled (OFF)
  module definition V2xGn [0..1]: variants pre-compile  # Configuration of the V2xGn (Vehicle-2-X Geo Networking) module.
    container V2xGnBeaconService  # This container contains the GeoNetworking configuration parameters related to the beacon service.
      float V2xGnItsGnBeaconServiceMaxJitter: 0.001..Inf, set at pre-compile, default-value=0.75  # Maximum beacon jitter [s]. The Jitter is used for the beacon retransmission. The actual jitter value is a random number between 0 and V2xGnItsGnBeaconServiceMaxJitter. The function introduces a random component for the timer to avoid synchronization issues among | GeoAdhoc routers.
      float V2xGnItsGnBeaconServiceRetransmitTimer: 0.001..Inf, set at pre-compile, default-value=3  # Duration of Beacon service retransmit timer [s].
    container V2xGnGeneral  # This container specifies the general configuration parameters of the V2xGn module.
      boolean V2xGnDevErrorDetect: set at pre-compile, default-value=false  # Switches the Default Error Tracer (Det) detection and notification ON or OFF. | - true: enabled (ON) - false: disabled (OFF)
      float V2xGnItsGnLifetimeLocTE: 0..65535, set at pre-compile, default-value=20  # Location table maintenance: Lifetime of an entry in the location table in [s]
      integer V2xGnItsGnLocalGnAddr: 0..18446744073709551615, set at pre-compile, default-value=1  # 64bit GeoNetworking Address.
      integer V2xGnItsGnMaxGeoNetworkingHeaderSize: 0..65535, set at pre-compile, default-value=88  # Maximum size of GeoNetworking header in [Byte].
      integer V2xGnItsGnMaxSduSize: 0..65535, set at pre-compile, default-value=1398  # Maximum size of GN-SDU in [Byte].
      float V2xGnItsGnMinUpdateFrequencyLPV: 0..65535, set at pre-compile  # Minimum update frequency of local position vector (LPV) in [s].
      integer V2xGnItsGnPaiInterval: 0..100, set at pre-compile, default-value=80  # Distance related to the confidence interval for latitude and longitude [m]. Used to determine the PAI.
      integer V2xGnItsGnProtocolVersion: 0..255, set at pre-compile  # GeoNetworking protocol version
      enumeration V2xGnItsGnSnDecapResultHandling: {V2XGN_NON_STRICT_SEC_HANDLING, V2XGN_STRICT_SEC_HANDLING}, set at pre-compile  # Indicates the handling of the V2xM_ReqDecap result code.
      enumeration V2xGnItsGnStationType: {V2XFAC_ST_BUS, V2XFAC_ST_CYCLIST, V2XFAC_ST_HEAVYTRUCK, V2XFAC_ST_LIGHTTRUCK, V2XFAC_ST_MOPED, V2XFAC_ST_MOTORCYCLE, V2XFAC_ST_PASSENGERCAR, V2XFAC_ST_PEDESTRIAN, V2XFAC_ST_SPECIALVEHICLES, V2XFAC_ST_TRAILER, V2XFAC_ST_TRAM, V2XFAC_ST_UNKNOWN}, set at pre-compile  # Station Type used in GeoNetworking protocol, RoadSideUnit (15) not supported by AUTOSAR.
      float V2xGnMainFunctionPeriod: 0..Inf, set at pre-compile, default-value=0.001  # Specifies the period of main function V2xGn_MainFunction in seconds. V2xGn does not require this information but the BSW scheduler.
      boolean V2xGnTxConfirmation: scope=ECU, set at pre-compile, default-value=false  # When enabled, transmission status information will be forwarded to the upper layer. | - true: enabled (ON) - false: disable (OFF)
      boolean V2xGnVersionInfoApi: set at pre-compile, default-value=false  # Enable/disables the API for reading the version information of the V2xGn Module. | - true: enabled (ON) - false: disabled (OFF)
      symbolic name reference V2xGnEthIfRef: set at pre-compile, destination=EthIfController  # This represents the reference to the Ethernet interface taken to transmit the V2X-Packets to.
    container V2xGnPacketForwarding  # This container contains the GeoNetworking configuration parameters related to packet forwarding.
      integer V2xGnItsGnBcForwardingPacketBufferSize: 0..18446744073709551615, set at pre-compile, default-value=1024000  # Size of BC forwarding packet buffer [Byte].
      integer V2xGnItsGnCbfPacketBufferSize: 0..18446744073709551615, set at pre-compile, default-value=256000  # Size of CBF packet buffer [Byte]
      integer V2xGnItsGnDefaultHopLimit: 0..255, set at pre-compile, default-value=10  # Default hop limit indicating the maximum number of hops a packet travels.
      integer V2xGnItsGnDefaultMaxCommunicationRange: 0..65535, set at pre-compile, default-value=1000  # Default theoretical maximum communication range [m]
      float V2xGnItsGnDefaultPacketLifetime: 0..6300, set at pre-compile, default-value=60  # Default packet lifetime [s].
      integer V2xGnItsGnDefaultTrafficClass: 0..255, set at pre-compile, default-value=0  # Forwarding: Default traffic class
      boolean V2xGnItsGnGeoAreaLineForwardingUsed: set at pre-compile, default-value=false  # Forwarding of GBC/GAC packet if GeoAdhoc router is located outside the destination GeoArea. | - true: enabled (ON) - false: disabled (OFF)
      float V2xGnItsGnGeoBroadcastCbfMaxTime: 0..Inf, set at pre-compile, default-value=0.001  # Maximum duration a GeoBroadcast packet shall be buffered in the CBF packet buffer [s]
      float V2xGnItsGnGeoBroadcastCbfMinTime: 0..Inf, set at pre-compile, default-value=0.001  # Minimum duration a GeoBroadcast packet shall be buffered in the CBF packet buffer [s]
      integer V2xGnItsGnMaxGeoAreaSize: 0..18446744073709551615, set at pre-compile, default-value=80  # Maximum size of the geographical area for a GBC and GAC packet [km2]. If the geographical area size exceeds the maximum value, the GeoNetworking packet shall not be sent (source) and not be forwarded (forwarder).
      integer V2xGnItsGnMaxPacketDataRate: 0..4294967295, set at pre-compile, default-value=100000  # Maximum packet data rate for a GeoAdhoc router [Byte/s]. If the mean (EMA) packet data rate a of a GeoAdhoc router exceeds the value, packets from this GeoAdhoc router (source or sender) are not forwarded.
      float V2xGnItsGnMaxPacketDataRateEmaBeta: 0..1, set at pre-compile, default-value=0.9  # Weight factor for the Exponential Moving Average of the packet data rate PDR in percent.
      float V2xGnItsGnMaxPacketLifetime: 0..6300, set at pre-compile, default-value=600  # Upper limit of the maximum lifetime [s]
  module definition V2xM [0..1]: variants pre-compile  # Configuration of the V2xM (V2XManagement) module.
    container V2xMConfig  # This container contains the configuration parameters and sub containers of the AUTOSAR V2xM module.
      container V2xMSecurityConfig  # Configuration of the security services of V2xM.
        boolean V2xMSecurityVerificationOnDemand: set at pre-compile  # Switches the Verification on Demand (VoD) ON or OFF. | * true: enabled (ON) * false: disabled (OFF)
        symbolic name reference V2xMSecurityNvMBlockDescriptorLongTermCertificates: set at pre-compile, destination=NvMBlockDescriptor  # Reference to NVRAM block containing the none volatile data of long term certificates.
        symbolic name reference V2xMSecurityNvMBlockDescriptorPseudonymCertificates: set at pre-compile, destination=NvMBlockDescriptor  # Reference to NVRAM block containing the none volatile data of pseudonym certificates.
        reference V2xMSignatureGenerationConfigRef: set at pre-compile, destination=CsmSignatureGenerateConfig  # Select CSM service configuration that is used for authentication.
        reference V2xMSignatureVerifyConfigRef: set at pre-compile, destination=CsmSignatureVerifyConfig  # Select CSM service configuration that is used for authentication.
    container V2xMGeneral  # General configuration of V2xM module.
      boolean V2xMDevErrorDetect: set at pre-compile, default-value=false  # Switches the Default Error Tracer (Det) detection and notification ON or OFF. | - true: enabled (ON) - false: disabled (OFF)
      float V2xMMainFunctionPeriod: 0..0.1, set at pre-compile, default-value=0.1  # This parameter defines the schedule period of V2xM_MainFunction.Unit: [s]
      boolean V2xMVersionInfoApi: set at pre-compile, default-value=false  # Enable/disables the API for reading the version information of the V2xM Module. | - true: enabled (ON) - false: disabled (OFF)
      symbolic name reference V2xMEthIfCtrlRef: set at pre-compile, destination=EthIfController  # Reference to EthIf controller where the channel and radio parameters should be read and written to.
      symbolic name reference V2xMGptChannelConfigurationRef [0..1]: set at pre-compile, destination=GptChannelConfiguration  # Reference to General Purpose Timer.
      symbolic name reference V2xMNvMBlockDescriptor: set at pre-compile, destination=NvMBlockDescriptor  # Reference to NVRAM block containing the none volatile data.
      symbolic name reference V2xMStbMSynchronizedTimeBaseRef [0..1]: set at pre-compile, destination=StbMSynchronizedTimeBase  # Reference to synchronized time-base.
  module definition WEth [0..*]: post-build-variant-support=true, variants link-time/post-build/pre-compile  # Configuration of the WEth (Wireless Ethernet Driver) module.
    container WEthConfigSet  # This container contains the configuration parameters and sub containers of the AUTOSAR WEth module.
      container WEthCtrlConfig [1..*]  # Configuration of the individual controller
        integer WEthCtrlId: 0..255, scope=ECU, set at pre-compile, symbolic-name-value=true  # Specifies the instance ID of the configured controller.
        string WEthCtrlPhyAddress [0..1]: multiplicity set at link in variant link-time / post-build in variant post-build / pre-compile in variant pre-compile, post-build-variant-multiplicity=true, post-build-variant-value=true, set at link in variant link-time / post-build in variant post-build / pre-compile in variant pre-compile, max-length=17, min-length=17  # Specifies the unique 48-bit physical address (MAC address) of the controller in network byte order. | Regular Expression: [0-9a-fA-F]{2}[[:-][0-9a-fA-F]{2}]{5}
        integer WEthCtrlRxBufLenByte: 0..1522, post-build-variant-value=true, set at link in variant link-time / post-build in variant post-build / pre-compile in variant pre-compile  # Limits the maximum receive buffer length (frame length) in bytes.
        integer WEthCtrlTxBufLenByte: 0..1522, post-build-variant-value=true, set at link in variant link-time / post-build in variant post-build / pre-compile in variant pre-compile  # Limits the maximum transmit buffer length (frame length) in bytes.
        integer WEthRxBufTotal: 0..255, post-build-variant-value=true, set at link in variant link-time / post-build in variant post-build / pre-compile in variant pre-compile  # Configures the number of receive buffers.
        integer WEthTxBufTotal: 0..255, post-build-variant-value=true, set at link in variant link-time / post-build in variant post-build / pre-compile in variant pre-compile  # Configures the number of transmit buffers.
        container WEthDemEventParameterRefs [0..1]  # Container for the references to DemEventParameter elements which shall be invoked using the API Dem_SetEventStatus in case the corresponding error occurs. The EventId is taken from the referenced DemEventParameter's DemEventId symbolic value. The standardized errors are provided in this container and can be extended by vendor-specific error references.
          symbolic name reference WETH_E_ACCESS [0..1]: multiplicity set at link in variant link-time / post-build in variant post-build / pre-compile in variant pre-compile, post-build-variant-multiplicity=true, post-build-variant-value=true, set at link in variant link-time / post-build in variant post-build / pre-compile in variant pre-compile, destination=DemEventParameter  # Reference to the DemEventParameter which shall be issued when the error "Controller access failed" has occured.
    container WEthGeneral  # General configuration of Wireless Ethernet Driver module.
      boolean WEthDevErrorDetect: set at pre-compile, default-value=false  # Switches the Default Error Tracer (Det) detection and notification ON or OFF. | * true: detection and notification is enabled. * false: detection and notification is disabled.
      boolean WEthGetWEtherStatsApi: set at pre-compile  # Enables / Disables WEth_GetWEtherStats_32 and WEth_GetWEtherStats_64 API.
      integer WEthIndex: 0..255, set at pre-compile  # Specifies the InstanceId of this module instance. If only one instance is present it shall have the Id 0.
      float WEthMainFunctionPeriod: 0..Inf, set at pre-compile  # Specifies the period of main function WEth_MainFunction in seconds. Wireless Ethernet driver does not require this information but the BSW scheduler.
      boolean WEthUpdatePhysAddrFilter: set at pre-compile, default-value=false  # Enables/Disables optional API WEth_UpdatePhysAddrFilter.
      boolean WEthVersionInfoApi: set at pre-compile, default-value=false  # Enables / Disables version info API.
  module definition WEthTrcv [0..*]: post-build-variant-support=true, variants link-time/post-build/pre-compile  # Configuration of Ethernet Transceiver Driver module
    container WEthTrcvAntennaConfigSet  # This container contains the antenna configurations.
      container WEthTrcvAntennaConfig [1..*]  # Configuration of the individual antenna.
        integer WEthTrcvAntennaId: 0..255, scope=ECU, set at pre-compile, symbolic-name-value=true  # Specifies the instance ID of the configured antenna.
    container WEthTrcvConfigSet  # This container contains the configuration parameters and sub containers of the AUTOSAR WEthTrcv module.
      container WEthTrcvConfig [1..*]  # Configuration of the individual transceiver
        integer WEthTrcvBusId: 0..255, post-build-variant-value=true, set at link in variant link-time / post-build in variant post-build / pre-compile in variant pre-compile  # Specifies the hardware id used for lower level bus interface access (e.g. MII/SPI) to the transceiver's hardware module. For example the MII index if MII would have been used.
        integer WEthTrcvId: 0..255, scope=ECU, set at pre-compile, symbolic-name-value=true  # Specifies the instance ID of the configured transceiver.
        enumeration WEthTrcvPhysLayerType [0..1]: {TRCV_PHYS_LAYER_TYPE_80211_P}, multiplicity set at link in variant link-time / post-build in variant post-build / pre-compile in variant pre-compile, post-build-variant-multiplicity=true, post-build-variant-value=true, set at link in variant link-time / post-build in variant post-build / pre-compile in variant pre-compile  # Specifies the physical layer type of the Wireless Ethernet transceiver link.
        symbolic name reference WEthTrcvCtrlRef: post-build-variant-value=true, set at link in variant link-time / post-build in variant post-build / pre-compile in variant pre-compile, destination=WEthCtrlConfig  # Specifies a reference to the wireless ethernet controller used for lower layer bus interface access to the transceiver.
        reference WEthTrcvRadioConfigSetRef: set at pre-compile, destination=WEthTrcvRadioConfigSet  # Reference to a WEthTrcvRadioConfigSet.
        container WEthTrcvDemEventParameterRefs [0..1]  # Container for the references to DemEventParameter elements which shall be invoked using the API Dem_SetEventStatus in case the corresponding error occurs. The EventId is taken from the referenced DemEventParameter's DemEventId symbolic value. The standardized errors are provided in this container and can be extended by vendor-specific error references.
          symbolic name reference WETHTRCV_E_ACCESS [0..1]: multiplicity set at link in variant link-time / post-build in variant post-build / pre-compile in variant pre-compile, post-build-variant-multiplicity=true, post-build-variant-value=true, set at link in variant link-time / post-build in variant post-build / pre-compile in variant pre-compile, destination=DemEventParameter  # Reference to the DemEventParameter which shall be issued when the error "Transceiver access failed" has occurred.
    container WEthTrcvGeneral  # General configuration of Wireless Ethernet Transceiver Driver module
      boolean WEthTrcvDevErrorDetect: set at pre-compile, default-value=false  # Switches the Default Error Tracer (Det) detection and notification ON or OFF. | * true: detection and notification is enabled. * false: detection and notification is disabled.
      boolean WEthTrcvGetLinkStateApi: set at pre-compile  # Enables / Disables WEthTrcv_GetLinkState API
      boolean WEthTrcvGetTransceiverModeApi: set at pre-compile  # Enables / Disables WEthTrcv_GetTransceiverMode API
      integer WEthTrcvIndex: 0..255, set at pre-compile  # Specifies the InstanceId of this module instance. If only one instance is present it shall have the Id 0.
      float WEthTrcvMainFunctionPeriod [0..1]: 0..Inf, multiplicity set at pre-compile, set at pre-compile  # Specifies the period of main function WEthTrcv_MainFunction in seconds.
      integer WEthTrcvMaxTrcvsSupported: 0..255, set at pre-compile, default-value=1
      boolean WEthTrcvSetTransceiverModeApi: set at pre-compile  # Enables / Disables WEthTrcv_SetTransceiverMode API
      boolean WEthTrcvVersionInfoApi: set at pre-compile, default-value=false  # Enables / Disables version info API
      boolean WEthTrcvVersionInfoApiMacro: set at pre-compile, default-value=false  # Enables / Disables version info API macro implementation
    container WEthTrcvRadioConfigSet [1..*]  # This container contains the radio configurations.
      container WEthTrcvRadioConfig [1..*]  # Configuration of the individual radio (PHY + MAC).
        enumeration WEthTrcvRadioChannelBandwidth: {BW_10MHZ, BW_20MHZ, BW_40MHZ, BW_5MHZ}, set at pre-compile  # Specifies the bandwidth of the physical channel.
        float WEthTrcvRadioChannelCsPowerThreshold: -100..100, set at pre-compile  # Specifies the threshold for carrier sense (CS) power of the physical channel [dBm].
        integer WEthTrcvRadioChannelFreq: 0..18446744073709551615, set at pre-compile  # Specifies the frequency of the physical channel [Hz].
        float WEthTrcvRadioChannelMaxTxPower: -100..100, set at pre-compile  # Specifies the transmit power of the physical channel [dBm].
        float WEthTrcvRadioChannelTxDatarate: 0..Inf, set at pre-compile  # Specifies the transmit datarate of the physical channel. [bit/s]
        integer WEthTrcvRadioId: 0..255, scope=ECU, set at pre-compile, symbolic-name-value=true  # Specifies the instance ID of the configured radio.
        enumeration WEthTrcvRadioMode: {OFF, RX_ON, RX_TX_ON, TX_ON, USED_FOR_CHANNEL_SWITCHING}, set at pre-compile  # Specifies the mode of the radio within a WEthTrcvRadioConfig. Inside of a WEthTrcvRadioConfigSet different modes for the respective WEthTrcvRadioConfigs are possible. The WEthTrcvRadioConfigSet can be selected at runtime.
        reference WEthTrcvRadioChannelRxAntenna: set at pre-compile, destination=WEthTrcvAntennaConfig  # Specifies the antenna used for reception of packets of the physical channel.
        reference WEthTrcvRadioChannelTxAntenna: set at pre-compile, destination=WEthTrcvAntennaConfig  # Specifies the antenna used for transmission of packets to the physical channel.
        container WEthTrcvRadioChannelTxQueueConfig [1..*]: multiplicity set at pre-compile  # Configuration of the individual EDCA transmit queue of a channel.
          integer WEthTrcvRadioChannelTxQueueAifsn: 0..15, set at pre-compile  # Specifies the arbitration inter frame space number (AIFSN) of the queue.
          integer WEthTrcvRadioChannelTxQueueCwMax: 0..255, set at pre-compile  # Specifies the maximum size of the contention windows (CW) of the queue.
          integer WEthTrcvRadioChannelTxQueueCwMin: 0..255, set at pre-compile  # Specifies the minimum size of the contention windows (CW) of the queue.
          integer WEthTrcvRadioChannelTxQueueId: 0..255, set at pre-compile  # Specifies the ID (equals priority) of the queue.
          float WEthTrcvRadioChannelTxQueueTxOpDurationLimit: 3.2E-5..0.00816, set at pre-compile  # Specifies the transmit operation duration limit of the queue in [s].
  module definition Wdg [0..*]: post-build-variant-support=true, variants link-time/post-build/pre-compile  # Configuration of the Wdg (Watchdog driver) module.
    container WdgDemEventParameterRefs [0..1]  # Container for the references to DemEventParameter elements which shall be invoked using the API Dem_SetEventStatus in case the corresponding error occurs. The EventId is taken from the referenced DemEventParameter's DemEventId symbolic value. The standardized errors are provided in this container and can be extended by vendor-specific error references.
      symbolic name reference WDG_E_DISABLE_REJECTED [0..1]: multiplicity set at pre-compile, set at pre-compile, destination=DemEventParameter  # Reference to the DemEventParameter which shall be issued when the error "Initialization or mode switch failed because it would disable the watchdog" has occurred.
      symbolic name reference WDG_E_MODE_FAILED [0..1]: multiplicity set at pre-compile, set at pre-compile, destination=DemEventParameter  # Reference to the DemEventParameter which shall be issued when the error "Setting a watchdog mode failed (during initialization or mode switch)" has occurred.
    container WdgGeneral  # All general parameters of the watchdog driver are collected here.
      boolean WdgDevErrorDetect: set at pre-compile, default-value=false  # Switches the development error detection and notification on or off. | * true: detection and notification is enabled. * false: detection and notification is disabled.
      boolean WdgDisableAllowed: set at pre-compile  # Compile switch to allow / forbid disabling the watchdog driver during runtime. | True: Disabling the watchdog driver at runtime is allowed. False: Disabling the watchdog driver at runtime is not allowed.
      integer WdgIndex: 0..255, set at pre-compile, symbolic-name-value=true  # Specifies the InstanceId of this module instance. If only one instance is present it shall have the Id 0.
      float WdgInitialTimeout: 0..65.535, set at pre-compile  # The initial timeout (sec) for the trigger condition to be initialized during Init function. It shall be not larger than WdgMaxTimeout.
      float WdgMaxTimeout: 0..65.535, set at pre-compile  # The maximum timeout (sec) to which the watchdog trigger condition can be initialized.
      enumeration WdgRunArea: {RAM, ROM}, set at pre-compile  # Represents the watchdog driver execution area is either from ROM(Flash) or RAM as required with the particular microcontroller.
      function name WdgTriggerLocation: set at pre-compile  # Location (memory address) of the watchdog trigger routine.
      boolean WdgVersionInfoApi: set at pre-compile, default-value=false  # Compile switch to enable / disable the version information API | * True: API enabled * False: API disabled
    container WdgPublishedInformation  # Container holding all Wdg specific published information parameters
      enumeration WdgTriggerMode: {WDG_BOTH, WDG_TOGGLE, WDG_WINDOW}, set at published-information  # Watchdog trigger mode (toggle/window/both)
    container WdgSettingsConfig  # Configuration items for the different watchdog settings, including those for external watchdog hardware. | Note: All postbuild parameters are handled via this container.
      enumeration WdgDefaultMode: {WDGIF_FAST_MODE, WDGIF_OFF_MODE, WDGIF_SLOW_MODE}, post-build-variant-value=true, set at link in variant link-time / post-build in variant post-build / pre-compile in variant pre-compile  # Default mode for watchdog driver initialization. | ImplementationType: WdgIf_ModeType
      container WdgExternalConfiguration [0..1]  # Configuration items for an external watchdog hardware
        choice reference WdgExternalContainerRef [0..1]: multiplicity set at link in variant link-time / post-build in variant post-build / pre-compile in variant pre-compile, post-build-variant-multiplicity=true, post-build-variant-value=true, set at link in variant link-time / post-build in variant post-build / pre-compile in variant pre-compile, destination=[DioChannelGroup, SpiSequence]  # Reference to either | - a DioChannelGroup container in case the hardware watchdog is connected via DIO pins - an SpiSequenceConfiguration container in case the watchdog hardware is accessed via SPI
      container WdgSettingsFast  # Hardware dependent settings for the watchdog driver's "fast" mode.
      container WdgSettingsOff  # Hardware dependent settings for the watchdog driver's "off" mode.
      container WdgSettingsSlow  # Hardware dependent settings for the watchdog driver's "slow" mode.
  module definition WdgIf [0..1]: variants pre-compile  # Configuration of the WdgIf (Watchdog Interface) module.
    container WdgIfDevice [1..*]  # It contains the information for the selection of a particular Watchdog device in case multiple Watchdog drivers are connected.
      integer WdgIfDeviceIndex: 0..255, scope=ECU, set at pre-compile, symbolic-name-value=true  # Represents the watchdog interface ID so that it can be referenced by the watchdog manager.
      symbolic name reference WdgIfDriverRef: set at pre-compile, destination=WdgGeneral  # Reference to the watchdog drivers that are controlled by the watchdog interface.
    container WdgIfGeneral  # This container collects all generic watchdog interface parameters.
      boolean WdgIfDevErrorDetect: set at pre-compile, default-value=false  # Switches the development error detection and notification on or off. | * true: detection and notification is enabled. * false: detection and notification is disabled.
      boolean WdgIfVersionInfoApi: set at pre-compile, default-value=false  # Pre-processor switch to enable / disable the service returning the version information. | true: Version information service enabled false: Version information service disabled
  module definition WdgM [0..1]: post-build-variant-support=true, variants post-build/pre-compile  # Configuration of the WdgM (Watchdog Manager) module.
    container WdgMConfigSet  # This container describes one of multiple configuration sets of WdgM.
      symbolic name reference WdgMInitialMode: post-build-variant-value=true, set at post-build in variant post-build / pre-compile in variant pre-compile, destination=WdgMMode  # The mode that the Watchdog Manager is in after it has been initialized.
      container WdgMDemEventParameterRefs [0..1]  # Container for the references to DemEventParameter elements which shall be invoked using the API Dem_SetEventStatus in case the corresponding error occurs. The EventId is taken from the referenced DemEventParameter's DemEventId symbolic value. The standardized errors are provided in this container and can be extended by vendor-specific error references.
        symbolic name reference WDGM_E_SET_MODE [0..1]: multiplicity set at post-build in variant post-build / pre-compile in variant pre-compile, post-build-variant-multiplicity=true, post-build-variant-value=true, set at post-build in variant post-build / pre-compile in variant pre-compile, destination=DemEventParameter  # Reference to the DemEventParameter which shall be issued when the error "Watchdog drivers' mode switch has failed" has occurred.
        symbolic name reference WDGM_E_SUPERVISION [0..1]: multiplicity set at post-build in variant post-build / pre-compile in variant pre-compile, post-build-variant-multiplicity=true, post-build-variant-value=true, set at post-build in variant post-build / pre-compile in variant pre-compile, destination=DemEventParameter  # Reference to the DemEventParameter which shall be issued when the error "Supervision has failed (Global Supervision Status has reached WDGM_GLOBAL_STATUS_STOPPED) and a watchdog reset will occur" has occurred.
      container WdgMMode [1..255]  # The container describes one of several modes of the Watchdog Manager.
        integer WdgMExpiredSupervisionCycleTol: 0..65535, scope=ECU, post-build-variant-value=true, set at post-build in variant post-build / pre-compile in variant pre-compile  # This parameter shall be used to define a value that fixes the amount of expired supervision cycles for how long the blocking of watchdog triggering shall be postponed, AFTER THE GLOBAL SUPERVISION STATUS HAS REACHED THE STATE EXPIRED.
        integer WdgMModeId: 0..255, set at pre-compile, symbolic-name-value=true  # This parameter fixes the identifier for the mode. This identifier is for instance passed as a parameter to the WdgM_SetMode service.
        float WdgMSupervisionCycle: 0..Inf, scope=ECU, set at pre-compile  # This parameter defines the schedule period of the main function WdgM_MainFunction. | Unit: [s]
        container WdgMAliveSupervision [0..65535]  # This container collects all configuration parameters of Alive-Supervision of one Checkpoint. Note that each Checkpoint may have different parameters. For example, it may have different min and max margin.
          integer WdgMExpectedAliveIndications: 0..65535, post-build-variant-value=true, set at post-build in variant post-build / pre-compile in variant pre-compile  # This parameter contains the amount of expected alive indications of the Checkpoint within the referenced amount of defined supervision cycles according to corresponding SE.
          integer WdgMMaxMargin: 0..255, post-build-variant-value=true, set at post-build in variant post-build / pre-compile in variant pre-compile  # This parameter contains the amount of alive indications of the Checkpoint that are acceptable to be additional to the expected alive indications within the corresponding supervision reference cycle.
          integer WdgMMinMargin: 0..255, post-build-variant-value=true, set at post-build in variant post-build / pre-compile in variant pre-compile  # This parameter contains the amount of alive indications of the Checkpoint that are acceptable to be missed from the expected alive indications within the corresponding supervision reference cycle.
          integer WdgMSupervisionReferenceCycle: 1..65535, post-build-variant-value=true, set at post-build in variant post-build / pre-compile in variant pre-compile  # This parameter shall contain the amount of supervision cycles to be used as reference by the alive-supervision mechanism to perform the checkup with counted alive indications according to corresponding SE.
          symbolic name reference WdgMAliveSupervisionCheckpointRef: post-build-variant-value=true, set at post-build in variant post-build / pre-compile in variant pre-compile, destination=WdgMCheckpoint  # Reference to Checkpoint within a Supervised Entity that shall be supervised.
        container WdgMDeadlineSupervision [0..65535]  # This container collects all configuration parameters for Deadline Supervision for a Supervised Entity.
          float WdgMDeadlineMax: 0..Inf, post-build-variant-value=true, set at post-build in variant post-build / pre-compile in variant pre-compile  # This parameter contains the longest time span after which the deadline is considered to be met. | Unit: [s]
          float WdgMDeadlineMin: 0..Inf, post-build-variant-value=true, set at post-build in variant post-build / pre-compile in variant pre-compile  # This parameter contains the shortest time span after which the deadline is considered to be met. | Unit: [s]
          symbolic name reference WdgMDeadlineStartRef: post-build-variant-value=true, set at post-build in variant post-build / pre-compile in variant pre-compile, destination=WdgMCheckpoint  # This is the reference to the start Checkpoint for Deadline Supervision.
          symbolic name reference WdgMDeadlineStopRef: post-build-variant-value=true, set at post-build in variant post-build / pre-compile in variant pre-compile, destination=WdgMCheckpoint  # This is the reference to the stop Checkpoint for Deadline Supervision.
        container WdgMExternalLogicalSupervision [0..65535]  # This container collects all configuration parameters for Logical Supervision for one external graph.
          symbolic name reference WdgMExternalCheckpointFinalRef [1..65535]: multiplicity set at post-build in variant post-build / pre-compile in variant pre-compile, post-build-variant-multiplicity=true, post-build-variant-value=true, set at post-build in variant post-build / pre-compile in variant pre-compile, destination=WdgMCheckpoint  # This is the reference to the final Checkpoint(s) for this External Graph.
          symbolic name reference WdgMExternalCheckpointInitialRef [1..65535]: multiplicity set at post-build in variant post-build / pre-compile in variant pre-compile, post-build-variant-multiplicity=true, post-build-variant-value=true, set at post-build in variant post-build / pre-compile in variant pre-compile, destination=WdgMCheckpoint  # This is the reference to the initial Checkpoint(s) for this External Graph.
          container WdgMExternalTransition [0..65535]  # This container collects the Checkpoints for an External Transition across Supervised Entities.
            symbolic name reference WdgMExternalTransitionDestRef: post-build-variant-value=true, set at post-build in variant post-build / pre-compile in variant pre-compile, destination=WdgMCheckpoint  # This is the reference to the destination Checkpoint of an External Transition.
            symbolic name reference WdgMExternalTransitionSourceRef: post-build-variant-value=true, set at post-build in variant post-build / pre-compile in variant pre-compile, destination=WdgMCheckpoint  # This is the reference to the source Checkpoint of an External Transition.
        container WdgMLocalStatusParams [0..65535]  # This container collects all configuration parameters for the Local Status of a Supervised Entity.
          integer WdgMFailedAliveSupervisionRefCycleTol: 0..255, post-build-variant-value=true, set at post-build in variant post-build / pre-compile in variant pre-compile  # This parameter shall contain the acceptable amount of reference cycles with incorrect/failed alive supervisions for this Supervised Entity.
          symbolic name reference WdgMLocalStatusSupervisedEntityRef: post-build-variant-value=true, set at post-build in variant post-build / pre-compile in variant pre-compile, destination=WdgMSupervisedEntity  # This is the reference to the Supervised Entity for which the Local Status parameters are specified.
        container WdgMTrigger [0..255]  # This container collects all configuration parameters for the triggering of hardware watchdogs.
          integer WdgMTriggerConditionValue: 1..65535, post-build-variant-value=true, set at post-build in variant post-build / pre-compile in variant pre-compile  # This parameter shall contain the value that is passed to WdgIf_SetTriggerCondition for this watchdog.
          enumeration WdgMWatchdogMode: {WDGIF_FAST_MODE, WDGIF_OFF_MODE, WDGIF_SLOW_MODE}, post-build-variant-value=true, set at post-build in variant post-build / pre-compile in variant pre-compile  # This parameter contains the watchdog mode that shall be used for the referenced watchdog in this Watchdog Manager mode. | Implementation Type: WdgIf_ModeType
          reference WdgMTriggerWatchdogRef: post-build-variant-value=true, set at post-build in variant post-build / pre-compile in variant pre-compile, destination=WdgMWatchdog  # This parameter is a reference to the configured watchdog.
    container WdgMGeneral  # Container defines all general configuration parameters of the Watchdog Manager.
      boolean WdgMDemStoppedSupervisionReport: set at pre-compile  # Parameter to enable/disable the error reporting to DEM. | true: A notification to DEM is sent if the Watchdog Manager reaches the state WDGM_GLOBAL_STATUS_STOPPED. false: The notification is disabled.
      boolean WdgMDevErrorDetect: set at pre-compile, default-value=false  # Switches the development error detection and notification on or off. | * true: detection and notification is enabled. * false: detection and notification is disabled.
      boolean WdgMImmediateReset: set at pre-compile  # This parameter enables/disablse the immediate reset feature in case of alive-supervision failure. | true: Immediate reset is enabled false: Immediate reset is disabled
      boolean WdgMOffModeEnabled: set at pre-compile  # This parameter enables/disables the selection of the "OffMode" of the watchdog driver. | true: "OffMode" selection is allowed false: "OffMode" selection is disallowed
      boolean WdgMVersionInfoApi: set at pre-compile, default-value=false  # Preprocessor switch to enable/disable the existence of the API WdgM_GetVersionInfo. Shall be used to remove unneeded code segments. | true: API is enabled false: API is disabled
      container WdgMSupervisedEntity [0..65535]  # This container collects all common (mode-independent) parameters of a Supervised Entity to be supervised by the Watchdog Manager.
        integer WdgMSupervisedEntityId: 0..65535, set at pre-compile, symbolic-name-value=true  # This parameter shall contain the unique identifier of the supervised entity.
        reference WdgMEcucPartitionRef [0..1]: multiplicity set at pre-compile, set at pre-compile, destination=EcucPartition  # Denotes in which "EcucPartition" the supervised entity is executed. When the partition is stopped, the supervised entity shall be de-activated in the WdgM to avoid an ECU reset.
        symbolic name reference WdgMInternalCheckpointInitialRef [1..65535]: set at pre-compile, destination=WdgMCheckpoint  # This is the reference to the initial Checkpoint for this Supervised Entity.
        symbolic name reference WdgMInternallCheckpointFinalRef [1..65535]: multiplicity set at pre-compile, set at pre-compile, destination=WdgMCheckpoint  # This is the reference to the final Checkpoint(s) for this Supervised Entity.
        reference WdgMOsApplicationRef [0..1]: multiplicity set at pre-compile, set at pre-compile, destination=OsApplication  # Optional reference to an OS Application. Beware, the Watchdog Manager module will trigger a partition restart of this OS Application when the corresponding Supervised Entity reaches WDGM_LOCAL_STATUS_FAILED.
        reference WdgMOSCounter [0..1]: multiplicity set at pre-compile, set at pre-compile, destination=OsCounter  # OS counter used by Watchdog Manager to perform the deadline supervision of the Supervised Entity.
        container WdgMCheckpoint [1..65535]  # This container collects all Checkpoints of this Supervised Entity. Each Supervised Entity has at least one Checkpoint.
          integer WdgMCheckpointId: 0..65535, set at pre-compile, symbolic-name-value=true  # This parameter shall contain the unique identifier of Checkpoint.
        container WdgMInternalTransition [0..65535]  # This container defines the graph of Internal Transitions within this Supervised Entity.
          symbolic name reference WdgMInternalTransitionDestRef: set at pre-compile, destination=WdgMCheckpoint  # This is the reference to the destination Checkpoint of a Internal Transition within this Supervised Entity.
          symbolic name reference WdgMInternalTransitionSourceRef: set at pre-compile, destination=WdgMCheckpoint  # This is the reference to the source Checkpoint of a Internal Transition within this Supervised Entity.
      container WdgMWatchdog [0..255]  # This container collects all common (mode-independent) parameters of a Watchdog to be triggered by the Watchdog Manager.
        string WdgMWatchdogName: set at pre-compile  # This parameter shall contain the name of the watchdog instance.
        symbolic name reference WdgMWatchdogDeviceRef: set at pre-compile, destination=WdgIfDevice  # Reference to one device container of Watchdog Interface. In the referenced container WdgIfDevice, the parameter WdgIfDeviceIndex contains the Index parameter that WdgM has to use for WdgIf_SetTriggerCondition calls for that watchdog instance.
  module definition Xcp [0..1]: post-build-variant-support=true, variants post-build/pre-compile  # Configuration of the XCP module
    container XcpConfig  # This container contains the configuration parameters and sub containers of the AUTOSAR Xcp module.
      container XcpCommunicationChannel [0..*]  # This container represents the configuration of the communication channel of XCP.
        reference XcpChannelRxPduRef [0..1]: scope=ECU, post-build-variant-value=true, set at post-build in variant post-build / pre-compile in variant pre-compile, destination=XcpRxPdu  # Optional reference to the XCP Rx PDU.
        reference XcpChannelTxPduRef: scope=ECU, post-build-variant-value=true, set at post-build in variant post-build / pre-compile in variant pre-compile, destination=XcpTxPdu  # Reference to the XCP Tx PDU.
        reference XcpComMChannelRef: scope=ECU, post-build-variant-value=true, set at post-build in variant post-build / pre-compile in variant pre-compile, destination=ComMChannel  # Reference to the ComM channel the PDUs belong to.
      container XcpDaqList [1..*]  # This container contains the configuration of the DAQs.
        integer XcpDaqListNumber: 0..65534, scope=ECU, set at pre-compile, symbolic-name-value=true  # Index number of the DAQ list
        enumeration XcpDaqListType: {DAQ, DAQ_STIM, STIM}, scope=ECU, set at pre-compile  # This indicates whether this DAQ list represents a DAQ or a STIM.
        integer XcpMaxOdt: 0..252, scope=ECU, set at pre-compile  # MAX_ODT indicates the maximum amount of ODTs in this DAQ list | (STATIC configuration)
        integer XcpMaxOdtEntries: 0..255, scope=ECU, set at pre-compile  # This parameter indicates the maximum amount of entries in an ODT of this DAQ list (STATIC configuration).
        container XcpDto [0..*]  # This container collects data transfer object specific parameters for the DAQ list.
          integer XcpDtoPid: 0..251, scope=ECU, set at pre-compile, symbolic-name-value=true  # Packet identifier (PID) of the DTO that identifies the ODT the content of the DTO.
          choice reference XcpDto2PduMapping: scope=ECU, set at pre-compile, destination=[XcpRxPdu, XcpTxPdu]  # This reference specifies the mapping of the DTO to the PDUs from the lower-layer interfaces (CanIf, FrIf, SoAd and Cdd). | A reference to a XcpRxPdu is only feasible if the the DaqListType is DAQ_STIM. A reference to a XcpTxPdu is only feasible if the DaqListType is DAQ.
        container XcpOdt [0..*]  # This container contains ODT-specific parameter for the DAQ list.
          integer XcpOdtEntryMaxSize: 0..254, scope=ECU, set at pre-compile  # This parameter indicates the upper limit for the size of the element described by an ODT entry. Depending on the DaqListType this ODT belongs to it describes the limit for a DAQ (MAX_ODT_ENTRY_SIZE_DAQ) or a STIM (MAX_ODT_ENTRY_SIZE_STIM).
          integer XcpOdtNumber [0..1]: 0..251, scope=ECU, multiplicity set at pre-compile, set at pre-compile, symbolic-name-value=true  # Index number of this ODT within the DAQ list.
          reference XcpOdt2DtoMapping [0..1]: scope=ECU, set at pre-compile, destination=XcpDto  # This reference maps the ODT to the according DTO in which it will be transmitted.
          container XcpOdtEntry [1..*]  # This container collects all configuration parameters that comprise an ODT entry.
            linker symbol XcpOdtEntryAddress [0..1]: scope=ECU, multiplicity set at pre-compile, set at pre-compile  # Memory address that the ODT entry is referencing to.
            integer XcpOdtEntryBitOffset [0..1]: 0..31, scope=ECU, multiplicity set at pre-compile, set at pre-compile  # Represent the bit offset in case of the element represents status bit.
            integer XcpOdtEntryLength [0..1]: 0..255, scope=ECU, multiplicity set at pre-compile, set at pre-compile  # Length of the referenced memory area that is referenced by the ODT entry.
            integer XcpOdtEntryNumber [0..1]: 0..254, scope=ECU, multiplicity set at pre-compile, set at pre-compile  # Index number of the ODT entry
      container XcpEventChannel [1..*]  # This container contains the configuration of event channels on the XCP slave.
        enumeration XcpEventChannelConsistency: {DAQ, EVENT, ODT}, set at pre-compile, default-value=ODT  # Type of consistency used by event channel
        integer XcpEventChannelMaxDaqList: 0..255, scope=ECU, set at pre-compile  # Maximum amount of DAQ lists that are handled by this event channel.
        integer XcpEventChannelNumber: 0..65534, scope=ECU, set at pre-compile, symbolic-name-value=true  # Index number of the event channel.
        integer XcpEventChannelPriority: 0..255, scope=ECU, set at pre-compile  # Priority of the event channel
        integer XcpEventChannelTimeCycle: 0..255, set at pre-compile  # The event channel time cycle indicates which sampling period is used to process this event channel. A value of 0 means 'Not cyclic'.
        enumeration XcpEventChannelTimeUnit [0..1]: {TIMESTAMP_UNIT_100MS, TIMESTAMP_UNIT_100NS, TIMESTAMP_UNIT_100PS, TIMESTAMP_UNIT_100US, TIMESTAMP_UNIT_10MS, TIMESTAMP_UNIT_10NS, TIMESTAMP_UNIT_10PS, TIMESTAMP_UNIT_10US, TIMESTAMP_UNIT_1MS, TIMESTAMP_UNIT_1NS, TIMESTAMP_UNIT_1PS, TIMESTAMP_UNIT_1S, TIMESTAMP_UNIT_1US}, multiplicity set at pre-compile, set at pre-compile  # This configuration parameter indicates the unit of the event channel time cycle.
        enumeration XcpEventChannelType: {DAQ, DAQ_STIM, STIM}, set at pre-compile, default-value=DAQ  # This configuration parameter indicates what kind of DAQ list can be allocated to this event channel.
        reference XcpEventChannelTriggeredDaqListRef [0..*]: scope=ECU, multiplicity set at pre-compile, set at pre-compile, destination=XcpDaqList  # References all DAQ lists that are trigged by this event channel.
      choice container XcpPdu [1..*]  # Contains PDU information. A PDU may be either a transmission PDU or a reception PDU.
        container XcpRxPdu [0..1]  # This container specifies received PDUs.
          integer XcpRxPduId: 0..65535, scope=ECU, set at pre-compile, symbolic-name-value=true  # ID of the PDU that will be received via a Xcp_<module>RxIndication.
          reference XcpRxPduRef: scope=ECU, post-build-variant-value=true, set at post-build in variant post-build / pre-compile in variant pre-compile, destination=Pdu
        container XcpTxPdu [0..1]  # This container specifies transmission PDUs.
          integer XcpTxPduId: 0..65535, scope=ECU, set at pre-compile, symbolic-name-value=true  # The PDU identifier, which has to be used by the lower layer BSW module for TxConfirmations or TriggerTransmits.
          reference XcpTxPduRef: scope=ECU, post-build-variant-value=true, set at post-build in variant post-build / pre-compile in variant pre-compile, destination=Pdu  # Reference to the external PDU definition.
    container XcpGeneral  # This container contains the general configuration parameters of the XCP.
      enumeration XcpDaqConfigType: {DAQ_DYNAMIC, DAQ_STATIC}, scope=ECU, set at pre-compile  # Sets the DAQ_CONFIG_TYPE bit within the DAQ_PROPERTIES parameter to "static" or to "dynamic". If DAQ_STATIC is selected, the DAQ_CONFIG_TYPE bit is set to "0". If DAQ_DYNAMIC is selected, the DAQ_CONFIG_TYPE bit is set to "1".
      integer XcpDaqCount: 0..65535, scope=ECU, set at pre-compile  # Indicates the number of DAQ lists for dynamic configuration.
      boolean XcpDevErrorDetect: set at pre-compile, default-value=false  # Switches the development error detection and notification on or off. | * true: detection and notification is enabled. * false: detection and notification is disabled.
      boolean XcpFlashProgrammingEnabled: set at pre-compile  # Enabling of XCP Flash programming functionality
      enumeration XcpIdentificationFieldType: {ABSOLUTE, RELATIVE_BYTE, RELATIVE_WORD, RELATIVE_WORD_ALIGNED}, set at pre-compile  # Type of Identification Field the slave will use when transferring DAQ Packets to the master. The master has to use the same Type of Identification Field when transferring STIM Packets to the slave.
      float XcpMainFunctionPeriod: 0..Inf, set at pre-compile  # The XCP does not require this information but the BSW scheduler, which invokes the main function, needs it in order to plan its tasks.
      integer XcpMaxCto: 8..255, set at pre-compile  # MAX_CTO shows the maximum length of a CTO packet in bytes.
      integer XcpMaxDto: 8..65535, set at pre-compile  # MAX_DTO shows the maximum length of a DTO packet in bytes.
      integer XcpMaxEventChannel: 0..65535, scope=ECU, set at pre-compile
      integer XcpMinDaq: 0..255, scope=ECU, set at pre-compile  # Indicates the number of predefined, read only DAQ lists on the XCP slave.
      integer XcpOdtCount: 0..252, scope=ECU, set at pre-compile  # This parameter indicates the amount of ODTs of a DAQ list using dynamic DAQ list configuration.
      integer XcpOdtEntriesCount: 0..255, scope=ECU, set at pre-compile  # Indicates the amount of entries into an ODT using dynamic DAQ list configuration.
      integer XcpOdtEntrySizeDaq: 0..255, scope=ECU, set at pre-compile  # Indicates the size of an element described by an ODT entry to the DaqListType for a DAQ.
      integer XcpOdtEntrySizeStim: 0..255, scope=ECU, set at pre-compile  # Indicates the size of an element described by an ODT entry to the DaqListType for a stim.
      boolean XcpOnCanEnabled: set at pre-compile  # Enabling of XCPonCAN functionality
      boolean XcpOnCddEnabled: set at pre-compile  # Enabling of XCPonCdd functionality
      boolean XcpOnEthernetEnabled: set at pre-compile  # Enabling of XCPonEthernet functionality
      boolean XcpOnFlexRayEnabled: set at pre-compile  # Enabling of XCPonFlexRay functionality
      boolean XcpPrescalerSupported: set at pre-compile  # This parameter enables and disables the support for Prescaler support. True is Enabled, False is disabled
      boolean XcpSuppressTxSupport: set at pre-compile  # Switches the support of suppressing transmission of PDUs per communication channel on or off. | TRUE: Suppressing of TxPDUs supported FALSE: Suppressing of TxPDUs not supported
      integer XcpTimestampTicks: 0..65535, set at pre-compile  # This parameter defines the timestamp that will increment based TIMESTAMP_TICKS per unit and wrap around if an overflow occurs.
      enumeration XcpTimestampType: {FOUR_BYTE, NO_TIME_STAMP, ONE_BYTE, TWO_BYTE}, set at pre-compile  # This parameter indicates the number of bytes used for the timestamp field. In case No_TIME_STAMP is selected the timestamp field is not available.
      enumeration XcpTimestampUnit: {TIMESTAMP_UNIT_100MS, TIMESTAMP_UNIT_100NS, TIMESTAMP_UNIT_100PS, TIMESTAMP_UNIT_100US, TIMESTAMP_UNIT_10MS, TIMESTAMP_UNIT_10NS, TIMESTAMP_UNIT_10PS, TIMESTAMP_UNIT_10US, TIMESTAMP_UNIT_1MS, TIMESTAMP_UNIT_1NS, TIMESTAMP_UNIT_1PS, TIMESTAMP_UNIT_1S, TIMESTAMP_UNIT_1US}, set at pre-compile  # This parameter indicates the resolution of the data acquisition clock of the slave when transferring data to master.
      boolean XcpVersionInfoApi: set at pre-compile, default-value=false  # Enables/disables the existence of the XCP_GetVersionInfo() API service. | TRUE: XCP_GetVersionInfo() API service exists FALSE: XCP_GetVersionInfo() API service does not exist
      reference XcpCounterRef: set at pre-compile, destination=OsCounter  # This parameter contains a reference to the counter, which is used by XCP.
      symbolic name reference XcpNvRamBlockIdRef [0..1]: multiplicity set at post-build in variant post-build / pre-compile in variant pre-compile, post-build-variant-multiplicity=true, post-build-variant-value=true, set at post-build in variant post-build / pre-compile in variant pre-compile, destination=NvMBlockDescriptor  # This reference contains the link to a non-volatile memory block to be used in the feature "RESUME MODE" so this information has to be stored non volatile to be available directly after start-up of the ECU.
  module definition Xfrm [0..*]: post-build-variant-support=true, variants link-time/post-build/pre-compile
    container XfrmGeneral  # Contains the general configuration parameters of the module.
      boolean XfrmDevErrorDetect: set at pre-compile, default-value=false  # Switches the development error detection and notification on or off. | * true: detection and notification is enabled. * false: detection and notification is disabled.
      integer XfrmInstanceId: 0..255, set at pre-compile  # Specifies the InstanceId of this module instance. If only one instance is present it shall have the Id 0.
      boolean XfrmVersionInfoApi: set at pre-compile, default-value=false  # Activate/Deactivate the version information API. | * true: version information API activated * false: version information API deactivated
    container XfrmImplementationMapping [1..*]  # For each transformer (TransformationTechnology) in a transformer chain (DataTransformation) which is applied to an ISignal it is necessary to specify the BswModuleEntry which implements it. This is the container to hold these mappings.
      foreign reference XfrmInvTransformerBswModuleEntryRef [0..1]: multiplicity set at pre-compile, set at pre-compile, destination-type=BSW-MODULE-ENTRY  # Reference to the BswModuleEntry which implements the referenced inverse transformer on the receiving/called side.
      foreign reference XfrmTransformationTechnologyRef: set at pre-compile, destination-type=TRANSFORMATION-TECHNOLOGY  # Reference to the TransformationTechnology in the DataTransformation of the system description for which the implementation (BswModuleEntry) shall be mapped.
      foreign reference XfrmTransformerBswModuleEntryRef [0..1]: multiplicity set at pre-compile, set at pre-compile, destination-type=BSW-MODULE-ENTRY  # Reference to the BswModuleEntry which implements the referenced transformer on the sending/calling side.
      instance reference XfrmVariableDataPrototypeInstanceRef [0..1]: multiplicity set at pre-compile, set at pre-compile, destination-context=SW-COMPONENT-PROTOTYPE PORT-PROTOTYPE, destination-type=VARIABLE-DATA-PROTOTYPE  # Instance Reference to a VariableDataPrototype in case a dedicated transformer BswModuleEntry is required per VariableDataPrototype access.
      container XfrmDemEventParameterRefs [0..1]  # Container for the references to DemEventParameter elements which shall be invoked using the API Dem_SetEventStatus in case the corresponding error occurs. The EventId is taken from the referenced DemEventParameter's DemEventId symbolic value. The standardized errors are provided in this container and can be extended by vendor-specific error references.
        symbolic name reference XFRM_E_MALFORMED_MESSAGE [0..1]: multiplicity set at pre-compile, set at pre-compile, destination=DemEventParameter  # Reference to configured DEM event to report if malformed messages were received by the transformer.
      container XfrmSignal [0..1]  # Reference to the signal in the system description that transports the transformed data.
        choice container XfrmSignalChoice  # Choice whether an ISignal or an ISignalGroup shall be referenced.
          container XfrmISignalGroupRefChoice [0..1]  # Reference to the ISignalGroup in the system description that transports the transformed data.
            foreign reference XfrmISignalGroupRef: set at pre-compile, destination-type=I-SIGNAL-GROUP  # Reference to the ISignalGroup in the system description that transports the transformed data.
          container XfrmISignalRefChoice [0..1]  # Reference to the ISignal in the system description that transports the transformed data.
            foreign reference XfrmISignalRef: set at pre-compile, destination-type=I-SIGNAL  # Reference to the ISignal in the system description that transports the transformed data.
package /AUTOSAR/LifeCycleInfoSets
  life cycle info set AUTOSARParameterDefinition
    life-cycle-infos:
      lc-object=BswMNmIfCarWakeUpIndication, lc-state=obsolete, period-begin=ar-release-version=4.3.1
      lc-object=CalAsymDecrypt, lc-state=obsolete
      lc-object=CalAsymDecryptMaxCtxBufByteSize, lc-state=obsolete
      lc-object=CalAsymDecryptMaxKeySize, lc-state=obsolete
      lc-object=CalAsymDecryptConfig, lc-state=obsolete
      lc-object=CalAsymDecryptInitConfiguration, lc-state=obsolete
      lc-object=CalAsymDecryptPrimitiveName, lc-state=obsolete
      lc-object=CalAsymEncrypt, lc-state=obsolete
      lc-object=CalAsymEncryptMaxCtxBufByteSize, lc-state=obsolete
      lc-object=CalAsymEncryptMaxKeySize, lc-state=obsolete
      lc-object=CalAsymEncryptConfig, lc-state=obsolete
      lc-object=CalAsymEncryptInitConfiguration, lc-state=obsolete
      lc-object=CalAsymEncryptPrimitiveName, lc-state=obsolete
      lc-object=CalAsymPrivateKeyExtract, lc-state=obsolete
      lc-object=CalAsymPrivateKeyExtractMaxCtxBufByteSize, lc-state=obsolete
      lc-object=CalAsymPrivateKeyExtractMaxKeySize, lc-state=obsolete
      lc-object=CalAsymPrivateKeyExtractConfig, lc-state=obsolete
      lc-object=CalAsymPrivateKeyExtractInitConfiguration, lc-state=obsolete
      lc-object=CalAsymPrivateKeyExtractPrimitiveName, lc-state=obsolete
      lc-object=CalAsymPrivateKeyWrapAsym, lc-state=obsolete
      lc-object=CalAsymPrivateKeyWrapAsymMaxCtxBufByteSize, lc-state=obsolete
      lc-object=CalAsymPrivateKeyWrapAsymMaxPrivKeySize, lc-state=obsolete
      lc-object=CalAsymPrivateKeyWrapAsymMaxPubKeySize, lc-state=obsolete
      lc-object=CalAsymPrivateKeyWrapAsymConfig, lc-state=obsolete
      lc-object=CalAsymPrivateKeyWrapAsymInitConfiguration, lc-state=obsolete
      lc-object=CalAsymPrivateKeyWrapAsymPrimitiveName, lc-state=obsolete
      lc-object=CalAsymPrivateKeyWrapSym, lc-state=obsolete
      lc-object=CalAsymPrivateKeyWrapSymMaxCtxBufByteSize, lc-state=obsolete
      lc-object=CalAsymPrivateKeyWrapSymMaxPrivKeySize, lc-state=obsolete
      lc-object=CalAsymPrivateKeyWrapSymMaxSymKeySize, lc-state=obsolete
      lc-object=CalAsymPrivateKeyWrapSymConfig, lc-state=obsolete
      lc-object=CalAsymPrivateKeyWrapSymInitConfiguration, lc-state=obsolete
      lc-object=CalAsymPrivateKeyWrapSymPrimitiveName, lc-state=obsolete
      lc-object=CalAsymPublicKeyExtract, lc-state=obsolete
      lc-object=CalAsymPublicKeyExtractMaxCtxBufByteSize, lc-state=obsolete
      lc-object=CalAsymPublicKeyExtractMaxKeySize, lc-state=obsolete
      lc-object=CalAsymPublicKeyExtractConfig, lc-state=obsolete
      lc-object=CalAsymPublicKeyExtractInitConfiguration, lc-state=obsolete
      lc-object=CalAsymPublicKeyExtractPrimitiveName, lc-state=obsolete
      lc-object=CalChecksum, lc-state=obsolete
      lc-object=CalChecksumMaxCtxBufByteSize, lc-state=obsolete
      lc-object=CalChecksumConfig, lc-state=obsolete
      lc-object=CalChecksumInitConfiguration, lc-state=obsolete
      lc-object=CalChecksumPrimitiveName, lc-state=obsolete
      lc-object=CalCompression, lc-state=obsolete
      lc-object=CalCompressMaxCtxBufByteSize, lc-state=obsolete
      lc-object=CalCompressionConfig, lc-state=obsolete
      lc-object=CalCompressInitConfiguration, lc-state=obsolete
      lc-object=CalCompressPrimitiveName, lc-state=obsolete
      lc-object=CalDecompression, lc-state=obsolete
      lc-object=CalDecompressMaxCtxBufByteSize, lc-state=obsolete
      lc-object=CalDecompressionConfig, lc-state=obsolete
      lc-object=CalDecompressInitConfiguration, lc-state=obsolete
      lc-object=CalDecompressPrimitiveName, lc-state=obsolete
      lc-object=CalGeneral, lc-state=obsolete
      lc-object=CalMaxAlignScalarType, lc-state=obsolete
      lc-object=CalVersionInfoApi, lc-state=obsolete
      lc-object=CalHash, lc-state=obsolete
      lc-object=CalHashMaxCtxBufByteSize, lc-state=obsolete
      lc-object=CalHashConfig, lc-state=obsolete
      lc-object=CalHashInitConfiguration, lc-state=obsolete
      lc-object=CalHashPrimitiveName, lc-state=obsolete
      lc-object=CalKeyDerive, lc-state=obsolete
      lc-object=CalKeyDeriveMaxCtxBufByteSize, lc-state=obsolete
      lc-object=CalKeyDeriveMaxKeySize, lc-state=obsolete
      lc-object=CalKeyDeriveConfig, lc-state=obsolete
      lc-object=CalKeyDeriveInitConfiguration, lc-state=obsolete
      lc-object=CalKeyDerivePrimitiveName, lc-state=obsolete
      lc-object=CalKeyExchangeCalcPubVal, lc-state=obsolete
      lc-object=CalKeyExchangeCalcPubValMaxBaseTypeSize, lc-state=obsolete
      lc-object=CalKeyExchangeCalcPubValMaxCtxBufByteSize, lc-state=obsolete
      lc-object=CalKeyExchangeCalcPubValMaxPrivateTypeSize, lc-state=obsolete
      lc-object=CalKeyExchangeCalcPubValConfig, lc-state=obsolete
      lc-object=CalKeyExchangeCalcPubValInitConfiguration, lc-state=obsolete
      lc-object=CalKeyExchangeCalcPubValPrimitiveName, lc-state=obsolete
      lc-object=CalKeyExchangeCalcSecret, lc-state=obsolete
      lc-object=CalKeyExchangeCalcSecretMaxBaseTypeSize, lc-state=obsolete
      lc-object=CalKeyExchangeCalcSecretMaxCtxBufByteSize, lc-state=obsolete
      lc-object=CalKeyExchangeCalcSecretMaxPrivateTypeSize, lc-state=obsolete
      lc-object=CalKeyExchangeCalcSecretConfig, lc-state=obsolete
      lc-object=CalKeyExchangeCalcSecretInitConfiguration, lc-state=obsolete
      lc-object=CalKeyExchangeCalcSecretPrimitiveName, lc-state=obsolete
      lc-object=CalMacGenerate, lc-state=obsolete
      lc-object=CalMacGenerateMaxCtxBufByteSize, lc-state=obsolete
      lc-object=CalMacGenerateMaxKeySize, lc-state=obsolete
      lc-object=CalMacGenerateConfig, lc-state=obsolete
      lc-object=CalMacGenerateInitConfiguration, lc-state=obsolete
      lc-object=CalMacGeneratePrimitiveName, lc-state=obsolete
      lc-object=CalMacVerify, lc-state=obsolete
      lc-object=CalMacVerifyMaxCtxBufByteSize, lc-state=obsolete
      lc-object=CalMacVerifyMaxKeySize, lc-state=obsolete
      lc-object=CalMacVerifyConfig, lc-state=obsolete
      lc-object=CalMacVerifyInitConfiguration, lc-state=obsolete
      lc-object=CalMacVerifyPrimitiveName, lc-state=obsolete
      lc-object=CalRandomGenerate, lc-state=obsolete
      lc-object=CalRandomGenerateConfig, lc-state=obsolete
      lc-object=CalRandomGenerateInitConfiguration, lc-state=obsolete
      lc-object=CalRandomGeneratePrimitiveName, lc-state=obsolete
      lc-object=CalRandomSeed, lc-state=obsolete
      lc-object=CalRandomMaxCtxBufByteSize, lc-state=obsolete
      lc-object=CalRandomSeedConfig, lc-state=obsolete
      lc-object=CalRandomSeedInitConfiguration, lc-state=obsolete
      lc-object=CalRandomSeedPrimitiveName, lc-state=obsolete
      lc-object=CalSignatureGenerate, lc-state=obsolete
      lc-object=CalSignatureGenerateMaxCtxBufByteSize, lc-state=obsolete
      lc-object=CalSignatureGenerateMaxKeySize, lc-state=obsolete
      lc-object=CalSignatureGenerateConfig, lc-state=obsolete
      lc-object=CalSignatureGenerateInitConfiguration, lc-state=obsolete
      lc-object=CalSignatureGeneratePrimitiveName, lc-state=obsolete
      lc-object=CalSignatureVerify, lc-state=obsolete
      lc-object=CalSignatureVerifyMaxCtxBufByteSize, lc-state=obsolete
      lc-object=CalSignatureVerifyMaxKeySize, lc-state=obsolete
      lc-object=CalSignatureVerifyConfig, lc-state=obsolete
      lc-object=CalSignatureVerifyInitConfiguration, lc-state=obsolete
      lc-object=CalSignatureVerifyPrimitiveName, lc-state=obsolete
      lc-object=CalSymBlockDecrypt, lc-state=obsolete
      lc-object=CalSymBlockDecryptMaxCtxBufByteSize, lc-state=obsolete
      lc-object=CalSymBlockDecryptMaxKeySize, lc-state=obsolete
      lc-object=CalSymBlockDecryptConfig, lc-state=obsolete
      lc-object=CalSymBlockDecryptInitConfiguration, lc-state=obsolete
      lc-object=CalSymBlockDecryptPrimitiveName, lc-state=obsolete
      lc-object=CalSymBlockEncrypt, lc-state=obsolete
      lc-object=CalSymBlockEncryptMaxCtxBufByteSize, lc-state=obsolete
      lc-object=CalSymBlockEncryptMaxKeySize, lc-state=obsolete
      lc-object=CalSymBlockEncryptConfig, lc-state=obsolete
      lc-object=CalSymBlockEncryptInitConfiguration, lc-state=obsolete
      lc-object=CalSymBlockEncryptPrimitiveName, lc-state=obsolete
      lc-object=CalSymDecrypt, lc-state=obsolete
      lc-object=CalSymDecryptMaxCtxBufByteSize, lc-state=obsolete
      lc-object=CalSymDecryptMaxKeySize, lc-state=obsolete
      lc-object=CalSymDecryptConfig, lc-state=obsolete
      lc-object=CalSymDecryptInitConfiguration, lc-state=obsolete
      lc-object=CalSymDecryptPrimitiveName, lc-state=obsolete
      lc-object=CalSymEncrypt, lc-state=obsolete
      lc-object=CalSymEncryptMaxCtxBufByteSize, lc-state=obsolete
      lc-object=CalSymEncryptMaxKeySize, lc-state=obsolete
      lc-object=CalSymEncryptConfig, lc-state=obsolete
      lc-object=CalSymEncryptInitConfiguration, lc-state=obsolete
      lc-object=CalSymEncryptPrimitiveName, lc-state=obsolete
      lc-object=CalSymKeyExtract, lc-state=obsolete
      lc-object=CalSymKeyExtractMaxCtxBufByteSize, lc-state=obsolete
      lc-object=CalSymKeyExtractMaxKeySize, lc-state=obsolete
      lc-object=CalSymKeyExtractConfig, lc-state=obsolete
      lc-object=CalSymKeyExtractInitConfiguration, lc-state=obsolete
      lc-object=CalSymKeyExtractPrimitiveName, lc-state=obsolete
      lc-object=CalSymKeyWrapAsym, lc-state=obsolete
      lc-object=CalSymKeyWrapAsymMaxCtxBufByteSize, lc-state=obsolete
      lc-object=CalSymKeyWrapAsymMaxPubKeySize, lc-state=obsolete
      lc-object=CalSymKeyWrapAsymMaxSymKeySize, lc-state=obsolete
      lc-object=CalSymKeyWrapAsymConfig, lc-state=obsolete
      lc-object=CalSymKeyWrapAsymInitConfiguration, lc-state=obsolete
      lc-object=CalSymKeyWrapAsymPrimitiveName, lc-state=obsolete
      lc-object=CalSymKeyWrapSym, lc-state=obsolete
      lc-object=CalSymKeyWrapSymMaxCtxBufByteSize, lc-state=obsolete
      lc-object=CalSymKeyWrapSymMaxSymKeySize, lc-state=obsolete
      lc-object=CalSymKeyWrapSymConfig, lc-state=obsolete
      lc-object=CalSymKeyWrapSymInitConfiguration, lc-state=obsolete
      lc-object=CalSymKeyWrapSymPrimitiveName, lc-state=obsolete
      lc-object=CanNmGlobalConfig/CanNmNodeDetectionEnabled, lc-state=obsolete
      lc-object=CanNmGlobalConfig/CanNmNodeIdEnabled, lc-state=obsolete
      lc-object=CanNmGlobalConfig/CanNmRepeatMsgIndEnabled, lc-state=obsolete
      lc-object=DcmDsdRequestManufacturerNotificationEnabled, lc-state=obsolete
      lc-object=DcmDsdRequestSupplierNotificationEnabled, lc-state=obsolete
      lc-object=DcmDslProtocolID, lc-state=obsolete
      lc-object=DcmDslProtocolPreemptTimeout, lc-state=obsolete, period-begin=ar-release-version=4.3.1
      lc-object=DcmSendRespPendOnTransToBoot, lc-state=obsolete
      lc-object=DcmDspPidDataType/UINT8_DYN, lc-state=obsolete, period-begin=ar-release-version=4.3.1
      lc-object=DcmDspRoeStorageState, lc-state=obsolete, period-begin=ar-release-version=4.3.1
      lc-object=DemTriggerDcmReports, lc-state=obsolete
      lc-object=DoIPVehicleAnnouncementRepetition, lc-state=obsolete
      lc-object=EcuMFixedConfiguration, lc-state=obsolete
      lc-object=EcuMNvramReadallTimeout, lc-state=obsolete
      lc-object=EcuMNvramWriteallTimeout, lc-state=obsolete
      lc-object=EcuMRunMinimumDuration, lc-state=obsolete
      lc-object=EcuMComMCommunicationAllowedList, lc-state=obsolete
      lc-object=EcuMFixedConfiguration/EcuMNormalMcuModeRef, lc-state=obsolete
      lc-object=EcuMDriverInitListThree, lc-state=obsolete
      lc-object=EcuMDriverInitListTwo, lc-state=obsolete
      lc-object=EcuMFixedUserConfig, lc-state=obsolete
      lc-object=EcuMFixedUser, lc-state=obsolete
      lc-object=EcuMTTII, lc-state=obsolete
      lc-object=EcuMDivisor, lc-state=obsolete
      lc-object=EcuMSleepModeRef, lc-state=obsolete
      lc-object=EcuMSuccessorRef, lc-state=obsolete
      lc-object=EcuMFixedGeneral, lc-state=obsolete
      lc-object=EcuMIncludeComM, lc-state=obsolete
      lc-object=EcuMTTIIEnabled, lc-state=obsolete
      lc-object=EcuMTTIIWakeupSourceRef, lc-state=obsolete
      lc-object=EthUpdatePhysAddrFilter, lc-state=obsolete
      lc-object=EthSwtPortEnableLinkDownCallback, lc-state=obsolete, period-begin=ar-release-version=4.3.1
      lc-object=EthSwtGetCfgHexDumpApi, lc-state=obsolete, period-begin=ar-release-version=4.3.1
      lc-object=EthSwtGetCfgHexDumpLengthApi, lc-state=obsolete, period-begin=ar-release-version=4.3.1
      lc-object=EthSwtLinkDownUser, lc-state=obsolete, period-begin=ar-release-version=4.3.1
      lc-object=EthSwtLinkUpUser, lc-state=obsolete, period-begin=ar-release-version=4.3.1
      lc-object=EthTSynIsSystemWideGlobalTimeMaster, lc-state=obsolete, period-begin=ar-release-version=4.3.1
      lc-object=FlsTstBlockBgndConfigSet, lc-state=obsolete, period-begin=ar-release-version=4.3.1
      lc-object=FlsTstBlockFgndConfigSet, lc-state=obsolete, period-begin=ar-release-version=4.3.1
      lc-object=FrNmGlobalFeatures/FrNmNodeDetectionEnabled, lc-state=obsolete
      lc-object=FrNmGlobalFeatures/FrNmSourceNodeIdentifierEnabled, lc-state=obsolete
      lc-object=IpduMContainedRxPdu/IpduMContainedPduOffset, lc-state=draft
      lc-object=IpduMContainedRxPdu/IpduMPduUpdateBitPosition, lc-state=draft
      lc-object=IpduMContainedRxPdu/IpduMContainedPduOffset, lc-state=draft
      lc-object=IpduMContainedRxPdu/IpduMPduUpdateBitPosition, lc-state=draft
      lc-object=IpduMContainerHeaderSize/IPDUM_HEADERTYPE_NONE, lc-state=draft
      lc-object=IpduMContainerHeaderSize/IPDUM_HEADERTYPE_NONE, lc-state=draft
      lc-object=IpduMUnusedAreasDefault, lc-state=draft
      lc-object=LinIfStartupState, lc-state=obsolete
      lc-object=LinIfStartupState/NORMAL, lc-state=obsolete
      lc-object=SLEEP, lc-state=obsolete
      lc-object=LinNmGlobalConfig/LinNmNodeDetectionEnabled, lc-state=obsolete
      lc-object=LinNmGlobalConfig/LinNmNodeIdEnabled, lc-state=obsolete
      lc-object=LinTrcvInitState, lc-state=obsolete
      lc-object=LINTRCV_TRCV_MODE_NORMAL, lc-state=obsolete
      lc-object=LINTRCV_TRCV_MODE_SLEEP, lc-state=obsolete
      lc-object=LINTRCV_TRCV_MODE_STANDBY, lc-state=obsolete
      lc-object=NmNodeDetectionEnabled, lc-state=obsolete
      lc-object=NmNodeIdEnabled, lc-state=obsolete
      lc-object=NmRepeatMsgIndEnabled, lc-state=obsolete
      lc-object=OcuGroup, lc-state=obsolete, period-begin=ar-release-version=4.3.0
      lc-object=OcuGroupId, lc-state=obsolete, period-begin=ar-release-version=4.3.0
      lc-object=OcuGroupDefinition, lc-state=obsolete, period-begin=ar-release-version=4.3.0
      lc-object=PduRChangeParameterApi, lc-state=obsolete
      lc-object=RteUseComShadowSignalApi, lc-state=obsolete, period-begin=ar-release-version=4.3.1
      lc-object=SpiHwUnitSynchronous, lc-state=obsolete
      lc-object=UdpNmGlobalConfig/UdpNmNodeDetectionEnabled, lc-state=obsolete
      lc-object=UdpNmGlobalConfig/UdpNmNodeIdEnabled, lc-state=obsolete
      lc-object=UdpNmGlobalConfig/UdpNmRepeatMsgIndEnabled, lc-state=obsolete
      lc-object=UdpNmMsgTimeoutTime, lc-state=obsolete, period-begin=ar-release-version=4.3.1
