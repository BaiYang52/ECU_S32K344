[part 3 of 9: package /AUTOSAR/EcucDefs]
AUTOSAR XML (schema 00044)
package /AUTOSAR/EcucDefs  (continued)
  module definition Csm [0..1]: variants pre-compile  # Configuration of the Csm (CryptoServiceManager) module.
    container CsmCallbacks [0..1]  # Container for callback function configurations
      container CsmCallback [0..*]: multiplicity set at pre-compile  # Container for configuration of a callback function
        function name CsmCallbackFunc [0..1]: multiplicity set at pre-compile, set at pre-compile  # Callback function to be called if an asynchronous operation has finished. The corresponding job has to be configured to be processed asynchronously.
        integer CsmCallbackId [0..1]: 0..4294967295, multiplicity set at pre-compile, set at pre-compile  # Identifier of the callback function. The set of actually configured identifiers shall be consecutive and gapless.
    container CsmGeneral: multiplicity set at pre-compile  # Container for common configuration options.
      integer CsmAsymPrivateKeyMaxLength [0..1]: 1..4294967295, multiplicity set at pre-compile, set at pre-compile  # Maximum length in bytes of an asymmetric public key for all algorithm
      integer CsmAsymPublicKeyMaxLength [0..1]: 1..4294967295, multiplicity set at pre-compile, set at pre-compile  # Maximum length in bytes of an asymmetric key for all algorithm
      boolean CsmDevErrorDetect: multiplicity set at pre-compile, set at pre-compile, default-value=false  # Switches the development error detection and notification on or off. | * true: detection and notification is enabled. * false: detection and notification is disabled.
      float CsmMainFunctionPeriod [0..1]: 0..Inf, multiplicity set at pre-compile, set at pre-compile  # Specifies the period of main function Csm_MainFunction in seconds.
      integer CsmSymKeyMaxLength [0..1]: 1..4294967295, multiplicity set at pre-compile, set at pre-compile  # Maximum length in bytes of a symmetric key for all algorithm
      boolean CsmUseDeprecated: multiplicity set at pre-compile, set at pre-compile, default-value=false  # Decides if the deprecated interfaces shall be used (Backwards combatibility). | true: use deprecated interfaces. false: use normal interfaces.
      boolean CsmVersionInfoApi: multiplicity set at pre-compile, set at pre-compile, default-value=false  # Pre-processor switch to enable and disable availability of the API Csm_GetVersionInfo(). | True: API Csm_GetVersionInfo() is available. False: API Csm_GetVersionInfo() is not available.
    container CsmJobs [0..1]: multiplicity set at pre-compile  # Container for configuration of CSM jobs.
      container CsmJob [1..*]: multiplicity set at pre-compile  # Container for configuration of CSM job. The container name serves as a symbolic name for the identifier of a job configuration.
        integer CsmJobId: 0..4294967295, multiplicity set at pre-compile, set at pre-compile, symbolic-name-value=true  # Identifier of the CSM job. The set of actually configured identifiers shall be consecutive and gapless.
        boolean CsmJobPrimitiveCallbackUpdateNotification [0..1]: multiplicity set at pre-compile, set at pre-compile, default-value=false  # This parameter indicates, whether the callback function shall be called, if the UPDATE operation has been finished.
        integer CsmJobPriority: 0..4294967295, multiplicity set at pre-compile, set at pre-compile  # Priority of the job. | The higher the value, the higher the job's priority.
        boolean CsmJobUsePort: multiplicity set at pre-compile, set at pre-compile, default-value=false  # Does the job need RTE interfaces? | True: the job needs RTE interfaces False: the job needs no RTE interfaces
        reference CsmJobKeyRef: multiplicity set at pre-compile, set at pre-compile, destination=CsmKey  # This parameter refers to the key which shall be used for the CsmPrimitive. It's possible to use a CsmKey for different jobs
        reference CsmJobPrimitiveCallbackRef [0..1]: multiplicity set at pre-compile, set at pre-compile, destination=CsmCallback  # This parameter refers to the used CsmCallback. | The referred CsmCallback is called when the crypto job has been finished.
        reference CsmJobPrimitiveRef: multiplicity set at pre-compile, set at pre-compile, destination=CsmPrimitives  # This parameter refers to the used CsmPrimitive. | Different jobs may refer to one CsmPrimitive. The referred CsmPrimitive provides detailed information on the actual cryptographic routine.
        reference CsmJobQueueRef: multiplicity set at pre-compile, set at pre-compile, destination=CsmQueue  # This parameter refers to the queue. | The queue is used if the underlying crypto driver object is busy. The queue refers also to the channel which is used.
    container CsmKeys [0..1]  # Container for CSM key configurations.
      container CsmKey [0..*]  # Container for configuration of a CSM key. The container name serves as a symbolic name for the identifier of a key configuration.
        integer CsmKeyId: 0..4294967295, multiplicity set at pre-compile, set at pre-compile  # Identifier of the CsmKey. The set of actually configured identifiers shall be consecutive and gapless.
        boolean CsmKeyUsePort: multiplicity set at pre-compile, set at pre-compile  # Does the key need RTE interfaces? | True: RTE interfaces used for this key False: No RTE interfaces used for this key
        symbolic name reference CsmKeyRef: multiplicity set at pre-compile, set at pre-compile, destination=CryIfKey  # This parameter refers to the used CryIfKey. The underlying CryIfKey refers to a specific CryptoKey in the Crypto Driver.
    container CsmPrimitives [0..*]  # Container for configuration of CsmPrimitives
      container CsmAEADDecrypt [0..1]  # Configuration of AEAD decryption primitives
        container CsmAEADDecryptConfig  # Container for configuration of a CSM decryption interface. The container name serves as a symbolic name for the identifier of an decryption interface.
          enumeration CsmAEADDecryptAlgorithmFamily: {CRYPTO_ALGOFAM_3DES, CRYPTO_ALGOFAM_AES, CRYPTO_ALGOFAM_CUSTOM}, multiplicity set at pre-compile, set at pre-compile  # Determines the algorithm family used for the crypto service. This parameter defines the most significant part of the algorithm.
          string CsmAEADDecryptAlgorithmFamilyCustom [0..1]: multiplicity set at pre-compile, set at pre-compile  # This is the name of the custom algorithm family, if CRYPTO_ALGOFAM_CUSTOM is used as CsmAEADDecryptAlgorithmFamily.
          integer CsmAEADDecryptAlgorithmKeyLength: 1..4294967295, multiplicity set at pre-compile, set at pre-compile  # Size of the AEAD decryption key in bytes
          enumeration CsmAEADDecryptAlgorithmMode: {CRYPTO_ALGOMODE_CUSTOM, CRYPTO_ALGOMODE_GCM}, multiplicity set at pre-compile, set at pre-compile  # Determines the algorithm mode used for the crypto service
          string CsmAEADDecryptAlgorithmModeCustom [0..1]: multiplicity set at pre-compile, set at pre-compile  # Name of the custom algorithm mode used for the crypto service
          integer CsmAEADDecryptAssociatedDataMaxLength [0..1]: 1..4294967295, multiplicity set at pre-compile, set at pre-compile  # Max size of the input associated data length in bytes
          integer CsmAEADDecryptCiphertextMaxLength [0..1]: 1..4294967295, multiplicity set at pre-compile, set at pre-compile  # Max size of the input ciphertext in bytes
          integer CsmAEADDecryptPlaintextMaxLength [0..1]: 1..4294967295, multiplicity set at pre-compile, set at pre-compile  # Size of the output plaintext length in bytes
          enumeration CsmAEADDecryptProcessing: {CSM_ASYNCHRONOUS, CSM_SYNCHRONOUS}, multiplicity set at pre-compile, set at pre-compile  # Determines how the interface shall be used for that primitive. Synchronous processing returns with the result while asynchronous processing returns without processing the job. The caller will be notified by the corresponding callback
          integer CsmAEADDecryptTagLength: 1..4294967295, multiplicity set at pre-compile, set at pre-compile  # Size of the input Tag length in BITS
          reference CsmAEADDecryptKeyRef: multiplicity set at pre-compile, set at pre-compile, destination=CsmKey  # This parameter refers to the key used for that decryption primitive.
          reference CsmAEADDecryptQueueRef: multiplicity set at pre-compile, set at pre-compile, destination=CsmQueue  # This parameter refers to the queue used for that decryption primitive.
      container CsmAEADEncrypt [0..1]  # Configuration of AEAD encryption primitives
        container CsmAEADEncryptConfig  # Container for configuration of a CSM encryption interface. The container name serves as a symbolic name for the identifier of an encryption interface.
          enumeration CsmAEADEncryptAlgorithmFamily: {CRYPTO_ALGOFAM_3DES, CRYPTO_ALGOFAM_AES, CRYPTO_ALGOFAM_CUSTOM}, multiplicity set at pre-compile, set at pre-compile  # Determines the algorithm family used for the crypto service. This parameter defines the most significant part of the algorithm.
          string CsmAEADEncryptAlgorithmFamilyCustom [0..1]: multiplicity set at pre-compile, set at pre-compile  # This is the name of the custom algorithm family, if CRYPTO_ALGOFAM_CUSTOM is used as CsmAEADEncryptAlgorithmFamily.
          integer CsmAEADEncryptAlgorithmKeyLength: 1..4294967295, multiplicity set at pre-compile, set at pre-compile  # Size of the AEAD encryption key in bytes
          enumeration CsmAEADEncryptAlgorithmMode: {CRYPTO_ALGOMODE_CUSTOM, CRYPTO_ALGOMODE_GCM}, multiplicity set at pre-compile, set at pre-compile  # Determines the algorithm mode used for the crypto service
          string CsmAEADEncryptAlgorithmModeCustom [0..1]: multiplicity set at pre-compile, set at pre-compile  # Name of the custom algorithm mode used for the crypto service
          integer CsmAEADEncryptAssociatedDataMaxLength [0..1]: 1..4294967295, multiplicity set at pre-compile, set at pre-compile  # Max size of the input associated data length in bytes
          integer CsmAEADEncryptCiphertextMaxLength [0..1]: 1..4294967295, multiplicity set at pre-compile, set at pre-compile  # Max size of the output ciphertext length in bytes
          integer CsmAEADEncryptPlaintextMaxLength [0..1]: 1..4294967295, multiplicity set at pre-compile, set at pre-compile  # Max size of the input plaintext length in bytes
          enumeration CsmAEADEncryptProcessing: {CSM_ASYNCHRONOUS, CSM_SYNCHRONOUS}, multiplicity set at pre-compile, set at pre-compile  # Determines how the interface shall be used for that primitive. Synchronous processing returns with the result while asynchronous processing returns without processing the job. The caller will be notified by the corresponding callback
          integer CsmAEADEncryptTagLength: 1..4294967295, multiplicity set at pre-compile, set at pre-compile  # Size of the output Tag length in bytes
          reference CsmAEADEncryptKeyRef: multiplicity set at pre-compile, set at pre-compile, destination=CsmKey  # This parameter refers to the key used for that encryption primitive.
          reference CsmAEADEncryptQueueRef: multiplicity set at pre-compile, set at pre-compile, destination=CsmQueue  # This parameter refers to the queue used for that encryption primitive.
      container CsmDecrypt [0..1]  # Configurations of Decryption primitives
        container CsmDecryptConfig  # Container for configuration of a CSM decryption interface. The container name serves as a symbolic name for the identifier of an decryption interface.
          enumeration CsmDecryptAlgorithmFamily: {CRYPTO_ALGOFAM_3DES, CRYPTO_ALGOFAM_AES, CRYPTO_ALGOFAM_CHACHA, CRYPTO_ALGOFAM_CUSTOM, CRYPTO_ALGOFAM_ECIES, CRYPTO_ALGOFAM_RSA}, multiplicity set at pre-compile, set at pre-compile  # Determines the algorithm family used for the crypto service. This parameter defines the most significant part of the algorithm.
          string CsmDecryptAlgorithmFamilyCustom [0..1]: multiplicity set at pre-compile, set at pre-compile  # Name of the custom algorithm family, if CRYPTO_ALGOFAM_CUSTOM is used as CsmDecryptAlgorithmFamily.
          integer CsmDecryptAlgorithmKeyLength: 1..4294967295, multiplicity set at pre-compile, set at pre-compile  # Size of the encryption key in bytes
          enumeration CsmDecryptAlgorithmMode: {CRYPTO_ALGOMODE_12ROUNDS, CRYPTO_ALGOMODE_20ROUNDS, CRYPTO_ALGOMODE_8ROUNDS, CRYPTO_ALGOMODE_CBC, CRYPTO_ALGOMODE_CFB, CRYPTO_ALGOMODE_CTR, CRYPTO_ALGOMODE_CUSTOM, CRYPTO_ALGOMODE_ECB, CRYPTO_ALGOMODE_OFB, CRYPTO_ALGOMODE_RSAES_OAEP, CRYPTO_ALGOMODE_RSAES_PKCS1_v1_5, CRYPTO_ALGOMODE_XTS}, multiplicity set at pre-compile, set at pre-compile  # Determines the algorithm mode used for the crypto service
          string CsmDecryptAlgorithmModeCustom [0..1]: multiplicity set at pre-compile, set at pre-compile  # Name of the custom algorithm mode used for the crypto service
          enumeration CsmDecryptAlgorithmSecondaryFamily: {CRYPTO_ALGOFAM_CUSTOM, CRYPTO_ALGOFAM_NOT_SET}, multiplicity set at pre-compile, set at pre-compile, default-value=CRYPTO_ALGOFAM_NOT_SET  # Determines the secondary algorithm family used for the crypto service
          string CsmDecryptAlgorithmSecondaryFamilyCustom [0..1]: multiplicity set at pre-compile, set at pre-compile  # Name of the custom secondary algorithm family used for the crypto service
          integer CsmDecryptDataMaxLength [0..1]: 1..4294967295, multiplicity set at pre-compile, set at pre-compile  # Max size of the input ciphertext length in bytes
          enumeration CsmDecryptProcessing: {CSM_ASYNCHRONOUS, CSM_SYNCHRONOUS}, multiplicity set at pre-compile, set at pre-compile  # Determines how the interface shall be used for that primitive. Synchronous processing returns with the result while asynchronous processing returns without processing the job. The caller will be notified by the corresponding callback
          integer CsmDecryptResultMaxLength [0..1]: 1..4294967295, multiplicity set at pre-compile, set at pre-compile  # Max size of the output plaintext length in bytes
      container CsmEncrypt [0..1]  # Configurations of Encryption primitives
        container CsmEncryptConfig  # Container for configuration of a CSM encryption interface. The container name serves as a symbolic name for the identifier of an encryption interface.
          enumeration CsmEncryptAlgorithmFamily: {CRYPTO_ALGOFAM_3DES, CRYPTO_ALGOFAM_AES, CRYPTO_ALGOFAM_CHACHA, CRYPTO_ALGOFAM_CUSTOM, CRYPTO_ALGOFAM_ECIES, CRYPTO_ALGOFAM_RSA}, multiplicity set at pre-compile, set at pre-compile  # Determines the algorithm family used for the crypto service. This parameter defines the most significant part of the algorithm.
          string CsmEncryptAlgorithmFamilyCustom [0..1]: multiplicity set at pre-compile, set at pre-compile  # This is the name of the custom algorithm family, if CRYPTO_ALGOFAM_CUSTOM is used as CsmEncryptAlgorithmFamily.
          integer CsmEncryptAlgorithmKeyLength: 1..4294967295, multiplicity set at pre-compile, set at pre-compile  # Size of the encryption key in bytes
          enumeration CsmEncryptAlgorithmMode: {CRYPTO_ALGOMODE_12ROUNDS, CRYPTO_ALGOMODE_20ROUNDS, CRYPTO_ALGOMODE_8ROUNDS, CRYPTO_ALGOMODE_CBC, CRYPTO_ALGOMODE_CFB, CRYPTO_ALGOMODE_CTR, CRYPTO_ALGOMODE_CUSTOM, CRYPTO_ALGOMODE_ECB, CRYPTO_ALGOMODE_NOT_SET, CRYPTO_ALGOMODE_OFB, CRYPTO_ALGOMODE_RSAES_OAEP, CRYPTO_ALGOMODE_RSAES_PKCS1_v1_5, CRYPTO_ALGOMODE_XTS}, multiplicity set at pre-compile, set at pre-compile  # Determines the algorithm mode used for the crypto service
          string CsmEncryptAlgorithmModeCustom [0..1]: multiplicity set at pre-compile, set at pre-compile  # Name of the custom algorithm mode used for the crypto service
          enumeration CsmEncryptAlgorithmSecondaryFamily: {CRYPTO_ALGOFAM_CUSTOM, CRYPTO_ALGOFAM_NOT_SET}, multiplicity set at pre-compile, set at pre-compile, default-value=CRYPTO_ALGOFAM_NOT_SET  # Determines the algorithm family used for the crypto service
          string CsmEncryptAlgorithmSecondaryFamilyCustom [0..1]: multiplicity set at pre-compile, set at pre-compile  # Name of the custom secondary algorithm family used for the crypto service
          integer CsmEncryptDataMaxLength [0..1]: 1..4294967295, multiplicity set at pre-compile, set at pre-compile  # Max size of the input plaintext length in bytes
          enumeration CsmEncryptProcessing: {CSM_ASYNCHRONOUS, CSM_SYNCHRONOUS}, multiplicity set at pre-compile, set at pre-compile  # Determines how the interface shall be used for that primitive. Synchronous processing returns with the result while asynchronous processing returns without processing the job. The caller will be notified by the corresponding callback
          integer CsmEncryptResultMaxLength [0..1]: 1..4294967295, multiplicity set at pre-compile, set at pre-compile  # Max size of the output cipher length in bytes
      container CsmHash [0..1]  # Container for Hash Configurations
        container CsmHashConfig  # Container for configuration of a CSM hash. The container name serves as a symbolic name for the identifier of a key configuration.
          enumeration CsmHashAlgorithmFamily: {CRYPTO_ALGOFAM_BLAKE_1_256, CRYPTO_ALGOFAM_BLAKE_1_512, CRYPTO_ALGOFAM_BLAKE_2s_256, CRYPTO_ALGOFAM_BLAKE_2s_512, CRYPTO_ALGOFAM_CUSTOM, CRYPTO_ALGOFAM_RIPEMD160, CRYPTO_ALGOFAM_SHA1, CRYPTO_ALGOFAM_SHA2_224, CRYPTO_ALGOFAM_SHA2_256, CRYPTO_ALGOFAM_SHA2_384, CRYPTO_ALGOFAM_SHA2_512, CRYPTO_ALGOFAM_SHA2_512_224, CRYPTO_ALGOFAM_SHA2_512_256, CRYPTO_ALGOFAM_SHA3_224, CRYPTO_ALGOFAM_SHA3_256, CRYPTO_ALGOFAM_SHA3_384, CRYPTO_ALGOFAM_SHA3_512, CRYPTO_ALGOFAM_SHA3_SHAKE128, CRYPTO_ALGOFAM_SHA3_SHAKE256}, multiplicity set at pre-compile, set at pre-compile  # Determines the algorithm family used for the crypto service. This parameter defines the most significant part of the algorithm.
          string CsmHashAlgorithmFamilyCustom [0..1]: multiplicity set at pre-compile, set at pre-compile  # This is the name of the custom algorithm family, if CRYPTO_ALGOFAM_CUSTOM is used as CsmHashAlgorithmFamily.
          enumeration CsmHashAlgorithmMode: {CRYPTO_ALGOMODE_CUSTOM, CRYPTO_ALGOMODE_NOT_SET}, multiplicity set at pre-compile, set at pre-compile, default-value=CRYPTO_ALGOMODE_NOT_SET  # Determines the algorithm mode used for the crypto service
          string CsmHashAlgorithmModeCustom [0..1]: multiplicity set at pre-compile, set at pre-compile  # Name of the custom primitive mode.
          enumeration CsmHashAlgorithmSecondaryFamily: {CRYPTO_ALGOFAM_CUSTOM, CRYPTO_ALGOFAM_NOT_SET}, multiplicity set at pre-compile, set at pre-compile, default-value=CRYPTO_ALGOFAM_NOT_SET  # Determines the algorithm family used for the crypto service
          string CsmHashAlgorithmSecondaryFamilyCustom [0..1]: multiplicity set at pre-compile, set at pre-compile  # This is the second name of the custom algorithm family, if CRYPTO_ALGOFAM_CUSTOM is set as CsmHashAlgorithmSecondaryFamily.
          integer CsmHashDataMaxLength [0..1]: 1..4294967295, multiplicity set at pre-compile, set at pre-compile  # Max size of the input data length in bytes
          enumeration CsmHashProcessing: {CSM_ASYNCHRONOUS, CSM_SYNCHRONOUS}, multiplicity set at pre-compile, set at pre-compile  # Determines how the interface shall be used for that primitive. Synchronous processing returns with the result while asynchronous processing returns without processing the job. The caller will be notified by the corresponding callback.
          integer CsmHashResultLength: 1..4294967295, multiplicity set at pre-compile, set at pre-compile  # Size of the output hash length in bytes
      container CsmMacGenerate [0..1]  # Configurations of MacGenerate primitives
        container CsmMacGenerateConfig  # Container for configuration of a CSM mac generation interface. The container name serves as a symbolic name for the identifier of a MAC generation interface.
          enumeration CsmMacGenerateAlgorithmFamily: {CRYPTO_ALGOFAM_3DES, CRYPTO_ALGOFAM_AES, CRYPTO_ALGOFAM_BLAKE_1_256, CRYPTO_ALGOFAM_BLAKE_1_512, CRYPTO_ALGOFAM_BLAKE_2s_256, CRYPTO_ALGOFAM_BLAKE_2s_512, CRYPTO_ALGOFAM_CHACHA, CRYPTO_ALGOFAM_CUSTOM, CRYPTO_ALGOFAM_RIPEMD160, CRYPTO_ALGOFAM_RNG, CRYPTO_ALGOFAM_SHA1, CRYPTO_ALGOFAM_SHA2_224, CRYPTO_ALGOFAM_SHA2_256, CRYPTO_ALGOFAM_SHA2_384, CRYPTO_ALGOFAM_SHA2_512, CRYPTO_ALGOFAM_SHA2_512_224, CRYPTO_ALGOFAM_SHA2_512_256, CRYPTO_ALGOFAM_SHA3_224, CRYPTO_ALGOFAM_SHA3_256, CRYPTO_ALGOFAM_SHA3_384, CRYPTO_ALGOFAM_SHA3_512, CRYPTO_ALGOFAM_SHA3_SHAKE128, CRYPTO_ALGOFAM_SHA3_SHAKE256}, multiplicity set at pre-compile, set at pre-compile  # Determines the algorithm family used for the crypto service. This parameter defines the most significant part of the algorithm.
          string CsmMacGenerateAlgorithmFamilyCustom [0..1]: multiplicity set at pre-compile, set at pre-compile  # This is the name of the custom algorithm family, | if CRYPTO_ALGOFAM_CUSTOM is used as CsmMacGenerateAlgorithmFamily
          integer CsmMacGenerateAlgorithmKeyLength: 1..4294967295, multiplicity set at pre-compile, set at pre-compile  # Size of the MAC key in bytes
          enumeration CsmMacGenerateAlgorithmMode: {CRYPTO_ALGOMODE_CMAC, CRYPTO_ALGOMODE_CTRDRBG, CRYPTO_ALGOMODE_CUSTOM, CRYPTO_ALGOMODE_GMAC, CRYPTO_ALGOMODE_HMAC, CRYPTO_ALGOMODE_NOT_SET, CRYPTO_ALGOMODE_SIPHASH_2_4, CRYPTO_ALGOMODE_SIPHASH_4_8}, multiplicity set at pre-compile, set at pre-compile  # Determines the algorithm mode used for the crypto service
          string CsmMacGenerateAlgorithmModeCustom [0..1]: multiplicity set at pre-compile, set at pre-compile  # Name of the custom algorithm mode used for the crypto service
          enumeration CsmMacGenerateAlgorithmSecondaryFamily: {CRYPTO_ALGOFAM_NOT_SET, CRYPTO_ALGOMODE_CUSTOM}, multiplicity set at pre-compile, set at pre-compile, default-value=CRYPTO_ALGOFAM_NOT_SET  # Determines the secondary algorithm family used for the crypto service
          string CsmMacGenerateAlgorithmSecondaryFamilyCustom [0..1]: multiplicity set at pre-compile, set at pre-compile  # This is the second name of the custom algorithm family, if CRYPTO_ALGOFAM_CUSTOM is set as CsmHashAlgorithmSecondaryFamilyCustom.
          integer CsmMacGenerateDataMaxLength [0..1]: 1..4294967295, multiplicity set at pre-compile, set at pre-compile  # Max size of the input data length in bytes
          enumeration CsmMacGenerateProcessing: {CSM_ASYNCHRONOUS, CSM_SYNCHRONOUS}, multiplicity set at pre-compile, set at pre-compile  # Determines how the interface shall be used for that primitive. Synchronous processing returns with the result while asynchronous processing returns without processing the job. The caller will be notified by the corresponding callback.
          integer CsmMacGenerateResultLength: 1..4294967295, multiplicity set at pre-compile, set at pre-compile  # Size of the output MAC length in bytes
      container CsmMacVerify [0..1]  # Configurations of MacVerify primitives
        container CsmMacVerifyConfig  # Container for configuration of a CSM MAC verification interface. The container name serves as a symbolic name for the identifier of a MAC generation interface
          enumeration CsmMacVerifyAlgorithmFamily: {CRYPTO_ALGOFAM_AES, CRYPTO_ALGOFAM_BLAKE_1_256, CRYPTO_ALGOFAM_BLAKE_1_512, CRYPTO_ALGOFAM_BLAKE_2s_256, CRYPTO_ALGOFAM_BLAKE_2s_512, CRYPTO_ALGOFAM_RIPEMD160, CRYPTO_ALGOFAM_SHA1, CRYPTO_ALGOFAM_SHA2_224, CRYPTO_ALGOFAM_SHA2_256, CRYPTO_ALGOFAM_SHA2_384, CRYPTO_ALGOFAM_SHA2_512, CRYPTO_ALGOFAM_SHA2_512_224, CRYPTO_ALGOFAM_SHA2_512_256, CRYPTO_ALGOFAM_SHA3_224, CRYPTO_ALGOFAM_SHA3_256, CRYPTO_ALGOFAM_SHA3_384, CRYPTO_ALGOFAM_SHA3_512, CRYPTO_ALGOFAM_SHA3_SHAKE128, CRYPTO_ALGOFAM_SHA3_SHAKE256, CRYPTO_ALGOFAM_SIPHASH, CRYPTO_ALGOMODE_CUSTOM}, multiplicity set at pre-compile, set at pre-compile  # Determines the algorithm family used for the crypto service. This parameter defines the most significant part of the algorithm.
          string CsmMacVerifyAlgorithmFamilyCustom [0..1]: multiplicity set at pre-compile, set at pre-compile  # Name of the custom algorithm family used for the crypto service
          integer CsmMacVerifyAlgorithmKeyLength: 1..4294967295, multiplicity set at pre-compile, set at pre-compile  # Size of the MAC key in bytes
          enumeration CsmMacVerifyAlgorithmMode: {CRYPTO_ALGOMODE_CMAC, CRYPTO_ALGOMODE_CTRDRBG, CRYPTO_ALGOMODE_CUSTOM, CRYPTO_ALGOMODE_GMAC, CRYPTO_ALGOMODE_HMAC, CRYPTO_ALGOMODE_NOT_SET, CRYPTO_ALGOMODE_SIPHASH_2_4, CRYPTO_ALGOMODE_SIPHASH_4_8}, multiplicity set at pre-compile, set at pre-compile  # Determines the algorithm mode used for the crypto service
          string CsmMacVerifyAlgorithmModeCustom [0..1]: multiplicity set at pre-compile, set at pre-compile  # Name of the custom algorithm mode used for the crypto service
          enumeration CsmMacVerifyAlgorithmSecondaryFamily: {CRYPTO_ALGOFAM_CUSTOM, CRYPTO_ALGOFAM_NOT_SET}, multiplicity set at pre-compile, set at pre-compile, default-value=CRYPTO_ALGOFAM_NOT_SET  # Determines the secondary algorithm family used for the crypto service
          string CsmMacVerifyAlgorithmSecondaryFamilyCustom [0..1]: multiplicity set at pre-compile, set at pre-compile  # This is the second the name of the custom algorithm, if CRYPTO_ALGOFAM_CUSTOM is set as CsmMacVerifyAlgorithmSecondaryFamily
          integer CsmMacVerifyCompareLength: 1..4294967295, multiplicity set at pre-compile, set at pre-compile  # Size of the input MAC length, that shall be verified, in BITS
          integer CsmMacVerifyDataMaxLength [0..1]: 1..4294967295, multiplicity set at pre-compile, set at pre-compile  # Max size of the input data length, for whichs MAC shall be verified, in bytes
          enumeration CsmMacVerifyProcessing: {CSM_ASYNCHRONOUS, CSM_SYNCHRONOUS}, multiplicity set at pre-compile, set at pre-compile  # Determines how the interface shall be used for that primitive. Synchronous processing returns with the result while asynchronous processing returns without processing the job. The caller will be notified by the corresponding callback.
      container CsmRandomGenerate [0..1]  # Configurations of RandomGenerate primitives
        container CsmRandomGenerateConfig  # Container for configuration of a CSM random generator. The container name serves as a symbolic name for the identifier of a random generator configuration.
          enumeration CsmRandomGenerateAlgorithmFamily: {CRYPTO_ALGOFAM_3DES, CRYPTO_ALGOFAM_AES, CRYPTO_ALGOFAM_BLAKE_1_256, CRYPTO_ALGOFAM_BLAKE_1_512, CRYPTO_ALGOFAM_BLAKE_2s_256, CRYPTO_ALGOFAM_BLAKE_2s_512, CRYPTO_ALGOFAM_CHACHA, CRYPTO_ALGOFAM_CUSTOM, CRYPTO_ALGOFAM_RIPEMD160, CRYPTO_ALGOFAM_RNG, CRYPTO_ALGOFAM_SHA1, CRYPTO_ALGOFAM_SHA2_224, CRYPTO_ALGOFAM_SHA2_256, CRYPTO_ALGOFAM_SHA2_384, CRYPTO_ALGOFAM_SHA2_512, CRYPTO_ALGOFAM_SHA2_512_224, CRYPTO_ALGOFAM_SHA2_512_256, CRYPTO_ALGOFAM_SHA3_224, CRYPTO_ALGOFAM_SHA3_256, CRYPTO_ALGOFAM_SHA3_384, CRYPTO_ALGOFAM_SHA3_512, CRYPTO_ALGOFAM_SHA3_SHAKE128, CRYPTO_ALGOFAM_SHA3_SHAKE256}, multiplicity set at pre-compile, set at pre-compile  # Determines the algorithm family used for the crypto service. This parameter defines the most significant part of the algorithm.
          string CsmRandomGenerateAlgorithmFamilyCustom [0..1]: multiplicity set at pre-compile, set at pre-compile  # Name of the custom algorithm family used for the crypto service. This is the name of the custom algorithm family, if CRYPTO_ALGOFAM_CUSTOM is used as CsmRandomAlgorithmFamily
          enumeration CsmRandomGenerateAlgorithmMode: {CRYPTO_ALGOMODE_CMAC, CRYPTO_ALGOMODE_CTRDRBG, CRYPTO_ALGOMODE_CUSTOM, CRYPTO_ALGOMODE_GMAC, CRYPTO_ALGOMODE_HMAC, CRYPTO_ALGOMODE_NOT_SET, CRYPTO_ALGOMODE_SIPHASH_2_4, CRYPTO_ALGOMODE_SIPHASH_4_8}, multiplicity set at pre-compile, set at pre-compile  # Determines the algorithm mode used for the crypto service
          string CsmRandomGenerateAlgorithmModeCustom [0..1]: multiplicity set at pre-compile, set at pre-compile  # Name of the custom algorithm mode used for the crypto service. This is the name of the custom algorithm family, if CRYPTO_ALGOFAM_CUSTOM is used as CsmRandomGenerateAlgorithmFamily.
          enumeration CsmRandomGenerateAlgorithmSecondaryFamily: {CRYPTO_ALGOFAM_CUSTOM, CRYPTO_ALGOFAM_NOT_SET}, multiplicity set at pre-compile, set at pre-compile  # Determines the algorithm family used for the crypto service
          string CsmRandomGenerateAlgorithmSecondaryFamilyCustom [0..1]: multiplicity set at pre-compile, set at pre-compile  # Name of the custom secondary algorithm family used for the crypto service. This is the second name of the custom algorithm family, if CRYPTO_ALGOFAM_CUSTOM is set as Csm RandomAlgorithmSecondaryFamily.
          enumeration CsmRandomGenerateProcessing: {CSM_ASYNCHRONOUS, CSM_SYNCHRONOUS}, multiplicity set at pre-compile, set at pre-compile  # Determines how the interface shall be used for that primitive. Synchronous processing returns with the result while asynchronous processing returns without processing the job. The caller will be notified by the corresponding callback
          integer CsmRandomGenerateResultLength: 1..4294967295, multiplicity set at pre-compile, set at pre-compile  # Size of the random generate key in bytes
      container CsmSecureCounter [0..1]  # Configurations of SecureCounter primitives
        container CsmSecureCounterConfig  # Container for configuration of a CSM counter. The container name serves as a symbolic name for the identifier of a secure counter configuration.
          reference CsmSecureCounterQueueRef: multiplicity set at pre-compile, set at pre-compile, destination=CsmQueue  # This parameter refers to the queue used for that secure counter
      container CsmSignatureGenerate [0..1]  # Configurations of SignatureGenerate primitives
        container CsmSignatureGenerateConfig  # Container for configuration of a CSM signature generation interface. The container name serves as a symbolic name for the identifier of signature generation interface.
          enumeration CsmSignatureGenerateAlgorithmFamily: {CRYPTO_ALGOFAM_BRAINPOOL, CRYPTO_ALGOFAM_CUSTOM, CRYPTO_ALGOFAM_ECCNIST, CRYPTO_ALGOFAM_ED25519, CRYPTO_ALGOFAM_RSA}, multiplicity set at pre-compile, set at pre-compile  # Determines the algorithm family used for the crypto service. This parameter defines the most significant part of the algorithm.
          string CsmSignatureGenerateAlgorithmFamilyCustom [0..1]: multiplicity set at pre-compile, set at pre-compile  # Name of the custom algorithm family used for the crypto service. | This is the name of the custom algorithm family, if CRYPTO_ALGOFAM_CUSTOM is used as CsmSignatureGenerateAlgorithmFamily.
          enumeration CsmSignatureGenerateAlgorithmMode: {CRYPTO_ALGOMODE_CUSTOM, CRYPTO_ALGOMODE_NOT_SET, CRYPTO_ALGOMODE_RSASSA_PKCS1_v1_5, CRYPTO_ALGOMODE_RSASSA_PSS}, multiplicity set at pre-compile, set at pre-compile  # Determines the algorithm mode used for the crypto service
          string CsmSignatureGenerateAlgorithmModeCustom [0..1]: multiplicity set at pre-compile, set at pre-compile  # Name of the custom algorithm mode used for the crypto service
          enumeration CsmSignatureGenerateAlgorithmSecondaryFamily: {CRYPTO_ALGOFAM_BLAKE_1_256, CRYPTO_ALGOFAM_BLAKE_1_512, CRYPTO_ALGOFAM_BLAKE_2s_256, CRYPTO_ALGOFAM_BLAKE_2s_512, CRYPTO_ALGOFAM_CUSTOM, CRYPTO_ALGOFAM_NOT_SET, CRYPTO_ALGOFAM_RIPEMD160, CRYPTO_ALGOFAM_SHA1, CRYPTO_ALGOFAM_SHA2_224, CRYPTO_ALGOFAM_SHA2_256, CRYPTO_ALGOFAM_SHA2_384, CRYPTO_ALGOFAM_SHA2_512, CRYPTO_ALGOFAM_SHA2_512_224, CRYPTO_ALGOFAM_SHA2_512_256, CRYPTO_ALGOFAM_SHA3_224, CRYPTO_ALGOFAM_SHA3_256, CRYPTO_ALGOFAM_SHA3_384, CRYPTO_ALGOFAM_SHA3_512, CRYPTO_ALGOFAM_SHA3_SHAKE128, CRYPTO_ALGOFAM_SHA3_SHAKE256}, multiplicity set at pre-compile, set at pre-compile, default-value=CRYPTO_ALGOFAM_NOT_SET  # Determines the algorithm mode used for the crypto service
          string CsmSignatureGenerateAlgorithmSecondaryFamilyCustom [0..1]: multiplicity set at pre-compile, set at pre-compile  # Name of the custom secondary algorithm family used for the crypto service. This is the second name of the custom algorithm family, if CRYPTO_ALGOFAM_CUSTOM is set as CsmSignatureGenerateAlgorithmSecondaryFamily.
          integer CsmSignatureGenerateDataMaxLength [0..1]: 1..4294967295, multiplicity set at pre-compile, set at pre-compile  # Size of the input data length in bytes
          integer CsmSignatureGenerateKeyLength: 1..4294967295, multiplicity set at pre-compile, set at pre-compile  # Size of the signature generate key in bytes
          enumeration CsmSignatureGenerateProcessing: {CSM_ASYNCHRONOUS, CSM_SYNCHRONOUS}, multiplicity set at pre-compile, set at pre-compile  # Determines how the interface shall be used for that primitive. Synchronous processing returns with the result while asynchronous processing returns without processing the job. The caller will be notified by the corresponding callback
          integer CsmSignatureGenerateResultLength: 1..4294967295, multiplicity set at pre-compile, set at pre-compile  # Size of the output signature length in bytes
      container CsmSignatureVerify [0..1]  # Configurations of SignatureVerify primitives
        container CsmSignatureVerifyConfig  # Container for configuration of a CSM signature verification interface. The container name serves as a symbolic name for the identifier of signature verification interface.
          enumeration CsmSignatureVerifyAlgorithmFamily: {CRYPTO_ALGOFAM_BRAINPOOL, CRYPTO_ALGOFAM_CUSTOM, CRYPTO_ALGOFAM_ECCNIST, CRYPTO_ALGOFAM_ED25519, CRYPTO_ALGOFAM_RSA}, multiplicity set at pre-compile, set at pre-compile  # Determines the algorithm family used for the crypto service. This parameter defines the most significant part of the algorithm.
          string CsmSignatureVerifyAlgorithmFamilyCustom [0..1]: multiplicity set at pre-compile, set at pre-compile  # Name of the custom algorithm family used for the crypto service. This is the name of the custom algorithm family, if CRYPTO_ALGOFAM_CUSTOM is used as CsmSignatureVerifyAlgorithmFamily.
          enumeration CsmSignatureVerifyAlgorithmMode: {CRYPTO_ALGOMODE_CUSTOM, CRYPTO_ALGOMODE_NOT_SET, CRYPTO_ALGOMODE_RSASSA_PKCS1_v1_5, CRYPTO_ALGOMODE_RSASSA_PSS}, multiplicity set at pre-compile, set at pre-compile  # Determines the algorithm mode used for the crypto service
          string CsmSignatureVerifyAlgorithmModeCustom [0..1]: multiplicity set at pre-compile, set at pre-compile  # Name of the custom algorithm mode used for the crypto service
          enumeration CsmSignatureVerifyAlgorithmSecondaryFamily: {CRYPTO_ALGOFAM_BLAKE_1_256, CRYPTO_ALGOFAM_BLAKE_1_512, CRYPTO_ALGOFAM_BLAKE_2s_256, CRYPTO_ALGOFAM_BLAKE_2s_512, CRYPTO_ALGOFAM_CUSTOM, CRYPTO_ALGOFAM_NOT_SET, CRYPTO_ALGOFAM_RIPEMD160, CRYPTO_ALGOFAM_SHA1, CRYPTO_ALGOFAM_SHA2_224, CRYPTO_ALGOFAM_SHA2_256, CRYPTO_ALGOFAM_SHA2_384, CRYPTO_ALGOFAM_SHA2_512, CRYPTO_ALGOFAM_SHA2_512_224, CRYPTO_ALGOFAM_SHA2_512_256, CRYPTO_ALGOFAM_SHA3_224, CRYPTO_ALGOFAM_SHA3_256, CRYPTO_ALGOFAM_SHA3_384, CRYPTO_ALGOFAM_SHA3_512, CRYPTO_ALGOFAM_SHA3_SHAKE128, CRYPTO_ALGOFAM_SHA3_SHAKE256}, multiplicity set at pre-compile, set at pre-compile  # Determines the algorithm family used for the crypto service. This parameter defines the most significant part of the algorithm.
          string CsmSignatureVerifyAlgorithmSecondaryFamilyCustom [0..1]: multiplicity set at pre-compile, set at pre-compile  # Name of the custom secondary algorithm family used for the crypto service. This is the name of the custom algorithm family, if CRYPTO_ALGOFAM_CUSTOM is used as CsmSignatureVerifyAlgorithmFamily.
          integer CsmSignatureVerifyCompareLength: 1..4294967295, multiplicity set at pre-compile, set at pre-compile  # Size of the input data length, for whichs signature shall be verified, in bytes
          integer CsmSignatureVerifyDataMaxLength [0..1]: 1..4294967295, multiplicity set at pre-compile, set at pre-compile  # Size of the input data length, for whichs signature shall be verified, in bytes
          integer CsmSignatureVerifyKeyLength: 1..4294967295, multiplicity set at pre-compile, set at pre-compile  # Size of the signature verify key in bytes
          enumeration CsmSignatureVerifyProcessing: {CSM_ASYNCHRONOUS, CSM_SYNCHRONOUS}, multiplicity set at pre-compile, set at pre-compile  # Determines how the interface shall be used for that primitive. Synchronous processing returns with the result while asynchronous processing returns without processing the job. The caller will be notified by the corresponding callback.
    container CsmQueues [0..1]  # Container for CSM queue configurations
      container CsmQueue [1..*]  # Container for configuration of a CSM queue. The container name serves as a symbolic name for the identifier of a queue configuration. | A queue has two tasks: 1. queue jobs which cannot be processed since the underlying hardware is busy and 2. refer to channel which shall be used
        integer CsmQueueSize: 1..4294967295, multiplicity set at pre-compile, set at pre-compile  # Size of the CsmQueue. If jobs cannot be processed by the underlying hardware since the hardware is busy, the jobs stay in the prioritized queue. If the queue is full, the next job will be rejected.
        symbolic name reference CsmChannelRef: multiplicity set at pre-compile, set at pre-compile, destination=CryIfChannel  # Refers to the underlying Crypto Interface channel.
  module definition Dbg [0..1]: variants pre-compile  # Configuration of the debugging module.
    container DbgBuffering [0..1]  # This container holds the parameters to manage the storage of debugging data in RAM.
      integer DbgBufferSize: 0..65535, set at pre-compile  # Size in bytes of the RAM for the ring buffer. A size of 0 means that no buffer exists. All data records are directly transferred.
      enumeration DbgBufferStrategy: {OverwriteOldestEntries, StopStorage}, set at pre-compile, default-value=StopStorage  # Strategy of buffer operations when it is full: overwrite oldest entries or stop the storage.
      enumeration DbgBufferTransmission: {StartAfterInitialization, StartOnHostRequest}, set at pre-compile, default-value=StartOnHostRequest  # Automatic or requested transmission of the buffer.
    container DbgCommunication [0..1]  # This container holds all configuration parameters for communication.
      container DbgRxPdu  # This container holds configuration parameters for the receive-pdu.
        integer DbgRxPduId: 0..65535, scope=ECU, set at published-information, symbolic-name-value=true, default-value=0  # Handle Id to be used by the PduR to indicate the reception of the DbgRxPdu to the Dbg module. The actual value of this parameter is fixed to 0 since there is only one RxPdu for the Dbg module. | The existence of this parameter is essential for the PduR generation tool to actually find a symbolicNameValue for the RxPdu.
        reference DbgReceiveIPduRef: scope=ECU, set at pre-compile, destination=Pdu  # Reference to the receive I-PDU.
      container DbgTxPdu  # This container holds configuration parameters for the transmit-pdu.
        integer DbgTxConfirmationPduId: 0..65535, scope=ECU, set at published-information, symbolic-name-value=true, default-value=0  # Handle Id to be used by the PduR to confirm the transmission of the DbgTxPdu to the Dbg module. The actual value of this parameter is fixed to 0 since there is only one TxPdu for the Dbg module. | The existence of this parameter is essential for the PduR generation tool to actually find a symbolicNameValue for the TxPdu.
        reference DbgSendIPduRef: scope=ECU, set at pre-compile, destination=Pdu  # Reference to the send I-PDU.
    container DbgDIDConfiguration  # Container holding the sub-structure for DID configuration.
      integer DbgMaxDynamicDID [0..1]: 0..200, multiplicity set at pre-compile, set at pre-compile  # Maximum number of dynamic DIDs. This value is only needed to reserve memory for dynamic DIDs added by the host at runtime. If this parameter is not supplied it is automatically set to the configured number of static DIDs. | The sum of configured number of static DIDs and MaxDynamicDID must not exceed 200. Dynamic DIDs are based on the configured number of static DIDs and consecutive.
      container DbgPredefinedDID [0..16]  # This container holds all configuration parameters for predefined DIDs. For predefined DIDs, only certain values can be changed.
        boolean DbgPredefinedDIDActivation: set at pre-compile, default-value=false  # Activation or not of the DID for debugging. | * true: DIDOn. * false: DIDOff.
        boolean DbgPredefinedDIDBuffering: set at pre-compile, default-value=false  # Buffer the data or transmit directly. | * true: BufferingOn. * false: BufferingOff.
        enumeration DbgPredefinedDIDName: {Dbg_PostTaskHook, Dbg_PreTaskHook, Dbg_TraceDetCall, Dbg_TraceFunctionEntry, Dbg_TraceFunctionExit, Dbg_TraceRTECall, Dbg_TraceRTEComCallback, Dbg_TraceRTEComSignalIv, Dbg_TraceRTEComSignalRx, Dbg_TraceRTEComSignalTx, Dbg_TraceRTEVfbSignalReceive, Dbg_TraceRTEVfbSignalSend, Dbg_TraceRunnableStart, Dbg_TraceRunnableTermination, Dbg_TraceTimestamps}, set at pre-compile  # List of possible names for predefined DIDs.
        boolean DbgPredefinedDIDTimeStampActivation: set at pre-compile, default-value=false  # Using or not of time stamp. | * true: TimeStampOn. * false: TimeStampOff.
        choice container DbgPredefinedDIDAddInfo [0..*]  # Additional information in case the Predefined DID needs further configuration parameters.
          container DbgAddInfoComSignal [0..1]  # Additional information for DIDs with the DbgPredefinedDIDName set to: | * Dbg_TraceRTEComSignalTx * Dbg_TraceRTEComSignalRx * Dbg_TraceRTEComSignalIv * Dbg_TraceRTEComCallback The actual SignalId used in the debugging trace APIs is taken from the ComHandleId available at the ComSignal configuration of the Com module.
            string DbgComSignalName [0..1]: multiplicity set at pre-compile, set at pre-compile  # Optional name of the traced signal. If present it shall be used in the display of the debugging tool.
            foreign reference DbgBswModuleEntryRef: set at pre-compile, destination-type=BSW-MODULE-ENTRY  # Foreign reference to the BSWModuleEntry describing the trace function implementation.
            symbolic name reference DbgComSignalRef: set at pre-compile, destination=ComSignal  # Reference to the ComSignal which shall be traced.
          container DbgAddInfoRteCall [0..1]  # Additional information for DIDs with the DbgPredefinedDIDName set to: | * Dbg_TraceRTECall
            integer DbgCallComponentId: 0..65535, set at pre-compile  # Id used to identify the SW-Component Type.
            integer DbgCallInstanceId: 0..255, set at pre-compile  # Id used to identify the SW-Component Instance.
            integer DbgCallPortId: 0..65535, set at pre-compile  # Id used to identify the Port.
            integer DbgCallServiceId: 0..255, set at pre-compile  # Id used to identify the OperationProtoype.
            foreign reference DbgBswModuleEntryRef: set at pre-compile, destination-type=BSW-MODULE-ENTRY  # Foreign reference to the BSWModuleEntry describing the trace function implementation.
            instance reference DbgServiceInstanceRef: set at pre-compile, destination-context=SW-COMPONENT-PROTOTYPE PORT-PROTOTYPE, destination-type=CLIENT-SERVER-OPERATION  # Reference to the actual OperationPrototype which shall be traced.
          container DbgAddInfoRunnable [0..1]  # Additional information for DIDs with the DbgPredefinedDIDName set to: | * Dbg_TraceRunnableStart * Dbg_TraceRunnableTermination
            integer DbgRunnableComponentId: 0..65535, set at pre-compile  # Id used to identify the SW-Component Type.
            integer DbgRunnableId: 0..255, set at pre-compile  # Id used to identify the RunnableEntity.
            integer DbgRunnableInstanceId: 0..255, set at pre-compile  # Id used to identify the SW-Component Instance.
            foreign reference DbgBswModuleEntryRef: set at pre-compile, destination-type=BSW-MODULE-ENTRY  # Foreign reference to the BSWModuleEntry describing the trace function implementation.
            foreign reference DbgRunnableEntityRef: set at pre-compile, destination-type=RUNNABLE-ENTITY  # Reference to the actual RunnableEntity which shall be traced.
            foreign reference DbgSoftwareComponentInstanceRef: set at pre-compile, destination-type=SW-COMPONENT-PROTOTYPE  # Reference to the SW-ComponentProtoype which shall be traced.
          container DbgAddInfoVfbSignal [0..1]  # Additional information for DIDs with the DbgPredefinedDIDName set to: | * Dbg_TraceRTEVfbSignalSend * Dbg_TraceRTEVfbSignalReceive
            integer DbgVfbComponentId: 0..65535, set at pre-compile  # Id used to identify the SW-Component Type.
            integer DbgVfbDataElementId: 0..255, set at pre-compile  # Id used to identify the VariableDataPrototype.
            integer DbgVfbInstanceId: 0..65535, set at pre-compile  # Id used to identify the SW-Component Instance.
            integer DbgVfbPortId: 0..255, set at pre-compile  # Id used to identify the Port.
            foreign reference DbgBswModuleEntryRef: set at pre-compile, destination-type=BSW-MODULE-ENTRY  # Foreign reference to the BSWModuleEntry describing the trace function implementation.
            instance reference DbgDataElementInstanceRef: set at pre-compile, destination-context=SW-COMPONENT-PROTOTYPE PORT-PROTOTYPE, destination-type=VARIABLE-DATA-PROTOTYPE  # Reference to the actual VariableDataPrototype which shall be traced.
      container DbgStaticDID [0..200]  # This container holds all configuration parameters for static DIDs. For predefined DIDs, only certain values can be changed.
        integer DbgAutomaticCollectionFrequency: 0..65535, set at pre-compile, default-value=0  # Cycle time of collection in DataCollectionTicks. A value of "0" indicates that the collection takes place only on request.
        boolean DbgStaticDIDActivation: set at pre-compile, default-value=false  # Activation or not of the DID for debugging. | * true: DIDOn. * false: DIDOff.
        boolean DbgStaticDIDBuffering: set at pre-compile, default-value=false  # Buffer the data or transmit directly. | * true: BufferingOn. * false: BufferingOff.
        string DbgStaticDIDNameRef: set at pre-compile  # Name of the DID, translated by the configuration/generation tool into consecutive DID numbers starting from 0.
        boolean DbgStaticTimeStampActivation: set at pre-compile, default-value=false  # Using or not of time stamp. | * true: TimeStampOn. * false: TimeStampOff.
        choice container DbgStaticDIDData [1..65535]  # Choice how the DID is to be configured.
          container DbgAddressSizePair [0..1]  # This container describes address/size pairs. It is used for static DIDs and dynamic DIDs.
            integer DbgASAbsoluteAddress [0..1]: 0..4294967295, multiplicity set at pre-compile, set at pre-compile  # Absolute address of memory location to be debugged. | max = (2**32)-1
            linker symbol DbgASNameRef [0..1]: multiplicity set at pre-compile, set at pre-compile  # Symbolic name of the variable, translated by the configuration/generation tool into the address and size of the variable.
            integer DbgASSize [0..1]: 0..255, multiplicity set at pre-compile, set at pre-compile  # Absolute size in Bytes of memory location to be debugged.
          container DbgDebugData [0..1]  # Reference to staticMemory used for Debug Data.
            foreign reference DbgDebugDataRef: set at pre-compile, destination-type=VARIABLE-DATA-PROTOTYPE  # Reference to staticMemory used for Debug Data.
          container DbgLocalDebugData [0..1]  # Reference to a localDebugData.
            foreign reference DbgLocalDebugDataRef: set at pre-compile, destination-type=IMPLEMENTATION-DATA-TYPE-ELEMENT  # Reference to a localDebugData.
    container DbgGeneral  # This container holds the general parameters of the debugging module.
      boolean DbgDevErrorDetect: set at pre-compile, default-value=false  # Switches the development error detection and notification on or off. | * true: detection and notification is enabled. * false: detection and notification is disabled.
      string DbgHeaderFileInclusion [0..*]: multiplicity set at pre-compile, set at pre-compile, regular-expression=[a-zA-Z]([a-zA-Z0-9_])*\.h  # Name of the header file(s) to be included by the Dbg module.
      boolean DbgVersionInfoApi: set at pre-compile, default-value=false  # Activate/Deactivate the version information API (Dbg_GetVersionInfo). | * true: version information API activated. * false: version information API deactivated.
    container DbgPeriodicDataCollection [0..1]  # This container holds the parameters to manage the time base of the debugging module.
      integer DbgDataCollectionTick: 0..4294967295, set at pre-compile  # Number of OS counter ticks to be used as data collection tick. The OS alarm used for periodic collection of DIDs is set with this value.
      reference DbgAlarmReference: set at pre-compile, destination=OsAlarm  # Reference to the OS alarm used for periodic collection of DIDs.
    container DbgTimestampConfiguration [0..1]  # This container holds the parameters to manage the time stamps of the debugging module.
      enumeration DbgGlobalTimestampActivation: {TimestampOff, TimestampOn}, set at pre-compile, default-value=TimestampOff  # Initial value for timestamp collection.
      enumeration DbgTimeStampSize: {TimeStampSize_16Bit, TimeStampSize_32Bit}, set at pre-compile, default-value=TimeStampSize_16Bit  # Memory size used for the time stamps of all DIDs.
      symbolic name reference DbgGptChannel: set at pre-compile, destination=GptChannelConfiguration  # Reference to the hardware free running timer of the GPT module for time stamps (if no HWFRT is applied, calls to add timestamps are ignored)
  module definition Dcm [0..1]: post-build-variant-support=true, variants link-time/post-build/pre-compile  # Configuration of the Dcm (Diagnostic Communications Manager) module.
    container DcmConfigSet  # This container contains the configuration parameters and sub containers of the DCM module supporting multiple configuration sets.
      container DcmDsd  # These parameters configure the Diagnostic Service Dispatcher submodule.
        boolean DcmDsdRequestManufacturerNotificationEnabled: scope=ECU, set at pre-compile  # Allows to enable or disable the requested notification mechanism for the Manufacturer. Tags: atp.Status=obsolete
        boolean DcmDsdRequestSupplierNotificationEnabled: scope=ECU, set at pre-compile  # Allows to enable or disable the requested notification mechanism for the Supplier. Tags: atp.Status=obsolete
        container DcmDsdServiceRequestManufacturerNotification [0..*]  # The name of this container is used to define the name of the R-Port through which the DCM accesses the interface ServiceRequestNotification. | The R-Port is named ServiceRequestManufacturerNotification_{Name} where {Name} is the name of the container DcmDsdServiceRequestManufacturerNotification. The lowerMultiplicity is 0: If container DcmDsdServiceRequestManufacturerNotification does not exist the Indication API is not available.
        container DcmDsdServiceRequestSupplierNotification [0..*]  # The name of this container is used to define the name of the R-Port through which the DCM accesses the interface ServiceRequestNotification. | The R-Port is named ServiceRequestSupplierNotification_<SWC> where <SWC> is the name of the container DcmDsdServiceRequestSupplierNotification. The lowerMultiplicity is 0: If the container DcmDsdRequestSupplierNotification does not exist the Indication API is not available.
        container DcmDsdServiceTable [1..256]  # This container contains the configuration (DSD parameters) for a Service Identifier Table. | Note: It is allowed to add OBD services to a DcmDsdServiceTable related to a UDS Protocol. But it is not allowed to add UDS services to a DcmDsdServiceTable related to an OBD Protocol.
          integer DcmDsdSidTabId: 0..255, scope=ECU, set at link in variant link-time / pre-compile in variant post-build+pre-compile  # Due to using possibly more service tables, the unique DcmDsdSidTabId can be used to identify them.
          container DcmDsdService [1..*]  # This container contains the configuration (DSD parameters) for a Service.
            boolean DcmDsdServiceUsed: post-build-variant-value=true, set at link in variant link-time / post-build in variant post-build / pre-compile in variant pre-compile, default-value=true  # Allows to activate or deactivate the usage of a Service. This parameter can be used for multi-purpose ECUs. | true - service is available false - service is not available
            function name DcmDsdSidTabFnc [0..1]: scope=ECU, multiplicity set at link in variant link-time / pre-compile in variant post-build+pre-compile, set at link in variant link-time / pre-compile in variant post-build+pre-compile  # Callback function of the ECU Supplier specific component for the particular service. The function's prototype is as described for <Module>_<DiagnosticService>. If this parameter is not configured, the service is handled Dcm-internally.
            integer DcmDsdSidTabServiceId: 0..255, scope=ECU, set at link in variant link-time / pre-compile in variant post-build+pre-compile  # Identifier of the service. | The possible service identifiers are defined in ISO 14229-1 and ISO 15031-5.
            boolean DcmDsdSidTabSubfuncAvail: scope=ECU, set at link in variant link-time / pre-compile in variant post-build+pre-compile  # Information about whether the service has subfunctions or not. This parameter is used for the handling of the "suppressPosRspMsgIndicationBit" as defined in ISO 14229-1, which can be used as a reference for the configuration. | true - service has subfunctions, suppressPosRspMsgIndicationBit is available false - service has no subfunctions, suppressPosRspMsgIndicationBit is not available
            reference DcmDsdSidTabModeRuleRef [0..1]: scope=ECU, multiplicity set at link in variant link-time / pre-compile in variant post-build+pre-compile, set at link in variant link-time / pre-compile in variant post-build+pre-compile, destination=DcmModeRule  # Reference to a DcmDspModeRule which controls the execution of the service. If there is no reference configured, no mode rule check shall be performed.
            reference DcmDsdSidTabSecurityLevelRef [0..*]: scope=ECU, multiplicity set at link in variant link-time / pre-compile in variant post-build+pre-compile, origin=AUTOSAR_ECUC V1.0.0, set at link in variant link-time / pre-compile in variant post-build+pre-compile, destination=DcmDspSecurityRow  # Reference to a Security Level in which the service is allowed to be executed. Multiple references are allowed for a service. | Please refer to ISO 14229-1, ISO 15031-5 and chapter "Verification of the Service Security Access levels." If there is no reference configured, no service security verification shall be performed.
            reference DcmDsdSidTabSessionLevelRef [0..*]: scope=ECU, multiplicity set at link in variant link-time / pre-compile in variant post-build+pre-compile, origin=AUTOSAR_ECUC V1.0.0, set at link in variant link-time / pre-compile in variant post-build+pre-compile, destination=DcmDspSessionRow  # Reference to a Session Level in which the service is allowed to be executed. Multiple references are allowed for a service. | Please refer to ISO 14229-1, ISO 15031-5 and chapter "Verification of the Diagnostic Session". If there is no reference configured, no diagnostic session verification shall be performed.
            container DcmDsdSubService [0..*]  # This container contains the configuration (DSD parameters) for a subservice of a service. Only those services may have subservices, which have the DcmDsdSidTabSubfuncAvail configured as TRUE.
              function name DcmDsdSubServiceFnc [0..1]: multiplicity set at link in variant link-time / pre-compile in variant post-build+pre-compile, set at link in variant link-time / pre-compile in variant post-build+pre-compile  # Callback function of the ECU Supplier specific component for the particular service. The function's prototype is as described for <Module>_<DiagnosticService>_<SubService>. | If this parameter is not configured, the subservice is handled Dcm-internally.
              integer DcmDsdSubServiceId: 0..127, scope=ECU, set at link in variant link-time / pre-compile in variant post-build+pre-compile  # Identifier of the subservice. | The possible subservice identifiers are defined in ISO 14229-1 and ISO 15031-5.
              boolean DcmDsdSubServiceUsed: post-build-variant-value=true, set at link in variant link-time / post-build in variant post-build / pre-compile in variant pre-compile, default-value=true  # Allows to activate or deactivate the usage of a Subservice. This parameter can be used for multi-purpose ECUs. | true - subservice is available false - subservice is not available.
              reference DcmDsdSubServiceModeRuleRef [0..1]: scope=ECU, multiplicity set at link in variant link-time / pre-compile in variant post-build+pre-compile, set at link in variant link-time / pre-compile in variant post-build+pre-compile, destination=DcmModeRule  # Reference to a DcmDspModeRule which controls the execution of the subservice. | If there is no reference configured, no mode rule check shall be performed.
              reference DcmDsdSubServiceSecurityLevelRef [0..*]: scope=ECU, multiplicity set at link in variant link-time / pre-compile in variant post-build+pre-compile, set at link in variant link-time / pre-compile in variant post-build+pre-compile, destination=DcmDspSecurityRow  # Reference to a Security Level in which the subservice is allowed to be executed. Multiple references are allowed for a subservice. | Please refer to ISO 14229-1, ISO 15031-5 and chapter "Verification of the Service Security Access levels." If there is no reference configured, no subservice security verification shall be performed.
              reference DcmDsdSubServiceSessionLevelRef [0..*]: scope=ECU, multiplicity set at link in variant link-time / pre-compile in variant post-build+pre-compile, set at link in variant link-time / pre-compile in variant post-build+pre-compile, destination=DcmDspSessionRow  # Reference to a Session Level in which the subservice is allowed to be executed. Multiple references are allowed for a subservice. | Please refer to ISO 14229-1, ISO 15031-5 and chapter "Verification of the Diagnostic Session". If there is no reference configured, no diagnostic session verification shall be performed.
      container DcmDsl  # These parameters configure the Diagnostic Session Layer submodule.
        container DcmDslBuffer [1..256]  # This container contains the configuration of a diagnostic buffer.
          integer DcmDslBufferSize: 8..4294967294, scope=ECU, set at pre-compile  # Size of the diagnostic buffer in bytes. | For a linear buffer the size shall be as large as the longest diagnostic message (request or response). For a paged buffer the size has impacts on the application performance.
        container DcmDslCallbackDCMRequestService [0..*]  # Each DcmDslCallbackDCMRequestService container defines an R-Port with the CallbackDCMRequestServices interface which the Dcm uses to ask permission for protocol changes from the application software. The R-Port has the name CallbackDCMRequestServices_<SWC> where <SWC> is the name of this container.
        container DcmDslDiagResp  # This container contains the configuration of the automatic requestCorrectlyReceivedResponsePending response management in the Dcm.
          integer DcmDslDiagRespMaxNumRespPend: 0..255, scope=ECU, origin=AUTOSAR_ECUC V1.0.0, set at link in variant link-time / pre-compile in variant post-build+pre-compile  # Maximum number of negative responses with response code 0x78 (requestCorrectlyReceivedResponsePending) allowed for a request. If Dcm reaches this limit, an automatic 0x10 (generalReject) final response will be trasmitted and the service processing will be cancelled.
          boolean DcmDslDiagRespOnSecondDeclinedRequest: scope=ECU, origin=AUTOSAR_ECUC V1.0.0, set at link in variant link-time / pre-compile in variant post-build+pre-compile  # Defines the reaction upon a second request (ClientB) that can not be processed (e.g. due to priority assessment). | TRUE: when the second request (Client B) can not be processed, it shall be answered with NRC21 BusyRepeatRequest. FALSE: when the second request (Client B) can not be processed, it shall not be responded.
        container DcmDslProtocol  # This container contains the configurations of the diagnostic protocols used in Dcm.
          container DcmDslProtocolRow [1..*]  # This container contains the configuration of one particular diagnostic protocol used in Dcm.
            enumeration DcmDslProtocolID: {DCM_OBD_ON_CAN, DCM_OBD_ON_FLEXRAY, DCM_OBD_ON_IP, DCM_PERIODICTRANS_ON_CAN, DCM_PERIODICTRANS_ON_FLEXRAY, DCM_PERIODICTRANS_ON_IP, DCM_ROE_ON_CAN, DCM_ROE_ON_FLEXRAY, DCM_ROE_ON_IP, DCM_SUPPLIER_1, DCM_SUPPLIER_10, DCM_SUPPLIER_11, DCM_SUPPLIER_12, DCM_SUPPLIER_13, DCM_SUPPLIER_14, DCM_SUPPLIER_15, DCM_SUPPLIER_2, DCM_SUPPLIER_3, DCM_SUPPLIER_4, DCM_SUPPLIER_5, DCM_SUPPLIER_6, DCM_SUPPLIER_7, DCM_SUPPLIER_8, DCM_SUPPLIER_9, DCM_UDS_ON_CAN, DCM_UDS_ON_FLEXRAY, DCM_UDS_ON_IP, DCM_UDS_ON_LIN}, scope=ECU, set at pre-compile, symbolic-name-value=true  # The diagnostic protocol type for the DCM DSL protocol that is being configured. Tags: atp.Status=obsolete | Implementation Type: Dcm_ProtocolType This element is obsolete and will be removed in a future revision.
            integer DcmDslProtocolMaximumResponseSize [0..1]: 1..65535, scope=ECU, multiplicity set at pre-compile, set at pre-compile, default-value=4095  # This parameter is mandatory and defines the maximum length of the response message in case DcmPagedBufferEnabled == TRUE
            float DcmDslProtocolPreemptTimeout: 0..1, scope=ECU, set at link in variant link-time / pre-compile in variant post-build+pre-compile  # This parameter is the timeout value used in protocol preemption if this protocol preempts another diagnostic protocol. The protocol shall be started maximum DcmDslProtocolPreemptTimeout time after the first request in the new protocol. Tags: atp.Status=obsolete, atp.StatusRevisionBegin=4.3.1
            integer DcmDslProtocolPriority: 0..255, scope=ECU, set at link in variant link-time / pre-compile in variant post-build+pre-compile  # Protocol priority used during protocol preemption. A higher priority protocol may preempt a lower priority protocol. | Lower numeric values represent higher protocol priority: 0 - Highest protocol priority 255 - Lowest protocol priority
            boolean DcmDslProtocolRowUsed: post-build-variant-value=true, set at link in variant link-time / post-build in variant post-build / pre-compile in variant pre-compile, default-value=true  # Allows to activate or deactivate the usage of a Protocol. This parameter can be used for multi-purpose ECUs. | true - protocol is available false - protocol is not available.
            enumeration DcmDslProtocolTransType [0..1]: {TYPE1, TYPE2}, scope=ECU, origin=AUTOSAR_ECUC V1.0.0, set at link in variant link-time / pre-compile in variant post-build+pre-compile  # This parameter is used only if the protocol is of type DCM_ROE_ON_xxx. It selects the transmission type of the protocol.
            enumeration DcmDslProtocolType: {DCM_OBD_ON_CAN, DCM_OBD_ON_FLEXRAY, DCM_OBD_ON_IP, DCM_PERIODICTRANS_ON_CAN, DCM_PERIODICTRANS_ON_FLEXRAY, DCM_PERIODICTRANS_ON_IP, DCM_ROE_ON_CAN, DCM_ROE_ON_FLEXRAY, DCM_ROE_ON_IP, DCM_SUPPLIER_1, DCM_SUPPLIER_10, DCM_SUPPLIER_11, DCM_SUPPLIER_12, DCM_SUPPLIER_13, DCM_SUPPLIER_14, DCM_SUPPLIER_15, DCM_SUPPLIER_2, DCM_SUPPLIER_3, DCM_SUPPLIER_4, DCM_SUPPLIER_5, DCM_SUPPLIER_6, DCM_SUPPLIER_7, DCM_SUPPLIER_8, DCM_SUPPLIER_9, DCM_UDS_ON_CAN, DCM_UDS_ON_FLEXRAY, DCM_UDS_ON_IP, DCM_UDS_ON_LIN}, scope=ECU, set at pre-compile, symbolic-name-value=true  # The diagnostic protocol type for the DCM DSL protocol that is being configured. | Implementation Type: Dcm_ProtocolType
            integer DcmDspProtocolEcuAddr [0..1]: 0..65535, scope=ECU, set at pre-compile  # Ecu source address used for diagnostic communication. This parameter is required for Generic Connections.
            boolean DcmSendRespPendOnRestart: set at link in variant link-time / pre-compile in variant post-build+pre-compile, default-value=true  # If set to TRUE, the Dcm will send a NRC 0x78 before a transition to bootloader or performing an ECU reset. If set to False, no 0x78 is send in this case.
            boolean DcmSendRespPendOnTransToBoot [0..1]: set at link in variant link-time / pre-compile in variant post-build+pre-compile, default-value=true  # Parameter specifying if the ECU should send a NRC 0x78 (response pending) before transitioning to the bootloader (parameter set to TRUE) or if the transition shall be initiated without sending NRC 0x78 (parameter set to FALSE). Tags: atp.Status=obsolete
            float DcmTimStrP2ServerAdjust: 0..1, scope=ECU, set at link in variant link-time / pre-compile in variant post-build+pre-compile  # This parameter is used to guarantee that the diagnostic response is available on the bus before reaching P2 by adjusting the current DcmDspSessionP2ServerMax. | This parameter mainly represents the software architecture dependent communication delay between the time the transmission is initiated by DCM and the time when the message is actually transmitted to the bus. The parameter value is defined in seconds and must be a multiple of DcmTaskTime.
            float DcmTimStrP2StarServerAdjust: 0..5, scope=ECU, set at link in variant link-time / pre-compile in variant post-build+pre-compile  # This parameter is used to guarantee that the diagnostic response is available on the bus before reaching P2Star by adjusting the current DcmDspSessionP2StarServerMax. | This parameter mainly represents the software architecture dependent communication delay between the time the transmission is initiated by DCM and the time when the message is actually transmitted to the bus. The parameter value is defined in seconds and must be a multiple of DcmTaskTime.
            reference DcmDemClientRef: scope=ECU, multiplicity set at pre-compile, set at pre-compile, destination=DemClient  # Reference to DemClient in Dem configuration. | Used by the Dem to distinguish different client calls.
            reference DcmDslProtocolRxBufferRef: scope=ECU, set at link in variant link-time / pre-compile in variant post-build+pre-compile, destination=DcmDslBuffer  # Reference to a configured diagnostic buffer that is used for diagnostic request reception for the protocol.
            reference DcmDslProtocolSIDTable: scope=ECU, set at link in variant link-time / pre-compile in variant post-build+pre-compile, destination=DcmDsdServiceTable  # Reference to a service table that is used for diagnostic request processing for this protocol.
            reference DcmDslProtocolTxBufferRef: scope=ECU, set at link in variant link-time / pre-compile in variant post-build+pre-compile, destination=DcmDslBuffer  # Reference to a configured diagnostic buffer that is used for diagnostic response transmission for the protocol.
            choice container DcmDslConnection [1..*]  # This container contains the configuration of a communication channel for one particular protocol. | Note that it is allowed to communicate with multiple testers, therefore multiple connections may be configured for a protocol.
              container DcmDslMainConnection [0..1]  # This container contains the configuration for a main connection of a diagnostic protocol. Additionally it may contain references to ROE and Periodic connections if the protocol type or protocol transmission type needs them.
                integer DcmDslProtocolRxConnectionId: 0..65535, scope=ECU, multiplicity set at pre-compile, set at link in variant link-time / pre-compile in variant post-build+pre-compile, symbolic-name-value=true  # Unique identifier of the tester which uses this connection for diagnostic communication.
                integer DcmDslProtocolRxTesterSourceAddr [0..1]: 0..65535, scope=ECU, multiplicity set at pre-compile, set at link in variant link-time / pre-compile in variant post-build+pre-compile  # Tester source address uniquely describes a client and will be used e.g within the jump to Bootloader interfaces. This parameter is not required for generic connections (DcmPdus with MetaDataLength >= 1).
                reference DcmDslPeriodicTransmissionConRef [0..1]: scope=ECU, multiplicity set at pre-compile, origin=AUTOSAR_ECUC V1.0.0, set at link in variant link-time / pre-compile in variant post-build+pre-compile, destination=DcmDslPeriodicTransmission  # Reference to a periodic transmission connection which is used for the processing of periodic transmission events.
                symbolic name reference DcmDslProtocolComMChannelRef: scope=ECU, set at link in variant link-time / pre-compile in variant post-build+pre-compile, destination=ComMChannel  # Reference to the ComMChannel on which the DcmDslProtocolRxPdu is received and the DcmDslProtocolTxPdu is transmitted.
                reference DcmDslROEConnectionRef [0..1]: scope=ECU, multiplicity set at pre-compile, origin=AUTOSAR_ECUC V1.0.0, set at link in variant link-time / pre-compile in variant post-build+pre-compile, destination=DcmDslResponseOnEvent  # Reference to a ResponseOnEvent connection which is used for the processing of ResponseOnEvent events.
                container DcmDslProtocolRx [1..*]  # This container contains the configuration parameters of a reception channel in a diagnostic connection. | The PDU referenced by this reception channel can consume meta data items of type SOURCE_ADDRESS_16 and TARGET_ADDRESS_16.
                  enumeration DcmDslProtocolRxAddrType: {DCM_FUNCTIONAL_TYPE, DCM_PHYSICAL_TYPE}, scope=ECU, set at link in variant link-time / pre-compile in variant post-build+pre-compile  # Selects the addressing type of the reception channel. Physical addressing is used for 1:1 communication, functional addressing is used for 1:N communication. | For details refer to ISO 14229-1.
                  integer DcmDslProtocolRxPduId: 0..65535, scope=ECU, set at pre-compile, symbolic-name-value=true  # Identifier of the PDU that is used for this reception channel.
                  reference DcmDslProtocolRxPduRef: scope=ECU, set at link in variant link-time / pre-compile in variant post-build+pre-compile, destination=Pdu  # Reference to a Pdu in EcuC that is used for this reception channel.
                container DcmDslProtocolTx [0..1]  # This container contains the configuration parameters of a transmission channel in a diagnostic connection. | The PDU referenced by this transmission channel can produce meta data items of type TARGET_ADDRESS_16 and SOURCE_ADDRESS_16.
                  integer DcmDslTxConfirmationPduId: 0..65535, scope=ECU, set at pre-compile, symbolic-name-value=true  # Identifier of the PDU that is used by the lower level module for transmission confirmation of responses on this channel.
                  reference DcmDslProtocolTxPduRef: scope=ECU, set at link in variant link-time / pre-compile in variant post-build+pre-compile, destination=Pdu  # Reference to a Pdu in EcuC that is used for this transmission channel.
              container DcmDslPeriodicTransmission [0..1]  # This container contains the configuration of a periodic transmission connection.
                container DcmDslPeriodicConnection [0..*]  # This container contains the configuration of a transmission channel for a periodic transmission connection. | The PDU referenced by this transmission channel can produce meta data items of type TARGET_ADDRESS_16 and SOURCE_ADDRESS_16.
                  integer DcmDslPeriodicTxConfirmationPduId: 0..65535, scope=ECU, set at pre-compile, symbolic-name-value=true  # Identifier of the PDU that is used by the lower level module for transmission confirmation of responses on this channel.
                  reference DcmDslPeriodicTxPduRef: scope=ECU, set at link in variant link-time / pre-compile in variant post-build+pre-compile, destination=Pdu  # Reference to a Pdu in EcuC that is used for this periodic transmission channel.
              container DcmDslResponseOnEvent [0..1]  # This container contains the configuration of a ResponseOnEvent connection. | The PDU referenced by this transmission channel can produce meta data items of type TARGET_ADDRESS_16 and SOURCE_ADDRESS_16.
                integer DcmDslRoeTxConfirmationPduId [0..1]: 0..65535, scope=ECU, multiplicity set at pre-compile, set at pre-compile, symbolic-name-value=true  # Identifier of the PDU that is used by the lower level module for transmission confirmation of responses on this connection.
                reference DcmDslRoeTxPduRef [0..1]: scope=ECU, multiplicity set at pre-compile, set at link in variant link-time / pre-compile in variant post-build+pre-compile, destination=Pdu  # Reference to a Pdu in EcuC that is used for this ResponseOnEvent transmission connection.
      container DcmDsp [0..1]  # These parameters apply to Diagnostic Service Processing. There will always be one set of these parameters per Dcm. | Please note: Although the multiplicity is set to 0..1. It can be expected that this container exists in any valid DCM configuration.
        enumeration DcmDspDataDefaultEndianness: {BIG_ENDIAN, LITTLE_ENDIAN, OPAQUE}, set at link in variant link-time / pre-compile in variant post-build+pre-compile  # Defines the default endianness belonging to a DID, RID or PID if the corresponding data does not define an endianness.
        boolean DcmDspDDDIDcheckPerSourceDID [0..1]: multiplicity set at link in variant link-time / pre-compile in variant post-build+pre-compile, set at link in variant link-time / pre-compile in variant post-build+pre-compile  # Defines the check for session, security and mode dependencies per source DIDs with a ReadDataByIdentifier (0x22). | true: Dcm module shall check the session, security and mode dependencies per source DIDs with a ReadDataByIdentifier (0x22) with DID in the range 0xF200 to 0xF3FF false: Dcm module shall not check the session, security and mode dependencies per source DIDs with a ReadDataByIdentifier (0x22) with DID in the range 0xF200 to 0xF3FF
        boolean DcmDspEnableObdMirror: scope=ECU, set at link in variant link-time / pre-compile in variant post-build+pre-compile, default-value=false  # DcmDspEnableObdMirror defines whether a DID inside the OBD range (F400-F4FF) and the OBD InfoType range (F800-F8FF) shall get the DID value as defined for OBD on reception of the UDS Service ReadDataByIdentifier (0x22), or not. | It also defines whether a RID inside the OBD range (E000-E0FF) shall handle the RID as defined for OBD on reception of the UDS Service RoutineControl (0x31), or not.
        integer DcmDspMaxDidToRead [0..1]: 1..65535, scope=ECU, multiplicity set at link in variant link-time / pre-compile in variant post-build+pre-compile, set at link in variant link-time / pre-compile in variant post-build+pre-compile  # Indicates the maximum allowed DIDs in a single "ReadDataByIdentifier" request.
        integer DcmDspMaxPeriodicDidToRead [0..1]: 1..65535, multiplicity set at link in variant link-time / pre-compile in variant post-build+pre-compile, set at link in variant link-time / pre-compile in variant post-build+pre-compile  # Indicates the maximum allowed periodicDIDs which can be read in a single "ReadDataByPeriodicIdentifier" request.
        integer DcmDspPowerDownTime [0..1]: 0..255, scope=ECU, multiplicity set at link in variant link-time / pre-compile in variant post-build+pre-compile, set at link in variant link-time / pre-compile in variant post-build+pre-compile  # This parameter indicates to the client the minimum time of the stand-by sequence the server will remain in the power-down sequence. | The resolution of this parameter is one second per count. The following values are valid: 00 - FE hex: 0 - 254 s powerDownTime; FF hex: indicates a failure or time not available. This value needs to be defined by the integrator according to the ECU capabilities. This parameter has to be available if the service EcuReset, sub-service enableRapidPowerShutDown is configured.
        container DcmDspClearDTC [0..1]  # This container contains the configuration for the Clear DTC service.
          function name DcmDspClearDTCCheckFnc [0..1]: scope=ECU, multiplicity set at pre-compile, set at pre-compile  # Callback function for condition check, manufacturer / supplier specific checks on the groupOfDTC, which is requested to clear. | This parameter is related to the interface : Xxx_ClearDTCCheckFnc.
          reference DcmDspClearDTCModeRuleRef [0..1]: scope=ECU, multiplicity set at link in variant link-time / pre-compile in variant post-build+pre-compile, set at link in variant link-time / pre-compile in variant post-build+pre-compile, destination=DcmModeRule  # Reference to DcmModeRule | Mode rule which controls to clear the DTCs. If there is no reference, no check of the mode rule shall be done.
        container DcmDspComControl [0..1]  # Provides the configuration of the CommunicationControl mechanism.
          container DcmDspComControlAllChannel [0..*]  # Collection of ComM channels which shall be controlled if all networks are addressed.
            boolean DcmDspComControlAllChannelUsed: post-build-variant-value=true, set at link in variant link-time / post-build in variant post-build / pre-compile in variant pre-compile, default-value=true  # Allow to activate or deactivate the usage of a ComM channel collection to be controlled, for multi purpose ECUs | true = ComM channel collection used false = ComM channel collection not used
            symbolic name reference DcmDspAllComMChannelRef: scope=ECU, post-build-variant-value=true, set at link in variant link-time / post-build in variant post-build / pre-compile in variant pre-compile, destination=ComMChannel  # Reference to ComM channel.
          container DcmDspComControlSetting [0..1]  # Provide the configuration of the Communication control.
            reference DcmDspComControlCommunicationReEnableModeRuleRef [0..1]: scope=ECU, multiplicity set at link in variant link-time / pre-compile in variant post-build+pre-compile, set at link in variant link-time / pre-compile in variant post-build+pre-compile, destination=DcmModeRule  # Reference to DcmModeRule Mode rule which controls re-enabling | of communication by DCM. [ref. SWS_Dcm_00753]
          container DcmDspComControlSpecificChannel [0..*]  # Assigns subnet number to ComM channel which will be controlled.
            boolean DcmDspComControlSpecificChannelUsed: post-build-variant-value=true, set at link in variant link-time / post-build in variant post-build / pre-compile in variant pre-compile, default-value=true  # Allow to activate or deactivate the usage of a Subnet assigned to the ComM channel which will be controlled, for multi purpose ECUs. | true = Subnet used false = Subnet not used
            integer DcmDspSubnetNumber: 1..14, scope=ECU, set at pre-compile  # Subnet Number which controls the specific ComMChannel.
            symbolic name reference DcmDspSpecificComMChannelRef: scope=ECU, post-build-variant-value=true, set at link in variant link-time / post-build in variant post-build / pre-compile in variant pre-compile, destination=ComMChannel  # Reference to ComM channel.
          container DcmDspComControlSubNode [0..65535]  # This container gives information about the node identification number and the ComM channel used to address a sub-network.
            integer DcmDspComControlSubNodeId: 1..65535, scope=ECU, set at link in variant link-time / pre-compile in variant post-build+pre-compile  # The node identification number DcmDspComControlSubNodeId is addressed by the CommunicationControl (0x28) request.
            boolean DcmDspComControlSubNodeUsed: post-build-variant-value=true, set at link in variant link-time / post-build in variant post-build / pre-compile in variant pre-compile, default-value=true  # This parameter determines if a node control function is available or not.
            symbolic name reference DcmDspComControlSubNodeComMChannelRef: scope=ECU, post-build-variant-value=true, set at link in variant link-time / post-build in variant post-build / pre-compile in variant pre-compile, destination=ComMChannel  # This parameter references a ComM channel where this node is connected to.
        container DcmDspCommonAuthorization [0..*]  # This container contains the configuration (parameters) for the common Authorization being equal for several services / sub-services.
          reference DcmDspCommonAuthorizationModeRuleRef [0..1]: scope=ECU, multiplicity set at link in variant link-time / pre-compile in variant post-build+pre-compile, set at link in variant link-time / pre-compile in variant post-build+pre-compile, destination=DcmModeRule  # Reference to DcmModeRule | Mode rule which controls this service/ sub-service. If there is no reference, no check of the mode rule shall be done.
          reference DcmDspCommonAuthorizationSecurityLevelRef [0..*]: scope=ECU, multiplicity set at link in variant link-time / pre-compile in variant post-build+pre-compile, set at link in variant link-time / pre-compile in variant post-build+pre-compile, destination=DcmDspSecurityRow  # Reference to DcmDspSecurityRow | Security levels allowed to control this service/ sub-service. If there is no reference, no check of security level shall be done.
          reference DcmDspCommonAuthorizationSessionRef [0..*]: scope=ECU, multiplicity set at link in variant link-time / pre-compile in variant post-build+pre-compile, set at link in variant link-time / pre-compile in variant post-build+pre-compile, destination=DcmDspSessionRow  # Reference to DcmDspSessionRow | Sessions allowed to control this service/ sub-service. If there is no reference, no check of session level shall be done.
        container DcmDspControlDTCSetting [0..1]  # Provide the configuration of the ControlDTCSetting mechanism.
          boolean DcmSupportDTCSettingControlOptionRecord [0..1]: scope=ECU, multiplicity set at pre-compile, set at pre-compile, default-value=false  # This configuration switch defines if the DTCSettingControlOptionRecord is in general supported in the request message or not.
          reference DcmDspControlDTCSettingReEnableModeRuleRef [0..1]: scope=ECU, multiplicity set at link in variant link-time / pre-compile in variant post-build+pre-compile, set at link in variant link-time / pre-compile in variant post-build+pre-compile, destination=DcmModeRule  # Reference to DcmModeRule | Mode rule which controls re-enabling of controlDTCsetting by DCM. The DCM module shall execute a ControlDTCSetting.Off (call Dem_EnableDTCSetting()) in case that the referenced mode rule is not fulfilled anymore.
        container DcmDspData [0..*]  # This container contains the configuration (parameters) of a Data belonging to a DID
          integer DcmDspDataByteSize [0..1]: 0..65535, scope=ECU, multiplicity set at link in variant link-time / pre-compile in variant post-build+pre-compile, set at link in variant link-time / pre-compile in variant post-build+pre-compile  # Defines the array length in bytes or the the maximum array length for variable datalengths.
          function name DcmDspDataConditionCheckReadFnc [0..1]: scope=ECU, multiplicity set at pre-compile, set at pre-compile  # Function name to demand application if the conditions (e.g. System state) to read the DID are correct. (ConditionCheckRead-function). | Multiplicity shall be equal to parameter DcmDspDataReadFnc. This parameter is related to the interface Xxx_ConditionCheckRead.
          boolean DcmDspDataConditionCheckReadFncUsed [0..1]: multiplicity set at pre-compile, set at pre-compile  # This parameter determines if a condition check function is available or not.
          function name DcmDspDataEcuSignal [0..1]: scope=ECU, multiplicity set at pre-compile, set at pre-compile  # Function name to control the access to a certain ECU Signal by the DCM. (IoHwAb_Dcm_<symbolic name of ECU signal>-function).
          enumeration DcmDspDataEndianness [0..1]: {BIG_ENDIAN, LITTLE_ENDIAN, OPAQUE}, multiplicity set at link in variant link-time / pre-compile in variant post-build+pre-compile, set at link in variant link-time / pre-compile in variant post-build+pre-compile  # Defines the endianness of the data belonging to a DID in a diagnostic request or response message.
          function name DcmDspDataFreezeCurrentStateFnc [0..1]: scope=ECU, multiplicity set at pre-compile, set at pre-compile  # Function name to request to application to freeze the current state of an IOControl. (FreezeCurrentState-function). | This parameter is related to the interface Xxx_FreezeCurrentState.
          function name DcmDspDataGetScalingInfoFnc [0..1]: scope=ECU, multiplicity set at pre-compile, set at pre-compile  # Function name to request to application the scaling information of the DID. (GetScalingInformation-function). | This parameter is related to the interface Xxxx_GetScalingInformation.
          function name DcmDspDataReadDataLengthFnc [0..1]: scope=ECU, multiplicity set at pre-compile, set at pre-compile  # Function name to request from application the data length of a DID. (ReadDataLength-function). | This parameter is related to the interface Xxx_ReadDataLength.
          function name DcmDspDataReadEcuSignal [0..1]: scope=ECU, multiplicity set at pre-compile, set at pre-compile  # Function name for read access to a certain ECU Signal by the DCM. (IoHwAb_Dcm_Read<EcuSignalName>-function). | Only relevant if DcmDspDataUsePort==USE_ECU_SIGNAL.
          function name DcmDspDataReadFnc [0..1]: multiplicity set at pre-compile, set at pre-compile  # Function name to request from application the data value of a DID. | (ReadData-function). This parameter is related to the interface Xxx_ReadData.
          function name DcmDspDataResetToDefaultFnc [0..1]: scope=ECU, multiplicity set at pre-compile, set at pre-compile  # Function name to request to application to reset an IOControl to default value. (ResetToDefault-function). | This parameter is related to the interface Xxx_ResetToDefault.
          function name DcmDspDataReturnControlToEcuFnc [0..1]: scope=ECU, multiplicity set at pre-compile, set at pre-compile  # Function name to request to application to return control to ECU of an IOControl. (ReturnControlToECU-function). | This parameter is related to the interface Xxx_ReturnControlToECU.
          function name DcmDspDataShortTermAdjustmentFnc [0..1]: scope=ECU, multiplicity set at pre-compile, set at pre-compile  # Function name to request to application to adjust the IO signal. (ShortTermAdjustment-function). | This parameter is related to the interface Xxx_ShortTermAdjustment.
          enumeration DcmDspDataType: {BOOLEAN, SINT16, SINT16_N, SINT32, SINT32_N, SINT8, SINT8_N, UINT16, UINT16_N, UINT32, UINT32_N, UINT8, UINT8_DYN, UINT8_N}, scope=ECU, set at link in variant link-time / pre-compile in variant post-build+pre-compile  # Provide the implementation data type of data belonging to a DID.
          enumeration DcmDspDataUsePort: {USE_BLOCK_ID, USE_DATA_ASYNCH_CLIENT_SERVER, USE_DATA_ASYNCH_CLIENT_SERVER_ERROR, USE_DATA_ASYNCH_FNC, USE_DATA_ASYNCH_FNC_ERROR, USE_DATA_SENDER_RECEIVER, USE_DATA_SENDER_RECEIVER_AS_SERVICE, USE_DATA_SYNCH_CLIENT_SERVER, USE_DATA_SYNCH_FNC, USE_ECU_SIGNAL}, scope=ECU, set at pre-compile  # Defines which interface shall be used to access the data.
          function name DcmDspDataWriteFnc [0..1]: scope=ECU, multiplicity set at pre-compile, set at pre-compile  # Function name to request application to write the data value of a DID. (WriteData-function). | This parameter is related to the interface Xxx_WriteData.
          add info DcmDspOdxDataDescription [0..1]: multiplicity set at pre-compile, set at pre-compile  # Defines additional description for ODX documentation
          symbolic name reference DcmDspDataBlockIdRef [0..1]: scope=ECU, multiplicity set at pre-compile, origin=AUTOSAR_ECUC V1.0.0, set at pre-compile, destination=NvMBlockDescriptor  # NRAM blockId to access the data. | Only relevant if DcmDspDataUsePort==USE_BLOCK_ID.
          reference DcmDspDataInfoRef [0..1]: scope=ECU, set at pre-compile, destination=DcmDspDataInfo  # Reference to 1 DcmDspDataInfo
          choice container DcmDspDiagnosisScaling [0..1]  # This container contains the configuration (parameters) of an alternative Diagnosis Representation. Out if this the scaling between Diagnosis and ECU internal representation and vice versa can be calculated.
            container DcmDspAlternativeDataInterface [0..1]  # This container contains the configuration (parameters) of an alternative Diagnosis Representation by the means of a VariableDataPrototoype in a DataInterface. | Additionally a reference to PortInterfaceMapping can be defined which provide already the mapping rules between the VariableDataPrototoype in a DataInterface used by the software component (DcmDspExternalSRDataElementClass) and the intended Diagnosis Representation defined by DcmDataElement.
              foreign reference DcmDataElement: set at pre-compile, destination-type=VARIABLE-DATA-PROTOTYPE  # Alternative Diagnosis Representation for the data defined by the means of a VariableDataPrototoype in a DataInterface. | The CompuMethod of the data type of the referenced VariableDataPrototype will be applied to the data type of the VariableDataPrototype in the interface used by the Dcm.
              foreign reference DcmPortInterfaceMapping [0..1]: multiplicity set at pre-compile, set at pre-compile, destination-type=PORT-INTERFACE-MAPPING  # Optional reference to PortInterfaceMapping which defines the mapping rules. | The PortInterfaceMapping is used to get the DataPrototypeMapping that describes a conversion between the data prototype referenced by DcmDataElement and the data prototype referenced from DcmDspExternalSRDataElementClass.
            container DcmDspAlternativeDataType [0..1]  # This container contains the configuration (parameters) of an alternative Diagnosis Representation by the means of an ApplicationDataType. | Additionally the definition of a text table mapping can be a defined for ApplicationDataTypes with a CompuMethod of category TEXTTABLE and SCALE_LINEAR_AND_TEXTTABLE.
              foreign reference DcmApplicationDataType: set at pre-compile, destination-type=APPLICATION-DATA-TYPE  # Alternative Diagnosis Representation for the data defined by the means of a ApplicationDataType of category VALUE, BOOLEAN or ARRAY. | The CompuMethod that applies to the referenced ApplicationDataType in case of category VALUE or BOOLEAN will be applied to the data type of the VariableDataPrototype in the interface used by the Dcm.
              container DcmDspTextTableMapping [0..*]  # The purpose of the DcmDspTextTableMapping is to associate a texttable value defined in the context of the Dcm to a texttable value defined in the context of a CompuMethod referenced by a DataType that shall be taken to create a dataElement in a SenderReceiverInterface. By this means it is possible to create a primitive version of a TexttableMapping (which can only be applied if a dataElement already exists). | In other words, the DcmDspTextTableMapping provides a similar mechanism to the TexttableMapping in a situation where the TexttableMapping cannot be applied since the SenderReceiverInterface for the PortPrototype on the Dcm ServiceComponent does not yet exist.
                integer DcmDspDiagnosisRepresentationDataValue: 0..18446744073709551615, scope=ECU, set at pre-compile  # The data value in the diagnosis representation.
                integer DcmDspInternalDataValue: 0..18446744073709551615, scope=ECU, set at pre-compile  # The ECU internal data value.
            container DcmDspAlternativeDiagnosticDataElement [0..1]  # This container contains the configuration (parameters) of an alternative Diagnosis Representation by the means of Diagnostic Extract.
              foreign reference DcmDspDiagnosticDataElementRef: set at pre-compile, destination-type=DIAGNOSTIC-DATA-ELEMENT  # Alternative Diagnosis Representation for the data defined by the means of a DiagnosticDataElement in the Diagnostic Extract. | This EcucForeignReference enables the access to all SwDataDefProps, in particular BaseType, CompuMethod and DataConstr The CompuMethod and DataConstr that applies to the referenced DiagnosticDataElement will be applied to the data type of the VariableDataPrototype in the interface used by the Dcm. The mapped ImplementationDataType needs to match the given BaseType.
          container DcmDspDidDataSupportInfo [0..1]  # This container defines the supported information.
            integer DcmDspDidDataSupportInfoBit: 0..255, scope=ECU, set at link in variant link-time / pre-compile in variant post-build+pre-compile  # Referenced Bit of the SupportInfo
            reference DcmDspDidDataSupportInfoRef: scope=ECU, multiplicity set at link in variant link-time / pre-compile in variant post-build+pre-compile, set at link in variant link-time / pre-compile in variant post-build+pre-compile, destination=DcmDspDidSupportInfo  # Reference to DcmDspDidSupportInfo
          choice container DcmDspExternalSRDataElementClass [0..1]  # This container defines the source of data in a provided port which shall be read respectively the target of data in a required port which shall be written. | This container shall contain either one DcmSubElementInDataElementInstance OR DcmDataElementInstance OR DcmSubElementInImplDataElementInstance reference.
            container DcmDataElementInstance [0..1]  # Instance Reference to the primitive data in a port where the data element is typed with an ApplicationPrimitveDataType or an ImplementationDataType.
              instance reference DcmDataElementInstanceRef: set at pre-compile, destination-context=ROOT-SW-COMPOSITION-PROTOTYPE SW-COMPONENT-PROTOTYPE PORT-PROTOTYPE, destination-type=AUTOSAR-DATA-PROTOTYPE  # Instance Reference to the primitive or array data which shall be read or written. | Supported are VariableDataPrototypes in SenderReceiverInterfaces and NvDataInterfaces and ParameterDataPrototypes in ParameterInterfaces (read only). This reference is applicable if the AutosarDataPrototype is typed with a ApplicationPrimitiveDataType of category VALUE or BOOLEAN or ApplicationArrayDataType or if the AutosarDataPrototype is typed with a ImplementationDataType of category VALUE, ARRAY or TYPE_REFERENCE that in turn boils down to VALUE or ARRAY
            container DcmSubElementInDataElementInstance [0..1]  # Instance Reference to the primitve sub-element (at any level) of composite data in a port where the data element is typed with an ApplicationCompositeDataType.
              instance reference DcmSubElementInDataElementInstanceRef: set at pre-compile, destination-context=ROOT-SW-COMPOSITION-PROTOTYPE SW-COMPONENT-PROTOTYPE PORT-PROTOTYPE AUTOSAR-DATA-PROTOTYPE APPLICATION-COMPOSITE-ELEMENT-DATA-PROTOTYPE*, destination-type=APPLICATION-COMPOSITE-ELEMENT-DATA-PROTOTYPE  # Instance Reference to the primitve sub-element (at any level) of composite data in a port which shall be read. | Supported are VariableDataPrototypes in SenderReceiverInterfaces and NvDataInterfaces and ParameterDataPrototypes in ParameterInterfaces (read only). This reference is applicable if the AutosarDataPrototype is typed with a ApplicationCompositeDataType.
            container DcmSubElementInImplDataElementInstance [0..1]  # Instance Reference to the primitve sub-element (at any level) of composite data in a port where the data element is typed with an ImplementationDataType.
              instance reference DcmSubElementInImplDataElementInstanceRef: set at pre-compile, destination-context=ROOT-SW-COMPOSITION-PROTOTYPE SW-COMPONENT-PROTOTYPE PORT-PROTOTYPE AUTOSAR-DATA-PROTOTYPE IMPLEMENTATION-DATA-TYPE-ELEMENT*, destination-type=IMPLEMENTATION-DATA-TYPE-ELEMENT  # Instance Reference to the primitve sub-element (at any level) of composite data in a port which shall be read. | Supported are VariableDataPrototypes in SenderReceiverInterfaces and NvDataInterfaces and ParameterDataPrototypes in ParameterInterfaces (read only). This reference is applicable if the AutosarDataPrototype is typed with a ImplementationDataType of category STRUCTURE or ARRAY. Please note that in case of ARRAY the index attribute in the target reference has to be set to select a single array element.
        container DcmDspDataInfo [0..*]  # This container contains the configuration (parameters) of one Data.
          integer DcmDspDataScalingInfoSize [0..1]: 0..4294967295, scope=ECU, multiplicity set at link in variant link-time / pre-compile in variant post-build+pre-compile, set at link in variant link-time / pre-compile in variant post-build+pre-compile  # If Scaling information service is available for this Data, it provides the size in bytes of the scaling information.
        container DcmDspDid [0..*]  # This container contains the configuration (parameters) of the DID.
          integer DcmDspDidIdentifier: 0..65535, scope=ECU, set at link in variant link-time / pre-compile in variant post-build+pre-compile  # 2 byte Identifier of the DID | Within each DcmConfigSet all DcmDspDidIdentifier values shall be unique.
          integer DcmDspDidSize [0..1]: 0..65535, scope=ECU, set at link in variant link-time / pre-compile in variant post-build+pre-compile  # Length of a DID in byte(s).
          boolean DcmDspDidUsed: scope=ECU, post-build-variant-value=true, set at link in variant link-time / post-build in variant post-build / pre-compile in variant pre-compile  # Allow to activate or deactivate the usage of a DID, for multi purpose ECUs | true = DID available false = DID not available
          reference DcmDspDidInfoRef: scope=ECU, set at link in variant link-time / pre-compile in variant post-build+pre-compile, destination=DcmDspDidInfo  # Reference to DcmDspDidInfo containing information on this DID.
          reference DcmDspDidRef [0..*]: scope=ECU, multiplicity set at link in variant link-time / pre-compile in variant post-build+pre-compile, requires-index=true, set at link in variant link-time / pre-compile in variant post-build+pre-compile, destination=DcmDspDid  # Reference to DcmDspDid in case this DID refer to one or serveral other DID's
          container DcmDspDidSignal [0..*]  # This container defines the reference to 1 DcmDspData container and position relevant for this DID.
            integer DcmDspDidByteOffset: 0..65535, scope=ECU, set at link in variant link-time / pre-compile in variant post-build+pre-compile  # Defines the absolute byte offset of the data defined by DcmDspDidDataRef reference to DcmDspData container in the DID.
            reference DcmDspDidDataRef: scope=ECU, set at link in variant link-time / pre-compile in variant post-build+pre-compile, destination=DcmDspData  # Reference to 1 DcmDspData container relevant for this DID.
          container DcmDspDidSupportInfo [0..1]  # This container defines the support information to declare the usability of the data bytes within the DIDs
            integer DcmDspDidSupportInfoLen: 0..255, scope=ECU, set at link in variant link-time / pre-compile in variant post-build+pre-compile  # Length of the support information in bytes.
            integer DcmDspDidSupportInfoPos: 0..255, scope=ECU, set at link in variant link-time / pre-compile in variant post-build+pre-compile  # Length of the support information in bytes.
        container DcmDspDidInfo [0..*]  # This container contains the configuration (parameters) of the DID's Info
          integer DcmDspDDDIDMaxElements [0..1]: 1..255, multiplicity set at link in variant link-time / pre-compile in variant post-build+pre-compile, set at link in variant link-time / pre-compile in variant post-build+pre-compile  # Maximum number of source elements of a DDDID.
          boolean DcmDspDidDynamicallyDefined: scope=ECU, set at link in variant link-time / pre-compile in variant post-build+pre-compile  # Indicates if this DID can be dynamically defined | true = DID can be dynamically defined false = DID can not be dynamically defined
          container DcmDspDidControl [0..1]  # This container contains the configuration (parameters) of the DID control.
            enumeration DcmDspDidControlMask: {DCM_CONTROLMASK_EXTERNAL, DCM_CONTROLMASK_INTERNAL, DCM_CONTROLMASK_NO}, scope=ECU, set at pre-compile, default-value=DCM_CONTROLMASK_INTERNAL  # This indicates the presence of "controlEnableMask" in SWC service interfaces and defines how the Dcm treats a service request.
            integer DcmDspDidControlMaskSize [0..1]: 1..4, scope=ECU, set at pre-compile  # The value defines the size of the controlEnableMaskRecord in bytes.
            boolean DcmDspDidFreezeCurrentState: scope=ECU, set at pre-compile  # This indicates the presence of "FreezeCurrentState".
            boolean DcmDspDidResetToDefault: scope=ECU, set at pre-compile  # This indicates the presence of "ResetToDefault".
            boolean DcmDspDidShortTermAdjustment: scope=ECU, set at pre-compile  # This indicates the presence of "ShortTermAdjustment".
            reference DcmDspDidControlModeRuleRef [0..1]: scope=ECU, multiplicity set at link in variant link-time / pre-compile in variant post-build+pre-compile, set at link in variant link-time / pre-compile in variant post-build+pre-compile, destination=DcmModeRule  # Reference to DcmModeRule | Mode rule which controls this DID. If there is no reference, no check of the mode rule shall be done.
            reference DcmDspDidControlSecurityLevelRef [0..*]: scope=ECU, multiplicity set at link in variant link-time / pre-compile in variant post-build+pre-compile, set at link in variant link-time / pre-compile in variant post-build+pre-compile, destination=DcmDspSecurityRow  # Reference to DcmDspSecurityRow | Security levels allowed to control this DID. If there is no reference, no check of security level shall be done.
            reference DcmDspDidControlSessionRef [0..*]: scope=ECU, multiplicity set at link in variant link-time / pre-compile in variant post-build+pre-compile, set at link in variant link-time / pre-compile in variant post-build+pre-compile, destination=DcmDspSessionRow  # Reference to DcmDspSessionRow | Sessions allowed to control this DID. If there is no reference, no check of session level shall be done.
            container DcmDspDidControlEnableMask [0..32]  # The shortname of the container value defines the symbol of the controlMask.
              integer DcmDspDidControlMaskBitPosition: 0..31, scope=ECU, set at pre-compile  # Defines the position of the bit in the controlMask starting from most significant bit (MSB first) to least significant bit. | This Bit endianness is identical to the controlMask in UDS. The DcmDspDidControlMaskSize should be considered for most significant bit.
          container DcmDspDidRead [0..1]  # This container contains the configuration (parameters) of the DID read.
            reference DcmDspDidReadModeRuleRef [0..1]: scope=ECU, multiplicity set at link in variant link-time / pre-compile in variant post-build+pre-compile, set at link in variant link-time / pre-compile in variant post-build+pre-compile, destination=DcmModeRule  # Reference to DcmModeRule | Mode rule which controls to read this DID. If there is no reference, no check of the mode rule shall be done.
            reference DcmDspDidReadSecurityLevelRef [0..*]: scope=ECU, multiplicity set at link in variant link-time / pre-compile in variant post-build+pre-compile, set at link in variant link-time / pre-compile in variant post-build+pre-compile, destination=DcmDspSecurityRow  # Reference to DcmDspSecurityRow Referenced security levels are allowed to read this DID. | If there is no reference, no check of security level shall be done.
            reference DcmDspDidReadSessionRef [0..*]: scope=ECU, multiplicity set at link in variant link-time / pre-compile in variant post-build+pre-compile, set at link in variant link-time / pre-compile in variant post-build+pre-compile, destination=DcmDspSessionRow  # Reference to DcmDspSessionRow Referenced sessions are allowed to read this DID. | If there is no reference, no check of session level shall be done.
          container DcmDspDidWrite [0..1]  # This container contains the configuration (parameters) of the DID write.
            reference DcmDspDidWriteModeRuleRef [0..1]: scope=ECU, multiplicity set at link in variant link-time / pre-compile in variant post-build+pre-compile, set at link in variant link-time / pre-compile in variant post-build+pre-compile, destination=DcmModeRule  # Reference to DcmModeRule | Mode rule which controls to write this DID. If there is no reference, no check of the mode rule shall be done.
            reference DcmDspDidWriteSecurityLevelRef [0..*]: scope=ECU, multiplicity set at link in variant link-time / pre-compile in variant post-build+pre-compile, set at link in variant link-time / pre-compile in variant post-build+pre-compile, destination=DcmDspSecurityRow  # Reference to DcmDspSecurityRow Referenced security levels are allowed to wirte this DID. | If there is no reference, no check of security level shall be done.
            reference DcmDspDidWriteSessionRef [0..*]: scope=ECU, multiplicity set at link in variant link-time / pre-compile in variant post-build+pre-compile, set at link in variant link-time / pre-compile in variant post-build+pre-compile, destination=DcmDspSessionRow  # Reference to DcmDspSessionRow Referenced sessions are allowed to write this DID. | If there is no reference, no check of session level shall be done.
        container DcmDspDidRange [0..*]  # This container defines the DID Range
          boolean DcmDspDidRangeHasGaps: scope=ECU, set at link in variant link-time / pre-compile in variant post-build+pre-compile  # Parameter specifying if there are gaps in the DID range (parameter set to TRUE) or not (parameter set to FALSE)
          integer DcmDspDidRangeIdentifierLowerLimit: 0..65535, scope=ECU, set at link in variant link-time / pre-compile in variant post-build+pre-compile  # Lower limit of DID range.
          integer DcmDspDidRangeIdentifierUpperLimit: 0..65535, scope=ECU, set at link in variant link-time / pre-compile in variant post-build+pre-compile  # Upper limit of DID range.
          function name DcmDspDidRangeIsDidAvailableFnc [0..1]: scope=ECU, multiplicity set at pre-compile, set at pre-compile  # Function name to request from application if a specific DID is available within the range or not. | Only relevant if DcmDspDidRangeUsePort is set to false. This parameter is related to the interface Xxx_IsDidAvailable.
          integer DcmDspDidRangeMaxDataLength: 0..65535, scope=ECU, set at link in variant link-time / pre-compile in variant post-build+pre-compile  # Maximum data length in bytes
          function name DcmDspDidRangeReadDataLengthFnc [0..1]: scope=ECU, multiplicity set at pre-compile, set at pre-compile  # Function name to request from application the length of the data of a range DID. | Only relevant if DcmDspDidRangeUsePort is set to false. This parameter is related to the interface Xxx_ReadDidRangeDataLength.
          function name DcmDspDidRangeReadDidFnc [0..1]: scope=ECU, multiplicity set at pre-compile, set at pre-compile  # Function name to request from application the data range value of a DID.(ReadData-function). | Only relevant if DcmDspDidRangeUsePort is set to false. This parameter is related to the interface Xxx_ReadDidData.
          boolean DcmDspDidRangeUsePort: scope=ECU, set at pre-compile  # When the parameter DcmDspDidRangeUsePort is set to true the DCM will access the Data using an R-Port requiring a PortInteface DataServices_DIDRange. In that case, DcmDspDidRangeIsDidAvailableFnc, DcmDspDidRangeReadDidFnc and DcmDspDidRangeWriteDidFnc are ignored and the RTE APIs are used. When the parameter DcmDspDidRangeUsePort is false, the DCM calls the functions defined in DcmDspDidRangeIsDidAvailableFnc, DcmDspDidRangeReadDidFnc and DcmDspDidRangeWriteDidFnc.
          function name DcmDspDidRangeWriteDidFnc [0..1]: scope=ECU, multiplicity set at pre-compile, set at pre-compile  # Function name to request application to write the data range value of a DID.(WriteData-function). | Only relevant if DcmDspDidRangeUsePort is set to false. This parameter is related to the interface Xxx_WriteDidData.
          reference DcmDspDidRangeInfoRef: scope=ECU, set at link in variant link-time / pre-compile in variant post-build+pre-compile, destination=DcmDspDidInfo  # Reference to DcmDspDidInfo containing information on this DID Range.
        container DcmDspEcuReset [0..1]  # This container contains the configuration for DcmDspEcuReset service
          container DcmDspEcuResetRow [1..*]  # This container contains the configuration for each DcmDspEcuReset subservice.
            integer DcmDspEcuResetId: 0..127, scope=ECU, multiplicity set at link in variant link-time / pre-compile in variant post-build+pre-compile, set at link in variant link-time / pre-compile in variant post-build+pre-compile  # Defines the subfunction ID
            enumeration DcmResponseToEcuReset: {AFTER_RESET, BEFORE_RESET}, scope=ECU, set at pre-compile  # Defines the answer to EcuReset service should come: Before or after the reset.
        container DcmDspMemory [0..1]  # This container contains the configuration of the memory access.
          container DcmDspAddressAndLengthFormatIdentifier [0..1]  # This container contains the configuration of the supported AddressAndLengthFormatIdentifiers for memory access.
            integer DcmDspSupportedAddressAndLengthFormatIdentifier [1..*]: 0..255, scope=ECU, multiplicity set at link in variant link-time / pre-compile in variant post-build+pre-compile, set at link in variant link-time / pre-compile in variant post-build+pre-compile  # This parameter defines the supported AddressAndLengthFormatIdentifier of the request message.
          container DcmDspMemoryIdInfo [1..*]  # Provides the value of memory identifier used to select the desired memory device | This container contains the configuration of the memory access requested through diagnostic services : ReadMemoryByAddress, WriteMemoryByAddress, RequestDownload, RequestUpload
            integer DcmDspMemoryIdValue [0..1]: 0..255, scope=ECU, multiplicity set at link in variant link-time / pre-compile in variant post-build+pre-compile, set at link in variant link-time / pre-compile in variant post-build+pre-compile  # Value of the memory device identifier used. | Each DcmDspMemoryIdInfo should have a unique ID. The MemoryIdValue is retrieved from the request messages (RMBA,WMBA,RD,RU,DDDI) according to ISO-14229-1.
            container DcmDspReadMemoryRangeByLabelInfo [0..*]  # Provides a memory range allowed for reading via labels (lower and higher address configured as strings).
              string DcmDspReadMemoryRangeByLabelHigh: set at pre-compile, regular-expression=[a-zA-Z0-9_]([a-zA-Z0-9\._])*  # High memory address as label (string) of a range allowed for reading.
              string DcmDspReadMemoryRangeByLabelLow: set at pre-compile, regular-expression=[a-zA-Z0-9_]([a-zA-Z0-9\._])*  # Low memory address as label (string) of a range allowed for reading.
              reference DcmDspReadMemoryRangeModeRuleRef [0..1]: scope=ECU, multiplicity set at link in variant link-time / pre-compile in variant post-build+pre-compile, set at link in variant link-time / pre-compile in variant post-build+pre-compile, destination=DcmModeRule  # Reference to DcmModeRule | Mode rule which controls read access on this memory address. If there is no reference, no check of the mode rule shall be done.
              reference DcmDspReadMemoryRangeSecurityLevelRef [0..*]: scope=ECU, multiplicity set at link in variant link-time / pre-compile in variant post-build+pre-compile, set at link in variant link-time / pre-compile in variant post-build+pre-compile, destination=DcmDspSecurityRow  # Link to the Security Access Levels needed for read access on this memory address. If there is no reference, no check of security level shall be done.
              reference DcmDspReadMemoryRangeSessionLevelRef [0..*]: scope=ECU, multiplicity set at link in variant link-time / pre-compile in variant post-build+pre-compile, set at link in variant link-time / pre-compile in variant post-build+pre-compile, destination=DcmDspSessionRow  # Link to the session level needed for access to this memory address range. | If there is no reference, no check of session level shall be done.
            container DcmDspReadMemoryRangeInfo [0..*]  # Provides the range of memory address allowed for reading
              integer DcmDspReadMemoryRangeHigh: 0..4294967294, scope=ECU, set at link in variant link-time / pre-compile in variant post-build+pre-compile  # High memory address of a range allowed for reading
              integer DcmDspReadMemoryRangeLow: 0..4294967294, scope=ECU, set at link in variant link-time / pre-compile in variant post-build+pre-compile  # Low memory address of a range allowed for reading
              reference DcmDspReadMemoryRangeModeRuleRef [0..1]: scope=ECU, multiplicity set at link in variant link-time / pre-compile in variant post-build+pre-compile, set at link in variant link-time / pre-compile in variant post-build+pre-compile, destination=DcmModeRule  # Reference to DcmModeRule | Mode rule which controls read access on this memory address. If there is no reference, no check of the mode rule shall be done.
              reference DcmDspReadMemoryRangeSecurityLevelRef [0..*]: scope=ECU, multiplicity set at link in variant link-time / pre-compile in variant post-build+pre-compile, set at link in variant link-time / pre-compile in variant post-build+pre-compile, destination=DcmDspSecurityRow  # Link to the Security Access Levels needed for read access on this memory address. If there is no reference, no check of security level shall be done.
              reference DcmDspReadMemoryRangeSessionLevelRef [0..*]: scope=ECU, multiplicity set at link in variant link-time / pre-compile in variant post-build+pre-compile, set at link in variant link-time / pre-compile in variant post-build+pre-compile, destination=DcmDspSessionRow  # Link to the session level needed for access to this memory address range. | If there is no reference, no check of session level shall be done.
            container DcmDspWriteMemoryRangeByLabelInfo [0..*]  # Provides a memory range allowed for writing via labels (lower and higher address configured as strings).
              string DcmDspWriteMemoryRangeByLabelHigh: set at pre-compile, regular-expression=[a-zA-Z0-9_]([a-zA-Z0-9\._])*  # High memory address as label (string) of a range allowed for writing.
              string DcmDspWriteMemoryRangeByLabelLow: set at pre-compile, regular-expression=[a-zA-Z0-9_]([a-zA-Z0-9\._])*  # Low memory address as label (string) of a range allowed for writing.
              reference DcmDspWriteMemoryRangeModeRuleRef [0..1]: scope=ECU, multiplicity set at link in variant link-time / pre-compile in variant post-build+pre-compile, set at link in variant link-time / pre-compile in variant post-build+pre-compile, destination=DcmModeRule  # Reference to DcmModeRule | Mode rule which controls write access on this memory address. If there is no reference, no check of the mode rule shall be done.
              reference DcmDspWriteMemoryRangeSecurityLevelRef [0..*]: scope=ECU, multiplicity set at link in variant link-time / pre-compile in variant post-build+pre-compile, set at link in variant link-time / pre-compile in variant post-build+pre-compile, destination=DcmDspSecurityRow  # Link to the Security Access Levels needed for write access on this memory address. If there is no reference, no check of security level shall be done.
              reference DcmDspWriteMemoryRangeSessionLevelRef [0..*]: scope=ECU, multiplicity set at link in variant link-time / pre-compile in variant post-build+pre-compile, set at link in variant link-time / pre-compile in variant post-build+pre-compile, destination=DcmDspSessionRow  # Link to the session level needed for access to this memory address range. | If there is no reference, no check of session level shall be done.
            container DcmDspWriteMemoryRangeInfo [0..*]  # Provides the range of memory address allowed for writting.
              integer DcmDspWriteMemoryRangeHigh: 0..4294967294, scope=ECU, set at link in variant link-time / pre-compile in variant post-build+pre-compile  # High memory address of a range allowed for writing.
              integer DcmDspWriteMemoryRangeLow: 0..4294967294, scope=ECU, set at link in variant link-time / pre-compile in variant post-build+pre-compile  # Low memory address of a range allowed for writing
              reference DcmDspWriteMemoryRangeModeRuleRef [0..1]: scope=ECU, multiplicity set at link in variant link-time / pre-compile in variant post-build+pre-compile, set at link in variant link-time / pre-compile in variant post-build+pre-compile, destination=DcmModeRule  # Reference to DcmModeRule | Mode rule which controls write access on this memory address. If there is no reference, no check of the mode rule shall be done.
              reference DcmDspWriteMemoryRangeSecurityLevelRef [0..*]: scope=ECU, multiplicity set at link in variant link-time / pre-compile in variant post-build+pre-compile, set at link in variant link-time / pre-compile in variant post-build+pre-compile, destination=DcmDspSecurityRow  # Link to the Security Access Levels needed for write access on this memory address. If there is no reference, no check of security level shall be done.
              reference DcmDspWriteMemoryRangeSessionLevelRef [0..*]: scope=ECU, multiplicity set at link in variant link-time / pre-compile in variant post-build+pre-compile, set at link in variant link-time / pre-compile in variant post-build+pre-compile, destination=DcmDspSessionRow  # Link to the session level needed for access to this memory address range. | If there is no reference, no check of session level shall be done.
        container DcmDspPeriodicTransmission [0..1]  # This container contains the configuration (parameters) for Periodic Transmission Scheduler.
          integer DcmDspMaxPeriodicDidScheduler: 1..255, set at link in variant link-time / pre-compile in variant post-build+pre-compile  # Defines the maximum number of periodicDataIdentifiers that can be scheduled concurrently.
          float DcmDspPeriodicTransmissionFastRate [0..1]: 1E-4..0.255, multiplicity set at pre-compile, set at link in variant link-time / pre-compile in variant post-build+pre-compile  # This parameter give the transmission rate of the requested periodicDataIdentifiers to be used if the parameter transmissionMode given in the ReadDataByPeriodicID request is equal to 0x03 ("sendAtFastRate"). This parameter value in seconds have to be configured as a multiple of DcmTaskTime. | min: A negative value and zero is not allowed.
          float DcmDspPeriodicTransmissionMediumRate [0..1]: 1E-4..0.255, multiplicity set at pre-compile, set at link in variant link-time / pre-compile in variant post-build+pre-compile  # This parameter give the transmission rate of the requested periodicDataIdentifiers to be used if the parameter transmissionMode given in the ReadDataByPeriodicID request is equal to 0x02 ("sendAtMediumRate"). This parameter value in seconds have to be configured as a multiple of DcmTaskTime. | min: A negative value and zero is not allowed.
          float DcmDspPeriodicTransmissionSlowRate [0..1]: 1E-4..0.255, multiplicity set at pre-compile, set at link in variant link-time / pre-compile in variant post-build+pre-compile  # This parameter give the transmission rate of the requested periodicDataIdentifiers to be used if the parameter transmissionMode given in the ReadDataByPeriodicID request is equal to 0x01 ("sendAtSlowRate"). This parameter value in seconds have to be configured as a multiple of DcmTaskTime. | min: A negative value and zero is not allowed.
        container DcmDspPid [0..*]  # This container defines the availability of a PID to the DCM.
          integer DcmDspPidIdentifier: 0..255, scope=ECU, set at link in variant link-time / pre-compile in variant post-build+pre-compile  # 1 byte Identifier of the PID | Within each DcmConfigSet all DcmDspPidIdentifier values shall be unique.
          enumeration DcmDspPidService: {DCM_SERVICE_01, DCM_SERVICE_01_02, DCM_SERVICE_02}, scope=ECU, set at link in variant link-time / pre-compile in variant post-build+pre-compile  # Indicates if a PID is used with service $01 and/or $02
          integer DcmDspPidSize: 0..255, scope=ECU, set at link in variant link-time / pre-compile in variant post-build+pre-compile  # Length of a PID in byte(s).
          boolean DcmDspPidUsed: scope=ECU, post-build-variant-value=true, set at link in variant link-time / post-build in variant post-build / pre-compile in variant pre-compile  # Allow to activate or deactivate the usage of a PID, for multi purpose ECUs | true = PID is available false = PID is not available
          container DcmDspPidData [1..*]  # This container defines the parameter for a Signal in the PID.
            integer DcmDspPidByteOffset: 0..255, scope=ECU, set at link in variant link-time / pre-compile in variant post-build+pre-compile  # This is the position in bytes of the PID structure and will not start at position 0 in case a support information is available (for packeted PIDs).
            integer DcmDspPidDataByteSize [0..1]: 0..255, scope=ECU, multiplicity set at link in variant link-time / pre-compile in variant post-build+pre-compile, set at link in variant link-time / pre-compile in variant post-build+pre-compile  # Defines the array length in bytes or the the maximum array length for variable datalengths.
            container DcmDspPidDataSupportInfo [0..1]  # This container defines the supported information.
              integer DcmDspPidDataSupportInfoBit: 0..255, scope=ECU, set at link in variant link-time / pre-compile in variant post-build+pre-compile  # Referenced Bit of the SupportInfo
              reference DcmDspPidDataSupportInfoRef: scope=ECU, set at link in variant link-time / pre-compile in variant post-build+pre-compile, destination=DcmDspPidSupportInfo  # Reference to DcmDspPidSupportInfo
            container DcmDspPidService01 [0..1]  # Contains specific configuration parameter of PID for service $01. This container exists only if DcmDspPidService is set to DCM_SERVICE_01 or DCM_SERVICE_01_02.
              enumeration DcmDspPidDataEndianness [0..1]: {BIG_ENDIAN, LITTLE_ENDIAN, OPAQUE}, scope=ECU, multiplicity set at pre-compile, set at pre-compile  # Defines the endianness of the data belonging to a PID in a diagnostic response message. | If no DcmDspPidDataEndianness is defined the value of DcmDspDataDefaultEndianness is applicable.
              function name DcmDspPidDataReadFnc [0..1]: scope=ECU, multiplicity set at pre-compile, set at pre-compile  # Function name for reading PID data value. | This is only relevant if DcmDspPidDataUsePort==USE_DATA_SYNCH_FNC. This parameter is related to the interface Xxx_ReadData.
              enumeration DcmDspPidDataType: scope=ECU, multiplicity set at link in variant link-time / pre-compile in variant post-build+pre-compile, set at link in variant link-time / pre-compile in variant post-build+pre-compile  # Provide the implementation data type of data belonging to a PID.
                BOOLEAN
                SINT16
                SINT16_N
                SINT32
                SINT32_N
                SINT8
                SINT8_N
                UINT16
                UINT16_N
                UINT32
                UINT32_N
                UINT8
                UINT8_DYN  # Tags: atp.Status=obsolete, atp.StatusRevisionBegin=4.3.1
                UINT8_N
              enumeration DcmDspPidDataUsePort: {USE_DATA_SENDER_RECEIVER, USE_DATA_SENDER_RECEIVER_AS_SERVICE, USE_DATA_SYNCH_CLIENT_SERVER, USE_DATA_SYNCH_FNC}, scope=ECU, set at pre-compile  # If this parameter is set to USE_DATA_SYNCH_FNC, the Dcm will use the function defined in DcmDspPidDataReadFnc to get the PID data value. | If this parameter is set to USE_DATA_SYNCH_CLIENT_SERVER, the Dcm will have an R-Port requiring the interface DataServices_{Data}. If this parameter is set to USE_DATA_SENDER_RECEIVER or USE_DATA_SENDER_RECEIVER_AS_SERVICE, the DCM will have an R-Port requiring a SenderReceiverInterface. The R-Port is named DataServices_{Data} where {Data} is the name of the container DcmDspPidData.
              choice container DcmDspDiagnosisScaling [0..1]  # This container contains the configuration (parameters) of an alternative Diagnosis Representation. Out if this the scaling between Diagnosis and ECU internal representation and vice versa can be calculated.
                container DcmDspAlternativeDataInterface [0..1]  # This container contains the configuration (parameters) of an alternative Diagnosis Representation by the means of a VariableDataPrototoype in a DataInterface. | Additionally a reference to PortInterfaceMapping can be defined which provide already the mapping rules between the VariableDataPrototoype in a DataInterface used by the software component (DcmDspExternalSRDataElementClass) and the intended Diagnosis Representation defined by DcmDataElement.
                  foreign reference DcmDataElement: set at pre-compile, destination-type=VARIABLE-DATA-PROTOTYPE  # Alternative Diagnosis Representation for the data defined by the means of a VariableDataPrototoype in a DataInterface. | The CompuMethod of the data type of the referenced VariableDataPrototype will be applied to the data type of the VariableDataPrototype in the interface used by the Dcm.
                  foreign reference DcmPortInterfaceMapping [0..1]: multiplicity set at pre-compile, set at pre-compile, destination-type=PORT-INTERFACE-MAPPING  # Optional reference to PortInterfaceMapping which defines the mapping rules. | The PortInterfaceMapping is used to get the DataPrototypeMapping that describes a conversion between the data prototype referenced by DcmDataElement and the data prototype referenced from DcmDspExternalSRDataElementClass.
                container DcmDspAlternativeDataType [0..1]  # This container contains the configuration (parameters) of an alternative Diagnosis Representation by the means of an ApplicationDataType. | Additionally the definition of a text table mapping can be a defined for ApplicationDataTypes with a CompuMethod of category TEXTTABLE and SCALE_LINEAR_AND_TEXTTABLE.
                  foreign reference DcmApplicationDataType: set at pre-compile, destination-type=APPLICATION-DATA-TYPE  # Alternative Diagnosis Representation for the data defined by the means of a ApplicationDataType of category VALUE, BOOLEAN or ARRAY. | The CompuMethod that applies to the referenced ApplicationDataType in case of category VALUE or BOOLEAN will be applied to the data type of the VariableDataPrototype in the interface used by the Dcm.
                  container DcmDspTextTableMapping [0..*]  # The purpose of the DcmDspTextTableMapping is to associate a texttable value defined in the context of the Dcm to a texttable value defined in the context of a CompuMethod referenced by a DataType that shall be taken to create a dataElement in a SenderReceiverInterface. By this means it is possible to create a primitive version of a TexttableMapping (which can only be applied if a dataElement already exists). | In other words, the DcmDspTextTableMapping provides a similar mechanism to the TexttableMapping in a situation where the TexttableMapping cannot be applied since the SenderReceiverInterface for the PortPrototype on the Dcm ServiceComponent does not yet exist.
                    integer DcmDspDiagnosisRepresentationDataValue: 0..18446744073709551615, scope=ECU, set at pre-compile  # The data value in the diagnosis representation.
                    integer DcmDspInternalDataValue: 0..18446744073709551615, scope=ECU, set at pre-compile  # The ECU internal data value.
                container DcmDspAlternativeDiagnosticDataElement [0..1]  # This container contains the configuration (parameters) of an alternative Diagnosis Representation by the means of Diagnostic Extract.
                  foreign reference DcmDspDiagnosticDataElementRef: set at pre-compile, destination-type=DIAGNOSTIC-DATA-ELEMENT  # Alternative Diagnosis Representation for the data defined by the means of a DiagnosticDataElement in the Diagnostic Extract. | This EcucForeignReference enables the access to all SwDataDefProps, in particular BaseType, CompuMethod and DataConstr The CompuMethod and DataConstr that applies to the referenced DiagnosticDataElement will be applied to the data type of the VariableDataPrototype in the interface used by the Dcm. The mapped ImplementationDataType needs to match the given BaseType.
              choice container DcmDspPidService01ExternalSRDataElementClass [0..1]  # This container defines the source of data in a provided port which shall be read respectively the target of data in a required port which shall be written. | This container shall contain either one DcmSubElementInDataElementInstance OR DcmDataElementInstance OR DcmSubElementInImplDataElementInstance reference.
                container DcmDataElementInstance [0..1]  # Instance Reference to the primitive data in a port where the data element is typed with an ApplicationPrimitveDataType or an ImplementationDataType.
                  instance reference DcmDataElementInstanceRef: set at pre-compile, destination-context=ROOT-SW-COMPOSITION-PROTOTYPE SW-COMPONENT-PROTOTYPE PORT-PROTOTYPE, destination-type=AUTOSAR-DATA-PROTOTYPE  # Instance Reference to the primitive or array data which shall be read or written. | Supported are VariableDataPrototypes in SenderReceiverInterfaces and NvDataInterfaces and ParameterDataPrototypes in ParameterInterfaces (read only). This reference is applicable if the AutosarDataPrototype is typed with a ApplicationPrimitiveDataType of category VALUE or BOOLEAN or ApplicationArrayDataType or if the AutosarDataPrototype is typed with a ImplementationDataType of category VALUE, ARRAY or TYPE_REFERENCE that in turn boils down to VALUE or ARRAY
                container DcmSubElementInDataElementInstance [0..1]  # Instance Reference to the primitve sub-element (at any level) of composite data in a port where the data element is typed with an ApplicationCompositeDataType.
                  instance reference DcmSubElementInDataElementInstanceRef: set at pre-compile, destination-context=ROOT-SW-COMPOSITION-PROTOTYPE SW-COMPONENT-PROTOTYPE PORT-PROTOTYPE AUTOSAR-DATA-PROTOTYPE APPLICATION-COMPOSITE-ELEMENT-DATA-PROTOTYPE*, destination-type=APPLICATION-COMPOSITE-ELEMENT-DATA-PROTOTYPE  # Instance Reference to the primitve sub-element (at any level) of composite data in a port which shall be read. | Supported are VariableDataPrototypes in SenderReceiverInterfaces and NvDataInterfaces and ParameterDataPrototypes in ParameterInterfaces (read only). This reference is applicable if the AutosarDataPrototype is typed with a ApplicationCompositeDataType.
                container DcmSubElementInImplDataElementInstance [0..1]  # Instance Reference to the primitve sub-element (at any level) of composite data in a port where the data element is typed with an ImplementationDataType.
                  instance reference DcmSubElementInImplDataElementInstanceRef: set at pre-compile, destination-context=ROOT-SW-COMPOSITION-PROTOTYPE SW-COMPONENT-PROTOTYPE PORT-PROTOTYPE AUTOSAR-DATA-PROTOTYPE IMPLEMENTATION-DATA-TYPE-ELEMENT*, destination-type=IMPLEMENTATION-DATA-TYPE-ELEMENT  # Instance Reference to the primitve sub-element (at any level) of composite data in a port which shall be read. | Supported are VariableDataPrototypes in SenderReceiverInterfaces and NvDataInterfaces and ParameterDataPrototypes in ParameterInterfaces (read only). This reference is applicable if the AutosarDataPrototype is typed with a ImplementationDataType of category STRUCTURE or ARRAY. Please note that in case of ARRAY the index attribute in the target reference has to be set to select a single array element.
            container DcmDspPidService02 [0..1]  # Contains specific configuration parameter of PID for service $02. This container exists only if DcmDspPidService is set to DCM_SERVICE_02 or DCM_SERVICE_01_02.
              reference DcmDspPidDataDemRef [0..1]: scope=ECU, multiplicity set at link in variant link-time / pre-compile in variant post-build+pre-compile, set at link in variant link-time / pre-compile in variant post-build+pre-compile, destination=DemPidDataElement  # Reference to DemPidDataElement in DEM configuration. Allows to link the DCM PID and DEM PID configuration for Mode $02.
          container DcmDspPidSupportInfo [0..*]  # This container defines the support information (typically byte A) to declare the usability of the data bytes within the so-called packeted PIDs (e.g. PID$68).
            integer DcmDspPidSupportInfoLen: 0..255, scope=ECU, set at link in variant link-time / pre-compile in variant post-build+pre-compile  # Length of the support information in bytes.
            integer DcmDspPidSupportInfoPos: 0..255, scope=ECU, set at link in variant link-time / pre-compile in variant post-build+pre-compile  # Position of the support information in bytes.
        container DcmDspRequestControl [0..*]  # This container contains the configuration (parameters) of the "Request control of on-board system, test or component" service (Service $08). | The DCM will request the control using an R-Port requiring a PortInteface RequestControlServices_{Tid}. The R-Port is named RequestControlServices_{Tid} where {Tid} is the name of the container DcmDspRequestControl.
          integer DcmDspRequestControlInBufferSize: 0..255, scope=ECU, set at link in variant link-time / pre-compile in variant post-build+pre-compile  # Number of bytes to be provided in the input buffer of the interface RequestControlServices_{Tid} for OBD Service $08
          integer DcmDspRequestControlInfoByte [0..1]: 0..255, scope=ECU, set at link in variant link-time / pre-compile in variant post-build+pre-compile  # Manufacturer specific value reported to the tester for the record identifiers 0xE000 to OxE1FF. (WWH-OBD use cases)
          integer DcmDspRequestControlOutBufferSize: 0..255, scope=ECU, set at link in variant link-time / pre-compile in variant post-build+pre-compile  # Number of bytes to be provided in the output buffer of the interface RequestControlServices_{Tid} for OBD Service $08
          integer DcmDspRequestControlTestId: 0..255, scope=ECU, set at link in variant link-time / pre-compile in variant post-build+pre-compile  # Test Id for Service $08
        container DcmDspRequestFileTransfer [0..1]  # This container contains the configuration for RequestFileTransfer. | This container only exists if RequestFileTransfer is configured.
          integer DcmRequestFileTransferFileSizeParameterLength: 0..255, scope=ECU, set at pre-compile  # Length of the fileSizeCompressed and fileSizeUncompressedOrDirInfoLength in the Dcm_ProcessRequestFileTransfer operation and response message.
          integer DcmRequestFileTransferLengthFormatIdentifier: 0..255, scope=ECU, set at pre-compile  # Defines the length (number of bytes) of the maxNumberOfBlockLength parameter.
        container DcmDspRoe [0..1]  # Provide the configuration of the ResponseOnEvent mechanism.
          float DcmDspRoeInterMessageTime: 0..5, set at link in variant link-time / pre-compile in variant post-build+pre-compile  # Provide the minimum time in seconds between two transmissions of ROE event. It is used for the delay between two different consecutive Roe transmissions.
          container DcmDspRoeEvent [1..255]  # This container contains a list of all supported Roe eventTypeRecords which are accepted by this ECU. | At most one DcmDspRoeEvent container is allowed to define a DcmDspRoeEventProperties container with the choice DcmDspRoeOnDTCStatusChange.
            integer DcmDspRoeEventId: 0..254, set at pre-compile, symbolic-name-value=true  # EventId for a global identification of this ROE event it is used within APIs Dcm_TriggerOnEvent() and the ModeDeclarationGroup. | The ratio Ids should be sequentially ordered beginning with 0 and no gaps in between.
            enumeration DcmDspRoeInitialEventStatus: {DCM_ROE_CLEARED, DCM_ROE_STOPPED}, set at link in variant link-time / pre-compile in variant post-build+pre-compile, default-value=DCM_ROE_CLEARED  # Initial Roe status of this RoeEvent
            choice container DcmDspRoeEventProperties  # This container contains the properties of Roe eventTypeRecords. | In one DcmDspRoeEventProperties container one DcmDspRoeOnDTCStatusChange or DcmDspRoeOnChangeOfDataIdentifier container shall be defined.
              container DcmDspRoeOnChangeOfDataIdentifier [0..1]  # This container contains the eventTypeRecord supported for onChangeOfDataIdentifier eventType.
                reference DcmDspRoeDidRef: set at link in variant link-time / pre-compile in variant post-build+pre-compile, destination=DcmDspDid  # Reference to a Did which is watched.
              container DcmDspRoeOnDTCStatusChange [0..1]  # This container contains the eventTypeRecord supported for onDTCStatusChange eventType.
                integer DcmDspRoeDTCStatusMask [0..1]: 0..255, set at pre-compile  # Value of the relevant DTCStatusMask
          container DcmDspRoeEventWindowTime [1..*]  # This container configures the available EventWindowTime in this Ecu. | This container contains a sub-set of EventWindowTimes supported by the Dcm, to limit the Ecu resources.
            enumeration DcmDspRoeEventWindowTime: {DCM_ROE_EVENT_WINDOW_CURRENT_AND_FOLLOWING_CYCLE, DCM_ROE_EVENT_WINDOW_CURRENT_CYCLE, DCM_ROE_EVENT_WINDOW_INFINITE}, set at pre-compile  # Value of the EventWindowTime
            boolean DcmDspRoeStorageState: set at pre-compile  # If this parameter is set to TRUE the StorageStateBit will be evaluated if this EventWindowTime is requested. Tags: atp.Status=obsolete, atp.StatusRevisionBegin=4.3.1
        container DcmDspRoutine [0..*]  # This container contains the configuration (parameters) for Routines
          integer DcmDspRoutineIdentifier: 0..65535, scope=ECU, set at link in variant link-time / pre-compile in variant post-build+pre-compile  # 2 bytes Identifier of the RID | Within each DcmConfigSet all DcmDspRoutineIdentifier values shall be unique.
          integer DcmDspRoutineInfoByte [0..1]: 0..255, scope=ECU, set at link in variant link-time / pre-compile in variant post-build+pre-compile  # Manufacturer specific value reported to the tester for the record identifiers 0xE000 to OxE1FF. (OBD use cases)
          boolean DcmDspRoutineUsed: scope=ECU, post-build-variant-value=true, set at link in variant link-time / post-build in variant post-build / pre-compile in variant pre-compile  # Allow to activate or deactivate the usage of a Routine, for multi purpose ECUs | True = Routine is available False = Routine is not available
          boolean DcmDspRoutineUsePort [0..1]: scope=ECU, multiplicity set at pre-compile, set at pre-compile  # If this parameter is set to true, the DCM uses a port requiring a PortInterface RoutineServices_{RoutineName}. | The R-Port is named RoutineServices_{RoutineName} where {RoutineName} is the name of the container DcmDspRoutine In that case, the configuration must not provide function names in DcmDspStartRoutineFnc, DcmDspStopRoutineFnc or DcmDspRequestResultsRoutineFnc. If this is false, the DCM expects to find the names of the functions to be used in DcmDspStartRoutineFnc, DcmDspStopRoutineFnc or DcmDspRequestResultsRoutineFnc.
          container DcmDspRequestRoutineResults [0..1]  # Provides the configuration of RequestResult subservice for RoutineControl service. | Existence indicates that the RequestRoutineResults in the RoutineControl is supported.
            boolean DcmDspRequestRoutineResultsConfirmationEnabled [0..1]: scope=ECU, multiplicity set at pre-compile, set at pre-compile, default-value=false  # Allows to enable/disable the confirmation function to indicate the transmission of a response to a RequestRoutineResults request
            function name DcmDspRequestRoutineResultsConfirmationFnc [0..1]: scope=ECU, multiplicity set at pre-compile, set at pre-compile  # C-function to call if a transmission confirmation is needed by the issuer (BSW module)
            function name DcmDspRequestRoutineResultsFnc [0..1]: scope=ECU, multiplicity set at pre-compile, set at pre-compile  # Function name for request to application the results of a routine. (Routine_RequestResults-function) | This parameter is related to the interface Xxx_RequestResults.
            reference DcmDspRequestRoutineResultsCommonAuthorizationRef [0..1]: scope=ECU, multiplicity set at link in variant link-time / pre-compile in variant post-build+pre-compile, set at link in variant link-time / pre-compile in variant post-build+pre-compile, destination=DcmDspCommonAuthorization  # Reference to DcmDspCommonAuthorization | Common authorization configuration taken from the referenced DcmDspRequestRoutineResultsCommonAuthorizationRef. If there is no reference, no check on the commonly defined authorization conditions shall be done to get the routine result.
            container DcmDspRequestRoutineResultsOut [0..1]  # Provide description of output parameter of RequestResult subservice for RoutineControl service.
              container DcmDspRequestRoutineResultsOutSignal [1..*]: requires-index=true  # Provides description of a routine signal used in RoutineControl service. | The ordering defined via the index attribute of the subcontainers in this list represents the order of the dataOutN elements in the XXX_RequestResult function call.
                integer DcmDspRoutineParameterSize [0..1]: 0..65535, scope=ECU, multiplicity set at link in variant link-time / pre-compile in variant post-build+pre-compile, set at link in variant link-time / pre-compile in variant post-build+pre-compile  # Provide the size of a RoutineControl parameter in bytes
                enumeration DcmDspRoutineSignalEndianness [0..1]: {BIG_ENDIAN, LITTLE_ENDIAN, OPAQUE}, scope=ECU, multiplicity set at link in variant link-time / pre-compile in variant post-build+pre-compile, set at link in variant link-time / pre-compile in variant post-build+pre-compile  # Defines the endianness of the data belonging to a Routine Out Signal for RequestResult subfunction.
                integer DcmDspRoutineSignalPos: 0..65535, scope=ECU, set at link in variant link-time / pre-compile in variant post-build+pre-compile  # Provide the position of the signal in the RoutineControl request/response. | The position is defined in bits.
                enumeration DcmDspRoutineSignalType: {BOOLEAN, SINT16, SINT16_N, SINT32, SINT32_N, SINT8, SINT8_N, UINT16, UINT16_N, UINT32, UINT32_N, UINT8, UINT8_N, VARIABLE_LENGTH}, scope=ECU, set at link in variant link-time / pre-compile in variant post-build+pre-compile  # Provide the type of the signal in the RoutineControl request/response.
                choice container DcmDspArgumentScaling [0..1]  # This container contains the configuration (arguments) of an alternative Diagnosis Representation. Out if this the scaling between Diagnosis and ECU internal representation and vice versa can be calculated.
                  container DcmDspAlternativeArgumentData [0..1]  # This container contains the configuration (parameters) of an alternative Diagnosis Representation by the means of a ArgumentDataPrototype.
                    foreign reference DcmDataElement: set at pre-compile, destination-type=ARGUMENT-DATA-PROTOTYPE  # Alternative Diagnosis Representation for the data defined by the means of a ArgumentDataPrototype. | The CompuMethod of the data type of the referenced ArgumentDataPrototype will be applied to the data type of the ArgumentDataPrototype in the interface used by the Dcm.
                  container DcmDspAlternativeDataType [0..1]  # This container contains the configuration (parameters) of an alternative Diagnosis Representation by the means of an ApplicationDataType. | Additionally the definition of a text table mapping can be a defined for ApplicationDataTypes with a CompuMethod of category TEXTTABLE and SCALE_LINEAR_AND_TEXTTABLE.
                    foreign reference DcmApplicationDataType: set at pre-compile, destination-type=APPLICATION-DATA-TYPE  # Alternative Diagnosis Representation for the data defined by the means of a ApplicationDataType of category VALUE, BOOLEAN or ARRAY. | The CompuMethod that applies to the referenced ApplicationDataType in case of category VALUE or BOOLEAN will be applied to the data type of the VariableDataPrototype in the interface used by the Dcm.
                    container DcmDspTextTableMapping [0..*]  # The purpose of the DcmDspTextTableMapping is to associate a texttable value defined in the context of the Dcm to a texttable value defined in the context of a CompuMethod referenced by a DataType that shall be taken to create a dataElement in a SenderReceiverInterface. By this means it is possible to create a primitive version of a TexttableMapping (which can only be applied if a dataElement already exists). | In other words, the DcmDspTextTableMapping provides a similar mechanism to the TexttableMapping in a situation where the TexttableMapping cannot be applied since the SenderReceiverInterface for the PortPrototype on the Dcm ServiceComponent does not yet exist.
                      integer DcmDspDiagnosisRepresentationDataValue: 0..18446744073709551615, scope=ECU, set at pre-compile  # The data value in the diagnosis representation.
                      integer DcmDspInternalDataValue: 0..18446744073709551615, scope=ECU, set at pre-compile  # The ECU internal data value.
                  container DcmDspAlternativeDiagnosticDataElement [0..1]  # This container contains the configuration (parameters) of an alternative Diagnosis Representation by the means of Diagnostic Extract.
                    foreign reference DcmDspDiagnosticDataElementRef: set at pre-compile, destination-type=DIAGNOSTIC-DATA-ELEMENT  # Alternative Diagnosis Representation for the data defined by the means of a DiagnosticDataElement in the Diagnostic Extract. | This EcucForeignReference enables the access to all SwDataDefProps, in particular BaseType, CompuMethod and DataConstr The CompuMethod and DataConstr that applies to the referenced DiagnosticDataElement will be applied to the data type of the VariableDataPrototype in the interface used by the Dcm. The mapped ImplementationDataType needs to match the given BaseType.
          container DcmDspStartRoutine [0..1]  # Provides the configuration of Start subservice for RoutineControl service.
            boolean DcmDspStartRoutineConfirmationEnabled [0..1]: scope=ECU, multiplicity set at pre-compile, set at pre-compile, default-value=false  # Allows to enable/disable the confirmation function to indicate the transmission of a response to a StartRoutine request
            function name DcmDspStartRoutineConfirmationFnc [0..1]: scope=ECU, multiplicity set at pre-compile, set at pre-compile  # C-function to call if a transmission confirmation is needed by the issuer (BSW module)
            function name DcmDspStartRoutineFnc [0..1]: scope=ECU, multiplicity set at pre-compile, set at pre-compile  # Function name for request to application to start a routine. (Routine_Start-function) | This parameter is related to the interface Xxx_Start.
            reference DcmDspStartRoutineCommonAuthorizationRef [0..1]: scope=ECU, multiplicity set at link in variant link-time / pre-compile in variant post-build+pre-compile, set at link in variant link-time / pre-compile in variant post-build+pre-compile, destination=DcmDspCommonAuthorization  # Reference to DcmDspCommonAuthorization | Common authorization configuration taken from the referenced DcmDspStartRoutineCommonAuthorizationRef. If there is no reference, no check on the commonly defined authorization conditions shall be done to start the routine.
            container DcmDspStartRoutineIn [0..1]  # Provide description of input parameter of Start subservice for RoutineControl service
              container DcmDspStartRoutineInSignal [1..*]: requires-index=true  # Provide description of a routine signal used in RoutineControl service. | The ordering defined via the index attribute of the subcontainers in this list represents the order of the dataInN elements in the XXX_Start function call.
                integer DcmDspRoutineParameterSize [0..1]: 0..65535, scope=ECU, multiplicity set at link in variant link-time / pre-compile in variant post-build+pre-compile, set at link in variant link-time / pre-compile in variant post-build+pre-compile  # Provide the size of a RoutineControl parameter in bytes
                enumeration DcmDspRoutineSignalEndianness [0..1]: {BIG_ENDIAN, LITTLE_ENDIAN, OPAQUE}, scope=ECU, multiplicity set at link in variant link-time / pre-compile in variant post-build+pre-compile, set at link in variant link-time / pre-compile in variant post-build+pre-compile  # Defines the endianness of the data belonging to a Routine In Signal for Start subfunction.
                integer DcmDspRoutineSignalPos: 0..65535, scope=ECU, set at link in variant link-time / pre-compile in variant post-build+pre-compile  # Provide the position of the signal in the RoutineControl request/response. | The position is defined in bits.
                enumeration DcmDspRoutineSignalType: {BOOLEAN, SINT16, SINT16_N, SINT32, SINT32_N, SINT8, SINT8_N, UINT16, UINT16_N, UINT32, UINT32_N, UINT8, UINT8_N, VARIABLE_LENGTH}, scope=ECU, set at link in variant link-time / pre-compile in variant post-build+pre-compile  # Provide the type of the signal in the RoutineControl request/response.
                choice container DcmDspArgumentScaling [0..1]  # This container contains the configuration (arguments) of an alternative Diagnosis Representation. Out if this the scaling between Diagnosis and ECU internal representation and vice versa can be calculated.
                  container DcmDspAlternativeArgumentData [0..1]  # This container contains the configuration (parameters) of an alternative Diagnosis Representation by the means of a ArgumentDataPrototype.
                    foreign reference DcmDataElement: set at pre-compile, destination-type=ARGUMENT-DATA-PROTOTYPE  # Alternative Diagnosis Representation for the data defined by the means of a ArgumentDataPrototype. | The CompuMethod of the data type of the referenced ArgumentDataPrototype will be applied to the data type of the ArgumentDataPrototype in the interface used by the Dcm.
                  container DcmDspAlternativeDataType [0..1]  # This container contains the configuration (parameters) of an alternative Diagnosis Representation by the means of an ApplicationDataType. | Additionally the definition of a text table mapping can be a defined for ApplicationDataTypes with a CompuMethod of category TEXTTABLE and SCALE_LINEAR_AND_TEXTTABLE.
                    foreign reference DcmApplicationDataType: set at pre-compile, destination-type=APPLICATION-DATA-TYPE  # Alternative Diagnosis Representation for the data defined by the means of a ApplicationDataType of category VALUE, BOOLEAN or ARRAY. | The CompuMethod that applies to the referenced ApplicationDataType in case of category VALUE or BOOLEAN will be applied to the data type of the VariableDataPrototype in the interface used by the Dcm.
                    container DcmDspTextTableMapping [0..*]  # The purpose of the DcmDspTextTableMapping is to associate a texttable value defined in the context of the Dcm to a texttable value defined in the context of a CompuMethod referenced by a DataType that shall be taken to create a dataElement in a SenderReceiverInterface. By this means it is possible to create a primitive version of a TexttableMapping (which can only be applied if a dataElement already exists). | In other words, the DcmDspTextTableMapping provides a similar mechanism to the TexttableMapping in a situation where the TexttableMapping cannot be applied since the SenderReceiverInterface for the PortPrototype on the Dcm ServiceComponent does not yet exist.
                      integer DcmDspDiagnosisRepresentationDataValue: 0..18446744073709551615, scope=ECU, set at pre-compile  # The data value in the diagnosis representation.
                      integer DcmDspInternalDataValue: 0..18446744073709551615, scope=ECU, set at pre-compile  # The ECU internal data value.
                  container DcmDspAlternativeDiagnosticDataElement [0..1]  # This container contains the configuration (parameters) of an alternative Diagnosis Representation by the means of Diagnostic Extract.
                    foreign reference DcmDspDiagnosticDataElementRef: set at pre-compile, destination-type=DIAGNOSTIC-DATA-ELEMENT  # Alternative Diagnosis Representation for the data defined by the means of a DiagnosticDataElement in the Diagnostic Extract. | This EcucForeignReference enables the access to all SwDataDefProps, in particular BaseType, CompuMethod and DataConstr The CompuMethod and DataConstr that applies to the referenced DiagnosticDataElement will be applied to the data type of the VariableDataPrototype in the interface used by the Dcm. The mapped ImplementationDataType needs to match the given BaseType.
            container DcmDspStartRoutineOut [0..1]  # Provide description of output parameter of Start subservice for RoutineControl service.
              container DcmDspStartRoutineOutSignal [1..*]: requires-index=true  # Provide description of a routine signal used in RoutineControl service. | The ordering defined via the index attribute of the subcontainers in this list represents the order of the dataOutN elements in the XXX_Start function call.
                integer DcmDspRoutineParameterSize [0..1]: 0..65535, scope=ECU, multiplicity set at link in variant link-time / pre-compile in variant post-build+pre-compile, set at link in variant link-time / pre-compile in variant post-build+pre-compile  # Provide the size of a RoutineControl parameter in bytes
                enumeration DcmDspRoutineSignalEndianness [0..1]: {BIG_ENDIAN, LITTLE_ENDIAN, OPAQUE}, scope=ECU, multiplicity set at link in variant link-time / pre-compile in variant post-build+pre-compile, set at link in variant link-time / pre-compile in variant post-build+pre-compile  # Defines the endianness of the data belonging to a Routine Out Signal for Start subfunction.
                integer DcmDspRoutineSignalPos [0..1]: 0..65535, scope=ECU, multiplicity set at link in variant link-time / pre-compile in variant post-build+pre-compile, set at link in variant link-time / pre-compile in variant post-build+pre-compile  # Provide the position of the signal in the RoutineControl request/response. | The position is defined in bits.
                enumeration DcmDspRoutineSignalType: {BOOLEAN, SINT16, SINT16_N, SINT32, SINT32_N, SINT8, SINT8_N, UINT16, UINT16_N, UINT32, UINT32_N, UINT8, UINT8_N, VARIABLE_LENGTH}, scope=ECU, set at link in variant link-time / pre-compile in variant post-build+pre-compile  # Provide the type of the signal in the RoutineControl request/response.
                choice container DcmDspArgumentScaling [0..1]  # This container contains the configuration (arguments) of an alternative Diagnosis Representation. Out if this the scaling between Diagnosis and ECU internal representation and vice versa can be calculated.
                  container DcmDspAlternativeArgumentData [0..1]  # This container contains the configuration (parameters) of an alternative Diagnosis Representation by the means of a ArgumentDataPrototype.
                    foreign reference DcmDataElement: set at pre-compile, destination-type=ARGUMENT-DATA-PROTOTYPE  # Alternative Diagnosis Representation for the data defined by the means of a ArgumentDataPrototype. | The CompuMethod of the data type of the referenced ArgumentDataPrototype will be applied to the data type of the ArgumentDataPrototype in the interface used by the Dcm.
                  container DcmDspAlternativeDataType [0..1]  # This container contains the configuration (parameters) of an alternative Diagnosis Representation by the means of an ApplicationDataType. | Additionally the definition of a text table mapping can be a defined for ApplicationDataTypes with a CompuMethod of category TEXTTABLE and SCALE_LINEAR_AND_TEXTTABLE.
                    foreign reference DcmApplicationDataType: set at pre-compile, destination-type=APPLICATION-DATA-TYPE  # Alternative Diagnosis Representation for the data defined by the means of a ApplicationDataType of category VALUE, BOOLEAN or ARRAY. | The CompuMethod that applies to the referenced ApplicationDataType in case of category VALUE or BOOLEAN will be applied to the data type of the VariableDataPrototype in the interface used by the Dcm.
                    container DcmDspTextTableMapping [0..*]  # The purpose of the DcmDspTextTableMapping is to associate a texttable value defined in the context of the Dcm to a texttable value defined in the context of a CompuMethod referenced by a DataType that shall be taken to create a dataElement in a SenderReceiverInterface. By this means it is possible to create a primitive version of a TexttableMapping (which can only be applied if a dataElement already exists). | In other words, the DcmDspTextTableMapping provides a similar mechanism to the TexttableMapping in a situation where the TexttableMapping cannot be applied since the SenderReceiverInterface for the PortPrototype on the Dcm ServiceComponent does not yet exist.
                      integer DcmDspDiagnosisRepresentationDataValue: 0..18446744073709551615, scope=ECU, set at pre-compile  # The data value in the diagnosis representation.
                      integer DcmDspInternalDataValue: 0..18446744073709551615, scope=ECU, set at pre-compile  # The ECU internal data value.
                  container DcmDspAlternativeDiagnosticDataElement [0..1]  # This container contains the configuration (parameters) of an alternative Diagnosis Representation by the means of Diagnostic Extract.
                    foreign reference DcmDspDiagnosticDataElementRef: set at pre-compile, destination-type=DIAGNOSTIC-DATA-ELEMENT  # Alternative Diagnosis Representation for the data defined by the means of a DiagnosticDataElement in the Diagnostic Extract. | This EcucForeignReference enables the access to all SwDataDefProps, in particular BaseType, CompuMethod and DataConstr The CompuMethod and DataConstr that applies to the referenced DiagnosticDataElement will be applied to the data type of the VariableDataPrototype in the interface used by the Dcm. The mapped ImplementationDataType needs to match the given BaseType.
          container DcmDspStopRoutine [0..1]  # Provides the configuration of Stop subservice for RoutineControl service. | Existence indicates that the StopRoutine in the RoutineControl is supported.
            boolean DcmDspStopRoutineConfirmationEnabled [0..1]: scope=ECU, multiplicity set at pre-compile, set at pre-compile, default-value=false  # Allows to enable/disable the confirmation function to indicate the transmission of a response to a StopRoutine request
            function name DcmDspStopRoutineConfirmationFnc [0..1]: scope=ECU, multiplicity set at pre-compile, set at pre-compile  # C-function to call if a transmission confirmation is needed by the issuer (BSW module)
            function name DcmDspStopRoutineFnc [0..1]: scope=ECU, multiplicity set at pre-compile, set at pre-compile  # Function name for request to application to stop a routine. (Routine_Stop-function) | This parameter is related to the interface Xxx_Stop.
            reference DcmDspStopRoutineCommonAuthorizationRef [0..1]: scope=ECU, multiplicity set at link in variant link-time / pre-compile in variant post-build+pre-compile, set at link in variant link-time / pre-compile in variant post-build+pre-compile, destination=DcmDspCommonAuthorization  # Reference to DcmDspCommonAuthorization | Common authorization configuration taken from the referenced DcmDspStopRoutineCommonAuthorizationRef. If there is no reference, no check on the commonly defined authorization conditions shall be done to stop the routine.
            container DcmDspStopRoutineIn [0..1]  # Provide description of input parameter of Stop subservice for RoutineControl service.
              container DcmDspStopRoutineInSignal [1..*]: requires-index=true  # Provide description of a routine signal used in RoutineControl service. | The ordering defined via the index attribute of the subcontainers in this list represents the order of the dataInN elements in the XXX_Stop function call.
                integer DcmDspRoutineParameterSize [0..1]: 0..65535, scope=ECU, multiplicity set at link in variant link-time / pre-compile in variant post-build+pre-compile, set at link in variant link-time / pre-compile in variant post-build+pre-compile  # Provide the size of a RoutineControl parameter in bytes
                enumeration DcmDspRoutineSignalEndianness [0..1]: {BIG_ENDIAN, LITTLE_ENDIAN, OPAQUE}, scope=ECU, multiplicity set at link in variant link-time / pre-compile in variant post-build+pre-compile, set at link in variant link-time / pre-compile in variant post-build+pre-compile  # Defines the endianness of the data belonging to a Routine In Signal for Stop subfunction.
                integer DcmDspRoutineSignalPos: 0..65535, scope=ECU, set at link in variant link-time / pre-compile in variant post-build+pre-compile  # Provide the position of the signal in the RoutineControl request/response. | The position is defined in bits.
                enumeration DcmDspRoutineSignalType: {BOOLEAN, SINT16, SINT16_N, SINT32, SINT32_N, SINT8, SINT8_N, UINT16, UINT16_N, UINT32, UINT32_N, UINT8, UINT8_N, VARIABLE_LENGTH}, scope=ECU, set at link in variant link-time / pre-compile in variant post-build+pre-compile  # Provide the type of the signal in the RoutineControl request/response.
                choice container DcmDspArgumentScaling [0..1]  # This container contains the configuration (arguments) of an alternative Diagnosis Representation. Out if this the scaling between Diagnosis and ECU internal representation and vice versa can be calculated.
                  container DcmDspAlternativeArgumentData [0..1]  # This container contains the configuration (parameters) of an alternative Diagnosis Representation by the means of a ArgumentDataPrototype.
                    foreign reference DcmDataElement: set at pre-compile, destination-type=ARGUMENT-DATA-PROTOTYPE  # Alternative Diagnosis Representation for the data defined by the means of a ArgumentDataPrototype. | The CompuMethod of the data type of the referenced ArgumentDataPrototype will be applied to the data type of the ArgumentDataPrototype in the interface used by the Dcm.
                  container DcmDspAlternativeDataType [0..1]  # This container contains the configuration (parameters) of an alternative Diagnosis Representation by the means of an ApplicationDataType. | Additionally the definition of a text table mapping can be a defined for ApplicationDataTypes with a CompuMethod of category TEXTTABLE and SCALE_LINEAR_AND_TEXTTABLE.
                    foreign reference DcmApplicationDataType: set at pre-compile, destination-type=APPLICATION-DATA-TYPE  # Alternative Diagnosis Representation for the data defined by the means of a ApplicationDataType of category VALUE, BOOLEAN or ARRAY. | The CompuMethod that applies to the referenced ApplicationDataType in case of category VALUE or BOOLEAN will be applied to the data type of the VariableDataPrototype in the interface used by the Dcm.
                    container DcmDspTextTableMapping [0..*]  # The purpose of the DcmDspTextTableMapping is to associate a texttable value defined in the context of the Dcm to a texttable value defined in the context of a CompuMethod referenced by a DataType that shall be taken to create a dataElement in a SenderReceiverInterface. By this means it is possible to create a primitive version of a TexttableMapping (which can only be applied if a dataElement already exists). | In other words, the DcmDspTextTableMapping provides a similar mechanism to the TexttableMapping in a situation where the TexttableMapping cannot be applied since the SenderReceiverInterface for the PortPrototype on the Dcm ServiceComponent does not yet exist.
                      integer DcmDspDiagnosisRepresentationDataValue: 0..18446744073709551615, scope=ECU, set at pre-compile  # The data value in the diagnosis representation.
                      integer DcmDspInternalDataValue: 0..18446744073709551615, scope=ECU, set at pre-compile  # The ECU internal data value.
                  container DcmDspAlternativeDiagnosticDataElement [0..1]  # This container contains the configuration (parameters) of an alternative Diagnosis Representation by the means of Diagnostic Extract.
                    foreign reference DcmDspDiagnosticDataElementRef: set at pre-compile, destination-type=DIAGNOSTIC-DATA-ELEMENT  # Alternative Diagnosis Representation for the data defined by the means of a DiagnosticDataElement in the Diagnostic Extract. | This EcucForeignReference enables the access to all SwDataDefProps, in particular BaseType, CompuMethod and DataConstr The CompuMethod and DataConstr that applies to the referenced DiagnosticDataElement will be applied to the data type of the VariableDataPrototype in the interface used by the Dcm. The mapped ImplementationDataType needs to match the given BaseType.
            container DcmDspStopRoutineOut [0..1]  # Provide description of output parameter of Stop subservice for RoutineControl service.
              container DcmDspStopRoutineOutSignal [1..*]: requires-index=true  # Provide description of a routine signal used in RoutineControl service. | The ordering defined via the index attribute of the subcontainers in this list represents the order of the dataOutN elements in the XXX_Stop function call.
                integer DcmDspRoutineParameterSize [0..1]: 0..65535, scope=ECU, multiplicity set at link in variant link-time / pre-compile in variant post-build+pre-compile, set at link in variant link-time / pre-compile in variant post-build+pre-compile  # Provide the size of a RoutineControl parameter in bytes
                enumeration DcmDspRoutineSignalEndianness [0..1]: {BIG_ENDIAN, LITTLE_ENDIAN, OPAQUE}, scope=ECU, multiplicity set at link in variant link-time / pre-compile in variant post-build+pre-compile, set at link in variant link-time / pre-compile in variant post-build+pre-compile  # Defines the endianness of the data belonging to a Routine Out Signal for Stop subfunction.
                integer DcmDspRoutineSignalPos: 0..65535, scope=ECU, set at link in variant link-time / pre-compile in variant post-build+pre-compile  # Provide the position of the signal in the RoutineControl request/response. | The position is defined in bits.
                enumeration DcmDspRoutineSignalType: {BOOLEAN, SINT16, SINT16_N, SINT32, SINT32_N, SINT8, SINT8_N, UINT16, UINT16_N, UINT32, UINT32_N, UINT8, UINT8_N, VARIABLE_LENGTH}, scope=ECU, set at link in variant link-time / pre-compile in variant post-build+pre-compile  # Provide the type of the signal in the RoutineControl request/response.
                choice container DcmDspArgumentScaling [0..1]  # This container contains the configuration (arguments) of an alternative Diagnosis Representation. Out if this the scaling between Diagnosis and ECU internal representation and vice versa can be calculated.
                  container DcmDspAlternativeArgumentData [0..1]  # This container contains the configuration (parameters) of an alternative Diagnosis Representation by the means of a ArgumentDataPrototype.
                    foreign reference DcmDataElement: set at pre-compile, destination-type=ARGUMENT-DATA-PROTOTYPE  # Alternative Diagnosis Representation for the data defined by the means of a ArgumentDataPrototype. | The CompuMethod of the data type of the referenced ArgumentDataPrototype will be applied to the data type of the ArgumentDataPrototype in the interface used by the Dcm.
                  container DcmDspAlternativeDataType [0..1]  # This container contains the configuration (parameters) of an alternative Diagnosis Representation by the means of an ApplicationDataType. | Additionally the definition of a text table mapping can be a defined for ApplicationDataTypes with a CompuMethod of category TEXTTABLE and SCALE_LINEAR_AND_TEXTTABLE.
                    foreign reference DcmApplicationDataType: set at pre-compile, destination-type=APPLICATION-DATA-TYPE  # Alternative Diagnosis Representation for the data defined by the means of a ApplicationDataType of category VALUE, BOOLEAN or ARRAY. | The CompuMethod that applies to the referenced ApplicationDataType in case of category VALUE or BOOLEAN will be applied to the data type of the VariableDataPrototype in the interface used by the Dcm.
                    container DcmDspTextTableMapping [0..*]  # The purpose of the DcmDspTextTableMapping is to associate a texttable value defined in the context of the Dcm to a texttable value defined in the context of a CompuMethod referenced by a DataType that shall be taken to create a dataElement in a SenderReceiverInterface. By this means it is possible to create a primitive version of a TexttableMapping (which can only be applied if a dataElement already exists). | In other words, the DcmDspTextTableMapping provides a similar mechanism to the TexttableMapping in a situation where the TexttableMapping cannot be applied since the SenderReceiverInterface for the PortPrototype on the Dcm ServiceComponent does not yet exist.
                      integer DcmDspDiagnosisRepresentationDataValue: 0..18446744073709551615, scope=ECU, set at pre-compile  # The data value in the diagnosis representation.
                      integer DcmDspInternalDataValue: 0..18446744073709551615, scope=ECU, set at pre-compile  # The ECU internal data value.
                  container DcmDspAlternativeDiagnosticDataElement [0..1]  # This container contains the configuration (parameters) of an alternative Diagnosis Representation by the means of Diagnostic Extract.
                    foreign reference DcmDspDiagnosticDataElementRef: set at pre-compile, destination-type=DIAGNOSTIC-DATA-ELEMENT  # Alternative Diagnosis Representation for the data defined by the means of a DiagnosticDataElement in the Diagnostic Extract. | This EcucForeignReference enables the access to all SwDataDefProps, in particular BaseType, CompuMethod and DataConstr The CompuMethod and DataConstr that applies to the referenced DiagnosticDataElement will be applied to the data type of the VariableDataPrototype in the interface used by the Dcm. The mapped ImplementationDataType needs to match the given BaseType.
        container DcmDspSecurity  # This container contains the configuration ( DSP parameter) for security level configuration (per security level) | Description This container contains Rows of DcmDspSecurityRow
          float DcmDspSecurityMaxAttemptCounterReadoutTime: 0..65535, set at link in variant link-time / pre-compile in variant post-build+pre-compile  # Delay, in seconds, from startup (measured from the first call of the Dcm_MainFunction()), allowed for all AttemptCounter values to be obtained from the Application. | Must be a multiple of the DcmTaskTime. min: A value equal to the DcmTaskTime
          container DcmDspSecurityRow [0..31]  # Definition of a single Row of configuration for security level configuration (per security level) | The name of this container is used to define the name of the R-Port through which the DCM accesses the interface SecurityAccess_{SecurityLevel}. The R-Port is named SecurityAccess_{SecurityLevel} where {SecurityLevel} is the name of the container DcmDspSecurityRow. If there is no reference, no check of security level shall be done.
            integer DcmDspSecurityADRSize [0..1]: 1..4294967295, multiplicity set at link in variant link-time / pre-compile in variant post-build+pre-compile, set at link in variant link-time / pre-compile in variant post-build+pre-compile  # Size in bytes of the AccessDataRecord used in GetSeed
            boolean DcmDspSecurityAttemptCounterEnabled: scope=ECU, set at link in variant link-time / pre-compile in variant post-build+pre-compile  # Allows to enable the external handling of the security attempt counter (e.g. to survive a reset of the ECU).
            function name DcmDspSecurityCompareKeyFnc [0..1]: multiplicity set at link in variant link-time / pre-compile in variant post-build+pre-compile, set at link in variant link-time / pre-compile in variant post-build+pre-compile  # Function name to request the result of a key comparison. | Parameter is only relevant if DcmDspSecurityUsePort=="USE_ ASYNCH_FNC". This parameter is related to the interface Xxx_CompareKey.
            float DcmDspSecurityDelayTime: 0..65535, set at link in variant link-time / pre-compile in variant post-build+pre-compile  # Delay time after failed security access in seconds. | This is started after DcmDspSecurityNumAttDelay number of failed security accesses. min: A negative value is not allowed.
            float DcmDspSecurityDelayTimeOnBoot: 0..65535, origin=AUTOSAR_ECUC V1.0.0, set at link in variant link-time / pre-compile in variant post-build+pre-compile  # Value of the delay timer in case of 'power on' in seconds. | This delay indicates the time at ECU boot power-on time during which the Dcm does not accept a security access. min: A negative value is not allowed.
            function name DcmDspSecurityGetAttemptCounterFnc [0..1]: multiplicity set at link in variant link-time / pre-compile in variant post-build+pre-compile, set at link in variant link-time / pre-compile in variant post-build+pre-compile  # Function name to request the value of an attempt counter. | This parameter is related to the interface Xxx_ GetSecurityAttemptCounter.
            function name DcmDspSecurityGetSeedFnc [0..1]: multiplicity set at link in variant link-time / pre-compile in variant post-build+pre-compile, set at link in variant link-time / pre-compile in variant post-build+pre-compile  # Callout function name used to request a seed. | This parameter is related to the interface Xxx_GetSeed.
            integer DcmDspSecurityKeySize: 1..4294967295, set at link in variant link-time / pre-compile in variant post-build+pre-compile  # size of the security key (in Bytes).
            integer DcmDspSecurityLevel: 1..63, set at pre-compile, symbolic-name-value=true  # Value of Security level. | The locked state cannot be configured explicitly. 1,2,3...63: configuration dependent - Conversion formula to calculate SecurityLevel out of tester requested SecurityAccessType parameter: SecurityLevel = (SecurityAccessType (requestSeed) + 1) / 2 Type: Dcm_SecLevelType
            integer DcmDspSecurityNumAttDelay: 1..255, set at link in variant link-time / pre-compile in variant post-build+pre-compile  # Number of failed security accesses after which the delay time is activated
            integer DcmDspSecuritySeedSize: 1..4294967295, set at link in variant link-time / pre-compile in variant post-build+pre-compile  # size of the security seed (in Bytes).
            function name DcmDspSecuritySetAttemptCounterFnc [0..1]: multiplicity set at link in variant link-time / pre-compile in variant post-build+pre-compile, set at link in variant link-time / pre-compile in variant post-build+pre-compile  # Function name to set the value of an attempt counter. | This parameter is related to the interface Xxx_ SetSecurityAttemptCounter.
            enumeration DcmDspSecurityUsePort: {USE_ASYNCH_CLIENT_SERVER, USE_ASYNCH_FNC}, set at pre-compile  # Defines which kind of interface shall be used for security access.
        container DcmDspSession  # Parent container holding single rows to configure particular sessions
          container DcmDspSessionRow [0..31]  # This container holds all parameters needed to configure a single session
            enumeration DcmDspSessionForBoot: {DCM_NO_BOOT, DCM_OEM_BOOT, DCM_OEM_BOOT_RESPAPP, DCM_SYS_BOOT, DCM_SYS_BOOT_RESPAPP}, origin=AUTOSAR_ECUC V1.0.0, set at link in variant link-time / pre-compile in variant post-build+pre-compile  # This parameter defines whether this diagnostic session allows to jump to Bootloader (OEM Bootloader or System Supplier Bootloader) and determines, from which unit the final response will be sent. | If this diagnostic session doesn't allow to jump to Bootloader the value DCM_NO_BOOT shall be chosen.
            integer DcmDspSessionLevel: 1..126, set at pre-compile, symbolic-name-value=true  # subFunction value of the DiagnosticSession. | 0, 127 and all values above 127 are reserved by ISO
            float DcmDspSessionP2ServerMax: 0..1, set at link in variant link-time / pre-compile in variant post-build+pre-compile  # This is the session value for P2ServerMax in seconds (per Session). | The AUTOSAR configuration standard is to use SI units, so this parameter is defined as a float value in seconds. DCM configuration tools must convert this float value to the appropriate value format for the use in the software implementation of DCM. This value is reported to the tester within the response to the 'Session Control' service.
            float DcmDspSessionP2StarServerMax: 0..100, set at link in variant link-time / pre-compile in variant post-build+pre-compile  # This is the session value for P2*ServerMax in seconds (per Session). | The AUTOSAR configuration standard is to use SI units, so this parameter is defined as a float value in seconds. DCM configuration tools must convert this float value to the appropriate value format for the use in the software implementation of DCM. This value is reported to the tester within the response to the 'Session Control' service.
        container DcmDspVehInfo [0..*]  # This container contains the configuration (parameters) for one single VehicleInfoType of service $09
          integer DcmDspVehInfoInfoType: 0..255, scope=ECU, set at link in variant link-time / pre-compile in variant post-build+pre-compile  # value of InfoType. | Within each DcmConfigSet all DcmDspVehInfoInfoType values shall be unique.
          boolean DcmDspVehInfoNODIProvResp [0..1]: set at pre-compile, default-value=false  # Indicate the Dcm, which side is responsible to fill the number of data items (NODI), Dcm or the provider of the InfoType data. In case the responsibility is on provider side, only one DcmDspVehInfoData container is allowed. | * true: Provider is responsible for providing the number of data items parameter * false or not existing: Dcm is responsible for providing the number of data items parameter
          container DcmDspVehInfoData [1..*]  # Data Item of an InfoType; ShortName is post-fix of the port interface name.
            integer DcmDspVehInfoDataOrder: 0..255, scope=ECU, set at pre-compile  # Defines the order of the data item in the InfoType; values: 0..255; first data item having the order number 0; the next 1 and so on. | The configuration of order needs to be unique per InfoType.
            function name DcmDspVehInfoDataReadFnc [0..1]: scope=ECU, multiplicity set at pre-compile, set at pre-compile  # Callout function name for reading InfoType data item. Only required in case parameter 'DcmDspVehInfoDataUsePort' is set to 'false'
            integer DcmDspVehInfoDataSize: 0..255, scope=ECU, set at pre-compile  # Size in bytes of the InfoType data item.
            boolean DcmDspVehInfoDataUsePort: scope=ECU, set at pre-compile  # When this parameter is set to true the DCM will access the Data using an R-Port requiring a PortInterface IInfotypeServices_{VehInfoData}. | The R-Port is named InfotypeServices_{VehInfoData} where {VEHINFODATA} is the name of the container DcmDspVehInfoData. In that case, the DcmDspVehInfoDataReadFnc is ignored and the RTE APIs are used. When this parameter is set to false, the DCM calls the function defined in DcmDspVehInfoDataReadFnc.
      container DcmPageBufferCfg  # This container contains the configuration (parameters) for Page Buffer handling
        boolean DcmPagedBufferEnabled: scope=ECU, set at pre-compile  # Allow to enable or disable the Paged buffer mechanism. | true = Paged buffer handling enabled false = Paged Buffer handling disabled
      container DcmProcessingConditions [0..1]  # This container contains the configuration for mode arbitration functionality of the Dcm
        container DcmModeCondition [1..*]  # This container contains the configuration of a mode condition or an environmental conditions which can be used as argument in DcmModeRules. | One DcmModeCondition shall contain either one DcmSwcModeRef or one DcmBswModeRef or one DcmSwcSRDataElementRef. Please note that the Dcm acts as well as mode manager. Therefore the references DcmSwcModeRef or one DcmBswModeRef. might point to provided ModeDeclarationGroupPrototypes of the Dcm itself as well as to provided ModeDeclarationGroupPrototypes of other Bsw Modules or software components. In case of a configured DcmSwcModeRef or DcmBswModeRef only the DcmConditionType DCM_EQUALS or DCM_EQUALS_NOT are applicable. In case of DcmSwcSRDataElementRef all literals of DcmConditionType are possible.
          enumeration DcmConditionType: {DCM_EQUALS, DCM_EQUALS_NOT, DCM_GREATER_OR_EQUAL, DCM_GREATER_THAN, DCM_LESS_OR_EQUAL, DCM_LESS_THAN}, set at pre-compile  # This parameter specifies what kind of comparison that is made for the evaluation of the mode condition.
          instance reference DcmBswModeRef [0..1]: multiplicity set at pre-compile, set at pre-compile, destination-context=MODE-DECLARATION-GROUP-PROTOTYPE, destination-type=MODE-DECLARATION  # This parameter references a mode of a ModeDeclarationGroupPrototype provided by a Basic Software Module used for the condition. | Please note that such ModeDeclarationGroupPrototype are owned by a Basic Software Module Description in the role providedModeGroup.
          instance reference DcmSwcModeRef [0..1]: multiplicity set at pre-compile, set at pre-compile, destination-context=ROOT-SW-COMPOSITION-PROTOTYPE SW-COMPONENT-PROTOTYPE P-PORT-PROTOTYPE MODE-DECLARATION-GROUP-PROTOTYPE, destination-type=MODE-DECLARATION  # This parameter references a mode in a particular mode request port of a software component that is used for the condition.
          choice reference DcmSwcSRDataElementRef [0..1]: multiplicity set at pre-compile, set at pre-compile, destination=[DcmDspExternalSRDataElementClass, DcmDspPidService01ExternalSRDataElementClass]  # Reference to environmental conditions. | It is possible to reference a S/R Receiver-Port to read physical values and compare (equal, greater, less,...) them with a configured value that is defined by DcmSwcSRDataElementValueRef.
          foreign reference DcmSwcSRDataElementValueRef [0..1]: multiplicity set at pre-compile, set at pre-compile, destination-type=CONSTANT-SPECIFICATION  # Reference to a constant specification defining the compare value for environmental condition.
        container DcmModeRule [1..*]  # This container contains the configuration of a mode rule which represents a logical expression with DcmModeConditions or other DcmModeRules as arguments. | All arguments are processed with the operator defined by DcmLogicalOperator, for instance: Argument_A AND Argument_B AND Argument_C
          enumeration DcmLogicalOperator [0..1]: {DCM_AND, DCM_OR}, multiplicity set at pre-compile, set at pre-compile  # This parameter specifies the logical operator to be used in the logical expression. If the expression only consists of a single condition this parameter shall not be used.
          integer DcmModeRuleNrcValue [0..1]: 1..255, scope=ECU, multiplicity set at link in variant link-time / pre-compile in variant pre-compile, set at link in variant link-time / pre-compile in variant pre-compile  # Optional parameter which defines the NRC to be sent in case the mode rule condition is not valid.
          choice reference DcmArgumentRef [1..*]: multiplicity set at pre-compile, requires-index=true, set at pre-compile, destination=[DcmModeCondition, DcmModeRule]  # This is a choice reference either to a mode condition or a an other mode rule serving as sub-expression.
    container DcmGeneral  # Contains general configuration parameters valid for the entire Dcm module.
      boolean DcmDDDIDStorage [0..1]: multiplicity set at pre-compile, set at pre-compile, default-value=false  # This configuration switch defines, whether DDDID definition is stored non-volatile or not. | true: DDDID are stored non-volatile false: DDDID are only maintained volatile
      boolean DcmDevErrorDetect: set at pre-compile, default-value=false  # Switches the development error detection and notification on or off. | * true: detection and notification is enabled. * false: detection and notification is disabled.
      string DcmHeaderFileInclusion [0..*]: scope=ECU, multiplicity set at pre-compile, set at pre-compile, regular-expression=[a-zA-Z0-9_]([a-zA-Z0-9\._])*  # Name of the header file(s) to be included by the Dcm module containing the used C-callback declarations.
      boolean DcmRespondAllRequest: scope=ECU, set at pre-compile  # If set to FALSE the Dcm will not respond to diagnostic request that contains a service ID which is in the range from 0x40 to 0x7F or in the range from 0xC0 to 0xFF (Response IDs).
      float DcmTaskTime: 0..Inf, set at link in variant link-time / pre-compile in variant post-build+pre-compile  # Allow to configure the time for the periodic cyclic task. Please note: This configuration value shall be equal to the value in the RTE module. | The AUTOSAR configuration standard is to use SI units, so this parameter is defined as float value in seconds. Dcm configuration tools must convert this float value to the appropriate value format for the use in the software implementation of Dcm. min: A negative value and zero is not allowed. upperMultiplicity: Exactly one TaskTime must be specified per configuration. lowerMultiplicity: Exactly one TaskTime must be specified per configuration.
      boolean DcmVersionInfoApi: set at pre-compile, default-value=false  # Preprocessor switch to enable or disable the output Version info of the functionality.
      reference DcmVinRef [0..1]: multiplicity set at pre-compile, set at pre-compile, destination=DcmDspDid  # Reference to the Did containing the VIN Information. | This parameter is needed for function Dcm_GetVin
