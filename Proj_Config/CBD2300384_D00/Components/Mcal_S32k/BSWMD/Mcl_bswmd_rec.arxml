AUTOSAR XML (schema 4-0-3)
package /TS_T40D34M8I0R0
  module config Mcl_Rec: definition=Mcl
  bsw implementation Mcl_Impl: programming-language=C, used-code-generator=Tresos, behavior=MclBehavior, recommended-configuration=Mcl_Rec, vendor-specific-module-def=Mcl
