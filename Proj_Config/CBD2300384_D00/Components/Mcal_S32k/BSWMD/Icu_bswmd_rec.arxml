AUTOSAR XML (schema 4-0-3)
package /TS_T40D34M8I0R0
  module config Icu_Rec: definition=Icu
  bsw implementation Icu_Impl: programming-language=C, behavior=IcuBehavior, recommended-configuration=Icu_Rec, vendor-specific-module-def=Icu
