AUTOSAR XML (schema 4-0-3)
package /Wdg_43_Instance2_TS_T40D17M8I1R0
  module config Wdg_Rec: definition=Wdg
  bsw implementation Wdg_Impl: programming-language=C, vendor-id=43, behavior=WdgBehavior, recommended-configuration=Wdg_Rec, vendor-api-infix=Instance2, vendor-specific-module-def=Wdg
