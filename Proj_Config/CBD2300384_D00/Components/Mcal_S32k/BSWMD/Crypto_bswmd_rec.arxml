AUTOSAR XML (schema 4-0-3)
package /TS_T40D34M8I0R0
  module config Crypto_Rec: definition=Crypto
  bsw implementation Crypto_Impl: programming-language=C, behavior=CryptoBehavior, recommended-configuration=Crypto_Rec, vendor-specific-module-def=Crypto
