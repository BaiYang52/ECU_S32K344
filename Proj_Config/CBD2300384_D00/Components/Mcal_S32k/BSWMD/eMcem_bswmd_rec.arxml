AUTOSAR XML (schema 00046)
package /TS_T40D34M10I0R0
  module config eMcem_Rec: definition=eMcem
  bsw implementation eMcem_Impl: programming-language=C, used-code-generator=Tresos, behavior=eMcemBehavior, recommended-configuration=eMcem_Rec, vendor-specific-module-def=eMcem
