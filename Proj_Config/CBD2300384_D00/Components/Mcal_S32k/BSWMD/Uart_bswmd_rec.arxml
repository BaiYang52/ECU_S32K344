AUTOSAR XML (schema 4-0-3)
package /TS_T40D34M8I0R0
  module config Uart_Rec: definition=Uart
  bsw implementation Uart_Impl: programming-language=C, behavior=UartBehavior, recommended-configuration=Uart_Rec, vendor-specific-module-def=Uart
