AUTOSAR XML (schema 4-0-3)
package /TS_T40D17M8I1R0
  module config Wdg_Rec: definition=Wdg
  bsw implementation Wdg_Impl: programming-language=C, behavior=WdgBehavior, recommended-configuration=Wdg_Rec, vendor-specific-module-def=Wdg
