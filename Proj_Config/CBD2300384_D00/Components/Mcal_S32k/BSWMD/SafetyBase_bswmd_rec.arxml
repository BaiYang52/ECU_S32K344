AUTOSAR XML (schema 00046)
package /TS_T40D34M10I0R0
  module config SafetyBase_Rec: definition=SafetyBase
  bsw implementation SafetyBase_Impl: programming-language=C, used-code-generator=Tresos, behavior=SafetyBaseBehavior, recommended-configuration=SafetyBase_Rec, vendor-specific-module-def=SafetyBase
