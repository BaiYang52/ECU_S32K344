AUTOSAR XML (schema 4-0-3)
package /TS_T40D34M8I0R0
  module config Spi_Rec: definition=Spi
  bsw implementation Spi_Impl: programming-language=C, used-code-generator=Tresos, behavior=SpiBehavior, recommended-configuration=Spi_Rec, vendor-specific-module-def=Spi
