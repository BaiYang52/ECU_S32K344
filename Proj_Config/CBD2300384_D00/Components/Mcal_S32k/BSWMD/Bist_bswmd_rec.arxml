AUTOSAR XML (schema 00046)
package /TS_T40D34M10I0R0
  module config Bist_Rec: definition=Bist
  bsw implementation Bist_Impl: programming-language=C, used-code-generator=Tresos, behavior=BistBehavior, recommended-configuration=Bist_Rec, vendor-specific-module-def=Bist
