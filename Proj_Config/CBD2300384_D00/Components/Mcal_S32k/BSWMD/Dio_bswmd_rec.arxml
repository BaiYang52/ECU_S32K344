AUTOSAR XML (schema 4-0-3)
package /TS_T40D34M8I0R0
  module config Dio_Rec: definition=Dio
  bsw implementation Dio_Impl: programming-language=C, used-code-generator=Tresos, behavior=DioBehavior, recommended-configuration=Dio_Rec, vendor-specific-module-def=Dio
