AUTOSAR XML (schema 4-0-3)
package /TS_T40D34M8I0R0
  module config I2c_Rec: definition=I2c
  bsw implementation I2c_Impl: programming-language=C, behavior=I2cBehavior, recommended-configuration=I2c_Rec, vendor-specific-module-def=I2c
